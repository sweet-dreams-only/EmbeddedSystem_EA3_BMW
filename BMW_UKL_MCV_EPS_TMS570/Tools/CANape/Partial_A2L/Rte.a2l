/begin MEASUREMENT HystComp.VehicleSpeed.Kph_f32 "MICROSAR RTE" FLOAT32_IEEE NO_COMPU_METHOD 0 0 1.175494351e-38 3.402823466e+38 ECU_ADDRESS 0 SYMBOL_LINK "Rte_SignlCondn_VehicleSpeed_Kph_f32" 0 DISPLAY_IDENTIFIER HystComp.ReceiverPorts.VehicleSpeed.Kph_f32 /end MEASUREMENT
/begin MEASUREMENT HystComp.WIRCmdAmpBlnd.MtrNm_f32 "MICROSAR RTE" FLOAT32_IEEE NO_COMPU_METHOD 0 0 1.175494351e-38 3.402823466e+38 ECU_ADDRESS 0 SYMBOL_LINK "Rte_HystComp_WIRCmdAmpBlnd_MtrNm_f32" 0 DISPLAY_IDENTIFIER HystComp.ReceiverPorts.WIRCmdAmpBlnd.MtrNm_f32 /end MEASUREMENT
/begin MEASUREMENT IoHwAb7.ADCMtrCurr1.Volt_f32 "This signal is intended to communicate any type voltage signal measured by the ecu.  This signal has a lower limit of 0 which reequires users of the signal to provide divide by 0 protection if it is used as a denominator in a calculation.  See Vecu port p" FLOAT32_IEEE NO_COMPU_METHOD 0 0 1.175494351e-38 3.402823466e+38 ECU_ADDRESS 0 SYMBOL_LINK "Rte_IoHwAb7_ADCMtrCurr1_Volt_f32" 0 DISPLAY_IDENTIFIER IoHwAb7.SenderPorts.ADCMtrCurr1.Volt_f32 /end MEASUREMENT
/begin MEASUREMENT IoHwAb7.Batt.Volt_f32 "This signal is intended to communicate any type voltage signal measured by the ecu.  This signal has a lower limit of 0 which reequires users of the signal to provide divide by 0 protection if it is used as a denominator in a calculation.  See Vecu port p" FLOAT32_IEEE NO_COMPU_METHOD 0 0 1.175494351e-38 3.402823466e+38 ECU_ADDRESS 0 SYMBOL_LINK "Rte_IoHwAb7_Batt_Volt_f32" 0 DISPLAY_IDENTIFIER IoHwAb7.SenderPorts.Batt.Volt_f32 /end MEASUREMENT
/begin MEASUREMENT IoHwAb7.BattSwitched.Volt_f32 "This signal is intended to communicate any type voltage signal measured by the ecu.  This signal has a lower limit of 0 which reequires users of the signal to provide divide by 0 protection if it is used as a denominator in a calculation.  See Vecu port p" FLOAT32_IEEE NO_COMPU_METHOD 0 0 1.175494351e-38 3.402823466e+38 ECU_ADDRESS 0 SYMBOL_LINK "Rte_IoHwAb7_BattSwitched_Volt_f32" 0 DISPLAY_IDENTIFIER IoHwAb7.SenderPorts.BattSwitched.Volt_f32 /end MEASUREMENT
/begin MEASUREMENT IoHwAb7.InvCos2Scaled.Volt_f32 "This signal is intended to communicate any type voltage signal measured by the ecu.  This signal has a lower limit of 0 which reequires users of the signal to provide divide by 0 protection if it is used as a denominator in a calculation.  See Vecu port p" FLOAT32_IEEE NO_COMPU_METHOD 0 0 1.175494351e-38 3.402823466e+38 ECU_ADDRESS 0 SYMBOL_LINK "Rte_IoHwAb7_InvCos2Scaled_Volt_f32" 0 DISPLAY_IDENTIFIER IoHwAb7.SenderPorts.InvCos2Scaled.Volt_f32 /end MEASUREMENT
/begin MEASUREMENT IoHwAb7.InvSin2Scaled.Volt_f32 "This signal is intended to communicate any type voltage signal measured by the ecu.  This signal has a lower limit of 0 which reequires users of the signal to provide divide by 0 protection if it is used as a denominator in a calculation.  See Vecu port p" FLOAT32_IEEE NO_COMPU_METHOD 0 0 1.175494351e-38 3.402823466e+38 ECU_ADDRESS 0 SYMBOL_LINK "Rte_IoHwAb7_InvSin2Scaled_Volt_f32" 0 DISPLAY_IDENTIFIER IoHwAb7.SenderPorts.InvSin2Scaled.Volt_f32 /end MEASUREMENT
/begin MEASUREMENT IoHwAb7.PDChrgPmpFdbkADC.Volt_f32 "This signal is intended to communicate any type voltage signal measured by the ecu.  This signal has a lower limit of 0 which reequires users of the signal to provide divide by 0 protection if it is used as a denominator in a calculation.  See Vecu port p" FLOAT32_IEEE NO_COMPU_METHOD 0 0 1.175494351e-38 3.402823466e+38 ECU_ADDRESS 0 SYMBOL_LINK "Rte_IoHwAb7_PDChrgPmpFdbkADC_Volt_f32" 0 DISPLAY_IDENTIFIER IoHwAb7.SenderPorts.PDChrgPmpFdbkADC.Volt_f32 /end MEASUREMENT
/begin MEASUREMENT IoHwAb7.PDSuplFdbkADC.Volt_f32 "This signal is intended to communicate any type voltage signal measured by the ecu.  This signal has a lower limit of 0 which reequires users of the signal to provide divide by 0 protection if it is used as a denominator in a calculation.  See Vecu port p" FLOAT32_IEEE NO_COMPU_METHOD 0 0 1.175494351e-38 3.402823466e+38 ECU_ADDRESS 0 SYMBOL_LINK "Rte_IoHwAb7_PDSuplFdbkADC_Volt_f32" 0 DISPLAY_IDENTIFIER IoHwAb7.SenderPorts.PDSuplFdbkADC.Volt_f32 /end MEASUREMENT
/begin MEASUREMENT IoHwAb7.SysCT1ADC.Volt_f32 "This signal is intended to communicate any type voltage signal measured by the ecu.  This signal has a lower limit of 0 which reequires users of the signal to provide divide by 0 protection if it is used as a denominator in a calculation.  See Vecu port p" FLOAT32_IEEE NO_COMPU_METHOD 0 0 1.175494351e-38 3.402823466e+38 ECU_ADDRESS 0 SYMBOL_LINK "Rte_IoHwAb7_SysCT1ADC_Volt_f32" 0 DISPLAY_IDENTIFIER IoHwAb7.SenderPorts.SysCT1ADC.Volt_f32 /end MEASUREMENT
/begin MEASUREMENT IoHwAb7.SysCT2ADC.Volt_f32 "This signal is intended to communicate any type voltage signal measured by the ecu.  This signal has a lower limit of 0 which reequires users of the signal to provide divide by 0 protection if it is used as a denominator in a calculation.  See Vecu port p" FLOAT32_IEEE NO_COMPU_METHOD 0 0 1.175494351e-38 3.402823466e+38 ECU_ADDRESS 0 SYMBOL_LINK "Rte_IoHwAb7_SysCT2ADC_Volt_f32" 0 DISPLAY_IDENTIFIER IoHwAb7.SenderPorts.SysCT2ADC.Volt_f32 /end MEASUREMENT
/begin MEASUREMENT IoHwAb7.SysCVSwitch.Volt_f32 "This signal is intended to communicate any type voltage signal measured by the ecu.  This signal has a lower limit of 0 which reequires users of the signal to provide divide by 0 protection if it is used as a denominator in a calculation.  See Vecu port p" FLOAT32_IEEE NO_COMPU_METHOD 0 0 1.175494351e-38 3.402823466e+38 ECU_ADDRESS 0 SYMBOL_LINK "Rte_IoHwAb7_SysCVSwitch_Volt_f32" 0 DISPLAY_IDENTIFIER IoHwAb7.SenderPorts.SysCVSwitch.Volt_f32 /end MEASUREMENT
/begin MEASUREMENT IoHwAb7.T1ADC.Volt_f32 "This signal is intended to communicate any type voltage signal measured by the ecu.  This signal has a lower limit of 0 which reequires users of the signal to provide divide by 0 protection if it is used as a denominator in a calculation.  See Vecu port p" FLOAT32_IEEE NO_COMPU_METHOD 0 0 1.175494351e-38 3.402823466e+38 ECU_ADDRESS 0 SYMBOL_LINK "Rte_IoHwAb7_T1ADC_Volt_f32" 0 DISPLAY_IDENTIFIER IoHwAb7.SenderPorts.T1ADC.Volt_f32 /end MEASUREMENT
/begin MEASUREMENT IoHwAb7.T2ADC.Volt_f32 "This signal is intended to communicate any type voltage signal measured by the ecu.  This signal has a lower limit of 0 which reequires users of the signal to provide divide by 0 protection if it is used as a denominator in a calculation.  See Vecu port p" FLOAT32_IEEE NO_COMPU_METHOD 0 0 1.175494351e-38 3.402823466e+38 ECU_ADDRESS 0 SYMBOL_LINK "Rte_IoHwAb7_T2ADC_Volt_f32" 0 DISPLAY_IDENTIFIER IoHwAb7.SenderPorts.T2ADC.Volt_f32 /end MEASUREMENT
/begin MEASUREMENT IoHwAb7.TemperatureADC.Volt_f32 "This signal is intended to communicate any type voltage signal measured by the ecu.  This signal has a lower limit of 0 which reequires users of the signal to provide divide by 0 protection if it is used as a denominator in a calculation.  See Vecu port p" FLOAT32_IEEE NO_COMPU_METHOD 0 0 1.175494351e-38 3.402823466e+38 ECU_ADDRESS 0 SYMBOL_LINK "Rte_IoHwAb7_TemperatureADC_Volt_f32" 0 DISPLAY_IDENTIFIER IoHwAb7.SenderPorts.TemperatureADC.Volt_f32 /end MEASUREMENT
/begin MEASUREMENT LktoLkStr.AlignedHwPosition.HwDeg_f32 "MICROSAR RTE" FLOAT32_IEEE NO_COMPU_METHOD 0 0 1.175494351e-38 3.402823466e+38 ECU_ADDRESS 0 SYMBOL_LINK "Rte_AbsHwPos_AlignedHwPos_HwDeg_f32" 0 DISPLAY_IDENTIFIER LktoLkStr.ReceiverPorts.AlignedHwPosition.HwDeg_f32 /end MEASUREMENT
/begin MEASUREMENT LktoLkStr.LrnPnCenterEnable.Cnt_lgc "MICROSAR RTE" UBYTE RTE_CM_BOOLEAN 0 0 0 255 ECU_ADDRESS 0 SYMBOL_LINK "Rte_CDDInterface9_LrnPnCenterEnable_Cnt_lgc" 0 DISPLAY_IDENTIFIER LktoLkStr.ReceiverPorts.LrnPnCenterEnable.Cnt_lgc /end MEASUREMENT
/begin MEASUREMENT LktoLkStr.LrnPnCntrCmd.MtrNm_f32 "MICROSAR RTE" FLOAT32_IEEE NO_COMPU_METHOD 0 0 1.175494351e-38 3.402823466e+38 ECU_ADDRESS 0 SYMBOL_LINK "Rte_LktoLkStr_LrnPnCntrCmd_MtrNm_f32" 0 DISPLAY_IDENTIFIER LktoLkStr.SenderPorts.LrnPnCntrCmd.MtrNm_f32 /end MEASUREMENT
/begin MEASUREMENT LktoLkStr.LrnPnCntrHwCenter.HwDeg_f32 "MICROSAR RTE" FLOAT32_IEEE NO_COMPU_METHOD 0 0 1.175494351e-38 3.402823466e+38 ECU_ADDRESS 0 SYMBOL_LINK "Rte_LktoLkStr_LrnPnCntrHwCenter_HwDeg_f32" 0 DISPLAY_IDENTIFIER LktoLkStr.SenderPorts.LrnPnCntrHwCenter.HwDeg_f32 /end MEASUREMENT
/begin MEASUREMENT LktoLkStr.LrnPnCntrHwTravel.HwDeg_f32 "MICROSAR RTE" FLOAT32_IEEE NO_COMPU_METHOD 0 0 1.175494351e-38 3.402823466e+38 ECU_ADDRESS 0 SYMBOL_LINK "Rte_LktoLkStr_LrnPnCntrHwTravel_HwDeg_f32" 0 DISPLAY_IDENTIFIER LktoLkStr.SenderPorts.LrnPnCntrHwTravel.HwDeg_f32 /end MEASUREMENT
/begin MEASUREMENT LktoLkStr.LrnPnCntrState.Cnt_enum "MICROSAR RTE" UBYTE RTE_CM_ENUM_LktoLkStrStateType 0 0 0 7 ECU_ADDRESS 0 SYMBOL_LINK "Rte_LktoLkStr_LrnPnCntrState_Cnt_enum" 0 DISPLAY_IDENTIFIER LktoLkStr.SenderPorts.LrnPnCntrState.Cnt_enum /end MEASUREMENT
/begin MEASUREMENT LktoLkStr.MotorVelCRF.MtrRadpS_f32 "MICROSAR RTE" FLOAT32_IEEE NO_COMPU_METHOD 0 0 1.175494351e-38 3.402823466e+38 ECU_ADDRESS 0 SYMBOL_LINK "Rte_MtrVel_CRFMotorVel_MtrRadpS_f32" 0 DISPLAY_IDENTIFIER LktoLkStr.ReceiverPorts.MotorVelCRF.MtrRadpS_f32 /end MEASUREMENT
/begin MEASUREMENT LmtCod.AssistEOTGain.Uls_f32 "MICROSAR RTE" FLOAT32_IEEE NO_COMPU_METHOD 0 0 1.175494351e-38 3.402823466e+38 ECU_ADDRESS 0 SYMBOL_LINK "Rte_EOTActuatorMng_AssistEOTGain_Uls_f32" 0 DISPLAY_IDENTIFIER LmtCod.ReceiverPorts.AssistEOTGain.Uls_f32 /end MEASUREMENT
/begin MEASUREMENT LmtCod.AssistEOTLimit.MtrNm_f32 "MICROSAR RTE" FLOAT32_IEEE NO_COMPU_METHOD 0 0 1.175494351e-38 3.402823466e+38 ECU_ADDRESS 0 SYMBOL_LINK "Rte_EOTActuatorMng_AssistEOTLimit_MtrNm_f32" 0 DISPLAY_IDENTIFIER LmtCod.ReceiverPorts.AssistEOTLimit.MtrNm_f32 /end MEASUREMENT
/begin MEASUREMENT LmtCod.AssistStallLimit.MtrNm_f32 "MICROSAR RTE" FLOAT32_IEEE NO_COMPU_METHOD 0 0 1.175494351e-38 3.402823466e+38 ECU_ADDRESS 0 SYMBOL_LINK "Rte_HiLoadStall_AssistStallLimit_MtrNm_f32" 0 DISPLAY_IDENTIFIER LmtCod.ReceiverPorts.AssistStallLimit.MtrNm_f32 /end MEASUREMENT
/begin MEASUREMENT LmtCod.AssistVehSpdLimit.MtrNm_f32 "MICROSAR RTE" FLOAT32_IEEE NO_COMPU_METHOD 0 0 1.175494351e-38 3.402823466e+38 ECU_ADDRESS 0 SYMBOL_LINK "Rte_VehSpdLmt_AstVehSpdLimit_MtrNm_f32" 0 DISPLAY_IDENTIFIER LmtCod.ReceiverPorts.AssistVehSpdLimit.MtrNm_f32 /end MEASUREMENT
/begin MEASUREMENT LmtCod.CCLTrqRamp.Uls_f32 "MICROSAR RTE" FLOAT32_IEEE NO_COMPU_METHOD 0 0 1.175494351e-38 3.402823466e+38 ECU_ADDRESS 0 SYMBOL_LINK "Rte_CustPL_CCLTrqRamp_Uls_f32" 0 DISPLAY_IDENTIFIER LmtCod.ReceiverPorts.CCLTrqRamp.Uls_f32 /end MEASUREMENT
/begin MEASUREMENT LmtCod.EOTGainLtd.Uls_f32 "MICROSAR RTE" FLOAT32_IEEE NO_COMPU_METHOD 0 0 1.175494351e-38 3.402823466e+38 ECU_ADDRESS 0 SYMBOL_LINK "Rte_LmtCod_EOTGainLtd_Uls_f32" 0 DISPLAY_IDENTIFIER LmtCod.SenderPorts.EOTGainLtd.Uls_f32 /end MEASUREMENT
/begin MEASUREMENT LmtCod.EOTLimitLtd.MtrNm_f32 "MICROSAR RTE" FLOAT32_IEEE NO_COMPU_METHOD 0 0 1.175494351e-38 3.402823466e+38 ECU_ADDRESS 0 SYMBOL_LINK "Rte_LmtCod_EOTLimitLtd_MtrNm_f32" 0 DISPLAY_IDENTIFIER LmtCod.SenderPorts.EOTLimitLtd.MtrNm_f32 /end MEASUREMENT
/begin MEASUREMENT LmtCod.OutputRampMult.Uls_f32 "MICROSAR RTE" FLOAT32_IEEE NO_COMPU_METHOD 0 0 1.175494351e-38 3.402823466e+38 ECU_ADDRESS 0 SYMBOL_LINK "Rte_StOpCtrl_OutputRampMult_Uls_f32" 0 DISPLAY_IDENTIFIER LmtCod.ReceiverPorts.OutputRampMult.Uls_f32 /end MEASUREMENT
/begin MEASUREMENT LmtCod.OutputRampMultLtd.Uls_f32 "MICROSAR RTE" FLOAT32_IEEE NO_COMPU_METHOD 0 0 1.175494351e-38 3.402823466e+38 ECU_ADDRESS 0 SYMBOL_LINK "Rte_LmtCod_OutputRampMultLtd_Uls_f32" 0 DISPLAY_IDENTIFIER LmtCod.SenderPorts.OutputRampMultLtd.Uls_f32 /end MEASUREMENT
/begin MEASUREMENT LmtCod.StallLimitLtd.MtrNm_f32 "MICROSAR RTE" FLOAT32_IEEE NO_COMPU_METHOD 0 0 1.175494351e-38 3.402823466e+38 ECU_ADDRESS 0 SYMBOL_LINK "Rte_LmtCod_StallLimitLtd_MtrNm_f32" 0 DISPLAY_IDENTIFIER LmtCod.SenderPorts.StallLimitLtd.MtrNm_f32 /end MEASUREMENT
/begin MEASUREMENT LmtCod.ThermalLimit.MtrNm_f32 "MICROSAR RTE" FLOAT32_IEEE NO_COMPU_METHOD 0 0 1.175494351e-38 3.402823466e+38 ECU_ADDRESS 0 SYMBOL_LINK "Rte_ThrmlDutyCycle_ThermalLimit_MtrNm_f32" 0 DISPLAY_IDENTIFIER LmtCod.ReceiverPorts.ThermalLimit.MtrNm_f32 /end MEASUREMENT
/begin MEASUREMENT LmtCod.ThermalLimitLtd.MtrNm_f32 "MICROSAR RTE" FLOAT32_IEEE NO_COMPU_METHOD 0 0 1.175494351e-38 3.402823466e+38 ECU_ADDRESS 0 SYMBOL_LINK "Rte_LmtCod_ThermalLimitLtd_MtrNm_f32" 0 DISPLAY_IDENTIFIER LmtCod.SenderPorts.ThermalLimitLtd.MtrNm_f32 /end MEASUREMENT
/begin MEASUREMENT LmtCod.VehSpdLimitLtd.MtrNm_f32 "MICROSAR RTE" FLOAT32_IEEE NO_COMPU_METHOD 0 0 1.175494351e-38 3.402823466e+38 ECU_ADDRESS 0 SYMBOL_LINK "Rte_LmtCod_VehSpdLimitLtd_MtrNm_f32" 0 DISPLAY_IDENTIFIER LmtCod.SenderPorts.VehSpdLimitLtd.MtrNm_f32 /end MEASUREMENT
/begin MEASUREMENT LmtCod.VehicleSpeed.Kph_f32 "MICROSAR RTE" FLOAT32_IEEE NO_COMPU_METHOD 0 0 1.175494351e-38 3.402823466e+38 ECU_ADDRESS 0 SYMBOL_LINK "Rte_SignlCondn_VehicleSpeed_Kph_f32" 0 DISPLAY_IDENTIFIER LmtCod.ReceiverPorts.VehicleSpeed.Kph_f32 /end MEASUREMENT
/begin MEASUREMENT LnRkCr.AlignedHwPos.HwDeg_f32 "MICROSAR RTE" FLOAT32_IEEE NO_COMPU_METHOD 0 0 1.175494351e-38 3.402823466e+38 ECU_ADDRESS 0 SYMBOL_LINK "Rte_AbsHwPos_AlignedHwPos_HwDeg_f32" 0 DISPLAY_IDENTIFIER LnRkCr.ReceiverPorts.AlignedHwPos.HwDeg_f32 /end MEASUREMENT
/begin MEASUREMENT LnRkCr.CRFMtrTrqCmd.MtrNm_f32 "MICROSAR RTE" FLOAT32_IEEE NO_COMPU_METHOD 0 0 1.175494351e-38 3.402823466e+38 ECU_ADDRESS 0 SYMBOL_LINK "Rte_CtrldDisShtdn_CntDisMtrTrqCmdCRF_MtrNm_f32" 0 DISPLAY_IDENTIFIER LnRkCr.ReceiverPorts.CRFMtrTrqCmd.MtrNm_f32 /end MEASUREMENT
/begin MEASUREMENT LnRkCr.LTRackCntrComplete.Cnt_lgc "MICROSAR RTE" UBYTE RTE_CM_BOOLEAN 0 0 0 255 ECU_ADDRESS 0 SYMBOL_LINK "Rte_LnRkCr_LTRackCntrComplete_Cnt_lgc" 0 DISPLAY_IDENTIFIER LnRkCr.SenderPorts.LTRackCntrComplete.Cnt_lgc /end MEASUREMENT
/begin MEASUREMENT LnRkCr.LearnedRackCntr.RackCntrComplete_Cnt_lgc "MICROSAR RTE" UBYTE RTE_CM_BOOLEAN 0 0 0 255 ECU_ADDRESS 0 SYMBOL_LINK "Rte_LnRkCr_LearnedRackCntr.RackCntrComplete_Cnt_lgc" 0 DISPLAY_IDENTIFIER LnRkCr.PerInstanceMemories.LearnedRackCntr.RackCntrComplete_Cnt_lgc READ_WRITE /end MEASUREMENT
/begin MEASUREMENT LnRkCr.LearnedRackCntr.RackCntrMtrAngleFound_Cnt_lgc "MICROSAR RTE" UBYTE RTE_CM_BOOLEAN 0 0 0 255 ECU_ADDRESS 0 SYMBOL_LINK "Rte_LnRkCr_LearnedRackCntr.RackCntrMtrAngleFound_Cnt_lgc" 0 DISPLAY_IDENTIFIER LnRkCr.PerInstanceMemories.LearnedRackCntr.RackCntrMtrAngleFound_Cnt_lgc READ_WRITE /end MEASUREMENT
/begin MEASUREMENT LnRkCr.LearnedRackCntr.RackCntrMtrDeg_MtrDeg_f32 "MICROSAR RTE" FLOAT32_IEEE NO_COMPU_METHOD 0 0 1.175494351e-38 3.402823466e+38 ECU_ADDRESS 0 SYMBOL_LINK "Rte_LnRkCr_LearnedRackCntr.RackCntrMtrDeg_MtrDeg_f32" 0 DISPLAY_IDENTIFIER LnRkCr.PerInstanceMemories.LearnedRackCntr.RackCntrMtrDeg_MtrDeg_f32 READ_WRITE /end MEASUREMENT
/begin MEASUREMENT LnRkCr.LearnedRackCntr.RackCntrMtrRev_MtrRev_f32 "MICROSAR RTE" FLOAT32_IEEE NO_COMPU_METHOD 0 0 1.175494351e-38 3.402823466e+38 ECU_ADDRESS 0 SYMBOL_LINK "Rte_LnRkCr_LearnedRackCntr.RackCntrMtrRev_MtrRev_f32" 0 DISPLAY_IDENTIFIER LnRkCr.PerInstanceMemories.LearnedRackCntr.RackCntrMtrRev_MtrRev_f32 READ_WRITE /end MEASUREMENT
/begin MEASUREMENT LnRkCr.LearnedRackCntr.TotalRackTravel_HwDeg_f32 "MICROSAR RTE" FLOAT32_IEEE NO_COMPU_METHOD 0 0 1.175494351e-38 3.402823466e+38 ECU_ADDRESS 0 SYMBOL_LINK "Rte_LnRkCr_LearnedRackCntr.TotalRackTravel_HwDeg_f32" 0 DISPLAY_IDENTIFIER LnRkCr.PerInstanceMemories.LearnedRackCntr.TotalRackTravel_HwDeg_f32 READ_WRITE /end MEASUREMENT
/begin MEASUREMENT LnRkCr.LrnPnCntrEnable.Cnt_lgc "MICROSAR RTE" UBYTE RTE_CM_BOOLEAN 0 0 0 255 ECU_ADDRESS 0 SYMBOL_LINK "Rte_CDDInterface9_LrnPnCenterEnable_Cnt_lgc" 0 DISPLAY_IDENTIFIER LnRkCr.ReceiverPorts.LrnPnCntrEnable.Cnt_lgc /end MEASUREMENT
/begin MEASUREMENT LnRkCr.LrnPnCntrHwCenter.HwDeg_f32 "MICROSAR RTE" FLOAT32_IEEE NO_COMPU_METHOD 0 0 1.175494351e-38 3.402823466e+38 ECU_ADDRESS 0 SYMBOL_LINK "Rte_LktoLkStr_LrnPnCntrHwCenter_HwDeg_f32" 0 DISPLAY_IDENTIFIER LnRkCr.ReceiverPorts.LrnPnCntrHwCenter.HwDeg_f32 /end MEASUREMENT
/begin MEASUREMENT LnRkCr.LrnPnCntrHwTravel.HwDeg_f32 "MICROSAR RTE" FLOAT32_IEEE NO_COMPU_METHOD 0 0 1.175494351e-38 3.402823466e+38 ECU_ADDRESS 0 SYMBOL_LINK "Rte_LktoLkStr_LrnPnCntrHwTravel_HwDeg_f32" 0 DISPLAY_IDENTIFIER LnRkCr.ReceiverPorts.LrnPnCntrHwTravel.HwDeg_f32 /end MEASUREMENT
/begin MEASUREMENT LnRkCr.LrnPnCntrState.Cnt_enum "MICROSAR RTE" UBYTE RTE_CM_ENUM_LktoLkStrStateType 0 0 0 7 ECU_ADDRESS 0 SYMBOL_LINK "Rte_LktoLkStr_LrnPnCntrState_Cnt_enum" 0 DISPLAY_IDENTIFIER LnRkCr.ReceiverPorts.LrnPnCntrState.Cnt_enum /end MEASUREMENT
/begin MEASUREMENT LnRkCr.MtrVelCRF.MtrRadpS_f32 "MICROSAR RTE" FLOAT32_IEEE NO_COMPU_METHOD 0 0 1.175494351e-38 3.402823466e+38 ECU_ADDRESS 0 SYMBOL_LINK "Rte_MtrVel_CRFMotorVel_MtrRadpS_f32" 0 DISPLAY_IDENTIFIER LnRkCr.ReceiverPorts.MtrVelCRF.MtrRadpS_f32 /end MEASUREMENT
/begin MEASUREMENT LnRkCr.RackCenter.HwDeg_f32 "MICROSAR RTE" FLOAT32_IEEE NO_COMPU_METHOD 0 0 1.175494351e-38 3.402823466e+38 ECU_ADDRESS 0 SYMBOL_LINK "Rte_LnRkCr_RackCenter_HwDeg_f32" 0 DISPLAY_IDENTIFIER LnRkCr.SenderPorts.RackCenter.HwDeg_f32 /end MEASUREMENT
/begin MEASUREMENT LnRkCr.RackCntrComplete.Cnt_lgc "MICROSAR RTE" UBYTE RTE_CM_BOOLEAN 0 0 0 255 ECU_ADDRESS 0 SYMBOL_LINK "Rte_LnRkCr_RackCntrComplete_Cnt_lgc" 0 DISPLAY_IDENTIFIER LnRkCr.SenderPorts.RackCntrComplete.Cnt_lgc /end MEASUREMENT
/begin MEASUREMENT LnRkCr.RackCntrMtrAngleError.Cnt_lgc "MICROSAR RTE" UBYTE RTE_CM_BOOLEAN 0 0 0 255 ECU_ADDRESS 0 SYMBOL_LINK "Rte_LnRkCr_RackCntrMtrAngleError_Cnt_lgc" 0 DISPLAY_IDENTIFIER LnRkCr.SenderPorts.RackCntrMtrAngleError.Cnt_lgc /end MEASUREMENT
/begin MEASUREMENT LnRkCr.RackCntrMtrAngleFound.Cnt_lgc "MICROSAR RTE" UBYTE RTE_CM_BOOLEAN 0 0 0 255 ECU_ADDRESS 0 SYMBOL_LINK "Rte_LnRkCr_RackCntrMtrAngleFound_Cnt_lgc" 0 DISPLAY_IDENTIFIER LnRkCr.SenderPorts.RackCntrMtrAngleFound.Cnt_lgc /end MEASUREMENT
/begin MEASUREMENT LrnEOT.CCWFound.Cnt_lgc "MICROSAR RTE" UBYTE RTE_CM_BOOLEAN 0 0 0 255 ECU_ADDRESS 0 SYMBOL_LINK "Rte_LrnEOT_CCWFound_Cnt_lgc" 0 DISPLAY_IDENTIFIER LrnEOT.SenderPorts.CCWFound.Cnt_lgc /end MEASUREMENT
/begin MEASUREMENT LrnEOT.CCWPosition.HwDeg_f32 "MICROSAR RTE" FLOAT32_IEEE NO_COMPU_METHOD 0 0 1.175494351e-38 3.402823466e+38 ECU_ADDRESS 0 SYMBOL_LINK "Rte_LrnEOT_CCWPosition_HwDeg_f32" 0 DISPLAY_IDENTIFIER LrnEOT.SenderPorts.CCWPosition.HwDeg_f32 /end MEASUREMENT
/begin MEASUREMENT LrnEOT.CWFound.Cnt_lgc "MICROSAR RTE" UBYTE RTE_CM_BOOLEAN 0 0 0 255 ECU_ADDRESS 0 SYMBOL_LINK "Rte_LrnEOT_CWFound_Cnt_lgc" 0 DISPLAY_IDENTIFIER LrnEOT.SenderPorts.CWFound.Cnt_lgc /end MEASUREMENT
/begin MEASUREMENT LrnEOT.CWPosition.HwDeg_f32 "MICROSAR RTE" FLOAT32_IEEE NO_COMPU_METHOD 0 0 1.175494351e-38 3.402823466e+38 ECU_ADDRESS 0 SYMBOL_LINK "Rte_LrnEOT_CWPosition_HwDeg_f32" 0 DISPLAY_IDENTIFIER LrnEOT.SenderPorts.CWPosition.HwDeg_f32 /end MEASUREMENT
/begin MEASUREMENT LrnEOT.DiagStsHwPosDis.Cnt_lgc "MICROSAR RTE" UBYTE RTE_CM_BOOLEAN 0 0 0 255 ECU_ADDRESS 0 SYMBOL_LINK "Rte_LrnEOT_DiagStsHwPosDis_Cnt_lgc" 0 DISPLAY_IDENTIFIER LrnEOT.ReceiverPorts.DiagStsHwPosDis.Cnt_lgc /end MEASUREMENT
/begin MEASUREMENT LrnEOT.HandwheelAuthority.Uls_f32 "MICROSAR RTE" FLOAT32_IEEE NO_COMPU_METHOD 0 0 1.175494351e-38 3.402823466e+38 ECU_ADDRESS 0 SYMBOL_LINK "Rte_AbsHwPos_HandwheelAuthority_Uls_f32" 0 DISPLAY_IDENTIFIER LrnEOT.ReceiverPorts.HandwheelAuthority.Uls_f32 /end MEASUREMENT
/begin MEASUREMENT LrnEOT.HandwheelPosition.HwDeg_f32 "MICROSAR RTE" FLOAT32_IEEE NO_COMPU_METHOD 0 0 1.175494351e-38 3.402823466e+38 ECU_ADDRESS 0 SYMBOL_LINK "Rte_AbsHwPos_SrlComHwPos_HwDeg_f32" 0 DISPLAY_IDENTIFIER LrnEOT.ReceiverPorts.HandwheelPosition.HwDeg_f32 /end MEASUREMENT
/begin MEASUREMENT LrnEOT.HwTorque.HwNm_f32 "MICROSAR RTE" FLOAT32_IEEE NO_COMPU_METHOD 0 0 1.175494351e-38 3.402823466e+38 ECU_ADDRESS 0 SYMBOL_LINK "Rte_Sweep_OutputHwTrq_HwNm_f32" 0 DISPLAY_IDENTIFIER LrnEOT.ReceiverPorts.HwTorque.HwNm_f32 /end MEASUREMENT
/begin MEASUREMENT LrnEOT.LearnedEOT.CCWEOTFound_Cnt_lgc "MICROSAR RTE" UBYTE RTE_CM_BOOLEAN 0 0 0 255 ECU_ADDRESS 0 SYMBOL_LINK "Rte_LrnEOT_LearnedEOT.CCWEOTFound_Cnt_lgc" 0 DISPLAY_IDENTIFIER LrnEOT.PerInstanceMemories.LearnedEOT.CCWEOTFound_Cnt_lgc READ_WRITE /end MEASUREMENT
/begin MEASUREMENT LrnEOT.LearnedEOT.CCWEOTPosition_HwDeg_f32 "MICROSAR RTE" FLOAT32_IEEE NO_COMPU_METHOD 0 0 1.175494351e-38 3.402823466e+38 ECU_ADDRESS 0 SYMBOL_LINK "Rte_LrnEOT_LearnedEOT.CCWEOTPosition_HwDeg_f32" 0 DISPLAY_IDENTIFIER LrnEOT.PerInstanceMemories.LearnedEOT.CCWEOTPosition_HwDeg_f32 READ_WRITE /end MEASUREMENT
/begin MEASUREMENT LrnEOT.LearnedEOT.CWEOTFound_Cnt_lgc "MICROSAR RTE" UBYTE RTE_CM_BOOLEAN 0 0 0 255 ECU_ADDRESS 0 SYMBOL_LINK "Rte_LrnEOT_LearnedEOT.CWEOTFound_Cnt_lgc" 0 DISPLAY_IDENTIFIER LrnEOT.PerInstanceMemories.LearnedEOT.CWEOTFound_Cnt_lgc READ_WRITE /end MEASUREMENT
/begin MEASUREMENT LrnEOT.LearnedEOT.CWEOTPosition_HwDeg_f32 "MICROSAR RTE" FLOAT32_IEEE NO_COMPU_METHOD 0 0 1.175494351e-38 3.402823466e+38 ECU_ADDRESS 0 SYMBOL_LINK "Rte_LrnEOT_LearnedEOT.CWEOTPosition_HwDeg_f32" 0 DISPLAY_IDENTIFIER LrnEOT.PerInstanceMemories.LearnedEOT.CWEOTPosition_HwDeg_f32 READ_WRITE /end MEASUREMENT
/begin MEASUREMENT LrnEOT.MtrVelCRF.MtrRadpS_f32 "MICROSAR RTE" FLOAT32_IEEE NO_COMPU_METHOD 0 0 1.175494351e-38 3.402823466e+38 ECU_ADDRESS 0 SYMBOL_LINK "Rte_MtrVel_CRFMotorVel_MtrRadpS_f32" 0 DISPLAY_IDENTIFIER LrnEOT.ReceiverPorts.MtrVelCRF.MtrRadpS_f32 /end MEASUREMENT
/begin MEASUREMENT LrnEOT.PostLimitTorque.MtrNm_f32 "MICROSAR RTE" FLOAT32_IEEE NO_COMPU_METHOD 0 0 1.175494351e-38 3.402823466e+38 ECU_ADDRESS 0 SYMBOL_LINK "Rte_Sweep2_OutputMtrTrq_MtrNm_f32" 0 DISPLAY_IDENTIFIER LrnEOT.ReceiverPorts.PostLimitTorque.MtrNm_f32 /end MEASUREMENT
/begin MEASUREMENT MtrCtrlOpConv.CommutationOffset.Cnt_u16 "MICROSAR RTE" UWORD NO_COMPU_METHOD 0 0 0 65535 ECU_ADDRESS 0 SYMBOL_LINK "Rte_MtrCtrlOpConv_CommutationOffset_Cnt_u16" 0 DISPLAY_IDENTIFIER MtrCtrlOpConv.SenderPorts.CommutationOffset.Cnt_u16 /end MEASUREMENT
/begin MEASUREMENT MtrCtrlOpConv.CurrentGainSvc.Cnt_b32 "MICROSAR RTE" ULONG NO_COMPU_METHOD 0 0 0 4294967295 ECU_ADDRESS 0 SYMBOL_LINK "Rte_CDDInterface9_SrlComSvcDft_Cnt_b32" 0 DISPLAY_IDENTIFIER MtrCtrlOpConv.ReceiverPorts.CurrentGainSvc.Cnt_b32 /end MEASUREMENT
/begin MEASUREMENT MtrCtrlOpConv.DeadTimeComp.Uls_f32 "MICROSAR RTE" FLOAT32_IEEE NO_COMPU_METHOD 0 0 1.175494351e-38 3.402823466e+38 ECU_ADDRESS 0 SYMBOL_LINK "Rte_MtrCtrlOpConv_DeadTimeComp_Uls_f32" 0 DISPLAY_IDENTIFIER MtrCtrlOpConv.SenderPorts.DeadTimeComp.Uls_f32 /end MEASUREMENT
/begin MEASUREMENT MtrCtrlOpConv.ModulationIndex.Uls_f32 "MICROSAR RTE" FLOAT32_IEEE NO_COMPU_METHOD 0 0 1.175494351e-38 3.402823466e+38 ECU_ADDRESS 0 SYMBOL_LINK "Rte_VltgCtrl_ModIdx_Uls_f32" 0 DISPLAY_IDENTIFIER MtrCtrlOpConv.ReceiverPorts.ModulationIndex.Uls_f32 /end MEASUREMENT
/begin MEASUREMENT MtrCtrlOpConv.ModulationIndexFinal.Uls_f32 "MICROSAR RTE" FLOAT32_IEEE NO_COMPU_METHOD 0 0 1.175494351e-38 3.402823466e+38 ECU_ADDRESS 0 SYMBOL_LINK "Rte_MtrCtrlOpConv_ModulationIndexFinal_Uls_f32" 0 DISPLAY_IDENTIFIER MtrCtrlOpConv.SenderPorts.ModulationIndexFinal.Uls_f32 /end MEASUREMENT
/begin MEASUREMENT MtrCtrlOpConv.MtrTrqCmdSign.Cnt_s16 "MICROSAR RTE" SWORD NO_COMPU_METHOD 0 0 -32768 32767 ECU_ADDRESS 0 SYMBOL_LINK "Rte_MtrCtrlOpConv_MtrTrqCmdSign_Cnt_s16" 0 DISPLAY_IDENTIFIER MtrCtrlOpConv.SenderPorts.MtrTrqCmdSign.Cnt_s16 /end MEASUREMENT
/begin MEASUREMENT MtrCtrlOpConv.PhaseAdvance.Cnt_s16 "MICROSAR RTE" SWORD NO_COMPU_METHOD 0 0 -32768 32767 ECU_ADDRESS 0 SYMBOL_LINK "Rte_VltgCtrl_PhsAdv_Cnt_s16" 0 DISPLAY_IDENTIFIER MtrCtrlOpConv.ReceiverPorts.PhaseAdvance.Cnt_s16 /end MEASUREMENT
/begin MEASUREMENT MtrCtrlOpConv.PhaseAdvanceFinal.Cnt_u16 "MICROSAR RTE" UWORD NO_COMPU_METHOD 0 0 0 65535 ECU_ADDRESS 0 SYMBOL_LINK "Rte_MtrCtrlOpConv_PhaseAdvanceFinal_Cnt_u16" 0 DISPLAY_IDENTIFIER MtrCtrlOpConv.SenderPorts.PhaseAdvanceFinal.Cnt_u16 /end MEASUREMENT
/begin MEASUREMENT MtrCtrlOpConv.TorqueCmdMRF.MtrNm_f32 "MICROSAR RTE" FLOAT32_IEEE NO_COMPU_METHOD 0 0 1.175494351e-38 3.402823466e+38 ECU_ADDRESS 0 SYMBOL_LINK "Rte_CtrldDisShtdn_CntDisMtrTrqCmdMRF_MtrNm_f32" 0 DISPLAY_IDENTIFIER MtrCtrlOpConv.ReceiverPorts.TorqueCmdMRF.MtrNm_f32 /end MEASUREMENT
/begin MEASUREMENT MtrCurr.ADCMtrCurr1.Volt_f32 "This signal is intended to communicate any type voltage signal measured by the ecu.  This signal has a lower limit of 0 which reequires users of the signal to provide divide by 0 protection if it is used as a denominator in a calculation.  See Vecu port p" FLOAT32_IEEE NO_COMPU_METHOD 0 0 1.175494351e-38 3.402823466e+38 ECU_ADDRESS 0 SYMBOL_LINK "Rte_IoHwAb7_ADCMtrCurr1_Volt_f32" 0 DISPLAY_IDENTIFIER MtrCurr.ReceiverPorts.ADCMtrCurr1.Volt_f32 /end MEASUREMENT
/begin MEASUREMENT MtrCurr.CorrectedMtrPos.Rev_f32 "MICROSAR RTE" FLOAT32_IEEE NO_COMPU_METHOD 0 0 1.175494351e-38 3.402823466e+38 ECU_ADDRESS 0 SYMBOL_LINK "Rte_MtrPos2_CorrectedMtrPos_Rev_f32" 0 DISPLAY_IDENTIFIER MtrCurr.ReceiverPorts.CorrectedMtrPos.Rev_f32 /end MEASUREMENT
/begin MEASUREMENT MtrCurr.DutyCycleSmall.Cnt_u16 "MICROSAR RTE" UWORD NO_COMPU_METHOD 0 0 0 65535 ECU_ADDRESS 0 SYMBOL_LINK "Rte_CDDInterface10_DutyCycleSmall_Cnt_u16" 0 DISPLAY_IDENTIFIER MtrCurr.ReceiverPorts.DutyCycleSmall.Cnt_u16 /end MEASUREMENT
/begin MEASUREMENT MtrCurr.InstantaneousMotorDirection.Cnt_s08 "MICROSAR RTE" SBYTE NO_COMPU_METHOD 0 0 -128 127 ECU_ADDRESS 0 SYMBOL_LINK "Rte_QuadDet_InstMtrDir_Cnt_s08" 0 DISPLAY_IDENTIFIER MtrCurr.ReceiverPorts.InstantaneousMotorDirection.Cnt_s08 /end MEASUREMENT
/begin MEASUREMENT MtrCurr.MtrCurrDax.Amp_f32 "MICROSAR RTE" FLOAT32_IEEE NO_COMPU_METHOD 0 0 1.175494351e-38 3.402823466e+38 ECU_ADDRESS 0 SYMBOL_LINK "Rte_MtrCurr_MtrCurrDax_Amp_f32" 0 DISPLAY_IDENTIFIER MtrCurr.SenderPorts.MtrCurrDax.Amp_f32 /end MEASUREMENT
/begin MEASUREMENT MtrCurr.MtrCurrQax.Amp_f32 "MICROSAR RTE" FLOAT32_IEEE NO_COMPU_METHOD 0 0 1.175494351e-38 3.402823466e+38 ECU_ADDRESS 0 SYMBOL_LINK "Rte_MtrCurr_MtrCurrQax_Amp_f32" 0 DISPLAY_IDENTIFIER MtrCurr.SenderPorts.MtrCurrQax.Amp_f32 /end MEASUREMENT
/begin MEASUREMENT MtrCurr.PADelta1.Cnt_u16 "MICROSAR RTE" UWORD NO_COMPU_METHOD 0 0 0 65535 ECU_ADDRESS 0 SYMBOL_LINK "Rte_MtrCurr_PADelta1_Cnt_u16" 0 DISPLAY_IDENTIFIER MtrCurr.ReceiverPorts.PADelta1.Cnt_u16 /end MEASUREMENT
/begin MEASUREMENT MtrCurr.RawCurrFiltered.Amp_f32 "MICROSAR RTE" FLOAT32_IEEE NO_COMPU_METHOD 0 0 1.175494351e-38 3.402823466e+38 ECU_ADDRESS 0 SYMBOL_LINK "Rte_MtrCurr_RawCurrFiltered_Amp_f32" 0 DISPLAY_IDENTIFIER MtrCurr.SenderPorts.RawCurrFiltered.Amp_f32 /end MEASUREMENT
/begin MEASUREMENT MtrCurr.ShCurrCal.EOLShcurrGain_Uls_f32 "MICROSAR RTE" FLOAT32_IEEE NO_COMPU_METHOD 0 0 1.175494351e-38 3.402823466e+38 ECU_ADDRESS 0 SYMBOL_LINK "Rte_MtrCurr_ShCurrCal.EOLShcurrGain_Uls_f32" 0 DISPLAY_IDENTIFIER MtrCurr.PerInstanceMemories.ShCurrCal.EOLShcurrGain_Uls_f32 READ_WRITE /end MEASUREMENT
/begin MEASUREMENT MtrCurr.ShCurrCal.EOLShcurrOffset_Volts_f32 "MICROSAR RTE" FLOAT32_IEEE NO_COMPU_METHOD 0 0 1.175494351e-38 3.402823466e+38 ECU_ADDRESS 0 SYMBOL_LINK "Rte_MtrCurr_ShCurrCal.EOLShcurrOffset_Volts_f32" 0 DISPLAY_IDENTIFIER MtrCurr.PerInstanceMemories.ShCurrCal.EOLShcurrOffset_Volts_f32 READ_WRITE /end MEASUREMENT
/begin MEASUREMENT MtrCurr.SystemState.Mode "MICROSAR RTE" UBYTE RTE_CM_ENUM_StaMd_Mode 0 0 0 255 ECU_ADDRESS 0 SYMBOL_LINK "Rte_ModeMachine_StaMd7_SystemState7_Mode" 0 DISPLAY_IDENTIFIER MtrCurr.ModeRequirePorts.SystemState.Mode /end MEASUREMENT
/begin MEASUREMENT MtrCurr.ValidSampleFlag.Cnt_lgc "MICROSAR RTE" UBYTE RTE_CM_BOOLEAN 0 0 0 255 ECU_ADDRESS 0 SYMBOL_LINK "Rte_MtrCurr_ValidSampleFlag_Cnt_lgc" 0 DISPLAY_IDENTIFIER MtrCurr.SenderPorts.ValidSampleFlag.Cnt_lgc /end MEASUREMENT
/begin MEASUREMENT MtrDrvDiag.FETFaultPhase.Cnt_enum "MICROSAR RTE" UBYTE RTE_CM_ENUM_FETPHASETYPE_ENUM 0 0 0 255 ECU_ADDRESS 0 SYMBOL_LINK "Rte_MtrDrvDiag_FETFaultPhase_Cnt_enum" 0 DISPLAY_IDENTIFIER MtrDrvDiag.SenderPorts.FETFaultPhase.Cnt_enum /end MEASUREMENT
/begin MEASUREMENT MtrDrvDiag.FETFaultType.Cnt_enum "MICROSAR RTE" UBYTE RTE_CM_ENUM_FETFAULTTYPE_ENUM 0 0 0 255 ECU_ADDRESS 0 SYMBOL_LINK "Rte_MtrDrvDiag_FETFaultType_Cnt_enum" 0 DISPLAY_IDENTIFIER MtrDrvDiag.SenderPorts.FETFaultType.Cnt_enum /end MEASUREMENT
/begin MEASUREMENT MtrDrvDiag.MtrDrvrInitComplete.Cnt_lgc "MICROSAR RTE" UBYTE RTE_CM_BOOLEAN 0 0 0 255 ECU_ADDRESS 0 SYMBOL_LINK "Rte_MtrDrvDiag_MtrDrvrInitComplete_Cnt_lgc" 0 DISPLAY_IDENTIFIER MtrDrvDiag.SenderPorts.MtrDrvrInitComplete.Cnt_lgc /end MEASUREMENT
/begin MEASUREMENT MtrDrvDiag.MtrDrvrInitStart.Cnt_lgc "MICROSAR RTE" UBYTE RTE_CM_BOOLEAN 0 0 0 255 ECU_ADDRESS 0 SYMBOL_LINK "Rte_HwPwUp_MtrDrvrInitStart_Cnt_lgc" 0 DISPLAY_IDENTIFIER MtrDrvDiag.ReceiverPorts.MtrDrvrInitStart.Cnt_lgc /end MEASUREMENT
/begin MEASUREMENT MtrDrvDiag.SystemState.Mode "MICROSAR RTE" UBYTE RTE_CM_ENUM_StaMd_Mode 0 0 0 255 ECU_ADDRESS 0 SYMBOL_LINK "Rte_ModeMachine_StaMd11_SystemState11_Mode" 0 DISPLAY_IDENTIFIER MtrDrvDiag.ModeRequirePorts.SystemState.Mode /end MEASUREMENT
/begin MEASUREMENT MtrDrvDiag.VswitchClosed.Cnt_lgc "MICROSAR RTE" UBYTE RTE_CM_BOOLEAN 0 0 0 255 ECU_ADDRESS 0 SYMBOL_LINK "Rte_BatteryVoltage_VswitchClosed_Cnt_lgc" 0 DISPLAY_IDENTIFIER MtrDrvDiag.ReceiverPorts.VswitchClosed.Cnt_lgc /end MEASUREMENT
/begin MEASUREMENT MtrPos.AlignedCumMtrPosMRF.Deg_f32 "MICROSAR RTE" FLOAT32_IEEE NO_COMPU_METHOD 0 0 1.175494351e-38 3.402823466e+38 ECU_ADDRESS 0 SYMBOL_LINK "Rte_MtrPos_AlignedCumMtrPosMRF_Deg_f32" 0 DISPLAY_IDENTIFIER MtrPos.SenderPorts.AlignedCumMtrPosMRF.Deg_f32 /end MEASUREMENT
/begin MEASUREMENT MtrPos.AssistAssemblyPolarity.Cnt_s08 "MICROSAR RTE" SBYTE NO_COMPU_METHOD 0 0 -128 127 ECU_ADDRESS 0 SYMBOL_LINK "Rte_Polarity_AssistAssyPolarity_Cnt_s08" 0 DISPLAY_IDENTIFIER MtrPos.ReceiverPorts.AssistAssemblyPolarity.Cnt_s08 /end MEASUREMENT
/begin MEASUREMENT MtrPos.CumMtrPosCRF.Deg_f32 "MICROSAR RTE" FLOAT32_IEEE NO_COMPU_METHOD 0 0 1.175494351e-38 3.402823466e+38 ECU_ADDRESS 0 SYMBOL_LINK "Rte_MtrPos_CumMtrPosCRF_Deg_f32" 0 DISPLAY_IDENTIFIER MtrPos.SenderPorts.CumMtrPosCRF.Deg_f32 /end MEASUREMENT
/begin MEASUREMENT MtrPos.CumMtrPosMRF.Deg_f32 "MICROSAR RTE" FLOAT32_IEEE NO_COMPU_METHOD 0 0 1.175494351e-38 3.402823466e+38 ECU_ADDRESS 0 SYMBOL_LINK "Rte_MtrPos_CumMtrPosMRF_Deg_f32" 0 DISPLAY_IDENTIFIER MtrPos.SenderPorts.CumMtrPosMRF.Deg_f32 /end MEASUREMENT
/begin MEASUREMENT MtrPos.MtrPosSnsr_EOLData.BEMFCal_Rev_u0p16 "MICROSAR RTE" UWORD NO_COMPU_METHOD 0 0 0 65535 ECU_ADDRESS 0 SYMBOL_LINK "Rte_MtrPos_MtrPosSnsr_EOLData.BEMFCal_Rev_u0p16" 0 DISPLAY_IDENTIFIER MtrPos.PerInstanceMemories.MtrPosSnsr_EOLData.BEMFCal_Rev_u0p16 READ_WRITE /end MEASUREMENT
/begin MEASUREMENT MtrPos.MtrPosSnsr_EOLData.Cos1AmpRec_Uls_u3p13 "MICROSAR RTE" UWORD NO_COMPU_METHOD 0 0 0 65535 ECU_ADDRESS 0 SYMBOL_LINK "Rte_MtrPos_MtrPosSnsr_EOLData.Cos1AmpRec_Uls_u3p13" 0 DISPLAY_IDENTIFIER MtrPos.PerInstanceMemories.MtrPosSnsr_EOLData.Cos1AmpRec_Uls_u3p13 READ_WRITE /end MEASUREMENT
/begin MEASUREMENT MtrPos.MtrPosSnsr_EOLData.Cos1GainCorr_Uls_u1p15 "MICROSAR RTE" UWORD NO_COMPU_METHOD 0 0 0 65535 ECU_ADDRESS 0 SYMBOL_LINK "Rte_MtrPos_MtrPosSnsr_EOLData.Cos1GainCorr_Uls_u1p15" 0 DISPLAY_IDENTIFIER MtrPos.PerInstanceMemories.MtrPosSnsr_EOLData.Cos1GainCorr_Uls_u1p15 READ_WRITE /end MEASUREMENT
/begin MEASUREMENT MtrPos.MtrPosSnsr_EOLData.Cos1OffCorr_Volts_s2p13 "MICROSAR RTE" SWORD NO_COMPU_METHOD 0 0 -32768 32767 ECU_ADDRESS 0 SYMBOL_LINK "Rte_MtrPos_MtrPosSnsr_EOLData.Cos1OffCorr_Volts_s2p13" 0 DISPLAY_IDENTIFIER MtrPos.PerInstanceMemories.MtrPosSnsr_EOLData.Cos1OffCorr_Volts_s2p13 READ_WRITE /end MEASUREMENT
/begin MEASUREMENT MtrPos.MtrPosSnsr_EOLData.Cos1Offset_Volts_u3p13 "MICROSAR RTE" UWORD NO_COMPU_METHOD 0 0 0 65535 ECU_ADDRESS 0 SYMBOL_LINK "Rte_MtrPos_MtrPosSnsr_EOLData.Cos1Offset_Volts_u3p13" 0 DISPLAY_IDENTIFIER MtrPos.PerInstanceMemories.MtrPosSnsr_EOLData.Cos1Offset_Volts_u3p13 READ_WRITE /end MEASUREMENT
/begin MEASUREMENT MtrPos.MtrPosSnsr_EOLData.CosDelta1Rec_Uls_u3p13 "MICROSAR RTE" UWORD NO_COMPU_METHOD 0 0 0 65535 ECU_ADDRESS 0 SYMBOL_LINK "Rte_MtrPos_MtrPosSnsr_EOLData.CosDelta1Rec_Uls_u3p13" 0 DISPLAY_IDENTIFIER MtrPos.PerInstanceMemories.MtrPosSnsr_EOLData.CosDelta1Rec_Uls_u3p13 READ_WRITE /end MEASUREMENT
/begin MEASUREMENT MtrPos.MtrPosSnsr_EOLData.CosHarTbl_Cnt_sm6p13 "MICROSAR RTE" SBYTE NO_COMPU_METHOD 0 0 -128 127 MATRIX_DIM 144 1 1 ECU_ADDRESS 0 SYMBOL_LINK "Rte_MtrPos_MtrPosSnsr_EOLData.CosHarTbl_Cnt_sm6p13" 0 DISPLAY_IDENTIFIER MtrPos.PerInstanceMemories.MtrPosSnsr_EOLData.CosHarTbl_Cnt_sm6p13 READ_WRITE /end MEASUREMENT
/begin MEASUREMENT MtrPos.MtrPosSnsr_EOLData.R_BEMFCal_Rev_u0p16 "MICROSAR RTE" UWORD NO_COMPU_METHOD 0 0 0 65535 ECU_ADDRESS 0 SYMBOL_LINK "Rte_MtrPos_MtrPosSnsr_EOLData.R_BEMFCal_Rev_u0p16" 0 DISPLAY_IDENTIFIER MtrPos.PerInstanceMemories.MtrPosSnsr_EOLData.R_BEMFCal_Rev_u0p16 READ_WRITE /end MEASUREMENT
/begin MEASUREMENT MtrPos.MtrPosSnsr_EOLData.Sin1AmpRec_Uls_u3p13 "MICROSAR RTE" UWORD NO_COMPU_METHOD 0 0 0 65535 ECU_ADDRESS 0 SYMBOL_LINK "Rte_MtrPos_MtrPosSnsr_EOLData.Sin1AmpRec_Uls_u3p13" 0 DISPLAY_IDENTIFIER MtrPos.PerInstanceMemories.MtrPosSnsr_EOLData.Sin1AmpRec_Uls_u3p13 READ_WRITE /end MEASUREMENT
/begin MEASUREMENT MtrPos.MtrPosSnsr_EOLData.Sin1GainCorr_Uls_u1p15 "MICROSAR RTE" UWORD NO_COMPU_METHOD 0 0 0 65535 ECU_ADDRESS 0 SYMBOL_LINK "Rte_MtrPos_MtrPosSnsr_EOLData.Sin1GainCorr_Uls_u1p15" 0 DISPLAY_IDENTIFIER MtrPos.PerInstanceMemories.MtrPosSnsr_EOLData.Sin1GainCorr_Uls_u1p15 READ_WRITE /end MEASUREMENT
/begin MEASUREMENT MtrPos.MtrPosSnsr_EOLData.Sin1OffCorr_Volts_s2p13 "MICROSAR RTE" SWORD NO_COMPU_METHOD 0 0 -32768 32767 ECU_ADDRESS 0 SYMBOL_LINK "Rte_MtrPos_MtrPosSnsr_EOLData.Sin1OffCorr_Volts_s2p13" 0 DISPLAY_IDENTIFIER MtrPos.PerInstanceMemories.MtrPosSnsr_EOLData.Sin1OffCorr_Volts_s2p13 READ_WRITE /end MEASUREMENT
/begin MEASUREMENT MtrPos.MtrPosSnsr_EOLData.Sin1Offset_Volts_u3p13 "MICROSAR RTE" UWORD NO_COMPU_METHOD 0 0 0 65535 ECU_ADDRESS 0 SYMBOL_LINK "Rte_MtrPos_MtrPosSnsr_EOLData.Sin1Offset_Volts_u3p13" 0 DISPLAY_IDENTIFIER MtrPos.PerInstanceMemories.MtrPosSnsr_EOLData.Sin1Offset_Volts_u3p13 READ_WRITE /end MEASUREMENT
/begin MEASUREMENT MtrPos.MtrPosSnsr_EOLData.SinDelta1_Uls_s2p13 "MICROSAR RTE" SWORD NO_COMPU_METHOD 0 0 -32768 32767 ECU_ADDRESS 0 SYMBOL_LINK "Rte_MtrPos_MtrPosSnsr_EOLData.SinDelta1_Uls_s2p13" 0 DISPLAY_IDENTIFIER MtrPos.PerInstanceMemories.MtrPosSnsr_EOLData.SinDelta1_Uls_s2p13 READ_WRITE /end MEASUREMENT
/begin MEASUREMENT MtrPos.MtrPosSnsr_EOLData.SinHarTbl_Cnt_sm6p13 "MICROSAR RTE" SBYTE NO_COMPU_METHOD 0 0 -128 127 MATRIX_DIM 144 1 1 ECU_ADDRESS 0 SYMBOL_LINK "Rte_MtrPos_MtrPosSnsr_EOLData.SinHarTbl_Cnt_sm6p13" 0 DISPLAY_IDENTIFIER MtrPos.PerInstanceMemories.MtrPosSnsr_EOLData.SinHarTbl_Cnt_sm6p13 READ_WRITE /end MEASUREMENT
/begin MEASUREMENT MtrPos.SysCCumMtrPosCRF.Deg_f32 "MICROSAR RTE" FLOAT32_IEEE NO_COMPU_METHOD 0 0 1.175494351e-38 3.402823466e+38 ECU_ADDRESS 0 SYMBOL_LINK "Rte_MtrPos_SysCCumMtrPosCRF_Deg_f32" 0 DISPLAY_IDENTIFIER MtrPos.SenderPorts.SysCCumMtrPosCRF.Deg_f32 /end MEASUREMENT
/begin MEASUREMENT MtrPos.SysCCumMtrPosMRF.Deg_f32 "MICROSAR RTE" FLOAT32_IEEE NO_COMPU_METHOD 0 0 1.175494351e-38 3.402823466e+38 ECU_ADDRESS 0 SYMBOL_LINK "Rte_MtrPos_SysCCumMtrPosMRF_Deg_f32" 0 DISPLAY_IDENTIFIER MtrPos.SenderPorts.SysCCumMtrPosMRF.Deg_f32 /end MEASUREMENT
/begin MEASUREMENT MtrPos2.CorrectedMtrPos.Rev_f32 "MICROSAR RTE" FLOAT32_IEEE NO_COMPU_METHOD 0 0 1.175494351e-38 3.402823466e+38 ECU_ADDRESS 0 SYMBOL_LINK "Rte_MtrPos2_CorrectedMtrPos_Rev_f32" 0 DISPLAY_IDENTIFIER MtrPos2.SenderPorts.CorrectedMtrPos.Rev_f32 /end MEASUREMENT
/begin MEASUREMENT MtrPos2.CosTheta1.Volt_f32 "This signal is intended to communicate any type voltage signal measured by the ecu.  This signal has a lower limit of 0 which reequires users of the signal to provide divide by 0 protection if it is used as a denominator in a calculation.  See Vecu port p" FLOAT32_IEEE NO_COMPU_METHOD 0 0 1.175494351e-38 3.402823466e+38 ECU_ADDRESS 0 SYMBOL_LINK "Rte_MtrPos2_CosTheta1_Volt_f32" 0 DISPLAY_IDENTIFIER MtrPos2.SenderPorts.CosTheta1.Volt_f32 /end MEASUREMENT
/begin MEASUREMENT MtrPos2.MechMtrPos.Rev_f32 "MICROSAR RTE" FLOAT32_IEEE NO_COMPU_METHOD 0 0 1.175494351e-38 3.402823466e+38 ECU_ADDRESS 0 SYMBOL_LINK "Rte_MtrPos2_MechMtrPos_Rev_f32" 0 DISPLAY_IDENTIFIER MtrPos2.SenderPorts.MechMtrPos.Rev_f32 /end MEASUREMENT
/begin MEASUREMENT MtrPos2.MotorVelMRF.MtrRadpS_f32 "MICROSAR RTE" FLOAT32_IEEE NO_COMPU_METHOD 0 0 1.175494351e-38 3.402823466e+38 ECU_ADDRESS 0 SYMBOL_LINK "Rte_MtrVel_MRFMotorVel_MtrRadpS_f32" 0 DISPLAY_IDENTIFIER MtrPos2.ReceiverPorts.MotorVelMRF.MtrRadpS_f32 /end MEASUREMENT
/begin MEASUREMENT MtrPos2.SinTheta1.Volt_f32 "This signal is intended to communicate any type voltage signal measured by the ecu.  This signal has a lower limit of 0 which reequires users of the signal to provide divide by 0 protection if it is used as a denominator in a calculation.  See Vecu port p" FLOAT32_IEEE NO_COMPU_METHOD 0 0 1.175494351e-38 3.402823466e+38 ECU_ADDRESS 0 SYMBOL_LINK "Rte_MtrPos2_SinTheta1_Volt_f32" 0 DISPLAY_IDENTIFIER MtrPos2.SenderPorts.SinTheta1.Volt_f32 /end MEASUREMENT
/begin MEASUREMENT MtrPos2.SysCCorrectedMtrPos.Rev_f32 "MICROSAR RTE" FLOAT32_IEEE NO_COMPU_METHOD 0 0 1.175494351e-38 3.402823466e+38 ECU_ADDRESS 0 SYMBOL_LINK "Rte_MtrPos2_SysCCorrectedMtrPos_Rev_f32" 0 DISPLAY_IDENTIFIER MtrPos2.SenderPorts.SysCCorrectedMtrPos.Rev_f32 /end MEASUREMENT
/begin MEASUREMENT MtrPos2.SysCMechMtrPos.Rev_f32 "MICROSAR RTE" FLOAT32_IEEE NO_COMPU_METHOD 0 0 1.175494351e-38 3.402823466e+38 ECU_ADDRESS 0 SYMBOL_LINK "Rte_MtrPos2_SysCMechMtrPos_Rev_f32" 0 DISPLAY_IDENTIFIER MtrPos2.SenderPorts.SysCMechMtrPos.Rev_f32 /end MEASUREMENT
/begin MEASUREMENT MtrPos3.InvCos2Scaled.Volt_f32 "This signal is intended to communicate any type voltage signal measured by the ecu.  This signal has a lower limit of 0 which reequires users of the signal to provide divide by 0 protection if it is used as a denominator in a calculation.  See Vecu port p" FLOAT32_IEEE NO_COMPU_METHOD 0 0 1.175494351e-38 3.402823466e+38 ECU_ADDRESS 0 SYMBOL_LINK "Rte_IoHwAb7_InvCos2Scaled_Volt_f32" 0 DISPLAY_IDENTIFIER MtrPos3.ReceiverPorts.InvCos2Scaled.Volt_f32 /end MEASUREMENT
/begin MEASUREMENT MtrPos3.InvSin2Scaled.Volt_f32 "This signal is intended to communicate any type voltage signal measured by the ecu.  This signal has a lower limit of 0 which reequires users of the signal to provide divide by 0 protection if it is used as a denominator in a calculation.  See Vecu port p" FLOAT32_IEEE NO_COMPU_METHOD 0 0 1.175494351e-38 3.402823466e+38 ECU_ADDRESS 0 SYMBOL_LINK "Rte_IoHwAb7_InvSin2Scaled_Volt_f32" 0 DISPLAY_IDENTIFIER MtrPos3.ReceiverPorts.InvSin2Scaled.Volt_f32 /end MEASUREMENT
/begin MEASUREMENT MtrTempEst.AmbTemp.DegC_f32 "MICROSAR RTE" FLOAT32_IEEE NO_COMPU_METHOD 0 0 1.175494351e-38 3.402823466e+38 ECU_ADDRESS 0 SYMBOL_LINK "Rte_MtrTempEst_AmbTemp_DegC_f32" 0 DISPLAY_IDENTIFIER MtrTempEst.ReceiverPorts.AmbTemp.DegC_f32 /end MEASUREMENT
/begin MEASUREMENT MtrTempEst.AssistMechTempEst.DegC_f32 "MICROSAR RTE" FLOAT32_IEEE NO_COMPU_METHOD 0 0 1.175494351e-38 3.402823466e+38 ECU_ADDRESS 0 SYMBOL_LINK "Rte_MtrTempEst_AssistMechTempEst_DegC_f32" 0 DISPLAY_IDENTIFIER MtrTempEst.SenderPorts.AssistMechTempEst.DegC_f32 /end MEASUREMENT
/begin MEASUREMENT MtrTempEst.CtrlTempFinal.DegC_f32 "MICROSAR RTE" FLOAT32_IEEE NO_COMPU_METHOD 0 0 1.175494351e-38 3.402823466e+38 ECU_ADDRESS 0 SYMBOL_LINK "Rte_CtrlTemp_FiltMeasTemp_DegC_f32" 0 DISPLAY_IDENTIFIER MtrTempEst.ReceiverPorts.CtrlTempFinal.DegC_f32 /end MEASUREMENT
/begin MEASUREMENT MtrTempEst.CuTempEst.DegC_f32 "MICROSAR RTE" FLOAT32_IEEE NO_COMPU_METHOD 0 0 1.175494351e-38 3.402823466e+38 ECU_ADDRESS 0 SYMBOL_LINK "Rte_MtrTempEst_CuTempEst_DegC_f32" 0 DISPLAY_IDENTIFIER MtrTempEst.SenderPorts.CuTempEst.DegC_f32 /end MEASUREMENT
/begin MEASUREMENT MtrTempEst.EngTemp.DegC_f32 "MICROSAR RTE" FLOAT32_IEEE NO_COMPU_METHOD 0 0 1.175494351e-38 3.402823466e+38 ECU_ADDRESS 0 SYMBOL_LINK "Rte_MtrTempEst_EngTemp_DegC_f32" 0 DISPLAY_IDENTIFIER MtrTempEst.ReceiverPorts.EngTemp.DegC_f32 /end MEASUREMENT
/begin MEASUREMENT MtrTempEst.EstPkCurr.AmpSq_f32 "MICROSAR RTE" FLOAT32_IEEE NO_COMPU_METHOD 0 0 1.175494351e-38 3.402823466e+38 ECU_ADDRESS 0 SYMBOL_LINK "Rte_CurrentEst_EstPkCurr_AmpSq_f32" 0 DISPLAY_IDENTIFIER MtrTempEst.ReceiverPorts.EstPkCurr.AmpSq_f32 /end MEASUREMENT
/begin MEASUREMENT MtrTempEst.HwVel.HwRadpS_f32 "MICROSAR RTE" FLOAT32_IEEE NO_COMPU_METHOD 0 0 1.175494351e-38 3.402823466e+38 ECU_ADDRESS 0 SYMBOL_LINK "Rte_MtrVel_HandwheelVel_HwRadpS_f32" 0 DISPLAY_IDENTIFIER MtrTempEst.ReceiverPorts.HwVel.HwRadpS_f32 /end MEASUREMENT
/begin MEASUREMENT MtrTempEst.MagTempEst.DegC_f32 "MICROSAR RTE" FLOAT32_IEEE NO_COMPU_METHOD 0 0 1.175494351e-38 3.402823466e+38 ECU_ADDRESS 0 SYMBOL_LINK "Rte_MtrTempEst_MagTempEst_DegC_f32" 0 DISPLAY_IDENTIFIER MtrTempEst.SenderPorts.MagTempEst.DegC_f32 /end MEASUREMENT
/begin MEASUREMENT MtrTempEst.ScomAMDefeat.Cnt_lgc "MICROSAR RTE" UBYTE RTE_CM_BOOLEAN 0 0 0 255 ECU_ADDRESS 0 SYMBOL_LINK "Rte_MtrTempEst_ScomAMDefeat_Cnt_lgc" 0 DISPLAY_IDENTIFIER MtrTempEst.ReceiverPorts.ScomAMDefeat.Cnt_lgc /end MEASUREMENT
/begin MEASUREMENT MtrTempEst.ScomTempDataRcvd.Cnt_lgc "MICROSAR RTE" UBYTE RTE_CM_BOOLEAN 0 0 0 255 ECU_ADDRESS 0 SYMBOL_LINK "Rte_MtrTempEst_ScomTempDataRcvd_Cnt_lgc" 0 DISPLAY_IDENTIFIER MtrTempEst.ReceiverPorts.ScomTempDataRcvd.Cnt_lgc /end MEASUREMENT
/begin MEASUREMENT MtrTempEst.SiTempEst.DegC_f32 "MICROSAR RTE" FLOAT32_IEEE NO_COMPU_METHOD 0 0 1.175494351e-38 3.402823466e+38 ECU_ADDRESS 0 SYMBOL_LINK "Rte_MtrTempEst_SiTempEst_DegC_f32" 0 DISPLAY_IDENTIFIER MtrTempEst.SenderPorts.SiTempEst.DegC_f32 /end MEASUREMENT
/begin MEASUREMENT MtrVel.AsstAssemPol.Cnt_s08 "MICROSAR RTE" SBYTE NO_COMPU_METHOD 0 0 -128 127 ECU_ADDRESS 0 SYMBOL_LINK "Rte_Polarity_AssistAssyPolarity_Cnt_s08" 0 DISPLAY_IDENTIFIER MtrVel.ReceiverPorts.AsstAssemPol.Cnt_s08 /end MEASUREMENT
/begin MEASUREMENT MtrVel.CRFMotorVel.MtrRadpS_f32 "MICROSAR RTE" FLOAT32_IEEE NO_COMPU_METHOD 0 0 1.175494351e-38 3.402823466e+38 ECU_ADDRESS 0 SYMBOL_LINK "Rte_MtrVel_CRFMotorVel_MtrRadpS_f32" 0 DISPLAY_IDENTIFIER MtrVel.SenderPorts.CRFMotorVel.MtrRadpS_f32 /end MEASUREMENT
/begin MEASUREMENT MtrVel.HandwheelVel.HwRadpS_f32 "MICROSAR RTE" FLOAT32_IEEE NO_COMPU_METHOD 0 0 1.175494351e-38 3.402823466e+38 ECU_ADDRESS 0 SYMBOL_LINK "Rte_MtrVel_HandwheelVel_HwRadpS_f32" 0 DISPLAY_IDENTIFIER MtrVel.SenderPorts.HandwheelVel.HwRadpS_f32 /end MEASUREMENT
/begin MEASUREMENT MtrVel.HwVelValid.Cnt_lgc "MICROSAR RTE" UBYTE RTE_CM_BOOLEAN 0 0 0 255 ECU_ADDRESS 0 SYMBOL_LINK "Rte_MtrVel_HwVelValid_Cnt_lgc" 0 DISPLAY_IDENTIFIER MtrVel.SenderPorts.HwVelValid.Cnt_lgc /end MEASUREMENT
/begin MEASUREMENT MtrVel.MRFMotorVel.MtrRadpS_f32 "MICROSAR RTE" FLOAT32_IEEE NO_COMPU_METHOD 0 0 1.175494351e-38 3.402823466e+38 ECU_ADDRESS 0 SYMBOL_LINK "Rte_MtrVel_MRFMotorVel_MtrRadpS_f32" 0 DISPLAY_IDENTIFIER MtrVel.SenderPorts.MRFMotorVel.MtrRadpS_f32 /end MEASUREMENT
/begin MEASUREMENT MtrVel.MRFMotorVelUnfiltered.MtrRadpS_f32 "MICROSAR RTE" FLOAT32_IEEE NO_COMPU_METHOD 0 0 1.175494351e-38 3.402823466e+38 ECU_ADDRESS 0 SYMBOL_LINK "Rte_MtrVel_MRFMotorVelUnfiltered_MtrRadpS_f32" 0 DISPLAY_IDENTIFIER MtrVel.SenderPorts.MRFMotorVelUnfiltered.MtrRadpS_f32 /end MEASUREMENT
/begin MEASUREMENT MtrVel.SysCDiagHandWheelVel.HwRadpS_f32 "MICROSAR RTE" FLOAT32_IEEE NO_COMPU_METHOD 0 0 1.175494351e-38 3.402823466e+38 ECU_ADDRESS 0 SYMBOL_LINK "Rte_MtrVel2_SysCDiagHandWheelVel_HwRadpS_f32" 0 DISPLAY_IDENTIFIER MtrVel.ReceiverPorts.SysCDiagHandWheelVel.HwRadpS_f32 /end MEASUREMENT
/begin MEASUREMENT MtrVel.SysCDiagMtrVelMRF.MtrRadpS_f32 "MICROSAR RTE" FLOAT32_IEEE NO_COMPU_METHOD 0 0 1.175494351e-38 3.402823466e+38 ECU_ADDRESS 0 SYMBOL_LINK "Rte_MtrVel2_SysCDiagMtrVelMRF_MtrRadpS_f32" 0 DISPLAY_IDENTIFIER MtrVel.ReceiverPorts.SysCDiagMtrVelMRF.MtrRadpS_f32 /end MEASUREMENT
/begin MEASUREMENT MtrVel.SysCHandwheelVel.HwRadpS_f32 "MICROSAR RTE" FLOAT32_IEEE NO_COMPU_METHOD 0 0 1.175494351e-38 3.402823466e+38 ECU_ADDRESS 0 SYMBOL_LINK "Rte_MtrVel_SysCHandwheelVel_HwRadpS_f32" 0 DISPLAY_IDENTIFIER MtrVel.SenderPorts.SysCHandwheelVel.HwRadpS_f32 /end MEASUREMENT
/begin MEASUREMENT MtrVel.SysCMotorVelMRF.MtrRadpS_f32 "MICROSAR RTE" FLOAT32_IEEE NO_COMPU_METHOD 0 0 1.175494351e-38 3.402823466e+38 ECU_ADDRESS 0 SYMBOL_LINK "Rte_MtrVel_SysCMotorVelMRF_MtrRadpS_f32" 0 DISPLAY_IDENTIFIER MtrVel.SenderPorts.SysCMotorVelMRF.MtrRadpS_f32 /end MEASUREMENT
/begin MEASUREMENT MtrVel.VehicleSpeed.Kph_f32 "MICROSAR RTE" FLOAT32_IEEE NO_COMPU_METHOD 0 0 1.175494351e-38 3.402823466e+38 ECU_ADDRESS 0 SYMBOL_LINK "Rte_SignlCondn_VehicleSpeed_Kph_f32" 0 DISPLAY_IDENTIFIER MtrVel.ReceiverPorts.VehicleSpeed.Kph_f32 /end MEASUREMENT
/begin MEASUREMENT MtrVel2.AsstAssemPol.Cnt_s08 "MICROSAR RTE" SBYTE NO_COMPU_METHOD 0 0 -128 127 ECU_ADDRESS 0 SYMBOL_LINK "Rte_Polarity_AssistAssyPolarity_Cnt_s08" 0 DISPLAY_IDENTIFIER MtrVel2.ReceiverPorts.AsstAssemPol.Cnt_s08 /end MEASUREMENT
/begin MEASUREMENT MtrVel2.CumMtrPosMRF.Deg_f32 "MICROSAR RTE" FLOAT32_IEEE NO_COMPU_METHOD 0 0 1.175494351e-38 3.402823466e+38 ECU_ADDRESS 0 SYMBOL_LINK "Rte_MtrPos_CumMtrPosMRF_Deg_f32" 0 DISPLAY_IDENTIFIER MtrVel2.ReceiverPorts.CumMtrPosMRF.Deg_f32 /end MEASUREMENT
/begin MEASUREMENT MtrVel2.HandWheelVel.HwRadpS_f32 "MICROSAR RTE" FLOAT32_IEEE NO_COMPU_METHOD 0 0 1.175494351e-38 3.402823466e+38 ECU_ADDRESS 0 SYMBOL_LINK "Rte_MtrVel_HandwheelVel_HwRadpS_f32" 0 DISPLAY_IDENTIFIER MtrVel2.ReceiverPorts.HandWheelVel.HwRadpS_f32 /end MEASUREMENT
/begin MEASUREMENT MtrVel2.MRFMotorVel.MtrRadpS_f32 "MICROSAR RTE" FLOAT32_IEEE NO_COMPU_METHOD 0 0 1.175494351e-38 3.402823466e+38 ECU_ADDRESS 0 SYMBOL_LINK "Rte_MtrVel_MRFMotorVel_MtrRadpS_f32" 0 DISPLAY_IDENTIFIER MtrVel2.ReceiverPorts.MRFMotorVel.MtrRadpS_f32 /end MEASUREMENT
/begin MEASUREMENT MtrVel2.SysCDiagHandWheelVel.HwRadpS_f32 "MICROSAR RTE" FLOAT32_IEEE NO_COMPU_METHOD 0 0 1.175494351e-38 3.402823466e+38 ECU_ADDRESS 0 SYMBOL_LINK "Rte_MtrVel2_SysCDiagHandWheelVel_HwRadpS_f32" 0 DISPLAY_IDENTIFIER MtrVel2.SenderPorts.SysCDiagHandWheelVel.HwRadpS_f32 /end MEASUREMENT
/begin MEASUREMENT MtrVel2.SysCDiagMtrVelMRF.MtrRadpS_f32 "MICROSAR RTE" FLOAT32_IEEE NO_COMPU_METHOD 0 0 1.175494351e-38 3.402823466e+38 ECU_ADDRESS 0 SYMBOL_LINK "Rte_MtrVel2_SysCDiagMtrVelMRF_MtrRadpS_f32" 0 DISPLAY_IDENTIFIER MtrVel2.SenderPorts.SysCDiagMtrVelMRF.MtrRadpS_f32 /end MEASUREMENT
/begin MEASUREMENT Nhet2.SystemState.Mode "MICROSAR RTE" UBYTE RTE_CM_ENUM_StaMd_Mode 0 0 0 255 ECU_ADDRESS 0 SYMBOL_LINK "Rte_ModeMachine_StaMd_SystemState_Mode" 0 DISPLAY_IDENTIFIER Nhet2.ModeRequirePorts.SystemState.Mode /end MEASUREMENT
/begin MEASUREMENT OscTraj.CalculateFlag.Cnt_lgc "MICROSAR RTE" UBYTE RTE_CM_BOOLEAN 0 0 0 255 ECU_ADDRESS 0 SYMBOL_LINK "Rte_CDDInterface9_OscTrajEnable_Cnt_lgc" 0 DISPLAY_IDENTIFIER OscTraj.ReceiverPorts.CalculateFlag.Cnt_lgc /end MEASUREMENT
/begin MEASUREMENT OscTraj.HwPos.HwDeg_f32 "MICROSAR RTE" FLOAT32_IEEE NO_COMPU_METHOD 0 0 1.175494351e-38 3.402823466e+38 ECU_ADDRESS 0 SYMBOL_LINK "Rte_AbsHwPos_HandwheelPosition_HwDeg_f32" 0 DISPLAY_IDENTIFIER OscTraj.ReceiverPorts.HwPos.HwDeg_f32 /end MEASUREMENT
/begin MEASUREMENT OscTraj.OscTrajState.Cnt_enum "MICROSAR RTE" UBYTE RTE_CM_ENUM_OscTrajCmdStateType 0 0 0 2 ECU_ADDRESS 0 SYMBOL_LINK "Rte_OscTraj_OscTrajState_Cnt_enum" 0 DISPLAY_IDENTIFIER OscTraj.SenderPorts.OscTrajState.Cnt_enum /end MEASUREMENT
/begin MEASUREMENT OscTraj.OscillateHwAngle.HwDeg_f32 "MICROSAR RTE" FLOAT32_IEEE NO_COMPU_METHOD 0 0 1.175494351e-38 3.402823466e+38 ECU_ADDRESS 0 SYMBOL_LINK "Rte_OscTraj_OscillateHwAngle_HwDeg_f32" 0 DISPLAY_IDENTIFIER OscTraj.SenderPorts.OscillateHwAngle.HwDeg_f32 /end MEASUREMENT
/begin MEASUREMENT ParamComp.CuTempEst.DegC_f32 "MICROSAR RTE" FLOAT32_IEEE NO_COMPU_METHOD 0 0 1.175494351e-38 3.402823466e+38 ECU_ADDRESS 0 SYMBOL_LINK "Rte_MtrTempEst_CuTempEst_DegC_f32" 0 DISPLAY_IDENTIFIER ParamComp.ReceiverPorts.CuTempEst.DegC_f32 /end MEASUREMENT
/begin MEASUREMENT ParamComp.EOLNomMtrParam.NomKe_VpRadpS_f32 "MICROSAR RTE" FLOAT32_IEEE NO_COMPU_METHOD 0 0 1.175494351e-38 3.402823466e+38 ECU_ADDRESS 0 SYMBOL_LINK "Rte_ParamComp_EOLNomMtrParam.NomKe_VpRadpS_f32" 0 DISPLAY_IDENTIFIER ParamComp.PerInstanceMemories.EOLNomMtrParam.NomKe_VpRadpS_f32 READ_WRITE /end MEASUREMENT
/begin MEASUREMENT ParamComp.EOLNomMtrParam.NomLq_Henry_f32 "MICROSAR RTE" FLOAT32_IEEE NO_COMPU_METHOD 0 0 1.175494351e-38 3.402823466e+38 ECU_ADDRESS 0 SYMBOL_LINK "Rte_ParamComp_EOLNomMtrParam.NomLq_Henry_f32" 0 DISPLAY_IDENTIFIER ParamComp.PerInstanceMemories.EOLNomMtrParam.NomLq_Henry_f32 READ_WRITE /end MEASUREMENT
/begin MEASUREMENT ParamComp.EOLNomMtrParam.NomRmtr_Ohm_f32 "MICROSAR RTE" FLOAT32_IEEE NO_COMPU_METHOD 0 0 1.175494351e-38 3.402823466e+38 ECU_ADDRESS 0 SYMBOL_LINK "Rte_ParamComp_EOLNomMtrParam.NomRmtr_Ohm_f32" 0 DISPLAY_IDENTIFIER ParamComp.PerInstanceMemories.EOLNomMtrParam.NomRmtr_Ohm_f32 READ_WRITE /end MEASUREMENT
/begin MEASUREMENT ParamComp.EstKe.VpRadpS_f32 "MICROSAR RTE" FLOAT32_IEEE NO_COMPU_METHOD 0 0 1.175494351e-38 3.402823466e+38 ECU_ADDRESS 0 SYMBOL_LINK "Rte_ParamComp_EstKe_VpRadpS_f32" 0 DISPLAY_IDENTIFIER ParamComp.SenderPorts.EstKe.VpRadpS_f32 /end MEASUREMENT
/begin MEASUREMENT ParamComp.EstLd.Henry_f32 "MICROSAR RTE" FLOAT32_IEEE NO_COMPU_METHOD 0 0 1.175494351e-38 3.402823466e+38 ECU_ADDRESS 0 SYMBOL_LINK "Rte_ParamComp_EstLd_Henry_f32" 0 DISPLAY_IDENTIFIER ParamComp.SenderPorts.EstLd.Henry_f32 /end MEASUREMENT
/begin MEASUREMENT ParamComp.EstLq.Henry_f32 "MICROSAR RTE" FLOAT32_IEEE NO_COMPU_METHOD 0 0 1.175494351e-38 3.402823466e+38 ECU_ADDRESS 0 SYMBOL_LINK "Rte_ParamComp_EstLq_Henry_f32" 0 DISPLAY_IDENTIFIER ParamComp.SenderPorts.EstLq.Henry_f32 /end MEASUREMENT
/begin MEASUREMENT ParamComp.EstR.Ohm_f32 "MICROSAR RTE" FLOAT32_IEEE NO_COMPU_METHOD 0 0 1.175494351e-38 3.402823466e+38 ECU_ADDRESS 0 SYMBOL_LINK "Rte_ParamComp_EstR_Ohm_f32" 0 DISPLAY_IDENTIFIER ParamComp.SenderPorts.EstR.Ohm_f32 /end MEASUREMENT
/begin MEASUREMENT ParamComp.ExpIq.Amp_f32 "MICROSAR RTE" FLOAT32_IEEE NO_COMPU_METHOD 0 0 1.175494351e-38 3.402823466e+38 ECU_ADDRESS 0 SYMBOL_LINK "Rte_ParamComp_ExpIq_Amp_f32" 0 DISPLAY_IDENTIFIER ParamComp.SenderPorts.ExpIq.Amp_f32 /end MEASUREMENT
/begin MEASUREMENT ParamComp.IdEst.Amp_f32 "MICROSAR RTE" FLOAT32_IEEE NO_COMPU_METHOD 0 0 1.175494351e-38 3.402823466e+38 ECU_ADDRESS 0 SYMBOL_LINK "Rte_CurrentEst_IdEst_Amp_f32" 0 DISPLAY_IDENTIFIER ParamComp.ReceiverPorts.IdEst.Amp_f32 /end MEASUREMENT
/begin MEASUREMENT ParamComp.MRFMtrTrqCmdScl.MtrNm_f32 "MICROSAR RTE" FLOAT32_IEEE NO_COMPU_METHOD 0 0 1.175494351e-38 3.402823466e+38 ECU_ADDRESS 0 SYMBOL_LINK "Rte_TrqCmdScl_MRFMtrTrqCmdScl_MtrNm_f32" 0 DISPLAY_IDENTIFIER ParamComp.ReceiverPorts.MRFMtrTrqCmdScl.MtrNm_f32 /end MEASUREMENT
/begin MEASUREMENT ParamComp.MRFMtrVel.MtrRadpS_f32 "MICROSAR RTE" FLOAT32_IEEE NO_COMPU_METHOD 0 0 1.175494351e-38 3.402823466e+38 ECU_ADDRESS 0 SYMBOL_LINK "Rte_MtrVel_MRFMotorVel_MtrRadpS_f32" 0 DISPLAY_IDENTIFIER ParamComp.ReceiverPorts.MRFMtrVel.MtrRadpS_f32 /end MEASUREMENT
/begin MEASUREMENT ParamComp.MagTempEst.DegC_f32 "MICROSAR RTE" FLOAT32_IEEE NO_COMPU_METHOD 0 0 1.175494351e-38 3.402823466e+38 ECU_ADDRESS 0 SYMBOL_LINK "Rte_MtrTempEst_MagTempEst_DegC_f32" 0 DISPLAY_IDENTIFIER ParamComp.ReceiverPorts.MagTempEst.DegC_f32 /end MEASUREMENT
/begin MEASUREMENT ParamComp.MtrCurrQax.Amp_f32 "MICROSAR RTE" FLOAT32_IEEE NO_COMPU_METHOD 0 0 1.175494351e-38 3.402823466e+38 ECU_ADDRESS 0 SYMBOL_LINK "Rte_MtrCurr_MtrCurrQax_Amp_f32" 0 DISPLAY_IDENTIFIER ParamComp.ReceiverPorts.MtrCurrQax.Amp_f32 /end MEASUREMENT
/begin MEASUREMENT ParamComp.MtrParmNrmLrnSrlComSvcDft.Cnt_lgc "MICROSAR RTE" UBYTE RTE_CM_BOOLEAN 0 0 0 255 ECU_ADDRESS 0 SYMBOL_LINK "Rte_CDDInterface9_MtrParmNrmLrnSrlComSvcDft_Cnt_lgc" 0 DISPLAY_IDENTIFIER ParamComp.ReceiverPorts.MtrParmNrmLrnSrlComSvcDft.Cnt_lgc /end MEASUREMENT
/begin MEASUREMENT ParamComp.MtrQuad.Cnt_u08 "MICROSAR RTE" UBYTE NO_COMPU_METHOD 0 0 0 255 ECU_ADDRESS 0 SYMBOL_LINK "Rte_QuadDet_MtrQuad_Cnt_u08" 0 DISPLAY_IDENTIFIER ParamComp.ReceiverPorts.MtrQuad.Cnt_u08 /end MEASUREMENT
/begin MEASUREMENT ParamComp.SiTempEst.DegC_f32 "MICROSAR RTE" FLOAT32_IEEE NO_COMPU_METHOD 0 0 1.175494351e-38 3.402823466e+38 ECU_ADDRESS 0 SYMBOL_LINK "Rte_MtrTempEst_SiTempEst_DegC_f32" 0 DISPLAY_IDENTIFIER ParamComp.ReceiverPorts.SiTempEst.DegC_f32 /end MEASUREMENT
/begin MEASUREMENT ParamComp.ValidCurrSample.Cnt_lgc "MICROSAR RTE" UBYTE RTE_CM_BOOLEAN 0 0 0 255 ECU_ADDRESS 0 SYMBOL_LINK "Rte_MtrCurr_ValidSampleFlag_Cnt_lgc" 0 DISPLAY_IDENTIFIER ParamComp.ReceiverPorts.ValidCurrSample.Cnt_lgc /end MEASUREMENT
/begin MEASUREMENT ParkAssistEnable.DiagStsRmpZeroNRec.Cnt_lgc "MICROSAR RTE" UBYTE RTE_CM_BOOLEAN 0 0 0 255 ECU_ADDRESS 0 SYMBOL_LINK "Rte_DiagMgr10_DiagStsNonRecRmpToZeroFltPres_Cnt_lgc" 0 DISPLAY_IDENTIFIER ParkAssistEnable.ReceiverPorts.DiagStsRmpZeroNRec.Cnt_lgc /end MEASUREMENT
/begin MEASUREMENT ParkAssistEnable.DiagStsRmpZeroRec.Cnt_lgc "MICROSAR RTE" UBYTE RTE_CM_BOOLEAN 0 0 0 255 ECU_ADDRESS 0 SYMBOL_LINK "Rte_DiagMgr10_DiagStsRecRmpToZeroFltPres_Cnt_lgc" 0 DISPLAY_IDENTIFIER ParkAssistEnable.ReceiverPorts.DiagStsRmpZeroRec.Cnt_lgc /end MEASUREMENT
/begin MEASUREMENT ParkAssistEnable.HandwheelAuthority.Uls_f32 "MICROSAR RTE" FLOAT32_IEEE NO_COMPU_METHOD 0 0 1.175494351e-38 3.402823466e+38 ECU_ADDRESS 0 SYMBOL_LINK "Rte_AbsHwPos_HandwheelAuthority_Uls_f32" 0 DISPLAY_IDENTIFIER ParkAssistEnable.ReceiverPorts.HandwheelAuthority.Uls_f32 /end MEASUREMENT
/begin MEASUREMENT ParkAssistEnable.HandwheelPosition.HwDeg_f32 "MICROSAR RTE" FLOAT32_IEEE NO_COMPU_METHOD 0 0 1.175494351e-38 3.402823466e+38 ECU_ADDRESS 0 SYMBOL_LINK "Rte_AbsHwPos_HandwheelPosition_HwDeg_f32" 0 DISPLAY_IDENTIFIER ParkAssistEnable.ReceiverPorts.HandwheelPosition.HwDeg_f32 /end MEASUREMENT
/begin MEASUREMENT ParkAssistEnable.HandwheelVel.HwRadpS_f32 "MICROSAR RTE" FLOAT32_IEEE NO_COMPU_METHOD 0 0 1.175494351e-38 3.402823466e+38 ECU_ADDRESS 0 SYMBOL_LINK "Rte_MtrVel_HandwheelVel_HwRadpS_f32" 0 DISPLAY_IDENTIFIER ParkAssistEnable.ReceiverPorts.HandwheelVel.HwRadpS_f32 /end MEASUREMENT
/begin MEASUREMENT ParkAssistEnable.HwTorque.HwNm_f32 "MICROSAR RTE" FLOAT32_IEEE NO_COMPU_METHOD 0 0 1.175494351e-38 3.402823466e+38 ECU_ADDRESS 0 SYMBOL_LINK "Rte_Sweep_OutputHwTrq_HwNm_f32" 0 DISPLAY_IDENTIFIER ParkAssistEnable.ReceiverPorts.HwTorque.HwNm_f32 /end MEASUREMENT
/begin MEASUREMENT ParkAssistEnable.LimitPercentFiltered.Uls_f32 "MICROSAR RTE" FLOAT32_IEEE NO_COMPU_METHOD 0 0 1.175494351e-38 3.402823466e+38 ECU_ADDRESS 0 SYMBOL_LINK "Rte_AssistSumnLmt_LimitPercentFiltered_Uls_f32" 0 DISPLAY_IDENTIFIER ParkAssistEnable.ReceiverPorts.LimitPercentFiltered.Uls_f32 /end MEASUREMENT
/begin MEASUREMENT ParkAssistEnable.PAEnableRqst.Cnt_lgc "MICROSAR RTE" UBYTE RTE_CM_BOOLEAN 0 0 0 255 ECU_ADDRESS 0 SYMBOL_LINK "Rte_ParkAssistEnable_PAEnableRqst_Cnt_lgc" 0 DISPLAY_IDENTIFIER ParkAssistEnable.ReceiverPorts.PAEnableRqst.Cnt_lgc /end MEASUREMENT
/begin MEASUREMENT ParkAssistEnable.PAErrInterfaceActive.Cnt_lgc "MICROSAR RTE" UBYTE RTE_CM_BOOLEAN 0 0 0 255 ECU_ADDRESS 0 SYMBOL_LINK "Rte_ParkAssistEnable_PAErrInterfaceActive_Cnt_lgc" 0 DISPLAY_IDENTIFIER ParkAssistEnable.ReceiverPorts.PAErrInterfaceActive.Cnt_lgc /end MEASUREMENT
/begin MEASUREMENT ParkAssistEnable.PAHWAngleRqst.HwDeg_f32 "MICROSAR RTE" FLOAT32_IEEE NO_COMPU_METHOD 0 0 1.175494351e-38 3.402823466e+38 ECU_ADDRESS 0 SYMBOL_LINK "Rte_ParkAssistEnable_PAHWAngleRqst_HwDeg_f32" 0 DISPLAY_IDENTIFIER ParkAssistEnable.ReceiverPorts.PAHWAngleRqst.HwDeg_f32 /end MEASUREMENT
/begin MEASUREMENT ParkAssistEnable.PASpdHigh.Cnt_u08 "MICROSAR RTE" UBYTE RTE_CM_ENUM_ST_V_VEH_NSS 0 0 0 15 ECU_ADDRESS 0 SYMBOL_LINK "Rte_SrlComInput2_SrlComVehNearStandstill_Cnt_u08" 0 DISPLAY_IDENTIFIER ParkAssistEnable.ReceiverPorts.PASpdHigh.Cnt_u08 /end MEASUREMENT
/begin MEASUREMENT ParkAssistEnable.PendEnable.Cnt_lgc "MICROSAR RTE" UBYTE RTE_CM_BOOLEAN 0 0 0 255 ECU_ADDRESS 0 SYMBOL_LINK "Rte_CDDInterface9_OscTrajEnable_Cnt_lgc" 0 DISPLAY_IDENTIFIER ParkAssistEnable.ReceiverPorts.PendEnable.Cnt_lgc /end MEASUREMENT
/begin MEASUREMENT ParkAssistEnable.PendHwAngle.HwDeg_f32 "MICROSAR RTE" FLOAT32_IEEE NO_COMPU_METHOD 0 0 1.175494351e-38 3.402823466e+38 ECU_ADDRESS 0 SYMBOL_LINK "Rte_OscTraj_OscillateHwAngle_HwDeg_f32" 0 DISPLAY_IDENTIFIER ParkAssistEnable.ReceiverPorts.PendHwAngle.HwDeg_f32 /end MEASUREMENT
/begin MEASUREMENT ParkAssistEnable.PosServEnable.Cnt_lgc "MICROSAR RTE" UBYTE RTE_CM_BOOLEAN 0 0 0 255 ECU_ADDRESS 0 SYMBOL_LINK "Rte_ParkAssistEnable_PosServEnable_Cnt_lgc" 0 DISPLAY_IDENTIFIER ParkAssistEnable.SenderPorts.PosServEnable.Cnt_lgc /end MEASUREMENT
/begin MEASUREMENT ParkAssistEnable.PosServoHwAngle.HwDeg_f32 "MICROSAR RTE" FLOAT32_IEEE NO_COMPU_METHOD 0 0 1.175494351e-38 3.402823466e+38 ECU_ADDRESS 0 SYMBOL_LINK "Rte_ParkAssistEnable_PosServoHwAngle_HwDeg_f32" 0 DISPLAY_IDENTIFIER ParkAssistEnable.SenderPorts.PosServoHwAngle.HwDeg_f32 /end MEASUREMENT
/begin MEASUREMENT ParkAssistEnable.PosTrajEnable.Cnt_lgc "MICROSAR RTE" UBYTE RTE_CM_BOOLEAN 0 0 0 255 ECU_ADDRESS 0 SYMBOL_LINK "Rte_CDDInterface9_PosTrajEnable_Cnt_lgc" 0 DISPLAY_IDENTIFIER ParkAssistEnable.ReceiverPorts.PosTrajEnable.Cnt_lgc /end MEASUREMENT
/begin MEASUREMENT ParkAssistEnable.PosTrajHwAngle.HwDeg_f32 "MICROSAR RTE" FLOAT32_IEEE NO_COMPU_METHOD 0 0 1.175494351e-38 3.402823466e+38 ECU_ADDRESS 0 SYMBOL_LINK "Rte_GenPosTraj_PosTrajHwAngle_HwDeg_f32" 0 DISPLAY_IDENTIFIER ParkAssistEnable.ReceiverPorts.PosTrajHwAngle.HwDeg_f32 /end MEASUREMENT
/begin MEASUREMENT ParkAssistEnable.PrkAssistState.Cnt_u08 "MICROSAR RTE" UBYTE RTE_CM_ENUM_QU_SER_WSTA_EST_FTAX 0 0 0 255 ECU_ADDRESS 0 SYMBOL_LINK "Rte_ParkAssistEnable_PrkAssistState_Cnt_u08" 0 DISPLAY_IDENTIFIER ParkAssistEnable.SenderPorts.PrkAssistState.Cnt_u08 /end MEASUREMENT
/begin MEASUREMENT ParkAssistEnable.SystemState.Mode "MICROSAR RTE" UBYTE RTE_CM_ENUM_StaMd_Mode 0 0 0 255 ECU_ADDRESS 0 SYMBOL_LINK "Rte_ModeMachine_StaMd7_SystemState7_Mode" 0 DISPLAY_IDENTIFIER ParkAssistEnable.ModeRequirePorts.SystemState.Mode /end MEASUREMENT
/begin MEASUREMENT PhaseCtrl.MRFMtrVel.MtrRadpS_f32 "MICROSAR RTE" FLOAT32_IEEE NO_COMPU_METHOD 0 0 1.175494351e-38 3.402823466e+38 ECU_ADDRESS 0 SYMBOL_LINK "Rte_MtrVel_MRFMotorVel_MtrRadpS_f32" 0 DISPLAY_IDENTIFIER PhaseCtrl.ReceiverPorts.MRFMtrVel.MtrRadpS_f32 /end MEASUREMENT
/begin MEASUREMENT PhaseCtrl.MtrQuad.Cnt_u08 "MICROSAR RTE" UBYTE NO_COMPU_METHOD 0 0 0 255 ECU_ADDRESS 0 SYMBOL_LINK "Rte_QuadDet_MtrQuad_Cnt_u08" 0 DISPLAY_IDENTIFIER PhaseCtrl.ReceiverPorts.MtrQuad.Cnt_u08 /end MEASUREMENT
/begin MEASUREMENT PhaseCtrl.TermA.Volt_f32 "This signal is intended to communicate any type voltage signal measured by the ecu.  This signal has a lower limit of 0 which reequires users of the signal to provide divide by 0 protection if it is used as a denominator in a calculation.  See Vecu port p" FLOAT32_IEEE NO_COMPU_METHOD 0 0 1.175494351e-38 3.402823466e+38 ECU_ADDRESS 0 SYMBOL_LINK "Rte_VltgCtrl_TermA_Volt_f32" 0 DISPLAY_IDENTIFIER PhaseCtrl.ReceiverPorts.TermA.Volt_f32 /end MEASUREMENT
/begin MEASUREMENT PhaseCtrl.TermBSS.Volt_f32 "This signal is intended to communicate any type voltage signal measured by the ecu.  This signal has a lower limit of 0 which reequires users of the signal to provide divide by 0 protection if it is used as a denominator in a calculation.  See Vecu port p" FLOAT32_IEEE NO_COMPU_METHOD 0 0 1.175494351e-38 3.402823466e+38 ECU_ADDRESS 0 SYMBOL_LINK "Rte_VltgCtrl_TermBSS_Volt_f32" 0 DISPLAY_IDENTIFIER PhaseCtrl.ReceiverPorts.TermBSS.Volt_f32 /end MEASUREMENT
/begin MEASUREMENT PhaseCtrl.TermBTOT.Volt_f32 "This signal is intended to communicate any type voltage signal measured by the ecu.  This signal has a lower limit of 0 which reequires users of the signal to provide divide by 0 protection if it is used as a denominator in a calculation.  See Vecu port p" FLOAT32_IEEE NO_COMPU_METHOD 0 0 1.175494351e-38 3.402823466e+38 ECU_ADDRESS 0 SYMBOL_LINK "Rte_VltgCtrl_TermBTOT_Volt_f32" 0 DISPLAY_IDENTIFIER PhaseCtrl.ReceiverPorts.TermBTOT.Volt_f32 /end MEASUREMENT
/begin MEASUREMENT PhaseCtrl.TermXd.Uls_f32 "MICROSAR RTE" FLOAT32_IEEE NO_COMPU_METHOD 0 0 1.175494351e-38 3.402823466e+38 ECU_ADDRESS 0 SYMBOL_LINK "Rte_VltgCtrl_TermXd_Uls_f32" 0 DISPLAY_IDENTIFIER PhaseCtrl.ReceiverPorts.TermXd.Uls_f32 /end MEASUREMENT
/begin MEASUREMENT PhaseCtrl.TermXq.Uls_f32 "MICROSAR RTE" FLOAT32_IEEE NO_COMPU_METHOD 0 0 1.175494351e-38 3.402823466e+38 ECU_ADDRESS 0 SYMBOL_LINK "Rte_VltgCtrl_TermXq_Uls_f32" 0 DISPLAY_IDENTIFIER PhaseCtrl.ReceiverPorts.TermXq.Uls_f32 /end MEASUREMENT
/begin MEASUREMENT PhaseCtrl.TermY.Uls_f32 "MICROSAR RTE" FLOAT32_IEEE NO_COMPU_METHOD 0 0 1.175494351e-38 3.402823466e+38 ECU_ADDRESS 0 SYMBOL_LINK "Rte_VltgCtrl_TermY_Uls_f32" 0 DISPLAY_IDENTIFIER PhaseCtrl.ReceiverPorts.TermY.Uls_f32 /end MEASUREMENT
/begin MEASUREMENT PhaseCtrl.VdTerm.Volt_f32 "This signal is intended to communicate any type voltage signal measured by the ecu.  This signal has a lower limit of 0 which reequires users of the signal to provide divide by 0 protection if it is used as a denominator in a calculation.  See Vecu port p" FLOAT32_IEEE NO_COMPU_METHOD 0 0 1.175494351e-38 3.402823466e+38 ECU_ADDRESS 0 SYMBOL_LINK "Rte_VltgCtrl_VdTerm_Volt_f32" 0 DISPLAY_IDENTIFIER PhaseCtrl.ReceiverPorts.VdTerm.Volt_f32 /end MEASUREMENT
/begin MEASUREMENT PhaseCtrl.VqTerm.Volt_f32 "This signal is intended to communicate any type voltage signal measured by the ecu.  This signal has a lower limit of 0 which reequires users of the signal to provide divide by 0 protection if it is used as a denominator in a calculation.  See Vecu port p" FLOAT32_IEEE NO_COMPU_METHOD 0 0 1.175494351e-38 3.402823466e+38 ECU_ADDRESS 0 SYMBOL_LINK "Rte_VltgCtrl_VqTerm_Volt_f32" 0 DISPLAY_IDENTIFIER PhaseCtrl.ReceiverPorts.VqTerm.Volt_f32 /end MEASUREMENT
/begin MEASUREMENT PhaseDscnt.MotorQuadrant.Cnt_u08 "MICROSAR RTE" UBYTE NO_COMPU_METHOD 0 0 0 255 ECU_ADDRESS 0 SYMBOL_LINK "Rte_QuadDet_MtrQuad_Cnt_u08" 0 DISPLAY_IDENTIFIER PhaseDscnt.ReceiverPorts.MotorQuadrant.Cnt_u08 /end MEASUREMENT
/begin MEASUREMENT PhaseDscnt.MotorVelMRF.MtrRadpS_f32 "MICROSAR RTE" FLOAT32_IEEE NO_COMPU_METHOD 0 0 1.175494351e-38 3.402823466e+38 ECU_ADDRESS 0 SYMBOL_LINK "Rte_MtrVel_MRFMotorVel_MtrRadpS_f32" 0 DISPLAY_IDENTIFIER PhaseDscnt.ReceiverPorts.MotorVelMRF.MtrRadpS_f32 /end MEASUREMENT
/begin MEASUREMENT PhaseDscnt.PDActivateTest.Cnt_lgc "MICROSAR RTE" UBYTE RTE_CM_BOOLEAN 0 0 0 255 ECU_ADDRESS 0 SYMBOL_LINK "Rte_PhaseDscnt_PDActivateTest_Cnt_lgc" 0 DISPLAY_IDENTIFIER PhaseDscnt.SenderPorts.PDActivateTest.Cnt_lgc /end MEASUREMENT
/begin MEASUREMENT PhaseDscnt.PDChrgPmpFdbkADC.Volt_f32 "This signal is intended to communicate any type voltage signal measured by the ecu.  This signal has a lower limit of 0 which reequires users of the signal to provide divide by 0 protection if it is used as a denominator in a calculation.  See Vecu port p" FLOAT32_IEEE NO_COMPU_METHOD 0 0 1.175494351e-38 3.402823466e+38 ECU_ADDRESS 0 SYMBOL_LINK "Rte_IoHwAb7_PDChrgPmpFdbkADC_Volt_f32" 0 DISPLAY_IDENTIFIER PhaseDscnt.ReceiverPorts.PDChrgPmpFdbkADC.Volt_f32 /end MEASUREMENT
/begin MEASUREMENT PhaseDscnt.PDPhaseAdvSelect.Cnt_s16 "MICROSAR RTE" SWORD NO_COMPU_METHOD 0 0 -32768 32767 ECU_ADDRESS 0 SYMBOL_LINK "Rte_PhaseDscnt_PDPhaseAdvSelect_Cnt_s16" 0 DISPLAY_IDENTIFIER PhaseDscnt.SenderPorts.PDPhaseAdvSelect.Cnt_s16 /end MEASUREMENT
/begin MEASUREMENT PhaseDscnt.PDSuplFdbkADC.Volt_f32 "This signal is intended to communicate any type voltage signal measured by the ecu.  This signal has a lower limit of 0 which reequires users of the signal to provide divide by 0 protection if it is used as a denominator in a calculation.  See Vecu port p" FLOAT32_IEEE NO_COMPU_METHOD 0 0 1.175494351e-38 3.402823466e+38 ECU_ADDRESS 0 SYMBOL_LINK "Rte_IoHwAb7_PDSuplFdbkADC_Volt_f32" 0 DISPLAY_IDENTIFIER PhaseDscnt.ReceiverPorts.PDSuplFdbkADC.Volt_f32 /end MEASUREMENT
/begin MEASUREMENT PhaseDscnt.PDTestModIndex.Uls_f32 "MICROSAR RTE" FLOAT32_IEEE NO_COMPU_METHOD 0 0 1.175494351e-38 3.402823466e+38 ECU_ADDRESS 0 SYMBOL_LINK "Rte_PhaseDscnt_PDTestModIndex_Uls_f32" 0 DISPLAY_IDENTIFIER PhaseDscnt.SenderPorts.PDTestModIndex.Uls_f32 /end MEASUREMENT
/begin MEASUREMENT PhaseDscnt.PhsDiscTestComplete.Cnt_lgc "MICROSAR RTE" UBYTE RTE_CM_BOOLEAN 0 0 0 255 ECU_ADDRESS 0 SYMBOL_LINK "Rte_PhaseDscnt_PhsDiscTestComplete_Cnt_lgc" 0 DISPLAY_IDENTIFIER PhaseDscnt.SenderPorts.PhsDiscTestComplete.Cnt_lgc /end MEASUREMENT
/begin MEASUREMENT PhaseDscnt.RawCurrFiltered.Amp_f32 "MICROSAR RTE" FLOAT32_IEEE NO_COMPU_METHOD 0 0 1.175494351e-38 3.402823466e+38 ECU_ADDRESS 0 SYMBOL_LINK "Rte_MtrCurr_RawCurrFiltered_Amp_f32" 0 DISPLAY_IDENTIFIER PhaseDscnt.ReceiverPorts.RawCurrFiltered.Amp_f32 /end MEASUREMENT
/begin MEASUREMENT PhaseDscnt.SystemState.Mode "MICROSAR RTE" UBYTE RTE_CM_ENUM_StaMd_Mode 0 0 0 255 ECU_ADDRESS 0 SYMBOL_LINK "Rte_ModeMachine_StaMd_SystemState_Mode" 0 DISPLAY_IDENTIFIER PhaseDscnt.ModeRequirePorts.SystemState.Mode /end MEASUREMENT
/begin MEASUREMENT Polarity.AssistAssyPolarity.Cnt_s08 "MICROSAR RTE" SBYTE NO_COMPU_METHOD 0 0 -128 127 ECU_ADDRESS 0 SYMBOL_LINK "Rte_Polarity_AssistAssyPolarity_Cnt_s08" 0 DISPLAY_IDENTIFIER Polarity.SenderPorts.AssistAssyPolarity.Cnt_s08 /end MEASUREMENT
/begin MEASUREMENT Polarity.HwPosPolarity.Cnt_s08 "MICROSAR RTE" SBYTE NO_COMPU_METHOD 0 0 -128 127 ECU_ADDRESS 0 SYMBOL_LINK "Rte_Polarity_HwPosPolarity_Cnt_s08" 0 DISPLAY_IDENTIFIER Polarity.SenderPorts.HwPosPolarity.Cnt_s08 /end MEASUREMENT
/begin MEASUREMENT Polarity.HwTrqPolarity.Cnt_s08 "MICROSAR RTE" SBYTE NO_COMPU_METHOD 0 0 -128 127 ECU_ADDRESS 0 SYMBOL_LINK "Rte_Polarity_HwTrqPolarity_Cnt_s08" 0 DISPLAY_IDENTIFIER Polarity.SenderPorts.HwTrqPolarity.Cnt_s08 /end MEASUREMENT
/begin MEASUREMENT Polarity.MtrElecMechPolarity.Cnt_s08 "MICROSAR RTE" SBYTE NO_COMPU_METHOD 0 0 -128 127 ECU_ADDRESS 0 SYMBOL_LINK "Rte_Polarity_MtrElecMechPolarity_Cnt_s08" 0 DISPLAY_IDENTIFIER Polarity.SenderPorts.MtrElecMechPolarity.Cnt_s08 /end MEASUREMENT
/begin MEASUREMENT Polarity.MtrPosPolarity.Cnt_s08 "MICROSAR RTE" SBYTE NO_COMPU_METHOD 0 0 -128 127 ECU_ADDRESS 0 SYMBOL_LINK "Rte_Polarity_MtrPosPolarity_Cnt_s08" 0 DISPLAY_IDENTIFIER Polarity.SenderPorts.MtrPosPolarity.Cnt_s08 /end MEASUREMENT
/begin MEASUREMENT Polarity.MtrVelPolarity.Cnt_s08 "MICROSAR RTE" SBYTE NO_COMPU_METHOD 0 0 -128 127 ECU_ADDRESS 0 SYMBOL_LINK "Rte_Polarity_MtrVelPolarity_Cnt_s08" 0 DISPLAY_IDENTIFIER Polarity.SenderPorts.MtrVelPolarity.Cnt_s08 /end MEASUREMENT
/begin MEASUREMENT Polarity.SysC_MtrElecMechPolarity.Cnt_s32 "MICROSAR RTE" SLONG NO_COMPU_METHOD 0 0 -2147483648 2147483647 ECU_ADDRESS 0 SYMBOL_LINK "Rte_Polarity_SysC_MtrElecMechPolarity_Cnt_s32" 0 DISPLAY_IDENTIFIER Polarity.SenderPorts.SysC_MtrElecMechPolarity.Cnt_s32 /end MEASUREMENT
/begin MEASUREMENT Polarity.k_SystemPolarity_Cnt_b16 "MICROSAR RTE" UWORD NO_COMPU_METHOD 0 0 0 65535 ECU_ADDRESS 0 SYMBOL_LINK "Rte_Polarity_k_SystemPolarity_Cnt_b16" 0 DISPLAY_IDENTIFIER Polarity.PerInstanceMemories.k_SystemPolarity_Cnt_b16 READ_WRITE /end MEASUREMENT
/begin MEASUREMENT PosServo.HandwheelPosition.HwDeg_f32 "MICROSAR RTE" FLOAT32_IEEE NO_COMPU_METHOD 0 0 1.175494351e-38 3.402823466e+38 ECU_ADDRESS 0 SYMBOL_LINK "Rte_AbsHwPos_HandwheelPosition_HwDeg_f32" 0 DISPLAY_IDENTIFIER PosServo.ReceiverPorts.HandwheelPosition.HwDeg_f32 /end MEASUREMENT
/begin MEASUREMENT PosServo.HwTorque.HwNm_f32 "MICROSAR RTE" FLOAT32_IEEE NO_COMPU_METHOD 0 0 1.175494351e-38 3.402823466e+38 ECU_ADDRESS 0 SYMBOL_LINK "Rte_Sweep_OutputHwTrq_HwNm_f32" 0 DISPLAY_IDENTIFIER PosServo.ReceiverPorts.HwTorque.HwNm_f32 /end MEASUREMENT
/begin MEASUREMENT PosServo.MotorVelCRF.MtrRadpS_f32 "MICROSAR RTE" FLOAT32_IEEE NO_COMPU_METHOD 0 0 1.175494351e-38 3.402823466e+38 ECU_ADDRESS 0 SYMBOL_LINK "Rte_MtrVel_CRFMotorVel_MtrRadpS_f32" 0 DISPLAY_IDENTIFIER PosServo.ReceiverPorts.MotorVelCRF.MtrRadpS_f32 /end MEASUREMENT
/begin MEASUREMENT PosServo.PosSrvoCmd.MtrNm_f32 "MICROSAR RTE" FLOAT32_IEEE NO_COMPU_METHOD 0 0 1.175494351e-38 3.402823466e+38 ECU_ADDRESS 0 SYMBOL_LINK "Rte_PosServo_PosSrvoCmd_MtrNm_f32" 0 DISPLAY_IDENTIFIER PosServo.SenderPorts.PosSrvoCmd.MtrNm_f32 /end MEASUREMENT
/begin MEASUREMENT PosServo.PosSrvoEnable.Cnt_lgc "MICROSAR RTE" UBYTE RTE_CM_BOOLEAN 0 0 0 255 ECU_ADDRESS 0 SYMBOL_LINK "Rte_ParkAssistEnable_PosServEnable_Cnt_lgc" 0 DISPLAY_IDENTIFIER PosServo.ReceiverPorts.PosSrvoEnable.Cnt_lgc /end MEASUREMENT
/begin MEASUREMENT PosServo.PosSrvoHwAngle.HwDeg_f32 "MICROSAR RTE" FLOAT32_IEEE NO_COMPU_METHOD 0 0 1.175494351e-38 3.402823466e+38 ECU_ADDRESS 0 SYMBOL_LINK "Rte_ParkAssistEnable_PosServoHwAngle_HwDeg_f32" 0 DISPLAY_IDENTIFIER PosServo.ReceiverPorts.PosSrvoHwAngle.HwDeg_f32 /end MEASUREMENT
/begin MEASUREMENT PosServo.PosSrvoReturnSclFct.Uls_f32 "MICROSAR RTE" FLOAT32_IEEE NO_COMPU_METHOD 0 0 1.175494351e-38 3.402823466e+38 ECU_ADDRESS 0 SYMBOL_LINK "Rte_PosServo_PosSrvoReturnSclFct_Uls_f32" 0 DISPLAY_IDENTIFIER PosServo.SenderPorts.PosSrvoReturnSclFct.Uls_f32 /end MEASUREMENT
/begin MEASUREMENT PosServo.PosSrvoSmoothEnable.Uls_f32 "MICROSAR RTE" FLOAT32_IEEE NO_COMPU_METHOD 0 0 1.175494351e-38 3.402823466e+38 ECU_ADDRESS 0 SYMBOL_LINK "Rte_PosServo_PosSrvoSmoothEnable_Uls_f32" 0 DISPLAY_IDENTIFIER PosServo.SenderPorts.PosSrvoSmoothEnable.Uls_f32 /end MEASUREMENT
/begin MEASUREMENT PosServo.VehicleSpeed.Kph_f32 "MICROSAR RTE" FLOAT32_IEEE NO_COMPU_METHOD 0 0 1.175494351e-38 3.402823466e+38 ECU_ADDRESS 0 SYMBOL_LINK "Rte_SignlCondn_VehicleSpeed_Kph_f32" 0 DISPLAY_IDENTIFIER PosServo.ReceiverPorts.VehicleSpeed.Kph_f32 /end MEASUREMENT
/begin MEASUREMENT PrimaryShutdown.SystemState.Mode "MICROSAR RTE" UBYTE RTE_CM_ENUM_StaMd_Mode 0 0 0 255 ECU_ADDRESS 0 SYMBOL_LINK "Rte_ModeMachine_StaMd9_SystemState9_Mode" 0 DISPLAY_IDENTIFIER PrimaryShutdown.ModeRequirePorts.SystemState.Mode /end MEASUREMENT
/begin MEASUREMENT PrkAstMfgServCh2.LrnPnCntrCmd.MtrNm_f32 "MICROSAR RTE" FLOAT32_IEEE NO_COMPU_METHOD 0 0 1.175494351e-38 3.402823466e+38 ECU_ADDRESS 0 SYMBOL_LINK "Rte_LktoLkStr_LrnPnCntrCmd_MtrNm_f32" 0 DISPLAY_IDENTIFIER PrkAstMfgServCh2.ReceiverPorts.LrnPnCntrCmd.MtrNm_f32 /end MEASUREMENT
/begin MEASUREMENT PrkAstMfgServCh2.LrnPnCntrEnable.Cnt_lgc "MICROSAR RTE" UBYTE RTE_CM_BOOLEAN 0 0 0 255 ECU_ADDRESS 0 SYMBOL_LINK "Rte_CDDInterface9_LrnPnCenterEnable_Cnt_lgc" 0 DISPLAY_IDENTIFIER PrkAstMfgServCh2.ReceiverPorts.LrnPnCntrEnable.Cnt_lgc /end MEASUREMENT
/begin MEASUREMENT PrkAstMfgServCh2.PASpdHigh.Cnt_u08 "MICROSAR RTE" UBYTE RTE_CM_ENUM_ST_V_VEH_NSS 0 0 0 15 ECU_ADDRESS 0 SYMBOL_LINK "Rte_SrlComInput2_SrlComVehNearStandstill_Cnt_u08" 0 DISPLAY_IDENTIFIER PrkAstMfgServCh2.ReceiverPorts.PASpdHigh.Cnt_u08 /end MEASUREMENT
/begin MEASUREMENT PrkAstMfgServCh2.PosServEnable.Cnt_lgc "MICROSAR RTE" UBYTE RTE_CM_BOOLEAN 0 0 0 255 ECU_ADDRESS 0 SYMBOL_LINK "Rte_ParkAssistEnable_PosServEnable_Cnt_lgc" 0 DISPLAY_IDENTIFIER PrkAstMfgServCh2.ReceiverPorts.PosServEnable.Cnt_lgc /end MEASUREMENT
/begin MEASUREMENT PrkAstMfgServCh2.PosSrvoSmoothEnable.Uls_f32 "MICROSAR RTE" FLOAT32_IEEE NO_COMPU_METHOD 0 0 1.175494351e-38 3.402823466e+38 ECU_ADDRESS 0 SYMBOL_LINK "Rte_PosServo_PosSrvoSmoothEnable_Uls_f32" 0 DISPLAY_IDENTIFIER PrkAstMfgServCh2.ReceiverPorts.PosSrvoSmoothEnable.Uls_f32 /end MEASUREMENT
/begin MEASUREMENT PrkAstMfgServCh2.PrkAssistCmd.MtrNm_f32 "MICROSAR RTE" FLOAT32_IEEE NO_COMPU_METHOD 0 0 1.175494351e-38 3.402823466e+38 ECU_ADDRESS 0 SYMBOL_LINK "Rte_PosServo_PosSrvoCmd_MtrNm_f32" 0 DISPLAY_IDENTIFIER PrkAstMfgServCh2.ReceiverPorts.PrkAssistCmd.MtrNm_f32 /end MEASUREMENT
/begin MEASUREMENT PrkAstMfgServCh2.SysCLnPnCtrCCDisable.Cnt_lgc "MICROSAR RTE" UBYTE RTE_CM_BOOLEAN 0 0 0 255 ECU_ADDRESS 0 SYMBOL_LINK "Rte_PrkAstMfgServCh2_SysCLnPnCtrCCDisable_Cnt_lgc" 0 DISPLAY_IDENTIFIER PrkAstMfgServCh2.SenderPorts.SysCLnPnCtrCCDisable.Cnt_lgc /end MEASUREMENT
/begin MEASUREMENT PrkAstMfgServCh2.SysCPosServCCDisable.Cnt_lgc "MICROSAR RTE" UBYTE RTE_CM_BOOLEAN 0 0 0 255 ECU_ADDRESS 0 SYMBOL_LINK "Rte_PrkAstMfgServCh2_SysCPosServCCDisable_Cnt_lgc" 0 DISPLAY_IDENTIFIER PrkAstMfgServCh2.SenderPorts.SysCPosServCCDisable.Cnt_lgc /end MEASUREMENT
/begin MEASUREMENT PrkAstMfgServCh2.VehicleSpeed.Kph_f32 "MICROSAR RTE" FLOAT32_IEEE NO_COMPU_METHOD 0 0 1.175494351e-38 3.402823466e+38 ECU_ADDRESS 0 SYMBOL_LINK "Rte_SignlCondn_VehicleSpeed_Kph_f32" 0 DISPLAY_IDENTIFIER PrkAstMfgServCh2.ReceiverPorts.VehicleSpeed.Kph_f32 /end MEASUREMENT
/begin GROUP HystComp.ReceiverPorts "MICROSAR RTE"
 /begin SUB_GROUP HystComp.AssistMechTempEst.DegC_f32 HystComp.BaseAssistCmd.MtrNm_f32 HystComp.DefeatHystService.Cnt_lgc HystComp.FricOffset.HwNm_f32 HystComp.HwTorque.HwNm_f32 HystComp.VehicleSpeed.Kph_f32 HystComp.WIRCmdAmpBlnd.MtrNm_f32 /end SUB_GROUP
 /begin FUNCTION_LIST /end FUNCTION_LIST
 /begin REF_CHARACTERISTIC /end REF_CHARACTERISTIC
 /begin REF_MEASUREMENT /end REF_MEASUREMENT
/end GROUP
/begin GROUP HystComp.SenderPorts "MICROSAR RTE" /begin SUB_GROUP HystComp.HysteresisComp.MtrNm_f32 /end SUB_GROUP /begin FUNCTION_LIST /end FUNCTION_LIST /begin REF_CHARACTERISTIC /end REF_CHARACTERISTIC /begin REF_MEASUREMENT /end REF_MEASUREMENT /end GROUP
/begin GROUP HystComp.VehicleSpeed.Kph_f32 "MICROSAR RTE" /begin SUB_GROUP /end SUB_GROUP /begin FUNCTION_LIST /end FUNCTION_LIST /begin REF_CHARACTERISTIC /end REF_CHARACTERISTIC /begin REF_MEASUREMENT HystComp.VehicleSpeed.Kph_f32 /end REF_MEASUREMENT /end GROUP
/begin GROUP HystComp.WIRCmdAmpBlnd.MtrNm_f32 "MICROSAR RTE" /begin SUB_GROUP /end SUB_GROUP /begin FUNCTION_LIST /end FUNCTION_LIST /begin REF_CHARACTERISTIC /end REF_CHARACTERISTIC /begin REF_MEASUREMENT HystComp.WIRCmdAmpBlnd.MtrNm_f32 /end REF_MEASUREMENT /end GROUP
/begin GROUP IoHwAb7 "MICROSAR RTE" /begin SUB_GROUP IoHwAb7.SenderPorts /end SUB_GROUP /begin FUNCTION_LIST /end FUNCTION_LIST /begin REF_CHARACTERISTIC /end REF_CHARACTERISTIC /begin REF_MEASUREMENT /end REF_MEASUREMENT /end GROUP
/begin GROUP IoHwAb7.ADCMtrCurr1.Volt_f32 "MICROSAR RTE" /begin SUB_GROUP /end SUB_GROUP /begin FUNCTION_LIST /end FUNCTION_LIST /begin REF_CHARACTERISTIC /end REF_CHARACTERISTIC /begin REF_MEASUREMENT IoHwAb7.ADCMtrCurr1.Volt_f32 /end REF_MEASUREMENT /end GROUP
/begin GROUP IoHwAb7.Batt.Volt_f32 "MICROSAR RTE" /begin SUB_GROUP /end SUB_GROUP /begin FUNCTION_LIST /end FUNCTION_LIST /begin REF_CHARACTERISTIC /end REF_CHARACTERISTIC /begin REF_MEASUREMENT IoHwAb7.Batt.Volt_f32 /end REF_MEASUREMENT /end GROUP
/begin GROUP IoHwAb7.BattSwitched.Volt_f32 "MICROSAR RTE" /begin SUB_GROUP /end SUB_GROUP /begin FUNCTION_LIST /end FUNCTION_LIST /begin REF_CHARACTERISTIC /end REF_CHARACTERISTIC /begin REF_MEASUREMENT IoHwAb7.BattSwitched.Volt_f32 /end REF_MEASUREMENT /end GROUP
/begin GROUP IoHwAb7.InvCos2Scaled.Volt_f32 "MICROSAR RTE" /begin SUB_GROUP /end SUB_GROUP /begin FUNCTION_LIST /end FUNCTION_LIST /begin REF_CHARACTERISTIC /end REF_CHARACTERISTIC /begin REF_MEASUREMENT IoHwAb7.InvCos2Scaled.Volt_f32 /end REF_MEASUREMENT /end GROUP
/begin GROUP IoHwAb7.InvSin2Scaled.Volt_f32 "MICROSAR RTE" /begin SUB_GROUP /end SUB_GROUP /begin FUNCTION_LIST /end FUNCTION_LIST /begin REF_CHARACTERISTIC /end REF_CHARACTERISTIC /begin REF_MEASUREMENT IoHwAb7.InvSin2Scaled.Volt_f32 /end REF_MEASUREMENT /end GROUP
/begin GROUP IoHwAb7.PDChrgPmpFdbkADC.Volt_f32 "MICROSAR RTE" /begin SUB_GROUP /end SUB_GROUP /begin FUNCTION_LIST /end FUNCTION_LIST /begin REF_CHARACTERISTIC /end REF_CHARACTERISTIC /begin REF_MEASUREMENT IoHwAb7.PDChrgPmpFdbkADC.Volt_f32 /end REF_MEASUREMENT /end GROUP
/begin GROUP IoHwAb7.PDSuplFdbkADC.Volt_f32 "MICROSAR RTE" /begin SUB_GROUP /end SUB_GROUP /begin FUNCTION_LIST /end FUNCTION_LIST /begin REF_CHARACTERISTIC /end REF_CHARACTERISTIC /begin REF_MEASUREMENT IoHwAb7.PDSuplFdbkADC.Volt_f32 /end REF_MEASUREMENT /end GROUP
/begin GROUP IoHwAb7.SenderPorts "MICROSAR RTE"
 /begin SUB_GROUP IoHwAb7.ADCMtrCurr1.Volt_f32 IoHwAb7.Batt.Volt_f32 IoHwAb7.BattSwitched.Volt_f32 IoHwAb7.InvCos2Scaled.Volt_f32 IoHwAb7.InvSin2Scaled.Volt_f32 IoHwAb7.PDChrgPmpFdbkADC.Volt_f32 IoHwAb7.PDSuplFdbkADC.Volt_f32 IoHwAb7.SysCT1ADC.Volt_f32 IoHwAb7.SysCT2ADC.Volt_f32 IoHwAb7.SysCVSwitch.Volt_f32 IoHwAb7.T1ADC.Volt_f32 IoHwAb7.T2ADC.Volt_f32 IoHwAb7.TemperatureADC.Volt_f32 /end SUB_GROUP
 /begin FUNCTION_LIST /end FUNCTION_LIST
 /begin REF_CHARACTERISTIC /end REF_CHARACTERISTIC
 /begin REF_MEASUREMENT /end REF_MEASUREMENT
/end GROUP
/begin GROUP IoHwAb7.SysCT1ADC.Volt_f32 "MICROSAR RTE" /begin SUB_GROUP /end SUB_GROUP /begin FUNCTION_LIST /end FUNCTION_LIST /begin REF_CHARACTERISTIC /end REF_CHARACTERISTIC /begin REF_MEASUREMENT IoHwAb7.SysCT1ADC.Volt_f32 /end REF_MEASUREMENT /end GROUP
/begin GROUP IoHwAb7.SysCT2ADC.Volt_f32 "MICROSAR RTE" /begin SUB_GROUP /end SUB_GROUP /begin FUNCTION_LIST /end FUNCTION_LIST /begin REF_CHARACTERISTIC /end REF_CHARACTERISTIC /begin REF_MEASUREMENT IoHwAb7.SysCT2ADC.Volt_f32 /end REF_MEASUREMENT /end GROUP
/begin GROUP IoHwAb7.SysCVSwitch.Volt_f32 "MICROSAR RTE" /begin SUB_GROUP /end SUB_GROUP /begin FUNCTION_LIST /end FUNCTION_LIST /begin REF_CHARACTERISTIC /end REF_CHARACTERISTIC /begin REF_MEASUREMENT IoHwAb7.SysCVSwitch.Volt_f32 /end REF_MEASUREMENT /end GROUP
/begin GROUP IoHwAb7.T1ADC.Volt_f32 "MICROSAR RTE" /begin SUB_GROUP /end SUB_GROUP /begin FUNCTION_LIST /end FUNCTION_LIST /begin REF_CHARACTERISTIC /end REF_CHARACTERISTIC /begin REF_MEASUREMENT IoHwAb7.T1ADC.Volt_f32 /end REF_MEASUREMENT /end GROUP
/begin GROUP IoHwAb7.T2ADC.Volt_f32 "MICROSAR RTE" /begin SUB_GROUP /end SUB_GROUP /begin FUNCTION_LIST /end FUNCTION_LIST /begin REF_CHARACTERISTIC /end REF_CHARACTERISTIC /begin REF_MEASUREMENT IoHwAb7.T2ADC.Volt_f32 /end REF_MEASUREMENT /end GROUP
/begin GROUP IoHwAb7.TemperatureADC.Volt_f32 "MICROSAR RTE" /begin SUB_GROUP /end SUB_GROUP /begin FUNCTION_LIST /end FUNCTION_LIST /begin REF_CHARACTERISTIC /end REF_CHARACTERISTIC /begin REF_MEASUREMENT IoHwAb7.TemperatureADC.Volt_f32 /end REF_MEASUREMENT /end GROUP
/begin GROUP LktoLkStr "MICROSAR RTE" /begin SUB_GROUP LktoLkStr.ReceiverPorts LktoLkStr.SenderPorts /end SUB_GROUP /begin FUNCTION_LIST /end FUNCTION_LIST /begin REF_CHARACTERISTIC /end REF_CHARACTERISTIC /begin REF_MEASUREMENT /end REF_MEASUREMENT /end GROUP
/begin GROUP LktoLkStr.AlignedHwPosition.HwDeg_f32 "MICROSAR RTE" /begin SUB_GROUP /end SUB_GROUP /begin FUNCTION_LIST /end FUNCTION_LIST /begin REF_CHARACTERISTIC /end REF_CHARACTERISTIC /begin REF_MEASUREMENT LktoLkStr.AlignedHwPosition.HwDeg_f32 /end REF_MEASUREMENT /end GROUP
/begin GROUP LktoLkStr.LrnPnCenterEnable.Cnt_lgc "MICROSAR RTE" /begin SUB_GROUP /end SUB_GROUP /begin FUNCTION_LIST /end FUNCTION_LIST /begin REF_CHARACTERISTIC /end REF_CHARACTERISTIC /begin REF_MEASUREMENT LktoLkStr.LrnPnCenterEnable.Cnt_lgc /end REF_MEASUREMENT /end GROUP
/begin GROUP LktoLkStr.LrnPnCntrCmd.MtrNm_f32 "MICROSAR RTE" /begin SUB_GROUP /end SUB_GROUP /begin FUNCTION_LIST /end FUNCTION_LIST /begin REF_CHARACTERISTIC /end REF_CHARACTERISTIC /begin REF_MEASUREMENT LktoLkStr.LrnPnCntrCmd.MtrNm_f32 /end REF_MEASUREMENT /end GROUP
/begin GROUP LktoLkStr.LrnPnCntrHwCenter.HwDeg_f32 "MICROSAR RTE" /begin SUB_GROUP /end SUB_GROUP /begin FUNCTION_LIST /end FUNCTION_LIST /begin REF_CHARACTERISTIC /end REF_CHARACTERISTIC /begin REF_MEASUREMENT LktoLkStr.LrnPnCntrHwCenter.HwDeg_f32 /end REF_MEASUREMENT /end GROUP
/begin GROUP LktoLkStr.LrnPnCntrHwTravel.HwDeg_f32 "MICROSAR RTE" /begin SUB_GROUP /end SUB_GROUP /begin FUNCTION_LIST /end FUNCTION_LIST /begin REF_CHARACTERISTIC /end REF_CHARACTERISTIC /begin REF_MEASUREMENT LktoLkStr.LrnPnCntrHwTravel.HwDeg_f32 /end REF_MEASUREMENT /end GROUP
/begin GROUP LktoLkStr.LrnPnCntrState.Cnt_enum "MICROSAR RTE" /begin SUB_GROUP /end SUB_GROUP /begin FUNCTION_LIST /end FUNCTION_LIST /begin REF_CHARACTERISTIC /end REF_CHARACTERISTIC /begin REF_MEASUREMENT LktoLkStr.LrnPnCntrState.Cnt_enum /end REF_MEASUREMENT /end GROUP
/begin GROUP LktoLkStr.MotorVelCRF.MtrRadpS_f32 "MICROSAR RTE" /begin SUB_GROUP /end SUB_GROUP /begin FUNCTION_LIST /end FUNCTION_LIST /begin REF_CHARACTERISTIC /end REF_CHARACTERISTIC /begin REF_MEASUREMENT LktoLkStr.MotorVelCRF.MtrRadpS_f32 /end REF_MEASUREMENT /end GROUP
/begin GROUP LktoLkStr.ReceiverPorts "MICROSAR RTE"
 /begin SUB_GROUP LktoLkStr.AlignedHwPosition.HwDeg_f32 LktoLkStr.LrnPnCenterEnable.Cnt_lgc LktoLkStr.MotorVelCRF.MtrRadpS_f32 /end SUB_GROUP
 /begin FUNCTION_LIST /end FUNCTION_LIST
 /begin REF_CHARACTERISTIC /end REF_CHARACTERISTIC
 /begin REF_MEASUREMENT /end REF_MEASUREMENT
/end GROUP
/begin GROUP LktoLkStr.SenderPorts "MICROSAR RTE"
 /begin SUB_GROUP LktoLkStr.LrnPnCntrCmd.MtrNm_f32 LktoLkStr.LrnPnCntrHwCenter.HwDeg_f32 LktoLkStr.LrnPnCntrHwTravel.HwDeg_f32 LktoLkStr.LrnPnCntrState.Cnt_enum /end SUB_GROUP
 /begin FUNCTION_LIST /end FUNCTION_LIST
 /begin REF_CHARACTERISTIC /end REF_CHARACTERISTIC
 /begin REF_MEASUREMENT /end REF_MEASUREMENT
/end GROUP
/begin GROUP LmtCod "MICROSAR RTE" /begin SUB_GROUP LmtCod.ReceiverPorts LmtCod.SenderPorts /end SUB_GROUP /begin FUNCTION_LIST /end FUNCTION_LIST /begin REF_CHARACTERISTIC /end REF_CHARACTERISTIC /begin REF_MEASUREMENT /end REF_MEASUREMENT /end GROUP
/begin GROUP LmtCod.AssistEOTGain.Uls_f32 "MICROSAR RTE" /begin SUB_GROUP /end SUB_GROUP /begin FUNCTION_LIST /end FUNCTION_LIST /begin REF_CHARACTERISTIC /end REF_CHARACTERISTIC /begin REF_MEASUREMENT LmtCod.AssistEOTGain.Uls_f32 /end REF_MEASUREMENT /end GROUP
/begin GROUP LmtCod.AssistEOTLimit.MtrNm_f32 "MICROSAR RTE" /begin SUB_GROUP /end SUB_GROUP /begin FUNCTION_LIST /end FUNCTION_LIST /begin REF_CHARACTERISTIC /end REF_CHARACTERISTIC /begin REF_MEASUREMENT LmtCod.AssistEOTLimit.MtrNm_f32 /end REF_MEASUREMENT /end GROUP
/begin GROUP LmtCod.AssistStallLimit.MtrNm_f32 "MICROSAR RTE" /begin SUB_GROUP /end SUB_GROUP /begin FUNCTION_LIST /end FUNCTION_LIST /begin REF_CHARACTERISTIC /end REF_CHARACTERISTIC /begin REF_MEASUREMENT LmtCod.AssistStallLimit.MtrNm_f32 /end REF_MEASUREMENT /end GROUP
/begin GROUP LmtCod.AssistVehSpdLimit.MtrNm_f32 "MICROSAR RTE" /begin SUB_GROUP /end SUB_GROUP /begin FUNCTION_LIST /end FUNCTION_LIST /begin REF_CHARACTERISTIC /end REF_CHARACTERISTIC /begin REF_MEASUREMENT LmtCod.AssistVehSpdLimit.MtrNm_f32 /end REF_MEASUREMENT /end GROUP
/begin GROUP LmtCod.CCLTrqRamp.Uls_f32 "MICROSAR RTE" /begin SUB_GROUP /end SUB_GROUP /begin FUNCTION_LIST /end FUNCTION_LIST /begin REF_CHARACTERISTIC /end REF_CHARACTERISTIC /begin REF_MEASUREMENT LmtCod.CCLTrqRamp.Uls_f32 /end REF_MEASUREMENT /end GROUP
/begin GROUP LmtCod.EOTGainLtd.Uls_f32 "MICROSAR RTE" /begin SUB_GROUP /end SUB_GROUP /begin FUNCTION_LIST /end FUNCTION_LIST /begin REF_CHARACTERISTIC /end REF_CHARACTERISTIC /begin REF_MEASUREMENT LmtCod.EOTGainLtd.Uls_f32 /end REF_MEASUREMENT /end GROUP
/begin GROUP LmtCod.EOTLimitLtd.MtrNm_f32 "MICROSAR RTE" /begin SUB_GROUP /end SUB_GROUP /begin FUNCTION_LIST /end FUNCTION_LIST /begin REF_CHARACTERISTIC /end REF_CHARACTERISTIC /begin REF_MEASUREMENT LmtCod.EOTLimitLtd.MtrNm_f32 /end REF_MEASUREMENT /end GROUP
/begin GROUP LmtCod.OutputRampMult.Uls_f32 "MICROSAR RTE" /begin SUB_GROUP /end SUB_GROUP /begin FUNCTION_LIST /end FUNCTION_LIST /begin REF_CHARACTERISTIC /end REF_CHARACTERISTIC /begin REF_MEASUREMENT LmtCod.OutputRampMult.Uls_f32 /end REF_MEASUREMENT /end GROUP
/begin GROUP LmtCod.OutputRampMultLtd.Uls_f32 "MICROSAR RTE" /begin SUB_GROUP /end SUB_GROUP /begin FUNCTION_LIST /end FUNCTION_LIST /begin REF_CHARACTERISTIC /end REF_CHARACTERISTIC /begin REF_MEASUREMENT LmtCod.OutputRampMultLtd.Uls_f32 /end REF_MEASUREMENT /end GROUP
/begin GROUP LmtCod.ReceiverPorts "MICROSAR RTE"
 /begin SUB_GROUP LmtCod.AssistEOTGain.Uls_f32 LmtCod.AssistEOTLimit.MtrNm_f32 LmtCod.AssistStallLimit.MtrNm_f32 LmtCod.AssistVehSpdLimit.MtrNm_f32 LmtCod.CCLTrqRamp.Uls_f32 LmtCod.OutputRampMult.Uls_f32 LmtCod.ThermalLimit.MtrNm_f32 LmtCod.VehicleSpeed.Kph_f32 /end SUB_GROUP
 /begin FUNCTION_LIST /end FUNCTION_LIST
 /begin REF_CHARACTERISTIC /end REF_CHARACTERISTIC
 /begin REF_MEASUREMENT /end REF_MEASUREMENT
/end GROUP
/begin GROUP LmtCod.SenderPorts "MICROSAR RTE"
 /begin SUB_GROUP LmtCod.EOTGainLtd.Uls_f32 LmtCod.EOTLimitLtd.MtrNm_f32 LmtCod.OutputRampMultLtd.Uls_f32 LmtCod.StallLimitLtd.MtrNm_f32 LmtCod.ThermalLimitLtd.MtrNm_f32 LmtCod.VehSpdLimitLtd.MtrNm_f32 /end SUB_GROUP
 /begin FUNCTION_LIST /end FUNCTION_LIST
 /begin REF_CHARACTERISTIC /end REF_CHARACTERISTIC
 /begin REF_MEASUREMENT /end REF_MEASUREMENT
/end GROUP
/begin GROUP LmtCod.StallLimitLtd.MtrNm_f32 "MICROSAR RTE" /begin SUB_GROUP /end SUB_GROUP /begin FUNCTION_LIST /end FUNCTION_LIST /begin REF_CHARACTERISTIC /end REF_CHARACTERISTIC /begin REF_MEASUREMENT LmtCod.StallLimitLtd.MtrNm_f32 /end REF_MEASUREMENT /end GROUP
/begin GROUP LmtCod.ThermalLimit.MtrNm_f32 "MICROSAR RTE" /begin SUB_GROUP /end SUB_GROUP /begin FUNCTION_LIST /end FUNCTION_LIST /begin REF_CHARACTERISTIC /end REF_CHARACTERISTIC /begin REF_MEASUREMENT LmtCod.ThermalLimit.MtrNm_f32 /end REF_MEASUREMENT /end GROUP
/begin GROUP LmtCod.ThermalLimitLtd.MtrNm_f32 "MICROSAR RTE" /begin SUB_GROUP /end SUB_GROUP /begin FUNCTION_LIST /end FUNCTION_LIST /begin REF_CHARACTERISTIC /end REF_CHARACTERISTIC /begin REF_MEASUREMENT LmtCod.ThermalLimitLtd.MtrNm_f32 /end REF_MEASUREMENT /end GROUP
/begin GROUP LmtCod.VehSpdLimitLtd.MtrNm_f32 "MICROSAR RTE" /begin SUB_GROUP /end SUB_GROUP /begin FUNCTION_LIST /end FUNCTION_LIST /begin REF_CHARACTERISTIC /end REF_CHARACTERISTIC /begin REF_MEASUREMENT LmtCod.VehSpdLimitLtd.MtrNm_f32 /end REF_MEASUREMENT /end GROUP
/begin GROUP LmtCod.VehicleSpeed.Kph_f32 "MICROSAR RTE" /begin SUB_GROUP /end SUB_GROUP /begin FUNCTION_LIST /end FUNCTION_LIST /begin REF_CHARACTERISTIC /end REF_CHARACTERISTIC /begin REF_MEASUREMENT LmtCod.VehicleSpeed.Kph_f32 /end REF_MEASUREMENT /end GROUP
/begin GROUP LnRkCr "MICROSAR RTE"
 /begin SUB_GROUP LnRkCr.PerInstanceMemories LnRkCr.ReceiverPorts LnRkCr.SenderPorts /end SUB_GROUP
 /begin FUNCTION_LIST /end FUNCTION_LIST
 /begin REF_CHARACTERISTIC /end REF_CHARACTERISTIC
 /begin REF_MEASUREMENT /end REF_MEASUREMENT
/end GROUP
/begin GROUP LnRkCr.AlignedHwPos.HwDeg_f32 "MICROSAR RTE" /begin SUB_GROUP /end SUB_GROUP /begin FUNCTION_LIST /end FUNCTION_LIST /begin REF_CHARACTERISTIC /end REF_CHARACTERISTIC /begin REF_MEASUREMENT LnRkCr.AlignedHwPos.HwDeg_f32 /end REF_MEASUREMENT /end GROUP
/begin GROUP LnRkCr.CRFMtrTrqCmd.MtrNm_f32 "MICROSAR RTE" /begin SUB_GROUP /end SUB_GROUP /begin FUNCTION_LIST /end FUNCTION_LIST /begin REF_CHARACTERISTIC /end REF_CHARACTERISTIC /begin REF_MEASUREMENT LnRkCr.CRFMtrTrqCmd.MtrNm_f32 /end REF_MEASUREMENT /end GROUP
/begin GROUP LnRkCr.LTRackCntrComplete.Cnt_lgc "MICROSAR RTE" /begin SUB_GROUP /end SUB_GROUP /begin FUNCTION_LIST /end FUNCTION_LIST /begin REF_CHARACTERISTIC /end REF_CHARACTERISTIC /begin REF_MEASUREMENT LnRkCr.LTRackCntrComplete.Cnt_lgc /end REF_MEASUREMENT /end GROUP
/begin GROUP LnRkCr.LearnedRackCntr "MICROSAR RTE" /begin SUB_GROUP /end SUB_GROUP /begin FUNCTION_LIST /end FUNCTION_LIST /begin REF_CHARACTERISTIC /end REF_CHARACTERISTIC
 /begin REF_MEASUREMENT LnRkCr.LearnedRackCntr.RackCntrComplete_Cnt_lgc LnRkCr.LearnedRackCntr.RackCntrMtrAngleFound_Cnt_lgc LnRkCr.LearnedRackCntr.RackCntrMtrDeg_MtrDeg_f32 LnRkCr.LearnedRackCntr.RackCntrMtrRev_MtrRev_f32 LnRkCr.LearnedRackCntr.TotalRackTravel_HwDeg_f32 /end REF_MEASUREMENT
/end GROUP
/begin GROUP LnRkCr.LrnPnCntrEnable.Cnt_lgc "MICROSAR RTE" /begin SUB_GROUP /end SUB_GROUP /begin FUNCTION_LIST /end FUNCTION_LIST /begin REF_CHARACTERISTIC /end REF_CHARACTERISTIC /begin REF_MEASUREMENT LnRkCr.LrnPnCntrEnable.Cnt_lgc /end REF_MEASUREMENT /end GROUP
/begin GROUP LnRkCr.LrnPnCntrHwCenter.HwDeg_f32 "MICROSAR RTE" /begin SUB_GROUP /end SUB_GROUP /begin FUNCTION_LIST /end FUNCTION_LIST /begin REF_CHARACTERISTIC /end REF_CHARACTERISTIC /begin REF_MEASUREMENT LnRkCr.LrnPnCntrHwCenter.HwDeg_f32 /end REF_MEASUREMENT /end GROUP
/begin GROUP LnRkCr.LrnPnCntrHwTravel.HwDeg_f32 "MICROSAR RTE" /begin SUB_GROUP /end SUB_GROUP /begin FUNCTION_LIST /end FUNCTION_LIST /begin REF_CHARACTERISTIC /end REF_CHARACTERISTIC /begin REF_MEASUREMENT LnRkCr.LrnPnCntrHwTravel.HwDeg_f32 /end REF_MEASUREMENT /end GROUP
/begin GROUP LnRkCr.LrnPnCntrState.Cnt_enum "MICROSAR RTE" /begin SUB_GROUP /end SUB_GROUP /begin FUNCTION_LIST /end FUNCTION_LIST /begin REF_CHARACTERISTIC /end REF_CHARACTERISTIC /begin REF_MEASUREMENT LnRkCr.LrnPnCntrState.Cnt_enum /end REF_MEASUREMENT /end GROUP
/begin GROUP LnRkCr.MtrVelCRF.MtrRadpS_f32 "MICROSAR RTE" /begin SUB_GROUP /end SUB_GROUP /begin FUNCTION_LIST /end FUNCTION_LIST /begin REF_CHARACTERISTIC /end REF_CHARACTERISTIC /begin REF_MEASUREMENT LnRkCr.MtrVelCRF.MtrRadpS_f32 /end REF_MEASUREMENT /end GROUP
/begin GROUP LnRkCr.PerInstanceMemories "MICROSAR RTE" /begin SUB_GROUP LnRkCr.LearnedRackCntr /end SUB_GROUP /begin FUNCTION_LIST /end FUNCTION_LIST /begin REF_CHARACTERISTIC /end REF_CHARACTERISTIC /begin REF_MEASUREMENT /end REF_MEASUREMENT /end GROUP
/begin GROUP LnRkCr.RackCenter.HwDeg_f32 "MICROSAR RTE" /begin SUB_GROUP /end SUB_GROUP /begin FUNCTION_LIST /end FUNCTION_LIST /begin REF_CHARACTERISTIC /end REF_CHARACTERISTIC /begin REF_MEASUREMENT LnRkCr.RackCenter.HwDeg_f32 /end REF_MEASUREMENT /end GROUP
/begin GROUP LnRkCr.RackCntrComplete.Cnt_lgc "MICROSAR RTE" /begin SUB_GROUP /end SUB_GROUP /begin FUNCTION_LIST /end FUNCTION_LIST /begin REF_CHARACTERISTIC /end REF_CHARACTERISTIC /begin REF_MEASUREMENT LnRkCr.RackCntrComplete.Cnt_lgc /end REF_MEASUREMENT /end GROUP
/begin GROUP LnRkCr.RackCntrMtrAngleError.Cnt_lgc "MICROSAR RTE" /begin SUB_GROUP /end SUB_GROUP /begin FUNCTION_LIST /end FUNCTION_LIST /begin REF_CHARACTERISTIC /end REF_CHARACTERISTIC /begin REF_MEASUREMENT LnRkCr.RackCntrMtrAngleError.Cnt_lgc /end REF_MEASUREMENT /end GROUP
/begin GROUP LnRkCr.RackCntrMtrAngleFound.Cnt_lgc "MICROSAR RTE" /begin SUB_GROUP /end SUB_GROUP /begin FUNCTION_LIST /end FUNCTION_LIST /begin REF_CHARACTERISTIC /end REF_CHARACTERISTIC /begin REF_MEASUREMENT LnRkCr.RackCntrMtrAngleFound.Cnt_lgc /end REF_MEASUREMENT /end GROUP
/begin GROUP LnRkCr.ReceiverPorts "MICROSAR RTE"
 /begin SUB_GROUP LnRkCr.AlignedHwPos.HwDeg_f32 LnRkCr.CRFMtrTrqCmd.MtrNm_f32 LnRkCr.LrnPnCntrEnable.Cnt_lgc LnRkCr.LrnPnCntrHwCenter.HwDeg_f32 LnRkCr.LrnPnCntrHwTravel.HwDeg_f32 LnRkCr.LrnPnCntrState.Cnt_enum LnRkCr.MtrVelCRF.MtrRadpS_f32 /end SUB_GROUP
 /begin FUNCTION_LIST /end FUNCTION_LIST
 /begin REF_CHARACTERISTIC /end REF_CHARACTERISTIC
 /begin REF_MEASUREMENT /end REF_MEASUREMENT
/end GROUP
/begin GROUP LnRkCr.SenderPorts "MICROSAR RTE"
 /begin SUB_GROUP LnRkCr.LTRackCntrComplete.Cnt_lgc LnRkCr.RackCenter.HwDeg_f32 LnRkCr.RackCntrComplete.Cnt_lgc LnRkCr.RackCntrMtrAngleError.Cnt_lgc LnRkCr.RackCntrMtrAngleFound.Cnt_lgc /end SUB_GROUP
 /begin FUNCTION_LIST /end FUNCTION_LIST
 /begin REF_CHARACTERISTIC /end REF_CHARACTERISTIC
 /begin REF_MEASUREMENT /end REF_MEASUREMENT
/end GROUP
/begin GROUP LrnEOT "MICROSAR RTE"
 /begin SUB_GROUP LrnEOT.PerInstanceMemories LrnEOT.ReceiverPorts LrnEOT.SenderPorts /end SUB_GROUP
 /begin FUNCTION_LIST /end FUNCTION_LIST
 /begin REF_CHARACTERISTIC /end REF_CHARACTERISTIC
 /begin REF_MEASUREMENT /end REF_MEASUREMENT
/end GROUP
/begin GROUP LrnEOT.CCWFound.Cnt_lgc "MICROSAR RTE" /begin SUB_GROUP /end SUB_GROUP /begin FUNCTION_LIST /end FUNCTION_LIST /begin REF_CHARACTERISTIC /end REF_CHARACTERISTIC /begin REF_MEASUREMENT LrnEOT.CCWFound.Cnt_lgc /end REF_MEASUREMENT /end GROUP
/begin GROUP LrnEOT.CCWPosition.HwDeg_f32 "MICROSAR RTE" /begin SUB_GROUP /end SUB_GROUP /begin FUNCTION_LIST /end FUNCTION_LIST /begin REF_CHARACTERISTIC /end REF_CHARACTERISTIC /begin REF_MEASUREMENT LrnEOT.CCWPosition.HwDeg_f32 /end REF_MEASUREMENT /end GROUP
/begin GROUP LrnEOT.CWFound.Cnt_lgc "MICROSAR RTE" /begin SUB_GROUP /end SUB_GROUP /begin FUNCTION_LIST /end FUNCTION_LIST /begin REF_CHARACTERISTIC /end REF_CHARACTERISTIC /begin REF_MEASUREMENT LrnEOT.CWFound.Cnt_lgc /end REF_MEASUREMENT /end GROUP
/begin GROUP LrnEOT.CWPosition.HwDeg_f32 "MICROSAR RTE" /begin SUB_GROUP /end SUB_GROUP /begin FUNCTION_LIST /end FUNCTION_LIST /begin REF_CHARACTERISTIC /end REF_CHARACTERISTIC /begin REF_MEASUREMENT LrnEOT.CWPosition.HwDeg_f32 /end REF_MEASUREMENT /end GROUP
/begin GROUP LrnEOT.DiagStsHwPosDis.Cnt_lgc "MICROSAR RTE" /begin SUB_GROUP /end SUB_GROUP /begin FUNCTION_LIST /end FUNCTION_LIST /begin REF_CHARACTERISTIC /end REF_CHARACTERISTIC /begin REF_MEASUREMENT LrnEOT.DiagStsHwPosDis.Cnt_lgc /end REF_MEASUREMENT /end GROUP
/begin GROUP LrnEOT.HandwheelAuthority.Uls_f32 "MICROSAR RTE" /begin SUB_GROUP /end SUB_GROUP /begin FUNCTION_LIST /end FUNCTION_LIST /begin REF_CHARACTERISTIC /end REF_CHARACTERISTIC /begin REF_MEASUREMENT LrnEOT.HandwheelAuthority.Uls_f32 /end REF_MEASUREMENT /end GROUP
/begin GROUP LrnEOT.HandwheelPosition.HwDeg_f32 "MICROSAR RTE" /begin SUB_GROUP /end SUB_GROUP /begin FUNCTION_LIST /end FUNCTION_LIST /begin REF_CHARACTERISTIC /end REF_CHARACTERISTIC /begin REF_MEASUREMENT LrnEOT.HandwheelPosition.HwDeg_f32 /end REF_MEASUREMENT /end GROUP
/begin GROUP LrnEOT.HwTorque.HwNm_f32 "MICROSAR RTE" /begin SUB_GROUP /end SUB_GROUP /begin FUNCTION_LIST /end FUNCTION_LIST /begin REF_CHARACTERISTIC /end REF_CHARACTERISTIC /begin REF_MEASUREMENT LrnEOT.HwTorque.HwNm_f32 /end REF_MEASUREMENT /end GROUP
/begin GROUP LrnEOT.LearnedEOT "MICROSAR RTE" /begin SUB_GROUP /end SUB_GROUP /begin FUNCTION_LIST /end FUNCTION_LIST /begin REF_CHARACTERISTIC /end REF_CHARACTERISTIC
 /begin REF_MEASUREMENT LrnEOT.LearnedEOT.CCWEOTFound_Cnt_lgc LrnEOT.LearnedEOT.CCWEOTPosition_HwDeg_f32 LrnEOT.LearnedEOT.CWEOTFound_Cnt_lgc LrnEOT.LearnedEOT.CWEOTPosition_HwDeg_f32 /end REF_MEASUREMENT
/end GROUP
/begin GROUP LrnEOT.MtrVelCRF.MtrRadpS_f32 "MICROSAR RTE" /begin SUB_GROUP /end SUB_GROUP /begin FUNCTION_LIST /end FUNCTION_LIST /begin REF_CHARACTERISTIC /end REF_CHARACTERISTIC /begin REF_MEASUREMENT LrnEOT.MtrVelCRF.MtrRadpS_f32 /end REF_MEASUREMENT /end GROUP
/begin GROUP LrnEOT.PerInstanceMemories "MICROSAR RTE" /begin SUB_GROUP LrnEOT.LearnedEOT /end SUB_GROUP /begin FUNCTION_LIST /end FUNCTION_LIST /begin REF_CHARACTERISTIC /end REF_CHARACTERISTIC /begin REF_MEASUREMENT /end REF_MEASUREMENT /end GROUP
/begin GROUP LrnEOT.PostLimitTorque.MtrNm_f32 "MICROSAR RTE" /begin SUB_GROUP /end SUB_GROUP /begin FUNCTION_LIST /end FUNCTION_LIST /begin REF_CHARACTERISTIC /end REF_CHARACTERISTIC /begin REF_MEASUREMENT LrnEOT.PostLimitTorque.MtrNm_f32 /end REF_MEASUREMENT /end GROUP
/begin GROUP LrnEOT.ReceiverPorts "MICROSAR RTE"
 /begin SUB_GROUP LrnEOT.DiagStsHwPosDis.Cnt_lgc LrnEOT.HandwheelAuthority.Uls_f32 LrnEOT.HandwheelPosition.HwDeg_f32 LrnEOT.HwTorque.HwNm_f32 LrnEOT.MtrVelCRF.MtrRadpS_f32 LrnEOT.PostLimitTorque.MtrNm_f32 /end SUB_GROUP
 /begin FUNCTION_LIST /end FUNCTION_LIST
 /begin REF_CHARACTERISTIC /end REF_CHARACTERISTIC
 /begin REF_MEASUREMENT /end REF_MEASUREMENT
/end GROUP
/begin GROUP LrnEOT.SenderPorts "MICROSAR RTE"
 /begin SUB_GROUP LrnEOT.CCWFound.Cnt_lgc LrnEOT.CCWPosition.HwDeg_f32 LrnEOT.CWFound.Cnt_lgc LrnEOT.CWPosition.HwDeg_f32 /end SUB_GROUP
 /begin FUNCTION_LIST /end FUNCTION_LIST
 /begin REF_CHARACTERISTIC /end REF_CHARACTERISTIC
 /begin REF_MEASUREMENT /end REF_MEASUREMENT
/end GROUP
/begin GROUP MtrCtrlOpConv "MICROSAR RTE" /begin SUB_GROUP MtrCtrlOpConv.ReceiverPorts MtrCtrlOpConv.SenderPorts /end SUB_GROUP /begin FUNCTION_LIST /end FUNCTION_LIST /begin REF_CHARACTERISTIC /end REF_CHARACTERISTIC /begin REF_MEASUREMENT /end REF_MEASUREMENT /end GROUP
/begin GROUP MtrCtrlOpConv.CommutationOffset.Cnt_u16 "MICROSAR RTE" /begin SUB_GROUP /end SUB_GROUP /begin FUNCTION_LIST /end FUNCTION_LIST /begin REF_CHARACTERISTIC /end REF_CHARACTERISTIC /begin REF_MEASUREMENT MtrCtrlOpConv.CommutationOffset.Cnt_u16 /end REF_MEASUREMENT /end GROUP
/begin GROUP MtrCtrlOpConv.CurrentGainSvc.Cnt_b32 "MICROSAR RTE" /begin SUB_GROUP /end SUB_GROUP /begin FUNCTION_LIST /end FUNCTION_LIST /begin REF_CHARACTERISTIC /end REF_CHARACTERISTIC /begin REF_MEASUREMENT MtrCtrlOpConv.CurrentGainSvc.Cnt_b32 /end REF_MEASUREMENT /end GROUP
/begin GROUP MtrCtrlOpConv.DeadTimeComp.Uls_f32 "MICROSAR RTE" /begin SUB_GROUP /end SUB_GROUP /begin FUNCTION_LIST /end FUNCTION_LIST /begin REF_CHARACTERISTIC /end REF_CHARACTERISTIC /begin REF_MEASUREMENT MtrCtrlOpConv.DeadTimeComp.Uls_f32 /end REF_MEASUREMENT /end GROUP
/begin GROUP MtrCtrlOpConv.ModulationIndex.Uls_f32 "MICROSAR RTE" /begin SUB_GROUP /end SUB_GROUP /begin FUNCTION_LIST /end FUNCTION_LIST /begin REF_CHARACTERISTIC /end REF_CHARACTERISTIC /begin REF_MEASUREMENT MtrCtrlOpConv.ModulationIndex.Uls_f32 /end REF_MEASUREMENT /end GROUP
/begin GROUP MtrCtrlOpConv.ModulationIndexFinal.Uls_f32 "MICROSAR RTE" /begin SUB_GROUP /end SUB_GROUP /begin FUNCTION_LIST /end FUNCTION_LIST /begin REF_CHARACTERISTIC /end REF_CHARACTERISTIC /begin REF_MEASUREMENT MtrCtrlOpConv.ModulationIndexFinal.Uls_f32 /end REF_MEASUREMENT /end GROUP
/begin GROUP MtrCtrlOpConv.MtrTrqCmdSign.Cnt_s16 "MICROSAR RTE" /begin SUB_GROUP /end SUB_GROUP /begin FUNCTION_LIST /end FUNCTION_LIST /begin REF_CHARACTERISTIC /end REF_CHARACTERISTIC /begin REF_MEASUREMENT MtrCtrlOpConv.MtrTrqCmdSign.Cnt_s16 /end REF_MEASUREMENT /end GROUP
/begin GROUP MtrCtrlOpConv.PhaseAdvance.Cnt_s16 "MICROSAR RTE" /begin SUB_GROUP /end SUB_GROUP /begin FUNCTION_LIST /end FUNCTION_LIST /begin REF_CHARACTERISTIC /end REF_CHARACTERISTIC /begin REF_MEASUREMENT MtrCtrlOpConv.PhaseAdvance.Cnt_s16 /end REF_MEASUREMENT /end GROUP
/begin GROUP MtrCtrlOpConv.PhaseAdvanceFinal.Cnt_u16 "MICROSAR RTE" /begin SUB_GROUP /end SUB_GROUP /begin FUNCTION_LIST /end FUNCTION_LIST /begin REF_CHARACTERISTIC /end REF_CHARACTERISTIC /begin REF_MEASUREMENT MtrCtrlOpConv.PhaseAdvanceFinal.Cnt_u16 /end REF_MEASUREMENT /end GROUP
/begin GROUP MtrCtrlOpConv.ReceiverPorts "MICROSAR RTE"
 /begin SUB_GROUP MtrCtrlOpConv.CurrentGainSvc.Cnt_b32 MtrCtrlOpConv.ModulationIndex.Uls_f32 MtrCtrlOpConv.PhaseAdvance.Cnt_s16 MtrCtrlOpConv.TorqueCmdMRF.MtrNm_f32 /end SUB_GROUP
 /begin FUNCTION_LIST /end FUNCTION_LIST
 /begin REF_CHARACTERISTIC /end REF_CHARACTERISTIC
 /begin REF_MEASUREMENT /end REF_MEASUREMENT
/end GROUP
/begin GROUP MtrCtrlOpConv.SenderPorts "MICROSAR RTE"
 /begin SUB_GROUP MtrCtrlOpConv.CommutationOffset.Cnt_u16 MtrCtrlOpConv.DeadTimeComp.Uls_f32 MtrCtrlOpConv.ModulationIndexFinal.Uls_f32 MtrCtrlOpConv.MtrTrqCmdSign.Cnt_s16 MtrCtrlOpConv.PhaseAdvanceFinal.Cnt_u16 /end SUB_GROUP
 /begin FUNCTION_LIST /end FUNCTION_LIST
 /begin REF_CHARACTERISTIC /end REF_CHARACTERISTIC
 /begin REF_MEASUREMENT /end REF_MEASUREMENT
/end GROUP
/begin GROUP MtrCtrlOpConv.TorqueCmdMRF.MtrNm_f32 "MICROSAR RTE" /begin SUB_GROUP /end SUB_GROUP /begin FUNCTION_LIST /end FUNCTION_LIST /begin REF_CHARACTERISTIC /end REF_CHARACTERISTIC /begin REF_MEASUREMENT MtrCtrlOpConv.TorqueCmdMRF.MtrNm_f32 /end REF_MEASUREMENT /end GROUP
/begin GROUP MtrCurr "MICROSAR RTE"
 /begin SUB_GROUP MtrCurr.ModeRequirePorts MtrCurr.PerInstanceMemories MtrCurr.ReceiverPorts MtrCurr.SenderPorts /end SUB_GROUP
 /begin FUNCTION_LIST /end FUNCTION_LIST
 /begin REF_CHARACTERISTIC /end REF_CHARACTERISTIC
 /begin REF_MEASUREMENT /end REF_MEASUREMENT
/end GROUP
/begin GROUP MtrCurr.ADCMtrCurr1.Volt_f32 "MICROSAR RTE" /begin SUB_GROUP /end SUB_GROUP /begin FUNCTION_LIST /end FUNCTION_LIST /begin REF_CHARACTERISTIC /end REF_CHARACTERISTIC /begin REF_MEASUREMENT MtrCurr.ADCMtrCurr1.Volt_f32 /end REF_MEASUREMENT /end GROUP
/begin GROUP MtrCurr.CorrectedMtrPos.Rev_f32 "MICROSAR RTE" /begin SUB_GROUP /end SUB_GROUP /begin FUNCTION_LIST /end FUNCTION_LIST /begin REF_CHARACTERISTIC /end REF_CHARACTERISTIC /begin REF_MEASUREMENT MtrCurr.CorrectedMtrPos.Rev_f32 /end REF_MEASUREMENT /end GROUP
/begin GROUP MtrCurr.DutyCycleSmall.Cnt_u16 "MICROSAR RTE" /begin SUB_GROUP /end SUB_GROUP /begin FUNCTION_LIST /end FUNCTION_LIST /begin REF_CHARACTERISTIC /end REF_CHARACTERISTIC /begin REF_MEASUREMENT MtrCurr.DutyCycleSmall.Cnt_u16 /end REF_MEASUREMENT /end GROUP
/begin GROUP MtrCurr.InstantaneousMotorDirection.Cnt_s08 "MICROSAR RTE" /begin SUB_GROUP /end SUB_GROUP /begin FUNCTION_LIST /end FUNCTION_LIST /begin REF_CHARACTERISTIC /end REF_CHARACTERISTIC /begin REF_MEASUREMENT MtrCurr.InstantaneousMotorDirection.Cnt_s08 /end REF_MEASUREMENT /end GROUP
/begin GROUP MtrCurr.ModeRequirePorts "MICROSAR RTE" /begin SUB_GROUP MtrCurr.SystemState.Mode /end SUB_GROUP /begin FUNCTION_LIST /end FUNCTION_LIST /begin REF_CHARACTERISTIC /end REF_CHARACTERISTIC /begin REF_MEASUREMENT /end REF_MEASUREMENT /end GROUP
/begin GROUP MtrCurr.MtrCurrDax.Amp_f32 "MICROSAR RTE" /begin SUB_GROUP /end SUB_GROUP /begin FUNCTION_LIST /end FUNCTION_LIST /begin REF_CHARACTERISTIC /end REF_CHARACTERISTIC /begin REF_MEASUREMENT MtrCurr.MtrCurrDax.Amp_f32 /end REF_MEASUREMENT /end GROUP
/begin GROUP MtrCurr.MtrCurrQax.Amp_f32 "MICROSAR RTE" /begin SUB_GROUP /end SUB_GROUP /begin FUNCTION_LIST /end FUNCTION_LIST /begin REF_CHARACTERISTIC /end REF_CHARACTERISTIC /begin REF_MEASUREMENT MtrCurr.MtrCurrQax.Amp_f32 /end REF_MEASUREMENT /end GROUP
/begin GROUP MtrCurr.PADelta1.Cnt_u16 "MICROSAR RTE" /begin SUB_GROUP /end SUB_GROUP /begin FUNCTION_LIST /end FUNCTION_LIST /begin REF_CHARACTERISTIC /end REF_CHARACTERISTIC /begin REF_MEASUREMENT MtrCurr.PADelta1.Cnt_u16 /end REF_MEASUREMENT /end GROUP
/begin GROUP MtrCurr.PerInstanceMemories "MICROSAR RTE" /begin SUB_GROUP MtrCurr.ShCurrCal /end SUB_GROUP /begin FUNCTION_LIST /end FUNCTION_LIST /begin REF_CHARACTERISTIC /end REF_CHARACTERISTIC /begin REF_MEASUREMENT /end REF_MEASUREMENT /end GROUP
/begin GROUP MtrCurr.RawCurrFiltered.Amp_f32 "MICROSAR RTE" /begin SUB_GROUP /end SUB_GROUP /begin FUNCTION_LIST /end FUNCTION_LIST /begin REF_CHARACTERISTIC /end REF_CHARACTERISTIC /begin REF_MEASUREMENT MtrCurr.RawCurrFiltered.Amp_f32 /end REF_MEASUREMENT /end GROUP
/begin GROUP MtrCurr.ReceiverPorts "MICROSAR RTE"
 /begin SUB_GROUP MtrCurr.ADCMtrCurr1.Volt_f32 MtrCurr.CorrectedMtrPos.Rev_f32 MtrCurr.DutyCycleSmall.Cnt_u16 MtrCurr.InstantaneousMotorDirection.Cnt_s08 MtrCurr.PADelta1.Cnt_u16 /end SUB_GROUP
 /begin FUNCTION_LIST /end FUNCTION_LIST
 /begin REF_CHARACTERISTIC /end REF_CHARACTERISTIC
 /begin REF_MEASUREMENT /end REF_MEASUREMENT
/end GROUP
/begin GROUP MtrCurr.SenderPorts "MICROSAR RTE"
 /begin SUB_GROUP MtrCurr.MtrCurrDax.Amp_f32 MtrCurr.MtrCurrQax.Amp_f32 MtrCurr.RawCurrFiltered.Amp_f32 MtrCurr.ValidSampleFlag.Cnt_lgc /end SUB_GROUP
 /begin FUNCTION_LIST /end FUNCTION_LIST
 /begin REF_CHARACTERISTIC /end REF_CHARACTERISTIC
 /begin REF_MEASUREMENT /end REF_MEASUREMENT
/end GROUP
/begin GROUP MtrCurr.ShCurrCal "MICROSAR RTE" /begin SUB_GROUP /end SUB_GROUP /begin FUNCTION_LIST /end FUNCTION_LIST /begin REF_CHARACTERISTIC /end REF_CHARACTERISTIC
 /begin REF_MEASUREMENT MtrCurr.ShCurrCal.EOLShcurrGain_Uls_f32 MtrCurr.ShCurrCal.EOLShcurrOffset_Volts_f32 /end REF_MEASUREMENT
/end GROUP
/begin GROUP MtrCurr.SystemState.Mode "MICROSAR RTE" /begin SUB_GROUP /end SUB_GROUP /begin FUNCTION_LIST /end FUNCTION_LIST /begin REF_CHARACTERISTIC /end REF_CHARACTERISTIC /begin REF_MEASUREMENT MtrCurr.SystemState.Mode /end REF_MEASUREMENT /end GROUP
/begin GROUP MtrCurr.ValidSampleFlag.Cnt_lgc "MICROSAR RTE" /begin SUB_GROUP /end SUB_GROUP /begin FUNCTION_LIST /end FUNCTION_LIST /begin REF_CHARACTERISTIC /end REF_CHARACTERISTIC /begin REF_MEASUREMENT MtrCurr.ValidSampleFlag.Cnt_lgc /end REF_MEASUREMENT /end GROUP
/begin GROUP MtrDrvDiag "MICROSAR RTE"
 /begin SUB_GROUP MtrDrvDiag.ModeRequirePorts MtrDrvDiag.ReceiverPorts MtrDrvDiag.SenderPorts /end SUB_GROUP
 /begin FUNCTION_LIST /end FUNCTION_LIST
 /begin REF_CHARACTERISTIC /end REF_CHARACTERISTIC
 /begin REF_MEASUREMENT /end REF_MEASUREMENT
/end GROUP
/begin GROUP MtrDrvDiag.FETFaultPhase.Cnt_enum "MICROSAR RTE" /begin SUB_GROUP /end SUB_GROUP /begin FUNCTION_LIST /end FUNCTION_LIST /begin REF_CHARACTERISTIC /end REF_CHARACTERISTIC /begin REF_MEASUREMENT MtrDrvDiag.FETFaultPhase.Cnt_enum /end REF_MEASUREMENT /end GROUP
/begin GROUP MtrDrvDiag.FETFaultType.Cnt_enum "MICROSAR RTE" /begin SUB_GROUP /end SUB_GROUP /begin FUNCTION_LIST /end FUNCTION_LIST /begin REF_CHARACTERISTIC /end REF_CHARACTERISTIC /begin REF_MEASUREMENT MtrDrvDiag.FETFaultType.Cnt_enum /end REF_MEASUREMENT /end GROUP
/begin GROUP MtrDrvDiag.ModeRequirePorts "MICROSAR RTE" /begin SUB_GROUP MtrDrvDiag.SystemState.Mode /end SUB_GROUP /begin FUNCTION_LIST /end FUNCTION_LIST /begin REF_CHARACTERISTIC /end REF_CHARACTERISTIC /begin REF_MEASUREMENT /end REF_MEASUREMENT /end GROUP
/begin GROUP MtrDrvDiag.MtrDrvrInitComplete.Cnt_lgc "MICROSAR RTE" /begin SUB_GROUP /end SUB_GROUP /begin FUNCTION_LIST /end FUNCTION_LIST /begin REF_CHARACTERISTIC /end REF_CHARACTERISTIC /begin REF_MEASUREMENT MtrDrvDiag.MtrDrvrInitComplete.Cnt_lgc /end REF_MEASUREMENT /end GROUP
/begin GROUP MtrDrvDiag.MtrDrvrInitStart.Cnt_lgc "MICROSAR RTE" /begin SUB_GROUP /end SUB_GROUP /begin FUNCTION_LIST /end FUNCTION_LIST /begin REF_CHARACTERISTIC /end REF_CHARACTERISTIC /begin REF_MEASUREMENT MtrDrvDiag.MtrDrvrInitStart.Cnt_lgc /end REF_MEASUREMENT /end GROUP
/begin GROUP MtrDrvDiag.ReceiverPorts "MICROSAR RTE"
 /begin SUB_GROUP MtrDrvDiag.MtrDrvrInitStart.Cnt_lgc MtrDrvDiag.VswitchClosed.Cnt_lgc /end SUB_GROUP
 /begin FUNCTION_LIST /end FUNCTION_LIST
 /begin REF_CHARACTERISTIC /end REF_CHARACTERISTIC
 /begin REF_MEASUREMENT /end REF_MEASUREMENT
/end GROUP
/begin GROUP MtrDrvDiag.SenderPorts "MICROSAR RTE"
 /begin SUB_GROUP MtrDrvDiag.FETFaultPhase.Cnt_enum MtrDrvDiag.FETFaultType.Cnt_enum MtrDrvDiag.MtrDrvrInitComplete.Cnt_lgc /end SUB_GROUP
 /begin FUNCTION_LIST /end FUNCTION_LIST
 /begin REF_CHARACTERISTIC /end REF_CHARACTERISTIC
 /begin REF_MEASUREMENT /end REF_MEASUREMENT
/end GROUP
/begin GROUP MtrDrvDiag.SystemState.Mode "MICROSAR RTE" /begin SUB_GROUP /end SUB_GROUP /begin FUNCTION_LIST /end FUNCTION_LIST /begin REF_CHARACTERISTIC /end REF_CHARACTERISTIC /begin REF_MEASUREMENT MtrDrvDiag.SystemState.Mode /end REF_MEASUREMENT /end GROUP
/begin GROUP MtrDrvDiag.VswitchClosed.Cnt_lgc "MICROSAR RTE" /begin SUB_GROUP /end SUB_GROUP /begin FUNCTION_LIST /end FUNCTION_LIST /begin REF_CHARACTERISTIC /end REF_CHARACTERISTIC /begin REF_MEASUREMENT MtrDrvDiag.VswitchClosed.Cnt_lgc /end REF_MEASUREMENT /end GROUP
/begin GROUP MtrPos "MICROSAR RTE"
 /begin SUB_GROUP MtrPos.PerInstanceMemories MtrPos.ReceiverPorts MtrPos.SenderPorts /end SUB_GROUP
 /begin FUNCTION_LIST /end FUNCTION_LIST
 /begin REF_CHARACTERISTIC /end REF_CHARACTERISTIC
 /begin REF_MEASUREMENT /end REF_MEASUREMENT
/end GROUP
/begin GROUP MtrPos.AlignedCumMtrPosMRF.Deg_f32 "MICROSAR RTE" /begin SUB_GROUP /end SUB_GROUP /begin FUNCTION_LIST /end FUNCTION_LIST /begin REF_CHARACTERISTIC /end REF_CHARACTERISTIC /begin REF_MEASUREMENT MtrPos.AlignedCumMtrPosMRF.Deg_f32 /end REF_MEASUREMENT /end GROUP
/begin GROUP MtrPos.AssistAssemblyPolarity.Cnt_s08 "MICROSAR RTE" /begin SUB_GROUP /end SUB_GROUP /begin FUNCTION_LIST /end FUNCTION_LIST /begin REF_CHARACTERISTIC /end REF_CHARACTERISTIC /begin REF_MEASUREMENT MtrPos.AssistAssemblyPolarity.Cnt_s08 /end REF_MEASUREMENT /end GROUP
/begin GROUP MtrPos.CumMtrPosCRF.Deg_f32 "MICROSAR RTE" /begin SUB_GROUP /end SUB_GROUP /begin FUNCTION_LIST /end FUNCTION_LIST /begin REF_CHARACTERISTIC /end REF_CHARACTERISTIC /begin REF_MEASUREMENT MtrPos.CumMtrPosCRF.Deg_f32 /end REF_MEASUREMENT /end GROUP
/begin GROUP MtrPos.CumMtrPosMRF.Deg_f32 "MICROSAR RTE" /begin SUB_GROUP /end SUB_GROUP /begin FUNCTION_LIST /end FUNCTION_LIST /begin REF_CHARACTERISTIC /end REF_CHARACTERISTIC /begin REF_MEASUREMENT MtrPos.CumMtrPosMRF.Deg_f32 /end REF_MEASUREMENT /end GROUP
/begin GROUP MtrPos.MtrPosSnsr_EOLData "MICROSAR RTE" /begin SUB_GROUP /end SUB_GROUP /begin FUNCTION_LIST /end FUNCTION_LIST /begin REF_CHARACTERISTIC /end REF_CHARACTERISTIC
 /begin REF_MEASUREMENT MtrPos.MtrPosSnsr_EOLData.BEMFCal_Rev_u0p16 MtrPos.MtrPosSnsr_EOLData.Cos1AmpRec_Uls_u3p13 MtrPos.MtrPosSnsr_EOLData.Cos1GainCorr_Uls_u1p15 MtrPos.MtrPosSnsr_EOLData.Cos1OffCorr_Volts_s2p13 MtrPos.MtrPosSnsr_EOLData.Cos1Offset_Volts_u3p13 MtrPos.MtrPosSnsr_EOLData.CosDelta1Rec_Uls_u3p13 MtrPos.MtrPosSnsr_EOLData.CosHarTbl_Cnt_sm6p13 MtrPos.MtrPosSnsr_EOLData.R_BEMFCal_Rev_u0p16 MtrPos.MtrPosSnsr_EOLData.Sin1AmpRec_Uls_u3p13 MtrPos.MtrPosSnsr_EOLData.Sin1GainCorr_Uls_u1p15 MtrPos.MtrPosSnsr_EOLData.Sin1OffCorr_Volts_s2p13 MtrPos.MtrPosSnsr_EOLData.Sin1Offset_Volts_u3p13 MtrPos.MtrPosSnsr_EOLData.SinDelta1_Uls_s2p13 MtrPos.MtrPosSnsr_EOLData.SinHarTbl_Cnt_sm6p13 /end REF_MEASUREMENT
/end GROUP
/begin GROUP MtrPos.PerInstanceMemories "MICROSAR RTE" /begin SUB_GROUP MtrPos.MtrPosSnsr_EOLData /end SUB_GROUP /begin FUNCTION_LIST /end FUNCTION_LIST /begin REF_CHARACTERISTIC /end REF_CHARACTERISTIC /begin REF_MEASUREMENT /end REF_MEASUREMENT /end GROUP
/begin GROUP MtrPos.ReceiverPorts "MICROSAR RTE" /begin SUB_GROUP MtrPos.AssistAssemblyPolarity.Cnt_s08 /end SUB_GROUP /begin FUNCTION_LIST /end FUNCTION_LIST /begin REF_CHARACTERISTIC /end REF_CHARACTERISTIC /begin REF_MEASUREMENT /end REF_MEASUREMENT /end GROUP
/begin GROUP MtrPos.SenderPorts "MICROSAR RTE"
 /begin SUB_GROUP MtrPos.AlignedCumMtrPosMRF.Deg_f32 MtrPos.CumMtrPosCRF.Deg_f32 MtrPos.CumMtrPosMRF.Deg_f32 MtrPos.SysCCumMtrPosCRF.Deg_f32 MtrPos.SysCCumMtrPosMRF.Deg_f32 /end SUB_GROUP
 /begin FUNCTION_LIST /end FUNCTION_LIST
 /begin REF_CHARACTERISTIC /end REF_CHARACTERISTIC
 /begin REF_MEASUREMENT /end REF_MEASUREMENT
/end GROUP
/begin GROUP MtrPos.SysCCumMtrPosCRF.Deg_f32 "MICROSAR RTE" /begin SUB_GROUP /end SUB_GROUP /begin FUNCTION_LIST /end FUNCTION_LIST /begin REF_CHARACTERISTIC /end REF_CHARACTERISTIC /begin REF_MEASUREMENT MtrPos.SysCCumMtrPosCRF.Deg_f32 /end REF_MEASUREMENT /end GROUP
/begin GROUP MtrPos.SysCCumMtrPosMRF.Deg_f32 "MICROSAR RTE" /begin SUB_GROUP /end SUB_GROUP /begin FUNCTION_LIST /end FUNCTION_LIST /begin REF_CHARACTERISTIC /end REF_CHARACTERISTIC /begin REF_MEASUREMENT MtrPos.SysCCumMtrPosMRF.Deg_f32 /end REF_MEASUREMENT /end GROUP
/begin GROUP MtrPos2 "MICROSAR RTE" /begin SUB_GROUP MtrPos2.ReceiverPorts MtrPos2.SenderPorts /end SUB_GROUP /begin FUNCTION_LIST /end FUNCTION_LIST /begin REF_CHARACTERISTIC /end REF_CHARACTERISTIC /begin REF_MEASUREMENT /end REF_MEASUREMENT /end GROUP
/begin GROUP MtrPos2.CorrectedMtrPos.Rev_f32 "MICROSAR RTE" /begin SUB_GROUP /end SUB_GROUP /begin FUNCTION_LIST /end FUNCTION_LIST /begin REF_CHARACTERISTIC /end REF_CHARACTERISTIC /begin REF_MEASUREMENT MtrPos2.CorrectedMtrPos.Rev_f32 /end REF_MEASUREMENT /end GROUP
/begin GROUP MtrPos2.CosTheta1.Volt_f32 "MICROSAR RTE" /begin SUB_GROUP /end SUB_GROUP /begin FUNCTION_LIST /end FUNCTION_LIST /begin REF_CHARACTERISTIC /end REF_CHARACTERISTIC /begin REF_MEASUREMENT MtrPos2.CosTheta1.Volt_f32 /end REF_MEASUREMENT /end GROUP
/begin GROUP MtrPos2.MechMtrPos.Rev_f32 "MICROSAR RTE" /begin SUB_GROUP /end SUB_GROUP /begin FUNCTION_LIST /end FUNCTION_LIST /begin REF_CHARACTERISTIC /end REF_CHARACTERISTIC /begin REF_MEASUREMENT MtrPos2.MechMtrPos.Rev_f32 /end REF_MEASUREMENT /end GROUP
/begin GROUP MtrPos2.MotorVelMRF.MtrRadpS_f32 "MICROSAR RTE" /begin SUB_GROUP /end SUB_GROUP /begin FUNCTION_LIST /end FUNCTION_LIST /begin REF_CHARACTERISTIC /end REF_CHARACTERISTIC /begin REF_MEASUREMENT MtrPos2.MotorVelMRF.MtrRadpS_f32 /end REF_MEASUREMENT /end GROUP
/begin GROUP MtrPos2.ReceiverPorts "MICROSAR RTE" /begin SUB_GROUP MtrPos2.MotorVelMRF.MtrRadpS_f32 /end SUB_GROUP /begin FUNCTION_LIST /end FUNCTION_LIST /begin REF_CHARACTERISTIC /end REF_CHARACTERISTIC /begin REF_MEASUREMENT /end REF_MEASUREMENT /end GROUP
/begin GROUP MtrPos2.SenderPorts "MICROSAR RTE"
 /begin SUB_GROUP MtrPos2.CorrectedMtrPos.Rev_f32 MtrPos2.CosTheta1.Volt_f32 MtrPos2.MechMtrPos.Rev_f32 MtrPos2.SinTheta1.Volt_f32 MtrPos2.SysCCorrectedMtrPos.Rev_f32 MtrPos2.SysCMechMtrPos.Rev_f32 /end SUB_GROUP
 /begin FUNCTION_LIST /end FUNCTION_LIST
 /begin REF_CHARACTERISTIC /end REF_CHARACTERISTIC
 /begin REF_MEASUREMENT /end REF_MEASUREMENT
/end GROUP
/begin GROUP MtrPos2.SinTheta1.Volt_f32 "MICROSAR RTE" /begin SUB_GROUP /end SUB_GROUP /begin FUNCTION_LIST /end FUNCTION_LIST /begin REF_CHARACTERISTIC /end REF_CHARACTERISTIC /begin REF_MEASUREMENT MtrPos2.SinTheta1.Volt_f32 /end REF_MEASUREMENT /end GROUP
/begin GROUP MtrPos2.SysCCorrectedMtrPos.Rev_f32 "MICROSAR RTE" /begin SUB_GROUP /end SUB_GROUP /begin FUNCTION_LIST /end FUNCTION_LIST /begin REF_CHARACTERISTIC /end REF_CHARACTERISTIC /begin REF_MEASUREMENT MtrPos2.SysCCorrectedMtrPos.Rev_f32 /end REF_MEASUREMENT /end GROUP
/begin GROUP MtrPos2.SysCMechMtrPos.Rev_f32 "MICROSAR RTE" /begin SUB_GROUP /end SUB_GROUP /begin FUNCTION_LIST /end FUNCTION_LIST /begin REF_CHARACTERISTIC /end REF_CHARACTERISTIC /begin REF_MEASUREMENT MtrPos2.SysCMechMtrPos.Rev_f32 /end REF_MEASUREMENT /end GROUP
/begin GROUP MtrPos3 "MICROSAR RTE" /begin SUB_GROUP MtrPos3.ReceiverPorts /end SUB_GROUP /begin FUNCTION_LIST /end FUNCTION_LIST /begin REF_CHARACTERISTIC /end REF_CHARACTERISTIC /begin REF_MEASUREMENT /end REF_MEASUREMENT /end GROUP
/begin GROUP MtrPos3.InvCos2Scaled.Volt_f32 "MICROSAR RTE" /begin SUB_GROUP /end SUB_GROUP /begin FUNCTION_LIST /end FUNCTION_LIST /begin REF_CHARACTERISTIC /end REF_CHARACTERISTIC /begin REF_MEASUREMENT MtrPos3.InvCos2Scaled.Volt_f32 /end REF_MEASUREMENT /end GROUP
/begin GROUP MtrPos3.InvSin2Scaled.Volt_f32 "MICROSAR RTE" /begin SUB_GROUP /end SUB_GROUP /begin FUNCTION_LIST /end FUNCTION_LIST /begin REF_CHARACTERISTIC /end REF_CHARACTERISTIC /begin REF_MEASUREMENT MtrPos3.InvSin2Scaled.Volt_f32 /end REF_MEASUREMENT /end GROUP
/begin GROUP MtrPos3.ReceiverPorts "MICROSAR RTE"
 /begin SUB_GROUP MtrPos3.InvCos2Scaled.Volt_f32 MtrPos3.InvSin2Scaled.Volt_f32 /end SUB_GROUP
 /begin FUNCTION_LIST /end FUNCTION_LIST
 /begin REF_CHARACTERISTIC /end REF_CHARACTERISTIC
 /begin REF_MEASUREMENT /end REF_MEASUREMENT
/end GROUP
/begin GROUP MtrTempEst "MICROSAR RTE" /begin SUB_GROUP MtrTempEst.ReceiverPorts MtrTempEst.SenderPorts /end SUB_GROUP /begin FUNCTION_LIST /end FUNCTION_LIST /begin REF_CHARACTERISTIC /end REF_CHARACTERISTIC /begin REF_MEASUREMENT /end REF_MEASUREMENT /end GROUP
/begin GROUP MtrTempEst.AmbTemp.DegC_f32 "MICROSAR RTE" /begin SUB_GROUP /end SUB_GROUP /begin FUNCTION_LIST /end FUNCTION_LIST /begin REF_CHARACTERISTIC /end REF_CHARACTERISTIC /begin REF_MEASUREMENT MtrTempEst.AmbTemp.DegC_f32 /end REF_MEASUREMENT /end GROUP
/begin GROUP MtrTempEst.AssistMechTempEst.DegC_f32 "MICROSAR RTE" /begin SUB_GROUP /end SUB_GROUP /begin FUNCTION_LIST /end FUNCTION_LIST /begin REF_CHARACTERISTIC /end REF_CHARACTERISTIC /begin REF_MEASUREMENT MtrTempEst.AssistMechTempEst.DegC_f32 /end REF_MEASUREMENT /end GROUP
/begin GROUP MtrTempEst.CtrlTempFinal.DegC_f32 "MICROSAR RTE" /begin SUB_GROUP /end SUB_GROUP /begin FUNCTION_LIST /end FUNCTION_LIST /begin REF_CHARACTERISTIC /end REF_CHARACTERISTIC /begin REF_MEASUREMENT MtrTempEst.CtrlTempFinal.DegC_f32 /end REF_MEASUREMENT /end GROUP
/begin GROUP MtrTempEst.CuTempEst.DegC_f32 "MICROSAR RTE" /begin SUB_GROUP /end SUB_GROUP /begin FUNCTION_LIST /end FUNCTION_LIST /begin REF_CHARACTERISTIC /end REF_CHARACTERISTIC /begin REF_MEASUREMENT MtrTempEst.CuTempEst.DegC_f32 /end REF_MEASUREMENT /end GROUP
/begin GROUP MtrTempEst.EngTemp.DegC_f32 "MICROSAR RTE" /begin SUB_GROUP /end SUB_GROUP /begin FUNCTION_LIST /end FUNCTION_LIST /begin REF_CHARACTERISTIC /end REF_CHARACTERISTIC /begin REF_MEASUREMENT MtrTempEst.EngTemp.DegC_f32 /end REF_MEASUREMENT /end GROUP
/begin GROUP MtrTempEst.EstPkCurr.AmpSq_f32 "MICROSAR RTE" /begin SUB_GROUP /end SUB_GROUP /begin FUNCTION_LIST /end FUNCTION_LIST /begin REF_CHARACTERISTIC /end REF_CHARACTERISTIC /begin REF_MEASUREMENT MtrTempEst.EstPkCurr.AmpSq_f32 /end REF_MEASUREMENT /end GROUP
/begin GROUP MtrTempEst.HwVel.HwRadpS_f32 "MICROSAR RTE" /begin SUB_GROUP /end SUB_GROUP /begin FUNCTION_LIST /end FUNCTION_LIST /begin REF_CHARACTERISTIC /end REF_CHARACTERISTIC /begin REF_MEASUREMENT MtrTempEst.HwVel.HwRadpS_f32 /end REF_MEASUREMENT /end GROUP
/begin GROUP MtrTempEst.MagTempEst.DegC_f32 "MICROSAR RTE" /begin SUB_GROUP /end SUB_GROUP /begin FUNCTION_LIST /end FUNCTION_LIST /begin REF_CHARACTERISTIC /end REF_CHARACTERISTIC /begin REF_MEASUREMENT MtrTempEst.MagTempEst.DegC_f32 /end REF_MEASUREMENT /end GROUP
/begin GROUP MtrTempEst.ReceiverPorts "MICROSAR RTE"
 /begin SUB_GROUP MtrTempEst.AmbTemp.DegC_f32 MtrTempEst.CtrlTempFinal.DegC_f32 MtrTempEst.EngTemp.DegC_f32 MtrTempEst.EstPkCurr.AmpSq_f32 MtrTempEst.HwVel.HwRadpS_f32 MtrTempEst.ScomAMDefeat.Cnt_lgc MtrTempEst.ScomTempDataRcvd.Cnt_lgc /end SUB_GROUP
 /begin FUNCTION_LIST /end FUNCTION_LIST
 /begin REF_CHARACTERISTIC /end REF_CHARACTERISTIC
 /begin REF_MEASUREMENT /end REF_MEASUREMENT
/end GROUP
/begin GROUP MtrTempEst.ScomAMDefeat.Cnt_lgc "MICROSAR RTE" /begin SUB_GROUP /end SUB_GROUP /begin FUNCTION_LIST /end FUNCTION_LIST /begin REF_CHARACTERISTIC /end REF_CHARACTERISTIC /begin REF_MEASUREMENT MtrTempEst.ScomAMDefeat.Cnt_lgc /end REF_MEASUREMENT /end GROUP
/begin GROUP MtrTempEst.ScomTempDataRcvd.Cnt_lgc "MICROSAR RTE" /begin SUB_GROUP /end SUB_GROUP /begin FUNCTION_LIST /end FUNCTION_LIST /begin REF_CHARACTERISTIC /end REF_CHARACTERISTIC /begin REF_MEASUREMENT MtrTempEst.ScomTempDataRcvd.Cnt_lgc /end REF_MEASUREMENT /end GROUP
/begin GROUP MtrTempEst.SenderPorts "MICROSAR RTE"
 /begin SUB_GROUP MtrTempEst.AssistMechTempEst.DegC_f32 MtrTempEst.CuTempEst.DegC_f32 MtrTempEst.MagTempEst.DegC_f32 MtrTempEst.SiTempEst.DegC_f32 /end SUB_GROUP
 /begin FUNCTION_LIST /end FUNCTION_LIST
 /begin REF_CHARACTERISTIC /end REF_CHARACTERISTIC
 /begin REF_MEASUREMENT /end REF_MEASUREMENT
/end GROUP
/begin GROUP MtrTempEst.SiTempEst.DegC_f32 "MICROSAR RTE" /begin SUB_GROUP /end SUB_GROUP /begin FUNCTION_LIST /end FUNCTION_LIST /begin REF_CHARACTERISTIC /end REF_CHARACTERISTIC /begin REF_MEASUREMENT MtrTempEst.SiTempEst.DegC_f32 /end REF_MEASUREMENT /end GROUP
/begin GROUP MtrVel "MICROSAR RTE" /begin SUB_GROUP MtrVel.ReceiverPorts MtrVel.SenderPorts /end SUB_GROUP /begin FUNCTION_LIST /end FUNCTION_LIST /begin REF_CHARACTERISTIC /end REF_CHARACTERISTIC /begin REF_MEASUREMENT /end REF_MEASUREMENT /end GROUP
/begin GROUP MtrVel.AsstAssemPol.Cnt_s08 "MICROSAR RTE" /begin SUB_GROUP /end SUB_GROUP /begin FUNCTION_LIST /end FUNCTION_LIST /begin REF_CHARACTERISTIC /end REF_CHARACTERISTIC /begin REF_MEASUREMENT MtrVel.AsstAssemPol.Cnt_s08 /end REF_MEASUREMENT /end GROUP
/begin GROUP MtrVel.CRFMotorVel.MtrRadpS_f32 "MICROSAR RTE" /begin SUB_GROUP /end SUB_GROUP /begin FUNCTION_LIST /end FUNCTION_LIST /begin REF_CHARACTERISTIC /end REF_CHARACTERISTIC /begin REF_MEASUREMENT MtrVel.CRFMotorVel.MtrRadpS_f32 /end REF_MEASUREMENT /end GROUP
/begin GROUP MtrVel.HandwheelVel.HwRadpS_f32 "MICROSAR RTE" /begin SUB_GROUP /end SUB_GROUP /begin FUNCTION_LIST /end FUNCTION_LIST /begin REF_CHARACTERISTIC /end REF_CHARACTERISTIC /begin REF_MEASUREMENT MtrVel.HandwheelVel.HwRadpS_f32 /end REF_MEASUREMENT /end GROUP
/begin GROUP MtrVel.HwVelValid.Cnt_lgc "MICROSAR RTE" /begin SUB_GROUP /end SUB_GROUP /begin FUNCTION_LIST /end FUNCTION_LIST /begin REF_CHARACTERISTIC /end REF_CHARACTERISTIC /begin REF_MEASUREMENT MtrVel.HwVelValid.Cnt_lgc /end REF_MEASUREMENT /end GROUP
/begin GROUP MtrVel.MRFMotorVel.MtrRadpS_f32 "MICROSAR RTE" /begin SUB_GROUP /end SUB_GROUP /begin FUNCTION_LIST /end FUNCTION_LIST /begin REF_CHARACTERISTIC /end REF_CHARACTERISTIC /begin REF_MEASUREMENT MtrVel.MRFMotorVel.MtrRadpS_f32 /end REF_MEASUREMENT /end GROUP
/begin GROUP MtrVel.MRFMotorVelUnfiltered.MtrRadpS_f32 "MICROSAR RTE" /begin SUB_GROUP /end SUB_GROUP /begin FUNCTION_LIST /end FUNCTION_LIST /begin REF_CHARACTERISTIC /end REF_CHARACTERISTIC /begin REF_MEASUREMENT MtrVel.MRFMotorVelUnfiltered.MtrRadpS_f32 /end REF_MEASUREMENT /end GROUP
/begin GROUP MtrVel.ReceiverPorts "MICROSAR RTE"
 /begin SUB_GROUP MtrVel.AsstAssemPol.Cnt_s08 MtrVel.SysCDiagHandWheelVel.HwRadpS_f32 MtrVel.SysCDiagMtrVelMRF.MtrRadpS_f32 MtrVel.VehicleSpeed.Kph_f32 /end SUB_GROUP
 /begin FUNCTION_LIST /end FUNCTION_LIST
 /begin REF_CHARACTERISTIC /end REF_CHARACTERISTIC
 /begin REF_MEASUREMENT /end REF_MEASUREMENT
/end GROUP
/begin GROUP MtrVel.SenderPorts "MICROSAR RTE"
 /begin SUB_GROUP MtrVel.CRFMotorVel.MtrRadpS_f32 MtrVel.HandwheelVel.HwRadpS_f32 MtrVel.HwVelValid.Cnt_lgc MtrVel.MRFMotorVel.MtrRadpS_f32 MtrVel.MRFMotorVelUnfiltered.MtrRadpS_f32 MtrVel.SysCHandwheelVel.HwRadpS_f32 MtrVel.SysCMotorVelMRF.MtrRadpS_f32 /end SUB_GROUP
 /begin FUNCTION_LIST /end FUNCTION_LIST
 /begin REF_CHARACTERISTIC /end REF_CHARACTERISTIC
 /begin REF_MEASUREMENT /end REF_MEASUREMENT
/end GROUP
/begin GROUP MtrVel.SysCDiagHandWheelVel.HwRadpS_f32 "MICROSAR RTE" /begin SUB_GROUP /end SUB_GROUP /begin FUNCTION_LIST /end FUNCTION_LIST /begin REF_CHARACTERISTIC /end REF_CHARACTERISTIC /begin REF_MEASUREMENT MtrVel.SysCDiagHandWheelVel.HwRadpS_f32 /end REF_MEASUREMENT /end GROUP
/begin GROUP MtrVel.SysCDiagMtrVelMRF.MtrRadpS_f32 "MICROSAR RTE" /begin SUB_GROUP /end SUB_GROUP /begin FUNCTION_LIST /end FUNCTION_LIST /begin REF_CHARACTERISTIC /end REF_CHARACTERISTIC /begin REF_MEASUREMENT MtrVel.SysCDiagMtrVelMRF.MtrRadpS_f32 /end REF_MEASUREMENT /end GROUP
/begin GROUP MtrVel.SysCHandwheelVel.HwRadpS_f32 "MICROSAR RTE" /begin SUB_GROUP /end SUB_GROUP /begin FUNCTION_LIST /end FUNCTION_LIST /begin REF_CHARACTERISTIC /end REF_CHARACTERISTIC /begin REF_MEASUREMENT MtrVel.SysCHandwheelVel.HwRadpS_f32 /end REF_MEASUREMENT /end GROUP
/begin GROUP MtrVel.SysCMotorVelMRF.MtrRadpS_f32 "MICROSAR RTE" /begin SUB_GROUP /end SUB_GROUP /begin FUNCTION_LIST /end FUNCTION_LIST /begin REF_CHARACTERISTIC /end REF_CHARACTERISTIC /begin REF_MEASUREMENT MtrVel.SysCMotorVelMRF.MtrRadpS_f32 /end REF_MEASUREMENT /end GROUP
/begin GROUP MtrVel.VehicleSpeed.Kph_f32 "MICROSAR RTE" /begin SUB_GROUP /end SUB_GROUP /begin FUNCTION_LIST /end FUNCTION_LIST /begin REF_CHARACTERISTIC /end REF_CHARACTERISTIC /begin REF_MEASUREMENT MtrVel.VehicleSpeed.Kph_f32 /end REF_MEASUREMENT /end GROUP
/begin GROUP MtrVel2 "MICROSAR RTE" /begin SUB_GROUP MtrVel2.ReceiverPorts MtrVel2.SenderPorts /end SUB_GROUP /begin FUNCTION_LIST /end FUNCTION_LIST /begin REF_CHARACTERISTIC /end REF_CHARACTERISTIC /begin REF_MEASUREMENT /end REF_MEASUREMENT /end GROUP
/begin GROUP MtrVel2.AsstAssemPol.Cnt_s08 "MICROSAR RTE" /begin SUB_GROUP /end SUB_GROUP /begin FUNCTION_LIST /end FUNCTION_LIST /begin REF_CHARACTERISTIC /end REF_CHARACTERISTIC /begin REF_MEASUREMENT MtrVel2.AsstAssemPol.Cnt_s08 /end REF_MEASUREMENT /end GROUP
/begin GROUP MtrVel2.CumMtrPosMRF.Deg_f32 "MICROSAR RTE" /begin SUB_GROUP /end SUB_GROUP /begin FUNCTION_LIST /end FUNCTION_LIST /begin REF_CHARACTERISTIC /end REF_CHARACTERISTIC /begin REF_MEASUREMENT MtrVel2.CumMtrPosMRF.Deg_f32 /end REF_MEASUREMENT /end GROUP
/begin GROUP MtrVel2.HandWheelVel.HwRadpS_f32 "MICROSAR RTE" /begin SUB_GROUP /end SUB_GROUP /begin FUNCTION_LIST /end FUNCTION_LIST /begin REF_CHARACTERISTIC /end REF_CHARACTERISTIC /begin REF_MEASUREMENT MtrVel2.HandWheelVel.HwRadpS_f32 /end REF_MEASUREMENT /end GROUP
/begin GROUP MtrVel2.MRFMotorVel.MtrRadpS_f32 "MICROSAR RTE" /begin SUB_GROUP /end SUB_GROUP /begin FUNCTION_LIST /end FUNCTION_LIST /begin REF_CHARACTERISTIC /end REF_CHARACTERISTIC /begin REF_MEASUREMENT MtrVel2.MRFMotorVel.MtrRadpS_f32 /end REF_MEASUREMENT /end GROUP
/begin GROUP MtrVel2.ReceiverPorts "MICROSAR RTE"
 /begin SUB_GROUP MtrVel2.AsstAssemPol.Cnt_s08 MtrVel2.CumMtrPosMRF.Deg_f32 MtrVel2.HandWheelVel.HwRadpS_f32 MtrVel2.MRFMotorVel.MtrRadpS_f32 /end SUB_GROUP
 /begin FUNCTION_LIST /end FUNCTION_LIST
 /begin REF_CHARACTERISTIC /end REF_CHARACTERISTIC
 /begin REF_MEASUREMENT /end REF_MEASUREMENT
/end GROUP
/begin GROUP MtrVel2.SenderPorts "MICROSAR RTE"
 /begin SUB_GROUP MtrVel2.SysCDiagHandWheelVel.HwRadpS_f32 MtrVel2.SysCDiagMtrVelMRF.MtrRadpS_f32 /end SUB_GROUP
 /begin FUNCTION_LIST /end FUNCTION_LIST
 /begin REF_CHARACTERISTIC /end REF_CHARACTERISTIC
 /begin REF_MEASUREMENT /end REF_MEASUREMENT
/end GROUP
/begin GROUP MtrVel2.SysCDiagHandWheelVel.HwRadpS_f32 "MICROSAR RTE" /begin SUB_GROUP /end SUB_GROUP /begin FUNCTION_LIST /end FUNCTION_LIST /begin REF_CHARACTERISTIC /end REF_CHARACTERISTIC /begin REF_MEASUREMENT MtrVel2.SysCDiagHandWheelVel.HwRadpS_f32 /end REF_MEASUREMENT /end GROUP
/begin GROUP MtrVel2.SysCDiagMtrVelMRF.MtrRadpS_f32 "MICROSAR RTE" /begin SUB_GROUP /end SUB_GROUP /begin FUNCTION_LIST /end FUNCTION_LIST /begin REF_CHARACTERISTIC /end REF_CHARACTERISTIC /begin REF_MEASUREMENT MtrVel2.SysCDiagMtrVelMRF.MtrRadpS_f32 /end REF_MEASUREMENT /end GROUP
/begin GROUP Nhet2 "MICROSAR RTE" /begin SUB_GROUP Nhet2.ModeRequirePorts /end SUB_GROUP /begin FUNCTION_LIST /end FUNCTION_LIST /begin REF_CHARACTERISTIC /end REF_CHARACTERISTIC /begin REF_MEASUREMENT /end REF_MEASUREMENT /end GROUP
/begin GROUP Nhet2.ModeRequirePorts "MICROSAR RTE" /begin SUB_GROUP Nhet2.SystemState.Mode /end SUB_GROUP /begin FUNCTION_LIST /end FUNCTION_LIST /begin REF_CHARACTERISTIC /end REF_CHARACTERISTIC /begin REF_MEASUREMENT /end REF_MEASUREMENT /end GROUP
/begin GROUP Nhet2.SystemState.Mode "MICROSAR RTE" /begin SUB_GROUP /end SUB_GROUP /begin FUNCTION_LIST /end FUNCTION_LIST /begin REF_CHARACTERISTIC /end REF_CHARACTERISTIC /begin REF_MEASUREMENT Nhet2.SystemState.Mode /end REF_MEASUREMENT /end GROUP
/begin GROUP OscTraj "MICROSAR RTE" /begin SUB_GROUP OscTraj.ReceiverPorts OscTraj.SenderPorts /end SUB_GROUP /begin FUNCTION_LIST /end FUNCTION_LIST /begin REF_CHARACTERISTIC /end REF_CHARACTERISTIC /begin REF_MEASUREMENT /end REF_MEASUREMENT /end GROUP
/begin GROUP OscTraj.CalculateFlag.Cnt_lgc "MICROSAR RTE" /begin SUB_GROUP /end SUB_GROUP /begin FUNCTION_LIST /end FUNCTION_LIST /begin REF_CHARACTERISTIC /end REF_CHARACTERISTIC /begin REF_MEASUREMENT OscTraj.CalculateFlag.Cnt_lgc /end REF_MEASUREMENT /end GROUP
/begin GROUP OscTraj.HwPos.HwDeg_f32 "MICROSAR RTE" /begin SUB_GROUP /end SUB_GROUP /begin FUNCTION_LIST /end FUNCTION_LIST /begin REF_CHARACTERISTIC /end REF_CHARACTERISTIC /begin REF_MEASUREMENT OscTraj.HwPos.HwDeg_f32 /end REF_MEASUREMENT /end GROUP
/begin GROUP OscTraj.OscTrajState.Cnt_enum "MICROSAR RTE" /begin SUB_GROUP /end SUB_GROUP /begin FUNCTION_LIST /end FUNCTION_LIST /begin REF_CHARACTERISTIC /end REF_CHARACTERISTIC /begin REF_MEASUREMENT OscTraj.OscTrajState.Cnt_enum /end REF_MEASUREMENT /end GROUP
/begin GROUP OscTraj.OscillateHwAngle.HwDeg_f32 "MICROSAR RTE" /begin SUB_GROUP /end SUB_GROUP /begin FUNCTION_LIST /end FUNCTION_LIST /begin REF_CHARACTERISTIC /end REF_CHARACTERISTIC /begin REF_MEASUREMENT OscTraj.OscillateHwAngle.HwDeg_f32 /end REF_MEASUREMENT /end GROUP
/begin GROUP OscTraj.ReceiverPorts "MICROSAR RTE" /begin SUB_GROUP OscTraj.CalculateFlag.Cnt_lgc OscTraj.HwPos.HwDeg_f32 /end SUB_GROUP /begin FUNCTION_LIST /end FUNCTION_LIST /begin REF_CHARACTERISTIC /end REF_CHARACTERISTIC /begin REF_MEASUREMENT /end REF_MEASUREMENT /end GROUP
/begin GROUP OscTraj.SenderPorts "MICROSAR RTE"
 /begin SUB_GROUP OscTraj.OscTrajState.Cnt_enum OscTraj.OscillateHwAngle.HwDeg_f32 /end SUB_GROUP
 /begin FUNCTION_LIST /end FUNCTION_LIST
 /begin REF_CHARACTERISTIC /end REF_CHARACTERISTIC
 /begin REF_MEASUREMENT /end REF_MEASUREMENT
/end GROUP
/begin GROUP ParamComp "MICROSAR RTE"
 /begin SUB_GROUP ParamComp.PerInstanceMemories ParamComp.ReceiverPorts ParamComp.SenderPorts /end SUB_GROUP
 /begin FUNCTION_LIST /end FUNCTION_LIST
 /begin REF_CHARACTERISTIC /end REF_CHARACTERISTIC
 /begin REF_MEASUREMENT /end REF_MEASUREMENT
/end GROUP
/begin GROUP ParamComp.CuTempEst.DegC_f32 "MICROSAR RTE" /begin SUB_GROUP /end SUB_GROUP /begin FUNCTION_LIST /end FUNCTION_LIST /begin REF_CHARACTERISTIC /end REF_CHARACTERISTIC /begin REF_MEASUREMENT ParamComp.CuTempEst.DegC_f32 /end REF_MEASUREMENT /end GROUP
/begin GROUP ParamComp.EOLNomMtrParam "MICROSAR RTE" /begin SUB_GROUP /end SUB_GROUP /begin FUNCTION_LIST /end FUNCTION_LIST /begin REF_CHARACTERISTIC /end REF_CHARACTERISTIC
 /begin REF_MEASUREMENT ParamComp.EOLNomMtrParam.NomKe_VpRadpS_f32 ParamComp.EOLNomMtrParam.NomLq_Henry_f32 ParamComp.EOLNomMtrParam.NomRmtr_Ohm_f32 /end REF_MEASUREMENT
/end GROUP
/begin GROUP ParamComp.EstKe.VpRadpS_f32 "MICROSAR RTE" /begin SUB_GROUP /end SUB_GROUP /begin FUNCTION_LIST /end FUNCTION_LIST /begin REF_CHARACTERISTIC /end REF_CHARACTERISTIC /begin REF_MEASUREMENT ParamComp.EstKe.VpRadpS_f32 /end REF_MEASUREMENT /end GROUP
/begin GROUP ParamComp.EstLd.Henry_f32 "MICROSAR RTE" /begin SUB_GROUP /end SUB_GROUP /begin FUNCTION_LIST /end FUNCTION_LIST /begin REF_CHARACTERISTIC /end REF_CHARACTERISTIC /begin REF_MEASUREMENT ParamComp.EstLd.Henry_f32 /end REF_MEASUREMENT /end GROUP
/begin GROUP ParamComp.EstLq.Henry_f32 "MICROSAR RTE" /begin SUB_GROUP /end SUB_GROUP /begin FUNCTION_LIST /end FUNCTION_LIST /begin REF_CHARACTERISTIC /end REF_CHARACTERISTIC /begin REF_MEASUREMENT ParamComp.EstLq.Henry_f32 /end REF_MEASUREMENT /end GROUP
/begin GROUP ParamComp.EstR.Ohm_f32 "MICROSAR RTE" /begin SUB_GROUP /end SUB_GROUP /begin FUNCTION_LIST /end FUNCTION_LIST /begin REF_CHARACTERISTIC /end REF_CHARACTERISTIC /begin REF_MEASUREMENT ParamComp.EstR.Ohm_f32 /end REF_MEASUREMENT /end GROUP
/begin GROUP ParamComp.ExpIq.Amp_f32 "MICROSAR RTE" /begin SUB_GROUP /end SUB_GROUP /begin FUNCTION_LIST /end FUNCTION_LIST /begin REF_CHARACTERISTIC /end REF_CHARACTERISTIC /begin REF_MEASUREMENT ParamComp.ExpIq.Amp_f32 /end REF_MEASUREMENT /end GROUP
/begin GROUP ParamComp.IdEst.Amp_f32 "MICROSAR RTE" /begin SUB_GROUP /end SUB_GROUP /begin FUNCTION_LIST /end FUNCTION_LIST /begin REF_CHARACTERISTIC /end REF_CHARACTERISTIC /begin REF_MEASUREMENT ParamComp.IdEst.Amp_f32 /end REF_MEASUREMENT /end GROUP
/begin GROUP ParamComp.MRFMtrTrqCmdScl.MtrNm_f32 "MICROSAR RTE" /begin SUB_GROUP /end SUB_GROUP /begin FUNCTION_LIST /end FUNCTION_LIST /begin REF_CHARACTERISTIC /end REF_CHARACTERISTIC /begin REF_MEASUREMENT ParamComp.MRFMtrTrqCmdScl.MtrNm_f32 /end REF_MEASUREMENT /end GROUP
/begin GROUP ParamComp.MRFMtrVel.MtrRadpS_f32 "MICROSAR RTE" /begin SUB_GROUP /end SUB_GROUP /begin FUNCTION_LIST /end FUNCTION_LIST /begin REF_CHARACTERISTIC /end REF_CHARACTERISTIC /begin REF_MEASUREMENT ParamComp.MRFMtrVel.MtrRadpS_f32 /end REF_MEASUREMENT /end GROUP
/begin GROUP ParamComp.MagTempEst.DegC_f32 "MICROSAR RTE" /begin SUB_GROUP /end SUB_GROUP /begin FUNCTION_LIST /end FUNCTION_LIST /begin REF_CHARACTERISTIC /end REF_CHARACTERISTIC /begin REF_MEASUREMENT ParamComp.MagTempEst.DegC_f32 /end REF_MEASUREMENT /end GROUP
/begin GROUP ParamComp.MtrCurrQax.Amp_f32 "MICROSAR RTE" /begin SUB_GROUP /end SUB_GROUP /begin FUNCTION_LIST /end FUNCTION_LIST /begin REF_CHARACTERISTIC /end REF_CHARACTERISTIC /begin REF_MEASUREMENT ParamComp.MtrCurrQax.Amp_f32 /end REF_MEASUREMENT /end GROUP
/begin GROUP ParamComp.MtrParmNrmLrnSrlComSvcDft.Cnt_lgc "MICROSAR RTE" /begin SUB_GROUP /end SUB_GROUP /begin FUNCTION_LIST /end FUNCTION_LIST /begin REF_CHARACTERISTIC /end REF_CHARACTERISTIC /begin REF_MEASUREMENT ParamComp.MtrParmNrmLrnSrlComSvcDft.Cnt_lgc /end REF_MEASUREMENT /end GROUP
/begin GROUP ParamComp.MtrQuad.Cnt_u08 "MICROSAR RTE" /begin SUB_GROUP /end SUB_GROUP /begin FUNCTION_LIST /end FUNCTION_LIST /begin REF_CHARACTERISTIC /end REF_CHARACTERISTIC /begin REF_MEASUREMENT ParamComp.MtrQuad.Cnt_u08 /end REF_MEASUREMENT /end GROUP
/begin GROUP ParamComp.PerInstanceMemories "MICROSAR RTE" /begin SUB_GROUP ParamComp.EOLNomMtrParam /end SUB_GROUP /begin FUNCTION_LIST /end FUNCTION_LIST /begin REF_CHARACTERISTIC /end REF_CHARACTERISTIC /begin REF_MEASUREMENT /end REF_MEASUREMENT /end GROUP
/begin GROUP ParamComp.ReceiverPorts "MICROSAR RTE"
 /begin SUB_GROUP ParamComp.CuTempEst.DegC_f32 ParamComp.IdEst.Amp_f32 ParamComp.MRFMtrTrqCmdScl.MtrNm_f32 ParamComp.MRFMtrVel.MtrRadpS_f32 ParamComp.MagTempEst.DegC_f32 ParamComp.MtrCurrQax.Amp_f32 ParamComp.MtrParmNrmLrnSrlComSvcDft.Cnt_lgc ParamComp.MtrQuad.Cnt_u08 ParamComp.SiTempEst.DegC_f32 ParamComp.ValidCurrSample.Cnt_lgc /end SUB_GROUP
 /begin FUNCTION_LIST /end FUNCTION_LIST
 /begin REF_CHARACTERISTIC /end REF_CHARACTERISTIC
 /begin REF_MEASUREMENT /end REF_MEASUREMENT
/end GROUP
/begin GROUP ParamComp.SenderPorts "MICROSAR RTE"
 /begin SUB_GROUP ParamComp.EstKe.VpRadpS_f32 ParamComp.EstLd.Henry_f32 ParamComp.EstLq.Henry_f32 ParamComp.EstR.Ohm_f32 ParamComp.ExpIq.Amp_f32 /end SUB_GROUP
 /begin FUNCTION_LIST /end FUNCTION_LIST
 /begin REF_CHARACTERISTIC /end REF_CHARACTERISTIC
 /begin REF_MEASUREMENT /end REF_MEASUREMENT
/end GROUP
/begin GROUP ParamComp.SiTempEst.DegC_f32 "MICROSAR RTE" /begin SUB_GROUP /end SUB_GROUP /begin FUNCTION_LIST /end FUNCTION_LIST /begin REF_CHARACTERISTIC /end REF_CHARACTERISTIC /begin REF_MEASUREMENT ParamComp.SiTempEst.DegC_f32 /end REF_MEASUREMENT /end GROUP
/begin GROUP ParamComp.ValidCurrSample.Cnt_lgc "MICROSAR RTE" /begin SUB_GROUP /end SUB_GROUP /begin FUNCTION_LIST /end FUNCTION_LIST /begin REF_CHARACTERISTIC /end REF_CHARACTERISTIC /begin REF_MEASUREMENT ParamComp.ValidCurrSample.Cnt_lgc /end REF_MEASUREMENT /end GROUP
/begin GROUP ParkAssistEnable "MICROSAR RTE"
 /begin SUB_GROUP ParkAssistEnable.ModeRequirePorts ParkAssistEnable.ReceiverPorts ParkAssistEnable.SenderPorts /end SUB_GROUP
 /begin FUNCTION_LIST /end FUNCTION_LIST
 /begin REF_CHARACTERISTIC /end REF_CHARACTERISTIC
 /begin REF_MEASUREMENT /end REF_MEASUREMENT
/end GROUP
/begin GROUP ParkAssistEnable.DiagStsRmpZeroNRec.Cnt_lgc "MICROSAR RTE" /begin SUB_GROUP /end SUB_GROUP /begin FUNCTION_LIST /end FUNCTION_LIST /begin REF_CHARACTERISTIC /end REF_CHARACTERISTIC /begin REF_MEASUREMENT ParkAssistEnable.DiagStsRmpZeroNRec.Cnt_lgc /end REF_MEASUREMENT /end GROUP
/begin GROUP ParkAssistEnable.DiagStsRmpZeroRec.Cnt_lgc "MICROSAR RTE" /begin SUB_GROUP /end SUB_GROUP /begin FUNCTION_LIST /end FUNCTION_LIST /begin REF_CHARACTERISTIC /end REF_CHARACTERISTIC /begin REF_MEASUREMENT ParkAssistEnable.DiagStsRmpZeroRec.Cnt_lgc /end REF_MEASUREMENT /end GROUP
/begin GROUP ParkAssistEnable.HandwheelAuthority.Uls_f32 "MICROSAR RTE" /begin SUB_GROUP /end SUB_GROUP /begin FUNCTION_LIST /end FUNCTION_LIST /begin REF_CHARACTERISTIC /end REF_CHARACTERISTIC /begin REF_MEASUREMENT ParkAssistEnable.HandwheelAuthority.Uls_f32 /end REF_MEASUREMENT /end GROUP
/begin GROUP ParkAssistEnable.HandwheelPosition.HwDeg_f32 "MICROSAR RTE" /begin SUB_GROUP /end SUB_GROUP /begin FUNCTION_LIST /end FUNCTION_LIST /begin REF_CHARACTERISTIC /end REF_CHARACTERISTIC /begin REF_MEASUREMENT ParkAssistEnable.HandwheelPosition.HwDeg_f32 /end REF_MEASUREMENT /end GROUP
/begin GROUP ParkAssistEnable.HandwheelVel.HwRadpS_f32 "MICROSAR RTE" /begin SUB_GROUP /end SUB_GROUP /begin FUNCTION_LIST /end FUNCTION_LIST /begin REF_CHARACTERISTIC /end REF_CHARACTERISTIC /begin REF_MEASUREMENT ParkAssistEnable.HandwheelVel.HwRadpS_f32 /end REF_MEASUREMENT /end GROUP
/begin GROUP ParkAssistEnable.HwTorque.HwNm_f32 "MICROSAR RTE" /begin SUB_GROUP /end SUB_GROUP /begin FUNCTION_LIST /end FUNCTION_LIST /begin REF_CHARACTERISTIC /end REF_CHARACTERISTIC /begin REF_MEASUREMENT ParkAssistEnable.HwTorque.HwNm_f32 /end REF_MEASUREMENT /end GROUP
/begin GROUP ParkAssistEnable.LimitPercentFiltered.Uls_f32 "MICROSAR RTE" /begin SUB_GROUP /end SUB_GROUP /begin FUNCTION_LIST /end FUNCTION_LIST /begin REF_CHARACTERISTIC /end REF_CHARACTERISTIC /begin REF_MEASUREMENT ParkAssistEnable.LimitPercentFiltered.Uls_f32 /end REF_MEASUREMENT /end GROUP
/begin GROUP ParkAssistEnable.ModeRequirePorts "MICROSAR RTE" /begin SUB_GROUP ParkAssistEnable.SystemState.Mode /end SUB_GROUP /begin FUNCTION_LIST /end FUNCTION_LIST /begin REF_CHARACTERISTIC /end REF_CHARACTERISTIC /begin REF_MEASUREMENT /end REF_MEASUREMENT /end GROUP
/begin GROUP ParkAssistEnable.PAEnableRqst.Cnt_lgc "MICROSAR RTE" /begin SUB_GROUP /end SUB_GROUP /begin FUNCTION_LIST /end FUNCTION_LIST /begin REF_CHARACTERISTIC /end REF_CHARACTERISTIC /begin REF_MEASUREMENT ParkAssistEnable.PAEnableRqst.Cnt_lgc /end REF_MEASUREMENT /end GROUP
/begin GROUP ParkAssistEnable.PAErrInterfaceActive.Cnt_lgc "MICROSAR RTE" /begin SUB_GROUP /end SUB_GROUP /begin FUNCTION_LIST /end FUNCTION_LIST /begin REF_CHARACTERISTIC /end REF_CHARACTERISTIC /begin REF_MEASUREMENT ParkAssistEnable.PAErrInterfaceActive.Cnt_lgc /end REF_MEASUREMENT /end GROUP
/begin GROUP ParkAssistEnable.PAHWAngleRqst.HwDeg_f32 "MICROSAR RTE" /begin SUB_GROUP /end SUB_GROUP /begin FUNCTION_LIST /end FUNCTION_LIST /begin REF_CHARACTERISTIC /end REF_CHARACTERISTIC /begin REF_MEASUREMENT ParkAssistEnable.PAHWAngleRqst.HwDeg_f32 /end REF_MEASUREMENT /end GROUP
/begin GROUP ParkAssistEnable.PASpdHigh.Cnt_u08 "MICROSAR RTE" /begin SUB_GROUP /end SUB_GROUP /begin FUNCTION_LIST /end FUNCTION_LIST /begin REF_CHARACTERISTIC /end REF_CHARACTERISTIC /begin REF_MEASUREMENT ParkAssistEnable.PASpdHigh.Cnt_u08 /end REF_MEASUREMENT /end GROUP
/begin GROUP ParkAssistEnable.PendEnable.Cnt_lgc "MICROSAR RTE" /begin SUB_GROUP /end SUB_GROUP /begin FUNCTION_LIST /end FUNCTION_LIST /begin REF_CHARACTERISTIC /end REF_CHARACTERISTIC /begin REF_MEASUREMENT ParkAssistEnable.PendEnable.Cnt_lgc /end REF_MEASUREMENT /end GROUP
/begin GROUP ParkAssistEnable.PendHwAngle.HwDeg_f32 "MICROSAR RTE" /begin SUB_GROUP /end SUB_GROUP /begin FUNCTION_LIST /end FUNCTION_LIST /begin REF_CHARACTERISTIC /end REF_CHARACTERISTIC /begin REF_MEASUREMENT ParkAssistEnable.PendHwAngle.HwDeg_f32 /end REF_MEASUREMENT /end GROUP
/begin GROUP ParkAssistEnable.PosServEnable.Cnt_lgc "MICROSAR RTE" /begin SUB_GROUP /end SUB_GROUP /begin FUNCTION_LIST /end FUNCTION_LIST /begin REF_CHARACTERISTIC /end REF_CHARACTERISTIC /begin REF_MEASUREMENT ParkAssistEnable.PosServEnable.Cnt_lgc /end REF_MEASUREMENT /end GROUP
/begin GROUP ParkAssistEnable.PosServoHwAngle.HwDeg_f32 "MICROSAR RTE" /begin SUB_GROUP /end SUB_GROUP /begin FUNCTION_LIST /end FUNCTION_LIST /begin REF_CHARACTERISTIC /end REF_CHARACTERISTIC /begin REF_MEASUREMENT ParkAssistEnable.PosServoHwAngle.HwDeg_f32 /end REF_MEASUREMENT /end GROUP
/begin GROUP ParkAssistEnable.PosTrajEnable.Cnt_lgc "MICROSAR RTE" /begin SUB_GROUP /end SUB_GROUP /begin FUNCTION_LIST /end FUNCTION_LIST /begin REF_CHARACTERISTIC /end REF_CHARACTERISTIC /begin REF_MEASUREMENT ParkAssistEnable.PosTrajEnable.Cnt_lgc /end REF_MEASUREMENT /end GROUP
/begin GROUP ParkAssistEnable.PosTrajHwAngle.HwDeg_f32 "MICROSAR RTE" /begin SUB_GROUP /end SUB_GROUP /begin FUNCTION_LIST /end FUNCTION_LIST /begin REF_CHARACTERISTIC /end REF_CHARACTERISTIC /begin REF_MEASUREMENT ParkAssistEnable.PosTrajHwAngle.HwDeg_f32 /end REF_MEASUREMENT /end GROUP
/begin GROUP ParkAssistEnable.PrkAssistState.Cnt_u08 "MICROSAR RTE" /begin SUB_GROUP /end SUB_GROUP /begin FUNCTION_LIST /end FUNCTION_LIST /begin REF_CHARACTERISTIC /end REF_CHARACTERISTIC /begin REF_MEASUREMENT ParkAssistEnable.PrkAssistState.Cnt_u08 /end REF_MEASUREMENT /end GROUP
/begin GROUP ParkAssistEnable.ReceiverPorts "MICROSAR RTE"
 /begin SUB_GROUP ParkAssistEnable.DiagStsRmpZeroNRec.Cnt_lgc ParkAssistEnable.DiagStsRmpZeroRec.Cnt_lgc ParkAssistEnable.HandwheelAuthority.Uls_f32 ParkAssistEnable.HandwheelPosition.HwDeg_f32 ParkAssistEnable.HandwheelVel.HwRadpS_f32 ParkAssistEnable.HwTorque.HwNm_f32 ParkAssistEnable.LimitPercentFiltered.Uls_f32 ParkAssistEnable.PAEnableRqst.Cnt_lgc ParkAssistEnable.PAErrInterfaceActive.Cnt_lgc ParkAssistEnable.PAHWAngleRqst.HwDeg_f32 ParkAssistEnable.PASpdHigh.Cnt_u08 ParkAssistEnable.PendEnable.Cnt_lgc ParkAssistEnable.PendHwAngle.HwDeg_f32 ParkAssistEnable.PosTrajEnable.Cnt_lgc ParkAssistEnable.PosTrajHwAngle.HwDeg_f32 /end SUB_GROUP
 /begin FUNCTION_LIST /end FUNCTION_LIST
 /begin REF_CHARACTERISTIC /end REF_CHARACTERISTIC
 /begin REF_MEASUREMENT /end REF_MEASUREMENT
/end GROUP
/begin GROUP ParkAssistEnable.SenderPorts "MICROSAR RTE"
 /begin SUB_GROUP ParkAssistEnable.PosServEnable.Cnt_lgc ParkAssistEnable.PosServoHwAngle.HwDeg_f32 ParkAssistEnable.PrkAssistState.Cnt_u08 /end SUB_GROUP
 /begin FUNCTION_LIST /end FUNCTION_LIST
 /begin REF_CHARACTERISTIC /end REF_CHARACTERISTIC
 /begin REF_MEASUREMENT /end REF_MEASUREMENT
/end GROUP
/begin GROUP ParkAssistEnable.SystemState.Mode "MICROSAR RTE" /begin SUB_GROUP /end SUB_GROUP /begin FUNCTION_LIST /end FUNCTION_LIST /begin REF_CHARACTERISTIC /end REF_CHARACTERISTIC /begin REF_MEASUREMENT ParkAssistEnable.SystemState.Mode /end REF_MEASUREMENT /end GROUP
/begin GROUP PhaseCtrl "MICROSAR RTE" /begin SUB_GROUP PhaseCtrl.ReceiverPorts /end SUB_GROUP /begin FUNCTION_LIST /end FUNCTION_LIST /begin REF_CHARACTERISTIC /end REF_CHARACTERISTIC /begin REF_MEASUREMENT /end REF_MEASUREMENT /end GROUP
/begin GROUP PhaseCtrl.MRFMtrVel.MtrRadpS_f32 "MICROSAR RTE" /begin SUB_GROUP /end SUB_GROUP /begin FUNCTION_LIST /end FUNCTION_LIST /begin REF_CHARACTERISTIC /end REF_CHARACTERISTIC /begin REF_MEASUREMENT PhaseCtrl.MRFMtrVel.MtrRadpS_f32 /end REF_MEASUREMENT /end GROUP
/begin GROUP PhaseCtrl.MtrQuad.Cnt_u08 "MICROSAR RTE" /begin SUB_GROUP /end SUB_GROUP /begin FUNCTION_LIST /end FUNCTION_LIST /begin REF_CHARACTERISTIC /end REF_CHARACTERISTIC /begin REF_MEASUREMENT PhaseCtrl.MtrQuad.Cnt_u08 /end REF_MEASUREMENT /end GROUP
/begin GROUP PhaseCtrl.ReceiverPorts "MICROSAR RTE"
 /begin SUB_GROUP PhaseCtrl.MRFMtrVel.MtrRadpS_f32 PhaseCtrl.MtrQuad.Cnt_u08 PhaseCtrl.TermA.Volt_f32 PhaseCtrl.TermBSS.Volt_f32 PhaseCtrl.TermBTOT.Volt_f32 PhaseCtrl.TermXd.Uls_f32 PhaseCtrl.TermXq.Uls_f32 PhaseCtrl.TermY.Uls_f32 PhaseCtrl.VdTerm.Volt_f32 PhaseCtrl.VqTerm.Volt_f32 /end SUB_GROUP
 /begin FUNCTION_LIST /end FUNCTION_LIST
 /begin REF_CHARACTERISTIC /end REF_CHARACTERISTIC
 /begin REF_MEASUREMENT /end REF_MEASUREMENT
/end GROUP
/begin GROUP PhaseCtrl.TermA.Volt_f32 "MICROSAR RTE" /begin SUB_GROUP /end SUB_GROUP /begin FUNCTION_LIST /end FUNCTION_LIST /begin REF_CHARACTERISTIC /end REF_CHARACTERISTIC /begin REF_MEASUREMENT PhaseCtrl.TermA.Volt_f32 /end REF_MEASUREMENT /end GROUP
/begin GROUP PhaseCtrl.TermBSS.Volt_f32 "MICROSAR RTE" /begin SUB_GROUP /end SUB_GROUP /begin FUNCTION_LIST /end FUNCTION_LIST /begin REF_CHARACTERISTIC /end REF_CHARACTERISTIC /begin REF_MEASUREMENT PhaseCtrl.TermBSS.Volt_f32 /end REF_MEASUREMENT /end GROUP
/begin GROUP PhaseCtrl.TermBTOT.Volt_f32 "MICROSAR RTE" /begin SUB_GROUP /end SUB_GROUP /begin FUNCTION_LIST /end FUNCTION_LIST /begin REF_CHARACTERISTIC /end REF_CHARACTERISTIC /begin REF_MEASUREMENT PhaseCtrl.TermBTOT.Volt_f32 /end REF_MEASUREMENT /end GROUP
/begin GROUP PhaseCtrl.TermXd.Uls_f32 "MICROSAR RTE" /begin SUB_GROUP /end SUB_GROUP /begin FUNCTION_LIST /end FUNCTION_LIST /begin REF_CHARACTERISTIC /end REF_CHARACTERISTIC /begin REF_MEASUREMENT PhaseCtrl.TermXd.Uls_f32 /end REF_MEASUREMENT /end GROUP
/begin GROUP PhaseCtrl.TermXq.Uls_f32 "MICROSAR RTE" /begin SUB_GROUP /end SUB_GROUP /begin FUNCTION_LIST /end FUNCTION_LIST /begin REF_CHARACTERISTIC /end REF_CHARACTERISTIC /begin REF_MEASUREMENT PhaseCtrl.TermXq.Uls_f32 /end REF_MEASUREMENT /end GROUP
/begin GROUP PhaseCtrl.TermY.Uls_f32 "MICROSAR RTE" /begin SUB_GROUP /end SUB_GROUP /begin FUNCTION_LIST /end FUNCTION_LIST /begin REF_CHARACTERISTIC /end REF_CHARACTERISTIC /begin REF_MEASUREMENT PhaseCtrl.TermY.Uls_f32 /end REF_MEASUREMENT /end GROUP
/begin GROUP PhaseCtrl.VdTerm.Volt_f32 "MICROSAR RTE" /begin SUB_GROUP /end SUB_GROUP /begin FUNCTION_LIST /end FUNCTION_LIST /begin REF_CHARACTERISTIC /end REF_CHARACTERISTIC /begin REF_MEASUREMENT PhaseCtrl.VdTerm.Volt_f32 /end REF_MEASUREMENT /end GROUP
/begin GROUP PhaseCtrl.VqTerm.Volt_f32 "MICROSAR RTE" /begin SUB_GROUP /end SUB_GROUP /begin FUNCTION_LIST /end FUNCTION_LIST /begin REF_CHARACTERISTIC /end REF_CHARACTERISTIC /begin REF_MEASUREMENT PhaseCtrl.VqTerm.Volt_f32 /end REF_MEASUREMENT /end GROUP
/begin GROUP PhaseDscnt "MICROSAR RTE"
 /begin SUB_GROUP PhaseDscnt.ModeRequirePorts PhaseDscnt.ReceiverPorts PhaseDscnt.SenderPorts /end SUB_GROUP
 /begin FUNCTION_LIST /end FUNCTION_LIST
 /begin REF_CHARACTERISTIC /end REF_CHARACTERISTIC
 /begin REF_MEASUREMENT /end REF_MEASUREMENT
/end GROUP
/begin GROUP PhaseDscnt.ModeRequirePorts "MICROSAR RTE" /begin SUB_GROUP PhaseDscnt.SystemState.Mode /end SUB_GROUP /begin FUNCTION_LIST /end FUNCTION_LIST /begin REF_CHARACTERISTIC /end REF_CHARACTERISTIC /begin REF_MEASUREMENT /end REF_MEASUREMENT /end GROUP
/begin GROUP PhaseDscnt.MotorQuadrant.Cnt_u08 "MICROSAR RTE" /begin SUB_GROUP /end SUB_GROUP /begin FUNCTION_LIST /end FUNCTION_LIST /begin REF_CHARACTERISTIC /end REF_CHARACTERISTIC /begin REF_MEASUREMENT PhaseDscnt.MotorQuadrant.Cnt_u08 /end REF_MEASUREMENT /end GROUP
/begin GROUP PhaseDscnt.MotorVelMRF.MtrRadpS_f32 "MICROSAR RTE" /begin SUB_GROUP /end SUB_GROUP /begin FUNCTION_LIST /end FUNCTION_LIST /begin REF_CHARACTERISTIC /end REF_CHARACTERISTIC /begin REF_MEASUREMENT PhaseDscnt.MotorVelMRF.MtrRadpS_f32 /end REF_MEASUREMENT /end GROUP
/begin GROUP PhaseDscnt.PDActivateTest.Cnt_lgc "MICROSAR RTE" /begin SUB_GROUP /end SUB_GROUP /begin FUNCTION_LIST /end FUNCTION_LIST /begin REF_CHARACTERISTIC /end REF_CHARACTERISTIC /begin REF_MEASUREMENT PhaseDscnt.PDActivateTest.Cnt_lgc /end REF_MEASUREMENT /end GROUP
/begin GROUP PhaseDscnt.PDChrgPmpFdbkADC.Volt_f32 "MICROSAR RTE" /begin SUB_GROUP /end SUB_GROUP /begin FUNCTION_LIST /end FUNCTION_LIST /begin REF_CHARACTERISTIC /end REF_CHARACTERISTIC /begin REF_MEASUREMENT PhaseDscnt.PDChrgPmpFdbkADC.Volt_f32 /end REF_MEASUREMENT /end GROUP
/begin GROUP PhaseDscnt.PDPhaseAdvSelect.Cnt_s16 "MICROSAR RTE" /begin SUB_GROUP /end SUB_GROUP /begin FUNCTION_LIST /end FUNCTION_LIST /begin REF_CHARACTERISTIC /end REF_CHARACTERISTIC /begin REF_MEASUREMENT PhaseDscnt.PDPhaseAdvSelect.Cnt_s16 /end REF_MEASUREMENT /end GROUP
/begin GROUP PhaseDscnt.PDSuplFdbkADC.Volt_f32 "MICROSAR RTE" /begin SUB_GROUP /end SUB_GROUP /begin FUNCTION_LIST /end FUNCTION_LIST /begin REF_CHARACTERISTIC /end REF_CHARACTERISTIC /begin REF_MEASUREMENT PhaseDscnt.PDSuplFdbkADC.Volt_f32 /end REF_MEASUREMENT /end GROUP
/begin GROUP PhaseDscnt.PDTestModIndex.Uls_f32 "MICROSAR RTE" /begin SUB_GROUP /end SUB_GROUP /begin FUNCTION_LIST /end FUNCTION_LIST /begin REF_CHARACTERISTIC /end REF_CHARACTERISTIC /begin REF_MEASUREMENT PhaseDscnt.PDTestModIndex.Uls_f32 /end REF_MEASUREMENT /end GROUP
/begin GROUP PhaseDscnt.PhsDiscTestComplete.Cnt_lgc "MICROSAR RTE" /begin SUB_GROUP /end SUB_GROUP /begin FUNCTION_LIST /end FUNCTION_LIST /begin REF_CHARACTERISTIC /end REF_CHARACTERISTIC /begin REF_MEASUREMENT PhaseDscnt.PhsDiscTestComplete.Cnt_lgc /end REF_MEASUREMENT /end GROUP
/begin GROUP PhaseDscnt.RawCurrFiltered.Amp_f32 "MICROSAR RTE" /begin SUB_GROUP /end SUB_GROUP /begin FUNCTION_LIST /end FUNCTION_LIST /begin REF_CHARACTERISTIC /end REF_CHARACTERISTIC /begin REF_MEASUREMENT PhaseDscnt.RawCurrFiltered.Amp_f32 /end REF_MEASUREMENT /end GROUP
/begin GROUP PhaseDscnt.ReceiverPorts "MICROSAR RTE"
 /begin SUB_GROUP PhaseDscnt.MotorQuadrant.Cnt_u08 PhaseDscnt.MotorVelMRF.MtrRadpS_f32 PhaseDscnt.PDChrgPmpFdbkADC.Volt_f32 PhaseDscnt.PDSuplFdbkADC.Volt_f32 PhaseDscnt.RawCurrFiltered.Amp_f32 /end SUB_GROUP
 /begin FUNCTION_LIST /end FUNCTION_LIST
 /begin REF_CHARACTERISTIC /end REF_CHARACTERISTIC
 /begin REF_MEASUREMENT /end REF_MEASUREMENT
/end GROUP
/begin GROUP PhaseDscnt.SenderPorts "MICROSAR RTE"
 /begin SUB_GROUP PhaseDscnt.PDActivateTest.Cnt_lgc PhaseDscnt.PDPhaseAdvSelect.Cnt_s16 PhaseDscnt.PDTestModIndex.Uls_f32 PhaseDscnt.PhsDiscTestComplete.Cnt_lgc /end SUB_GROUP
 /begin FUNCTION_LIST /end FUNCTION_LIST
 /begin REF_CHARACTERISTIC /end REF_CHARACTERISTIC
 /begin REF_MEASUREMENT /end REF_MEASUREMENT
/end GROUP
/begin GROUP PhaseDscnt.SystemState.Mode "MICROSAR RTE" /begin SUB_GROUP /end SUB_GROUP /begin FUNCTION_LIST /end FUNCTION_LIST /begin REF_CHARACTERISTIC /end REF_CHARACTERISTIC /begin REF_MEASUREMENT PhaseDscnt.SystemState.Mode /end REF_MEASUREMENT /end GROUP
/begin GROUP Polarity "MICROSAR RTE" /begin SUB_GROUP Polarity.PerInstanceMemories Polarity.SenderPorts /end SUB_GROUP /begin FUNCTION_LIST /end FUNCTION_LIST /begin REF_CHARACTERISTIC /end REF_CHARACTERISTIC /begin REF_MEASUREMENT /end REF_MEASUREMENT /end GROUP
/begin GROUP Polarity.AssistAssyPolarity.Cnt_s08 "MICROSAR RTE" /begin SUB_GROUP /end SUB_GROUP /begin FUNCTION_LIST /end FUNCTION_LIST /begin REF_CHARACTERISTIC /end REF_CHARACTERISTIC /begin REF_MEASUREMENT Polarity.AssistAssyPolarity.Cnt_s08 /end REF_MEASUREMENT /end GROUP
/begin GROUP Polarity.HwPosPolarity.Cnt_s08 "MICROSAR RTE" /begin SUB_GROUP /end SUB_GROUP /begin FUNCTION_LIST /end FUNCTION_LIST /begin REF_CHARACTERISTIC /end REF_CHARACTERISTIC /begin REF_MEASUREMENT Polarity.HwPosPolarity.Cnt_s08 /end REF_MEASUREMENT /end GROUP
/begin GROUP Polarity.HwTrqPolarity.Cnt_s08 "MICROSAR RTE" /begin SUB_GROUP /end SUB_GROUP /begin FUNCTION_LIST /end FUNCTION_LIST /begin REF_CHARACTERISTIC /end REF_CHARACTERISTIC /begin REF_MEASUREMENT Polarity.HwTrqPolarity.Cnt_s08 /end REF_MEASUREMENT /end GROUP
/begin GROUP Polarity.MtrElecMechPolarity.Cnt_s08 "MICROSAR RTE" /begin SUB_GROUP /end SUB_GROUP /begin FUNCTION_LIST /end FUNCTION_LIST /begin REF_CHARACTERISTIC /end REF_CHARACTERISTIC /begin REF_MEASUREMENT Polarity.MtrElecMechPolarity.Cnt_s08 /end REF_MEASUREMENT /end GROUP
/begin GROUP Polarity.MtrPosPolarity.Cnt_s08 "MICROSAR RTE" /begin SUB_GROUP /end SUB_GROUP /begin FUNCTION_LIST /end FUNCTION_LIST /begin REF_CHARACTERISTIC /end REF_CHARACTERISTIC /begin REF_MEASUREMENT Polarity.MtrPosPolarity.Cnt_s08 /end REF_MEASUREMENT /end GROUP
/begin GROUP Polarity.MtrVelPolarity.Cnt_s08 "MICROSAR RTE" /begin SUB_GROUP /end SUB_GROUP /begin FUNCTION_LIST /end FUNCTION_LIST /begin REF_CHARACTERISTIC /end REF_CHARACTERISTIC /begin REF_MEASUREMENT Polarity.MtrVelPolarity.Cnt_s08 /end REF_MEASUREMENT /end GROUP
/begin GROUP Polarity.PerInstanceMemories "MICROSAR RTE" /begin SUB_GROUP Polarity.k_SystemPolarity_Cnt_b16 /end SUB_GROUP /begin FUNCTION_LIST /end FUNCTION_LIST /begin REF_CHARACTERISTIC /end REF_CHARACTERISTIC /begin REF_MEASUREMENT /end REF_MEASUREMENT /end GROUP
/begin GROUP Polarity.SenderPorts "MICROSAR RTE"
 /begin SUB_GROUP Polarity.AssistAssyPolarity.Cnt_s08 Polarity.HwPosPolarity.Cnt_s08 Polarity.HwTrqPolarity.Cnt_s08 Polarity.MtrElecMechPolarity.Cnt_s08 Polarity.MtrPosPolarity.Cnt_s08 Polarity.MtrVelPolarity.Cnt_s08 Polarity.SysC_MtrElecMechPolarity.Cnt_s32 /end SUB_GROUP
 /begin FUNCTION_LIST /end FUNCTION_LIST
 /begin REF_CHARACTERISTIC /end REF_CHARACTERISTIC
 /begin REF_MEASUREMENT /end REF_MEASUREMENT
/end GROUP
/begin GROUP Polarity.SysC_MtrElecMechPolarity.Cnt_s32 "MICROSAR RTE" /begin SUB_GROUP /end SUB_GROUP /begin FUNCTION_LIST /end FUNCTION_LIST /begin REF_CHARACTERISTIC /end REF_CHARACTERISTIC /begin REF_MEASUREMENT Polarity.SysC_MtrElecMechPolarity.Cnt_s32 /end REF_MEASUREMENT /end GROUP
/begin GROUP Polarity.k_SystemPolarity_Cnt_b16 "MICROSAR RTE" /begin SUB_GROUP /end SUB_GROUP /begin FUNCTION_LIST /end FUNCTION_LIST /begin REF_CHARACTERISTIC /end REF_CHARACTERISTIC /begin REF_MEASUREMENT Polarity.k_SystemPolarity_Cnt_b16 /end REF_MEASUREMENT /end GROUP
/begin GROUP PosServo "MICROSAR RTE" /begin SUB_GROUP PosServo.ReceiverPorts PosServo.SenderPorts /end SUB_GROUP /begin FUNCTION_LIST /end FUNCTION_LIST /begin REF_CHARACTERISTIC /end REF_CHARACTERISTIC /begin REF_MEASUREMENT /end REF_MEASUREMENT /end GROUP
/begin GROUP PosServo.HandwheelPosition.HwDeg_f32 "MICROSAR RTE" /begin SUB_GROUP /end SUB_GROUP /begin FUNCTION_LIST /end FUNCTION_LIST /begin REF_CHARACTERISTIC /end REF_CHARACTERISTIC /begin REF_MEASUREMENT PosServo.HandwheelPosition.HwDeg_f32 /end REF_MEASUREMENT /end GROUP
/begin GROUP PosServo.HwTorque.HwNm_f32 "MICROSAR RTE" /begin SUB_GROUP /end SUB_GROUP /begin FUNCTION_LIST /end FUNCTION_LIST /begin REF_CHARACTERISTIC /end REF_CHARACTERISTIC /begin REF_MEASUREMENT PosServo.HwTorque.HwNm_f32 /end REF_MEASUREMENT /end GROUP
/begin GROUP PosServo.MotorVelCRF.MtrRadpS_f32 "MICROSAR RTE" /begin SUB_GROUP /end SUB_GROUP /begin FUNCTION_LIST /end FUNCTION_LIST /begin REF_CHARACTERISTIC /end REF_CHARACTERISTIC /begin REF_MEASUREMENT PosServo.MotorVelCRF.MtrRadpS_f32 /end REF_MEASUREMENT /end GROUP
/begin GROUP PosServo.PosSrvoCmd.MtrNm_f32 "MICROSAR RTE" /begin SUB_GROUP /end SUB_GROUP /begin FUNCTION_LIST /end FUNCTION_LIST /begin REF_CHARACTERISTIC /end REF_CHARACTERISTIC /begin REF_MEASUREMENT PosServo.PosSrvoCmd.MtrNm_f32 /end REF_MEASUREMENT /end GROUP
/begin GROUP PosServo.PosSrvoEnable.Cnt_lgc "MICROSAR RTE" /begin SUB_GROUP /end SUB_GROUP /begin FUNCTION_LIST /end FUNCTION_LIST /begin REF_CHARACTERISTIC /end REF_CHARACTERISTIC /begin REF_MEASUREMENT PosServo.PosSrvoEnable.Cnt_lgc /end REF_MEASUREMENT /end GROUP
/begin GROUP PosServo.PosSrvoHwAngle.HwDeg_f32 "MICROSAR RTE" /begin SUB_GROUP /end SUB_GROUP /begin FUNCTION_LIST /end FUNCTION_LIST /begin REF_CHARACTERISTIC /end REF_CHARACTERISTIC /begin REF_MEASUREMENT PosServo.PosSrvoHwAngle.HwDeg_f32 /end REF_MEASUREMENT /end GROUP
/begin GROUP PosServo.PosSrvoReturnSclFct.Uls_f32 "MICROSAR RTE" /begin SUB_GROUP /end SUB_GROUP /begin FUNCTION_LIST /end FUNCTION_LIST /begin REF_CHARACTERISTIC /end REF_CHARACTERISTIC /begin REF_MEASUREMENT PosServo.PosSrvoReturnSclFct.Uls_f32 /end REF_MEASUREMENT /end GROUP
/begin GROUP PosServo.PosSrvoSmoothEnable.Uls_f32 "MICROSAR RTE" /begin SUB_GROUP /end SUB_GROUP /begin FUNCTION_LIST /end FUNCTION_LIST /begin REF_CHARACTERISTIC /end REF_CHARACTERISTIC /begin REF_MEASUREMENT PosServo.PosSrvoSmoothEnable.Uls_f32 /end REF_MEASUREMENT /end GROUP
/begin GROUP PosServo.ReceiverPorts "MICROSAR RTE"
 /begin SUB_GROUP PosServo.HandwheelPosition.HwDeg_f32 PosServo.HwTorque.HwNm_f32 PosServo.MotorVelCRF.MtrRadpS_f32 PosServo.PosSrvoEnable.Cnt_lgc PosServo.PosSrvoHwAngle.HwDeg_f32 PosServo.VehicleSpeed.Kph_f32 /end SUB_GROUP
 /begin FUNCTION_LIST /end FUNCTION_LIST
 /begin REF_CHARACTERISTIC /end REF_CHARACTERISTIC
 /begin REF_MEASUREMENT /end REF_MEASUREMENT
/end GROUP
/begin GROUP PosServo.SenderPorts "MICROSAR RTE"
 /begin SUB_GROUP PosServo.PosSrvoCmd.MtrNm_f32 PosServo.PosSrvoReturnSclFct.Uls_f32 PosServo.PosSrvoSmoothEnable.Uls_f32 /end SUB_GROUP
 /begin FUNCTION_LIST /end FUNCTION_LIST
 /begin REF_CHARACTERISTIC /end REF_CHARACTERISTIC
 /begin REF_MEASUREMENT /end REF_MEASUREMENT
/end GROUP
/begin GROUP PosServo.VehicleSpeed.Kph_f32 "MICROSAR RTE" /begin SUB_GROUP /end SUB_GROUP /begin FUNCTION_LIST /end FUNCTION_LIST /begin REF_CHARACTERISTIC /end REF_CHARACTERISTIC /begin REF_MEASUREMENT PosServo.VehicleSpeed.Kph_f32 /end REF_MEASUREMENT /end GROUP
/begin GROUP PrimaryShutdown "MICROSAR RTE" /begin SUB_GROUP PrimaryShutdown.ModeRequirePorts /end SUB_GROUP /begin FUNCTION_LIST /end FUNCTION_LIST /begin REF_CHARACTERISTIC /end REF_CHARACTERISTIC /begin REF_MEASUREMENT /end REF_MEASUREMENT /end GROUP
/begin GROUP PrimaryShutdown.ModeRequirePorts "MICROSAR RTE" /begin SUB_GROUP PrimaryShutdown.SystemState.Mode /end SUB_GROUP /begin FUNCTION_LIST /end FUNCTION_LIST /begin REF_CHARACTERISTIC /end REF_CHARACTERISTIC /begin REF_MEASUREMENT /end REF_MEASUREMENT /end GROUP
/begin GROUP PrimaryShutdown.SystemState.Mode "MICROSAR RTE" /begin SUB_GROUP /end SUB_GROUP /begin FUNCTION_LIST /end FUNCTION_LIST /begin REF_CHARACTERISTIC /end REF_CHARACTERISTIC /begin REF_MEASUREMENT PrimaryShutdown.SystemState.Mode /end REF_MEASUREMENT /end GROUP
/begin GROUP PrkAstMfgServCh2 "MICROSAR RTE"
 /begin SUB_GROUP PrkAstMfgServCh2.ReceiverPorts PrkAstMfgServCh2.SenderPorts /end SUB_GROUP
 /begin FUNCTION_LIST /end FUNCTION_LIST
 /begin REF_CHARACTERISTIC /end REF_CHARACTERISTIC
 /begin REF_MEASUREMENT /end REF_MEASUREMENT
/end GROUP
/begin GROUP PrkAstMfgServCh2.LrnPnCntrCmd.MtrNm_f32 "MICROSAR RTE" /begin SUB_GROUP /end SUB_GROUP /begin FUNCTION_LIST /end FUNCTION_LIST /begin REF_CHARACTERISTIC /end REF_CHARACTERISTIC /begin REF_MEASUREMENT PrkAstMfgServCh2.LrnPnCntrCmd.MtrNm_f32 /end REF_MEASUREMENT /end GROUP
/begin GROUP PrkAstMfgServCh2.LrnPnCntrEnable.Cnt_lgc "MICROSAR RTE" /begin SUB_GROUP /end SUB_GROUP /begin FUNCTION_LIST /end FUNCTION_LIST /begin REF_CHARACTERISTIC /end REF_CHARACTERISTIC /begin REF_MEASUREMENT PrkAstMfgServCh2.LrnPnCntrEnable.Cnt_lgc /end REF_MEASUREMENT /end GROUP
/begin GROUP PrkAstMfgServCh2.PASpdHigh.Cnt_u08 "MICROSAR RTE" /begin SUB_GROUP /end SUB_GROUP /begin FUNCTION_LIST /end FUNCTION_LIST /begin REF_CHARACTERISTIC /end REF_CHARACTERISTIC /begin REF_MEASUREMENT PrkAstMfgServCh2.PASpdHigh.Cnt_u08 /end REF_MEASUREMENT /end GROUP
/begin GROUP PrkAstMfgServCh2.PosServEnable.Cnt_lgc "MICROSAR RTE" /begin SUB_GROUP /end SUB_GROUP /begin FUNCTION_LIST /end FUNCTION_LIST /begin REF_CHARACTERISTIC /end REF_CHARACTERISTIC /begin REF_MEASUREMENT PrkAstMfgServCh2.PosServEnable.Cnt_lgc /end REF_MEASUREMENT /end GROUP
/begin GROUP PrkAstMfgServCh2.PosSrvoSmoothEnable.Uls_f32 "MICROSAR RTE" /begin SUB_GROUP /end SUB_GROUP /begin FUNCTION_LIST /end FUNCTION_LIST /begin REF_CHARACTERISTIC /end REF_CHARACTERISTIC /begin REF_MEASUREMENT PrkAstMfgServCh2.PosSrvoSmoothEnable.Uls_f32 /end REF_MEASUREMENT /end GROUP
/begin GROUP PrkAstMfgServCh2.PrkAssistCmd.MtrNm_f32 "MICROSAR RTE" /begin SUB_GROUP /end SUB_GROUP /begin FUNCTION_LIST /end FUNCTION_LIST /begin REF_CHARACTERISTIC /end REF_CHARACTERISTIC /begin REF_MEASUREMENT PrkAstMfgServCh2.PrkAssistCmd.MtrNm_f32 /end REF_MEASUREMENT /end GROUP
/begin GROUP PrkAstMfgServCh2.ReceiverPorts "MICROSAR RTE"
 /begin SUB_GROUP PrkAstMfgServCh2.LrnPnCntrCmd.MtrNm_f32 PrkAstMfgServCh2.LrnPnCntrEnable.Cnt_lgc PrkAstMfgServCh2.PASpdHigh.Cnt_u08 PrkAstMfgServCh2.PosServEnable.Cnt_lgc PrkAstMfgServCh2.PosSrvoSmoothEnable.Uls_f32 PrkAstMfgServCh2.PrkAssistCmd.MtrNm_f32 PrkAstMfgServCh2.VehicleSpeed.Kph_f32 /end SUB_GROUP
 /begin FUNCTION_LIST /end FUNCTION_LIST
 /begin REF_CHARACTERISTIC /end REF_CHARACTERISTIC
 /begin REF_MEASUREMENT /end REF_MEASUREMENT
/end GROUP
/begin GROUP PrkAstMfgServCh2.SenderPorts "MICROSAR RTE"
 /begin SUB_GROUP PrkAstMfgServCh2.SysCLnPnCtrCCDisable.Cnt_lgc PrkAstMfgServCh2.SysCPosServCCDisable.Cnt_lgc /end SUB_GROUP
 /begin FUNCTION_LIST /end FUNCTION_LIST
 /begin REF_CHARACTERISTIC /end REF_CHARACTERISTIC
 /begin REF_MEASUREMENT /end REF_MEASUREMENT
/end GROUP
/begin GROUP PrkAstMfgServCh2.SysCLnPnCtrCCDisable.Cnt_lgc "MICROSAR RTE" /begin SUB_GROUP /end SUB_GROUP /begin FUNCTION_LIST /end FUNCTION_LIST /begin REF_CHARACTERISTIC /end REF_CHARACTERISTIC /begin REF_MEASUREMENT PrkAstMfgServCh2.SysCLnPnCtrCCDisable.Cnt_lgc /end REF_MEASUREMENT /end GROUP
/begin GROUP PrkAstMfgServCh2.SysCPosServCCDisable.Cnt_lgc "MICROSAR RTE" /begin SUB_GROUP /end SUB_GROUP /begin FUNCTION_LIST /end FUNCTION_LIST /begin REF_CHARACTERISTIC /end REF_CHARACTERISTIC /begin REF_MEASUREMENT PrkAstMfgServCh2.SysCPosServCCDisable.Cnt_lgc /end REF_MEASUREMENT /end GROUP
/begin GROUP PrkAstMfgServCh2.VehicleSpeed.Kph_f32 "MICROSAR RTE" /begin SUB_GROUP /end SUB_GROUP /begin FUNCTION_LIST /end FUNCTION_LIST /begin REF_CHARACTERISTIC /end REF_CHARACTERISTIC /begin REF_MEASUREMENT PrkAstMfgServCh2.VehicleSpeed.Kph_f32 /end REF_MEASUREMENT /end GROUP
/begin GROUP PwrLmtFunc "MICROSAR RTE"
 /begin SUB_GROUP PwrLmtFunc.ModeRequirePorts PwrLmtFunc.ReceiverPorts PwrLmtFunc.SenderPorts /end SUB_GROUP
 /begin FUNCTION_LIST /end FUNCTION_LIST
 /begin REF_CHARACTERISTIC /end REF_CHARACTERISTIC
 /begin REF_MEASUREMENT /end REF_MEASUREMENT
/end GROUP
/begin RECORD_LAYOUT RTE_RL_SWORD FNC_VALUES 1 SWORD ROW_DIR DIRECT /end RECORD_LAYOUT
/begin RECORD_LAYOUT RTE_RL_SLONG FNC_VALUES 1 SLONG ROW_DIR DIRECT /end RECORD_LAYOUT
/**********************************************************************************************************************
* COMPU_METHOD / COMPU_VTAB_RANGE
*********************************************************************************************************************/
/begin COMPU_METHOD RTE_CM_BOOLEAN "" TAB_VERB "%3.1" "" COMPU_TAB_REF RTE_CM_BOOLEAN /end COMPU_METHOD
/begin COMPU_VTAB_RANGE RTE_CM_BOOLEAN "" 2 0 0 "false" 1 255 "true" /end COMPU_VTAB_RANGE
/begin COMPU_METHOD RTE_CM_ENUM_StaMd_Mode "" TAB_VERB "%.1" "" COMPU_TAB_REF RTE_CM_ENUM_StaMd_Mode /end COMPU_METHOD
/begin COMPU_VTAB_RANGE RTE_CM_ENUM_StaMd_Mode "" 5 0 0 "RTE_MODE_StaMd_Mode_DISABLE" 1 1 "RTE_MODE_StaMd_Mode_OFF" 2 2 "RTE_MODE_StaMd_Mode_OPERATE" 3 3 "RTE_MODE_StaMd_Mode_WARMINIT" 4 4 "RTE_TRANSITION_StaMd_Mode" /end COMPU_VTAB_RANGE
/begin COMPU_METHOD RTE_CM_ENUM_FETPHASETYPE_ENUM "" TAB_VERB "%.1" "" COMPU_TAB_REF RTE_CM_ENUM_FETPHASETYPE_ENUM /end COMPU_METHOD
/begin COMPU_VTAB_RANGE RTE_CM_ENUM_FETPHASETYPE_ENUM "" 4 0 0 "NOPHASE" 1 1 "PHASEA" 2 2 "PHASEB" 3 3 "PHASEC" /end COMPU_VTAB_RANGE
/begin COMPU_METHOD RTE_CM_ENUM_FETFAULTTYPE_ENUM "" TAB_VERB "%.1" "" COMPU_TAB_REF RTE_CM_ENUM_FETFAULTTYPE_ENUM /end COMPU_METHOD
/begin COMPU_VTAB_RANGE RTE_CM_ENUM_FETFAULTTYPE_ENUM "" 3 0 0 "NOFAULT" 1 1 "LOWER" 2 2 "UPPER" /end COMPU_VTAB_RANGE
/begin COMPU_METHOD RTE_CM_ENUM_QU_SER_WSTA_EST_FTAX "" TAB_VERB "%.1" "" COMPU_TAB_REF RTE_CM_ENUM_QU_SER_WSTA_EST_FTAX /end COMPU_METHOD
/begin COMPU_VTAB_RANGE RTE_CM_ENUM_QU_SER_WSTA_EST_FTAX "" 10 32 32 "Cx20_Schnittstelle_verfuegbar___funktionsbereit" 33 33 "Cx21_Schnittstelle_aktiv" 96 96 "Cx60_Service_nicht_verfuegbar___Fehler" 128 128 "Cx80_Schnittstelle_wird_initialisiert" 224 224 "CxE0_Funktion_in_Rueckfallebene___V_Fzg_____0" 226 226 "CxE2_Funktion_in_Rueckfallebene___Hands_On" 227 227 "CxE3_Funktion_in_Rueckfallebene___EPS_Status" 228 228 "CxE4_Schnittstelle_inaktiv___Stillstandsnaher_Bereich_verlassen" 231 231 "CxE7_Schnittstelle_aktiv_degradiert" 255 255 "CxFF_Signal_ungueltig" /end COMPU_VTAB_RANGE
/begin COMPU_METHOD RTE_CM_ENUM_LktoLkStrStateType "" TAB_VERB "%.1" "" COMPU_TAB_REF RTE_CM_ENUM_LktoLkStrStateType /end COMPU_METHOD
/begin COMPU_VTAB_RANGE RTE_CM_ENUM_LktoLkStrStateType "" 8 0 0 "HOLD" 1 1 "POSANGVEL" 2 2 "POSMTRTRQ" 3 3 "NEGANGVEL" 4 4 "NEGMTRTRQ" 5 5 "MOVETO" 6 6 "DONE" 7 7 "TIMEOUT" /end COMPU_VTAB_RANGE
/begin COMPU_METHOD RTE_CM_ENUM_OscTrajCmdStateType "" TAB_VERB "%.1" "" COMPU_TAB_REF RTE_CM_ENUM_OscTrajCmdStateType /end COMPU_METHOD
/begin COMPU_VTAB_RANGE RTE_CM_ENUM_OscTrajCmdStateType "" 3 0 0 "CMD_STATE0" 1 1 "CMD_STATE1" 2 2 "CMD_STATE2" /end COMPU_VTAB_RANGE
/begin COMPU_METHOD RTE_CM_ENUM_ST_V_VEH_NSS "" TAB_VERB "%.1" "" COMPU_TAB_REF RTE_CM_ENUM_ST_V_VEH_NSS /end COMPU_METHOD
/begin COMPU_VTAB_RANGE RTE_CM_ENUM_ST_V_VEH_NSS "" 3 12 12 "CxC_Fahrzeug_im_stillstandsnahen_Bereich" 13 13 "CxD_Fahrzeug_nicht_im_stillstandsnahen_Bereich" 15 15 "CxF_Signal_ungueltig" /end COMPU_VTAB_RANGE
