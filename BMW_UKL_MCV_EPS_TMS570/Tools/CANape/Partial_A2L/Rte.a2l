/begin MEASUREMENT CtrldDisShtdn.SystemState.Mode "MICROSAR RTE" UBYTE RTE_CM_ENUM_StaMd_Mode 0 0 0 255 ECU_ADDRESS 0 SYMBOL_LINK "Rte_ModeMachine_StaMd_SystemState_Mode" 0 DISPLAY_IDENTIFIER CtrldDisShtdn.ModeRequirePorts.SystemState.Mode /end MEASUREMENT
/begin MEASUREMENT CurrentEst.EstPkCurr.AmpSq_f32 "MICROSAR RTE" FLOAT32_IEEE NO_COMPU_METHOD 0 0 1.175494351e-38 3.402823466e+38 ECU_ADDRESS 0 SYMBOL_LINK "Rte_CurrentEst_EstPkCurr_AmpSq_f32" 0 DISPLAY_IDENTIFIER CurrentEst.SenderPorts.EstPkCurr.AmpSq_f32 /end MEASUREMENT
/begin MEASUREMENT CurrentEst.EstPkCurr_AmpSq_f32 "MICROSAR RTE" FLOAT32_IEEE NO_COMPU_METHOD 0 0 1.175494351e-38 3.402823466e+38 ECU_ADDRESS 0 SYMBOL_LINK "Rte_Irv_CurrentEst_EstPkCurr_AmpSq_f32" 0 DISPLAY_IDENTIFIER CurrentEst.InterRunnableVariables.EstPkCurr_AmpSq_f32 /end MEASUREMENT
/begin MEASUREMENT CurrentEst.EstR.Ohm_f32 "MICROSAR RTE" FLOAT32_IEEE NO_COMPU_METHOD 0 0 1.175494351e-38 3.402823466e+38 ECU_ADDRESS 0 SYMBOL_LINK "Rte_ParamComp_EstR_Ohm_f32" 0 DISPLAY_IDENTIFIER CurrentEst.ReceiverPorts.EstR.Ohm_f32 /end MEASUREMENT
/begin MEASUREMENT CurrentEst.ExpIq.Amp_f32 "MICROSAR RTE" FLOAT32_IEEE NO_COMPU_METHOD 0 0 1.175494351e-38 3.402823466e+38 ECU_ADDRESS 0 SYMBOL_LINK "Rte_ParamComp_ExpIq_Amp_f32" 0 DISPLAY_IDENTIFIER CurrentEst.ReceiverPorts.ExpIq.Amp_f32 /end MEASUREMENT
/begin MEASUREMENT CurrentEst.FiltEstPkCurr.AmpSq_f32 "MICROSAR RTE" FLOAT32_IEEE NO_COMPU_METHOD 0 0 1.175494351e-38 3.402823466e+38 ECU_ADDRESS 0 SYMBOL_LINK "Rte_CurrentEst_FiltEstPkCurr_AmpSq_f32" 0 DISPLAY_IDENTIFIER CurrentEst.SenderPorts.FiltEstPkCurr.AmpSq_f32 /end MEASUREMENT
/begin MEASUREMENT CurrentEst.IdEst.Amp_f32 "MICROSAR RTE" FLOAT32_IEEE NO_COMPU_METHOD 0 0 1.175494351e-38 3.402823466e+38 ECU_ADDRESS 0 SYMBOL_LINK "Rte_CurrentEst_IdEst_Amp_f32" 0 DISPLAY_IDENTIFIER CurrentEst.SenderPorts.IdEst.Amp_f32 /end MEASUREMENT
/begin MEASUREMENT CurrentEst.ModIdx.Uls_f32 "MICROSAR RTE" FLOAT32_IEEE NO_COMPU_METHOD 0 0 1.175494351e-38 3.402823466e+38 ECU_ADDRESS 0 SYMBOL_LINK "Rte_VltgCtrl_ModIdx_Uls_f32" 0 DISPLAY_IDENTIFIER CurrentEst.ReceiverPorts.ModIdx.Uls_f32 /end MEASUREMENT
/begin MEASUREMENT CurrentEst.SystemState.Mode "MICROSAR RTE" UBYTE RTE_CM_ENUM_StaMd_Mode 0 0 0 255 ECU_ADDRESS 0 SYMBOL_LINK "Rte_ModeMachine_StaMd_SystemState_Mode" 0 DISPLAY_IDENTIFIER CurrentEst.ModeRequirePorts.SystemState.Mode /end MEASUREMENT
/begin MEASUREMENT CurrentEst.TermXq.Uls_f32 "MICROSAR RTE" FLOAT32_IEEE NO_COMPU_METHOD 0 0 1.175494351e-38 3.402823466e+38 ECU_ADDRESS 0 SYMBOL_LINK "Rte_VltgCtrl_TermXq_Uls_f32" 0 DISPLAY_IDENTIFIER CurrentEst.ReceiverPorts.TermXq.Uls_f32 /end MEASUREMENT
/begin MEASUREMENT CurrentEst.UncorrPhsAdv.Cnt_s16 "MICROSAR RTE" SWORD NO_COMPU_METHOD 0 0 -32768 32767 ECU_ADDRESS 0 SYMBOL_LINK "Rte_VltgCtrl_UnCorrPhsAdv_Cnt_s16" 0 DISPLAY_IDENTIFIER CurrentEst.ReceiverPorts.UncorrPhsAdv.Cnt_s16 /end MEASUREMENT
/begin MEASUREMENT CurrentEst.Vecu.Volt_f32 "This port prototype is inteded to communicate voltage signals that represent the ecu supplied voltage.  This signal has a lower limit, which is non-zero, to allow users of the signal to use it as a denominator in an expression without requiring a divide b" FLOAT32_IEEE NO_COMPU_METHOD 0 0 1.175494351e-38 3.402823466e+38 ECU_ADDRESS 0 SYMBOL_LINK "Rte_BatteryVoltage_Vecu_Volt_f32" 0 DISPLAY_IDENTIFIER CurrentEst.ReceiverPorts.Vecu.Volt_f32 /end MEASUREMENT
/begin MEASUREMENT CustPL.CASSISTMSA.Cnt_lgc "MICROSAR RTE" UBYTE RTE_CM_BOOLEAN 0 0 0 255 ECU_ADDRESS 0 SYMBOL_LINK "Rte_VehCfg_CASSISTMSA_Cnt_lgc" 0 DISPLAY_IDENTIFIER CustPL.ReceiverPorts.CASSISTMSA.Cnt_lgc /end MEASUREMENT
/begin MEASUREMENT CustPL.CBATCURLIMITCUR.Amp_f32 "MICROSAR RTE" FLOAT32_IEEE NO_COMPU_METHOD 0 0 1.175494351e-38 3.402823466e+38 ECU_ADDRESS 0 SYMBOL_LINK "Rte_VehCfg_CBATCURLIMITCURRENT_Amp_f32" 0 DISPLAY_IDENTIFIER CustPL.ReceiverPorts.CBATCURLIMITCUR.Amp_f32 /end MEASUREMENT
/begin MEASUREMENT CustPL.CCLMSAActive.Cnt_lgc "MICROSAR RTE" UBYTE RTE_CM_BOOLEAN 0 0 0 255 ECU_ADDRESS 0 SYMBOL_LINK "Rte_CustPL_CCLMSAActive_Cnt_lgc" 0 DISPLAY_IDENTIFIER CustPL.SenderPorts.CCLMSAActive.Cnt_lgc /end MEASUREMENT
/begin MEASUREMENT CustPL.CCLTrqRamp.Uls_f32 "MICROSAR RTE" FLOAT32_IEEE NO_COMPU_METHOD 0 0 1.175494351e-38 3.402823466e+38 ECU_ADDRESS 0 SYMBOL_LINK "Rte_CustPL_CCLTrqRamp_Uls_f32" 0 DISPLAY_IDENTIFIER CustPL.SenderPorts.CCLTrqRamp.Uls_f32 /end MEASUREMENT
/begin MEASUREMENT CustPL.CVEHSPDCURLIMITCURRENT.Amp_f32 "MICROSAR RTE" FLOAT32_IEEE NO_COMPU_METHOD 0 0 1.175494351e-38 3.402823466e+38 ECU_ADDRESS 0 SYMBOL_LINK "Rte_VehCfg_CVEHSPDCURLIMITCURRENT_Amp_f32" 0 DISPLAY_IDENTIFIER CustPL.ReceiverPorts.CVEHSPDCURLIMITCURRENT.Amp_f32 /end MEASUREMENT
/begin MEASUREMENT CustPL.CVEHSPDCURLIMITER.Cnt_lgc "MICROSAR RTE" UBYTE RTE_CM_BOOLEAN 0 0 0 255 ECU_ADDRESS 0 SYMBOL_LINK "Rte_VehCfg_CVEHSPDCURLIMITER_Cnt_lgc" 0 DISPLAY_IDENTIFIER CustPL.ReceiverPorts.CVEHSPDCURLIMITER.Cnt_lgc /end MEASUREMENT
/begin MEASUREMENT CustPL.CVEHSPDCURLIMITSPEED.Kph_f32 "MICROSAR RTE" FLOAT32_IEEE NO_COMPU_METHOD 0 0 1.175494351e-38 3.402823466e+38 ECU_ADDRESS 0 SYMBOL_LINK "Rte_VehCfg_CVEHSPDCURLIMITSPEED_Kph_f32" 0 DISPLAY_IDENTIFIER CustPL.ReceiverPorts.CVEHSPDCURLIMITSPEED.Kph_f32 /end MEASUREMENT
/begin MEASUREMENT CustPL.CustCurrLmt.Amp_f32 "MICROSAR RTE" FLOAT32_IEEE NO_COMPU_METHOD 0 0 1.175494351e-38 3.402823466e+38 ECU_ADDRESS 0 SYMBOL_LINK "Rte_CustPL_CustCurrLmt_Amp_f32" 0 DISPLAY_IDENTIFIER CustPL.SenderPorts.CustCurrLmt.Amp_f32 /end MEASUREMENT
/begin MEASUREMENT CustPL.MSACommand.MSACmd_enum "MICROSAR RTE" UBYTE RTE_CM_ENUM_MSA_Cmd_Type 0 0 0 3 ECU_ADDRESS 0 SYMBOL_LINK "Rte_VehPwrMd_MSACommand_MSACmd_enum" 0 DISPLAY_IDENTIFIER CustPL.ReceiverPorts.MSACommand.MSACmd_enum /end MEASUREMENT
/begin MEASUREMENT CustPL.SupplyCurrLmt.Amp_f32 "MICROSAR RTE" FLOAT32_IEEE NO_COMPU_METHOD 0 0 1.175494351e-38 3.402823466e+38 ECU_ADDRESS 0 SYMBOL_LINK "Rte_SrlComInput_SupplyCurrLmt_Amp_f32" 0 DISPLAY_IDENTIFIER CustPL.ReceiverPorts.SupplyCurrLmt.Amp_f32 /end MEASUREMENT
/begin MEASUREMENT CustPL.SystemState.Mode "MICROSAR RTE" UBYTE RTE_CM_ENUM_StaMd_Mode 0 0 0 255 ECU_ADDRESS 0 SYMBOL_LINK "Rte_ModeMachine_StaMd7_SystemState7_Mode" 0 DISPLAY_IDENTIFIER CustPL.ModeRequirePorts.SystemState.Mode /end MEASUREMENT
/begin MEASUREMENT CustPL.VehicleSpeed.Kph_f32 "MICROSAR RTE" FLOAT32_IEEE NO_COMPU_METHOD 0 0 1.175494351e-38 3.402823466e+38 ECU_ADDRESS 0 SYMBOL_LINK "Rte_SignlCondn_VehicleSpeed_Kph_f32" 0 DISPLAY_IDENTIFIER CustPL.ReceiverPorts.VehicleSpeed.Kph_f32 /end MEASUREMENT
/begin MEASUREMENT Damping.AssistCmd.MtrNm_f32 "MICROSAR RTE" FLOAT32_IEEE NO_COMPU_METHOD 0 0 1.175494351e-38 3.402823466e+38 ECU_ADDRESS 0 SYMBOL_LINK "Rte_StabilityComp_AssistCmd_MtrNm_f32" 0 DISPLAY_IDENTIFIER Damping.ReceiverPorts.AssistCmd.MtrNm_f32 /end MEASUREMENT
/begin MEASUREMENT Damping.AssistMechTempEst.DegC_f32 "MICROSAR RTE" FLOAT32_IEEE NO_COMPU_METHOD 0 0 1.175494351e-38 3.402823466e+38 ECU_ADDRESS 0 SYMBOL_LINK "Rte_MtrTempEst_AssistMechTempEst_DegC_f32" 0 DISPLAY_IDENTIFIER Damping.ReceiverPorts.AssistMechTempEst.DegC_f32 /end MEASUREMENT
/begin MEASUREMENT Damping.CustomDamp.MtrNm_f32 "MICROSAR RTE" FLOAT32_IEEE NO_COMPU_METHOD 0 0 1.175494351e-38 3.402823466e+38 ECU_ADDRESS 0 SYMBOL_LINK "Rte_Ap_TJADamp_CustomDamp_MtrNm_f32" 0 DISPLAY_IDENTIFIER Damping.ReceiverPorts.CustomDamp.MtrNm_f32 /end MEASUREMENT
/begin MEASUREMENT Damping.DampingCmd.MtrNm_f32 "MICROSAR RTE" FLOAT32_IEEE NO_COMPU_METHOD 0 0 1.175494351e-38 3.402823466e+38 ECU_ADDRESS 0 SYMBOL_LINK "Rte_Damping_DampingCmd_MtrNm_f32" 0 DISPLAY_IDENTIFIER Damping.SenderPorts.DampingCmd.MtrNm_f32 /end MEASUREMENT
/begin MEASUREMENT Damping.DampingDDFactor.Uls_f32 "MICROSAR RTE" FLOAT32_IEEE NO_COMPU_METHOD 0 0 1.175494351e-38 3.402823466e+38 ECU_ADDRESS 0 SYMBOL_LINK "Rte_DrvDynCtrl_DampingDDFactor_Uls_f32" 0 DISPLAY_IDENTIFIER Damping.ReceiverPorts.DampingDDFactor.Uls_f32 /end MEASUREMENT
/begin MEASUREMENT Damping.DefeatDampingSvc.Cnt_lgc "MICROSAR RTE" UBYTE RTE_CM_BOOLEAN 0 0 0 255 ECU_ADDRESS 0 SYMBOL_LINK "Rte_CDDInterface9_DampingSrlComSvcDft_Cnt_lgc" 0 DISPLAY_IDENTIFIER Damping.ReceiverPorts.DefeatDampingSvc.Cnt_lgc /end MEASUREMENT
/begin MEASUREMENT Damping.HwTorque.HwNm_f32 "MICROSAR RTE" FLOAT32_IEEE NO_COMPU_METHOD 0 0 1.175494351e-38 3.402823466e+38 ECU_ADDRESS 0 SYMBOL_LINK "Rte_Sweep_OutputHwTrq_HwNm_f32" 0 DISPLAY_IDENTIFIER Damping.ReceiverPorts.HwTorque.HwNm_f32 /end MEASUREMENT
/begin MEASUREMENT Damping.MotorVelCRF.MtrRadpS_f32 "MICROSAR RTE" FLOAT32_IEEE NO_COMPU_METHOD 0 0 1.175494351e-38 3.402823466e+38 ECU_ADDRESS 0 SYMBOL_LINK "Rte_MtrVel_CRFMotorVel_MtrRadpS_f32" 0 DISPLAY_IDENTIFIER Damping.ReceiverPorts.MotorVelCRF.MtrRadpS_f32 /end MEASUREMENT
/begin MEASUREMENT Damping.VehicleSpeed.Kph_f32 "MICROSAR RTE" FLOAT32_IEEE NO_COMPU_METHOD 0 0 1.175494351e-38 3.402823466e+38 ECU_ADDRESS 0 SYMBOL_LINK "Rte_SignlCondn_VehicleSpeed_Kph_f32" 0 DISPLAY_IDENTIFIER Damping.ReceiverPorts.VehicleSpeed.Kph_f32 /end MEASUREMENT
/begin MEASUREMENT DampingFirewall.AsstFirewallActive.Uls_f32 "MICROSAR RTE" FLOAT32_IEEE NO_COMPU_METHOD 0 0 1.175494351e-38 3.402823466e+38 ECU_ADDRESS 0 SYMBOL_LINK "Rte_AssistFirewall_AsstFirewallActive_Uls_f32" 0 DISPLAY_IDENTIFIER DampingFirewall.ReceiverPorts.AsstFirewallActive.Uls_f32 /end MEASUREMENT
/begin MEASUREMENT DampingFirewall.BaseAssistCmd.MtrNm_f32 "MICROSAR RTE" FLOAT32_IEEE NO_COMPU_METHOD 0 0 1.175494351e-38 3.402823466e+38 ECU_ADDRESS 0 SYMBOL_LINK "Rte_Assist_BaseAssistCmd_MtrNm_f32" 0 DISPLAY_IDENTIFIER DampingFirewall.ReceiverPorts.BaseAssistCmd.MtrNm_f32 /end MEASUREMENT
/begin MEASUREMENT DampingFirewall.CombinedDamping.MtrNm_f32 "MICROSAR RTE" FLOAT32_IEEE NO_COMPU_METHOD 0 0 1.175494351e-38 3.402823466e+38 ECU_ADDRESS 0 SYMBOL_LINK "Rte_DampingFirewall_CombinedDamping_MtrNm_f32" 0 DISPLAY_IDENTIFIER DampingFirewall.SenderPorts.CombinedDamping.MtrNm_f32 /end MEASUREMENT
/begin MEASUREMENT DampingFirewall.DampingCmd.MtrNm_f32 "MICROSAR RTE" FLOAT32_IEEE NO_COMPU_METHOD 0 0 1.175494351e-38 3.402823466e+38 ECU_ADDRESS 0 SYMBOL_LINK "Rte_Damping_DampingCmd_MtrNm_f32" 0 DISPLAY_IDENTIFIER DampingFirewall.ReceiverPorts.DampingCmd.MtrNm_f32 /end MEASUREMENT
/begin MEASUREMENT DampingFirewall.Defeat_Damping_Svc.Cnt_lgc "MICROSAR RTE" UBYTE RTE_CM_BOOLEAN 0 0 0 255 ECU_ADDRESS 0 SYMBOL_LINK "Rte_CDDInterface9_FirewallSrlComSrvDft_Cnt_lgc" 0 DISPLAY_IDENTIFIER DampingFirewall.ReceiverPorts.Defeat_Damping_Svc.Cnt_lgc /end MEASUREMENT
/begin MEASUREMENT DampingFirewall.FreqDepDmpSrlComSvcDft.Cnt_lgc "MICROSAR RTE" UBYTE RTE_CM_BOOLEAN 0 0 0 255 ECU_ADDRESS 0 SYMBOL_LINK "Rte_CDDInterface9_FreqDepDmpSrlComSvcDft_Cnt_lgc" 0 DISPLAY_IDENTIFIER DampingFirewall.ReceiverPorts.FreqDepDmpSrlComSvcDft.Cnt_lgc /end MEASUREMENT
/begin MEASUREMENT DampingFirewall.HwTorque.HwNm_f32 "MICROSAR RTE" FLOAT32_IEEE NO_COMPU_METHOD 0 0 1.175494351e-38 3.402823466e+38 ECU_ADDRESS 0 SYMBOL_LINK "Rte_Sweep_OutputHwTrq_HwNm_f32" 0 DISPLAY_IDENTIFIER DampingFirewall.ReceiverPorts.HwTorque.HwNm_f32 /end MEASUREMENT
/begin MEASUREMENT DampingFirewall.InertiaComp.MtrNm_f32 "MICROSAR RTE" FLOAT32_IEEE NO_COMPU_METHOD 0 0 1.175494351e-38 3.402823466e+38 ECU_ADDRESS 0 SYMBOL_LINK "Rte_FrqDepDmpnInrtCmp_FrqDepDmpnInrtCmp_MtrNm_f32" 0 DISPLAY_IDENTIFIER DampingFirewall.ReceiverPorts.InertiaComp.MtrNm_f32 /end MEASUREMENT
/begin MEASUREMENT DampingFirewall.MEC_Counter.Cnt_enum "MICROSAR RTE" UBYTE RTE_CM_ENUM_ManufModeType 0 0 0 2 ECU_ADDRESS 0 SYMBOL_LINK "Rte_CDDInterface9_NxtrMEC_Cnt_enum" 0 DISPLAY_IDENTIFIER DampingFirewall.ReceiverPorts.MEC_Counter.Cnt_enum /end MEASUREMENT
/begin MEASUREMENT DampingFirewall.MtrVelCRF.MtrRadpS_f32 "MICROSAR RTE" FLOAT32_IEEE NO_COMPU_METHOD 0 0 1.175494351e-38 3.402823466e+38 ECU_ADDRESS 0 SYMBOL_LINK "Rte_MtrVel_CRFMotorVel_MtrRadpS_f32" 0 DISPLAY_IDENTIFIER DampingFirewall.ReceiverPorts.MtrVelCRF.MtrRadpS_f32 /end MEASUREMENT
/begin MEASUREMENT DampingFirewall.SystemState.Mode "MICROSAR RTE" UBYTE RTE_CM_ENUM_StaMd_Mode 0 0 0 255 ECU_ADDRESS 0 SYMBOL_LINK "Rte_ModeMachine_StaMd_SystemState_Mode" 0 DISPLAY_IDENTIFIER DampingFirewall.ModeRequirePorts.SystemState.Mode /end MEASUREMENT
/begin MEASUREMENT DampingFirewall.VehicleLonAccel.KphpS_f32 "MICROSAR RTE" FLOAT32_IEEE NO_COMPU_METHOD 0 0 1.175494351e-38 3.402823466e+38 ECU_ADDRESS 0 SYMBOL_LINK "Rte_DampingFirewall_VehicleLonAccel_KphpS_f32" 0 DISPLAY_IDENTIFIER DampingFirewall.ReceiverPorts.VehicleLonAccel.KphpS_f32 /end MEASUREMENT
/begin MEASUREMENT DampingFirewall.VehicleSpeed.Kph_f32 "MICROSAR RTE" FLOAT32_IEEE NO_COMPU_METHOD 0 0 1.175494351e-38 3.402823466e+38 ECU_ADDRESS 0 SYMBOL_LINK "Rte_SignlCondn_VehicleSpeed_Kph_f32" 0 DISPLAY_IDENTIFIER DampingFirewall.ReceiverPorts.VehicleSpeed.Kph_f32 /end MEASUREMENT
/begin MEASUREMENT DampingFirewall.WIRCmdAmpBlnd.MtrNm_f32 "MICROSAR RTE" FLOAT32_IEEE NO_COMPU_METHOD 0 0 1.175494351e-38 3.402823466e+38 ECU_ADDRESS 0 SYMBOL_LINK "Rte_DampingFirewall_WIRCmdAmpBlnd_MtrNm_f32" 0 DISPLAY_IDENTIFIER DampingFirewall.ReceiverPorts.WIRCmdAmpBlnd.MtrNm_f32 /end MEASUREMENT
/begin MEASUREMENT DemIf.ErrmBnU.Cnt_u8 "MICROSAR RTE" UBYTE RTE_CM_ENUM_CTR_ERRM_BN_U 0 0 0 63 ECU_ADDRESS 0 SYMBOL_LINK "Rte_SrlComInput_ErrmBnU_Cnt_u8" 0 DISPLAY_IDENTIFIER DemIf.ReceiverPorts.ErrmBnU.Cnt_u8 /end MEASUREMENT
/begin MEASUREMENT DemIf.IlkErrmFzm.Cnt_u8 "MICROSAR RTE" UBYTE RTE_CM_ENUM_ST_ILK_ERRM_FZM 0 0 0 3 ECU_ADDRESS 0 SYMBOL_LINK "Rte_SrlComInput_IlkErrmFzm_Cnt_u8" 0 DISPLAY_IDENTIFIER DemIf.ReceiverPorts.IlkErrmFzm.Cnt_u8 /end MEASUREMENT
/begin MEASUREMENT DemIf.SrlComEngCrank.Cnt_lgc "MICROSAR RTE" UBYTE RTE_CM_BOOLEAN 0 0 0 255 ECU_ADDRESS 0 SYMBOL_LINK "Rte_SrlComInput2_SrlComEngCrank_Cnt_lgc" 0 DISPLAY_IDENTIFIER DemIf.ReceiverPorts.SrlComEngCrank.Cnt_lgc /end MEASUREMENT
/begin MEASUREMENT DiagMgr10.DiagRampRate.XpmS_f32 "MICROSAR RTE" FLOAT32_IEEE NO_COMPU_METHOD 0 0 1.175494351e-38 3.402823466e+38 ECU_ADDRESS 0 SYMBOL_LINK "Rte_DiagMgr10_DiagRampRate_XpmS_f32" 0 DISPLAY_IDENTIFIER DiagMgr10.SenderPorts.DiagRampRate.XpmS_f32 /end MEASUREMENT
/begin MEASUREMENT DiagMgr10.DiagRampValue.Uls_f32 "MICROSAR RTE" FLOAT32_IEEE NO_COMPU_METHOD 0 0 1.175494351e-38 3.402823466e+38 ECU_ADDRESS 0 SYMBOL_LINK "Rte_DiagMgr10_DiagRampValue_Uls_f32" 0 DISPLAY_IDENTIFIER DiagMgr10.SenderPorts.DiagRampValue.Uls_f32 /end MEASUREMENT
/begin MEASUREMENT DiagMgr10.DiagRmpToZeroActive.Cnt_lgc "MICROSAR RTE" UBYTE RTE_CM_BOOLEAN 0 0 0 255 ECU_ADDRESS 0 SYMBOL_LINK "Rte_DiagMgr10_DiagRmpToZeroActive_Cnt_lgc" 0 DISPLAY_IDENTIFIER DiagMgr10.SenderPorts.DiagRmpToZeroActive.Cnt_lgc /end MEASUREMENT
/begin MEASUREMENT DiagMgr10.DiagStsCtrldDisRmpPres.Cnt_lgc "MICROSAR RTE" UBYTE RTE_CM_BOOLEAN 0 0 0 255 ECU_ADDRESS 0 SYMBOL_LINK "Rte_DiagMgr10_DiagStsCtrldDisRmpPres_Cnt_lgc" 0 DISPLAY_IDENTIFIER DiagMgr10.SenderPorts.DiagStsCtrldDisRmpPres.Cnt_lgc /end MEASUREMENT
/begin MEASUREMENT DiagMgr10.DiagStsDefTemp.Cnt_lgc "MICROSAR RTE" UBYTE RTE_CM_BOOLEAN 0 0 0 255 ECU_ADDRESS 0 SYMBOL_LINK "Rte_DiagMgr10_DiagStsDefTemp_Cnt_lgc" 0 DISPLAY_IDENTIFIER DiagMgr10.SenderPorts.DiagStsDefTemp.Cnt_lgc /end MEASUREMENT
/begin MEASUREMENT DiagMgr10.DiagStsDefVehSpd.Cnt_lgc "MICROSAR RTE" UBYTE RTE_CM_BOOLEAN 0 0 0 255 ECU_ADDRESS 0 SYMBOL_LINK "Rte_DiagMgr10_DiagStsDefVehSpd_Cnt_lgc" 0 DISPLAY_IDENTIFIER DiagMgr10.SenderPorts.DiagStsDefVehSpd.Cnt_lgc /end MEASUREMENT
/begin MEASUREMENT DiagMgr10.DiagStsHWASbSystmFltPres.Cnt_lgc "MICROSAR RTE" UBYTE RTE_CM_BOOLEAN 0 0 0 255 ECU_ADDRESS 0 SYMBOL_LINK "Rte_DiagMgr10_DiagStsHWASbSystmFltPres_Cnt_lgc" 0 DISPLAY_IDENTIFIER DiagMgr10.SenderPorts.DiagStsHWASbSystmFltPres.Cnt_lgc /end MEASUREMENT
/begin MEASUREMENT DiagMgr10.DiagStsNonRecRmpToZeroFltPres.Cnt_lgc "MICROSAR RTE" UBYTE RTE_CM_BOOLEAN 0 0 0 255 ECU_ADDRESS 0 SYMBOL_LINK "Rte_DiagMgr10_DiagStsNonRecRmpToZeroFltPres_Cnt_lgc" 0 DISPLAY_IDENTIFIER DiagMgr10.SenderPorts.DiagStsNonRecRmpToZeroFltPres.Cnt_lgc /end MEASUREMENT
/begin MEASUREMENT DiagMgr10.DiagStsRecRmpToZeroFltPres.Cnt_lgc "MICROSAR RTE" UBYTE RTE_CM_BOOLEAN 0 0 0 255 ECU_ADDRESS 0 SYMBOL_LINK "Rte_DiagMgr10_DiagStsRecRmpToZeroFltPres_Cnt_lgc" 0 DISPLAY_IDENTIFIER DiagMgr10.SenderPorts.DiagStsRecRmpToZeroFltPres.Cnt_lgc /end MEASUREMENT
/begin MEASUREMENT DiagMgr10.DiagStsScomHWANotValid.Cnt_lgc "MICROSAR RTE" UBYTE RTE_CM_BOOLEAN 0 0 0 255 ECU_ADDRESS 0 SYMBOL_LINK "Rte_DiagMgr10_DiagStsScomHWANotValid_Cnt_lgc" 0 DISPLAY_IDENTIFIER DiagMgr10.SenderPorts.DiagStsScomHWANotValid.Cnt_lgc /end MEASUREMENT
/begin MEASUREMENT DiagMgr10.DiagStsWIRDisable.Cnt_lgc "MICROSAR RTE" UBYTE RTE_CM_BOOLEAN 0 0 0 255 ECU_ADDRESS 0 SYMBOL_LINK "Rte_DiagMgr10_DiagStsWIRDisable_Cnt_lgc" 0 DISPLAY_IDENTIFIER DiagMgr10.SenderPorts.DiagStsWIRDisable.Cnt_lgc /end MEASUREMENT
/begin MEASUREMENT DiagMgr10.HwTrq.HwNm_f32 "MICROSAR RTE" FLOAT32_IEEE NO_COMPU_METHOD 0 0 1.175494351e-38 3.402823466e+38 ECU_ADDRESS 0 SYMBOL_LINK "Rte_HwTrq_AnaHwTorque_HwNm_f32" 0 DISPLAY_IDENTIFIER DiagMgr10.ReceiverPorts.HwTrq.HwNm_f32 /end MEASUREMENT
/begin MEASUREMENT DiagMgr10.IgnCnt.Cnt_u16 "MICROSAR RTE" UWORD NO_COMPU_METHOD 0 0 0 65535 ECU_ADDRESS 0 SYMBOL_LINK "Rte_CDDInterface9_IgnCnt_Cnt_u16" 0 DISPLAY_IDENTIFIER DiagMgr10.ReceiverPorts.IgnCnt.Cnt_u16 /end MEASUREMENT
/begin MEASUREMENT DiagMgr10.MEC.Cnt_enum "MICROSAR RTE" UBYTE RTE_CM_ENUM_ManufModeType 0 0 0 2 ECU_ADDRESS 0 SYMBOL_LINK "Rte_CDDInterface9_NxtrMEC_Cnt_enum" 0 DISPLAY_IDENTIFIER DiagMgr10.ReceiverPorts.MEC.Cnt_enum /end MEASUREMENT
/begin MEASUREMENT DiagMgr10.MfgDiagInhibit.Cnt_lgc "MICROSAR RTE" UBYTE RTE_CM_BOOLEAN 0 0 0 255 ECU_ADDRESS 0 SYMBOL_LINK "Rte_CDDInterface9_MfgDiagInhibit_Cnt_lgc" 0 DISPLAY_IDENTIFIER DiagMgr10.ReceiverPorts.MfgDiagInhibit.Cnt_lgc /end MEASUREMENT
/begin MEASUREMENT DiagMgr10.MtrTrq.MtrNm_f32 "MICROSAR RTE" FLOAT32_IEEE NO_COMPU_METHOD 0 0 1.175494351e-38 3.402823466e+38 ECU_ADDRESS 0 SYMBOL_LINK "Rte_CtrldDisShtdn_CntDisMtrTrqCmdMRF_MtrNm_f32" 0 DISPLAY_IDENTIFIER DiagMgr10.ReceiverPorts.MtrTrq.MtrNm_f32 /end MEASUREMENT
/begin MEASUREMENT DiagMgr10.SystemState.Mode "MICROSAR RTE" UBYTE RTE_CM_ENUM_StaMd_Mode 0 0 0 255 ECU_ADDRESS 0 SYMBOL_LINK "Rte_ModeMachine_StaMd_SystemState_Mode" 0 DISPLAY_IDENTIFIER DiagMgr10.ModeRequirePorts.SystemState.Mode /end MEASUREMENT
/begin MEASUREMENT DiagMgr10.VehSpd.Kph_f32 "MICROSAR RTE" FLOAT32_IEEE NO_COMPU_METHOD 0 0 1.175494351e-38 3.402823466e+38 ECU_ADDRESS 0 SYMBOL_LINK "Rte_SignlCondn_VehicleSpeed_Kph_f32" 0 DISPLAY_IDENTIFIER DiagMgr10.ReceiverPorts.VehSpd.Kph_f32 /end MEASUREMENT
/begin MEASUREMENT DiagMgr11.HwTrq.HwNm_f32 "MICROSAR RTE" FLOAT32_IEEE NO_COMPU_METHOD 0 0 1.175494351e-38 3.402823466e+38 ECU_ADDRESS 0 SYMBOL_LINK "Rte_HwTrq_AnaHwTorque_HwNm_f32" 0 DISPLAY_IDENTIFIER DiagMgr11.ReceiverPorts.HwTrq.HwNm_f32 /end MEASUREMENT
/begin MEASUREMENT DiagMgr11.IgnCnt.Cnt_u16 "MICROSAR RTE" UWORD NO_COMPU_METHOD 0 0 0 65535 ECU_ADDRESS 0 SYMBOL_LINK "Rte_CDDInterface9_IgnCnt_Cnt_u16" 0 DISPLAY_IDENTIFIER DiagMgr11.ReceiverPorts.IgnCnt.Cnt_u16 /end MEASUREMENT
/begin MEASUREMENT DiagMgr11.MEC.Cnt_enum "MICROSAR RTE" UBYTE RTE_CM_ENUM_ManufModeType 0 0 0 2 ECU_ADDRESS 0 SYMBOL_LINK "Rte_CDDInterface9_NxtrMEC_Cnt_enum" 0 DISPLAY_IDENTIFIER DiagMgr11.ReceiverPorts.MEC.Cnt_enum /end MEASUREMENT
/begin MEASUREMENT DiagMgr11.MfgDiagInhibit.Cnt_lgc "MICROSAR RTE" UBYTE RTE_CM_BOOLEAN 0 0 0 255 ECU_ADDRESS 0 SYMBOL_LINK "Rte_CDDInterface9_MfgDiagInhibit_Cnt_lgc" 0 DISPLAY_IDENTIFIER DiagMgr11.ReceiverPorts.MfgDiagInhibit.Cnt_lgc /end MEASUREMENT
/begin MEASUREMENT DiagMgr11.MtrTrq.MtrNm_f32 "MICROSAR RTE" FLOAT32_IEEE NO_COMPU_METHOD 0 0 1.175494351e-38 3.402823466e+38 ECU_ADDRESS 0 SYMBOL_LINK "Rte_CtrldDisShtdn_CntDisMtrTrqCmdMRF_MtrNm_f32" 0 DISPLAY_IDENTIFIER DiagMgr11.ReceiverPorts.MtrTrq.MtrNm_f32 /end MEASUREMENT
/begin MEASUREMENT DiagMgr11.SystemState.Mode "MICROSAR RTE" UBYTE RTE_CM_ENUM_StaMd_Mode 0 0 0 255 ECU_ADDRESS 0 SYMBOL_LINK "Rte_ModeMachine_StaMd11_SystemState11_Mode" 0 DISPLAY_IDENTIFIER DiagMgr11.ModeRequirePorts.SystemState.Mode /end MEASUREMENT
/begin MEASUREMENT DiagMgr11.VehSpd.Kph_f32 "MICROSAR RTE" FLOAT32_IEEE NO_COMPU_METHOD 0 0 1.175494351e-38 3.402823466e+38 ECU_ADDRESS 0 SYMBOL_LINK "Rte_SignlCondn_VehicleSpeed_Kph_f32" 0 DISPLAY_IDENTIFIER DiagMgr11.ReceiverPorts.VehSpd.Kph_f32 /end MEASUREMENT
/begin MEASUREMENT DiagMgr7.HwTrq.HwNm_f32 "MICROSAR RTE" FLOAT32_IEEE NO_COMPU_METHOD 0 0 1.175494351e-38 3.402823466e+38 ECU_ADDRESS 0 SYMBOL_LINK "Rte_HwTrq_AnaHwTorque_HwNm_f32" 0 DISPLAY_IDENTIFIER DiagMgr7.ReceiverPorts.HwTrq.HwNm_f32 /end MEASUREMENT
/begin MEASUREMENT DiagMgr7.IgnCnt.Cnt_u16 "MICROSAR RTE" UWORD NO_COMPU_METHOD 0 0 0 65535 ECU_ADDRESS 0 SYMBOL_LINK "Rte_CDDInterface9_IgnCnt_Cnt_u16" 0 DISPLAY_IDENTIFIER DiagMgr7.ReceiverPorts.IgnCnt.Cnt_u16 /end MEASUREMENT
/begin MEASUREMENT DiagMgr7.MEC.Cnt_enum "MICROSAR RTE" UBYTE RTE_CM_ENUM_ManufModeType 0 0 0 2 ECU_ADDRESS 0 SYMBOL_LINK "Rte_CDDInterface9_NxtrMEC_Cnt_enum" 0 DISPLAY_IDENTIFIER DiagMgr7.ReceiverPorts.MEC.Cnt_enum /end MEASUREMENT
/begin MEASUREMENT DiagMgr7.MfgDiagInhibit.Cnt_lgc "MICROSAR RTE" UBYTE RTE_CM_BOOLEAN 0 0 0 255 ECU_ADDRESS 0 SYMBOL_LINK "Rte_CDDInterface9_MfgDiagInhibit_Cnt_lgc" 0 DISPLAY_IDENTIFIER DiagMgr7.ReceiverPorts.MfgDiagInhibit.Cnt_lgc /end MEASUREMENT
/begin MEASUREMENT DiagMgr7.MtrTrq.MtrNm_f32 "MICROSAR RTE" FLOAT32_IEEE NO_COMPU_METHOD 0 0 1.175494351e-38 3.402823466e+38 ECU_ADDRESS 0 SYMBOL_LINK "Rte_CtrldDisShtdn_CntDisMtrTrqCmdMRF_MtrNm_f32" 0 DISPLAY_IDENTIFIER DiagMgr7.ReceiverPorts.MtrTrq.MtrNm_f32 /end MEASUREMENT
/begin MEASUREMENT DiagMgr7.SystemState.Mode "MICROSAR RTE" UBYTE RTE_CM_ENUM_StaMd_Mode 0 0 0 255 ECU_ADDRESS 0 SYMBOL_LINK "Rte_ModeMachine_StaMd7_SystemState7_Mode" 0 DISPLAY_IDENTIFIER DiagMgr7.ModeRequirePorts.SystemState.Mode /end MEASUREMENT
/begin MEASUREMENT DiagMgr7.VehSpd.Kph_f32 "MICROSAR RTE" FLOAT32_IEEE NO_COMPU_METHOD 0 0 1.175494351e-38 3.402823466e+38 ECU_ADDRESS 0 SYMBOL_LINK "Rte_SignlCondn_VehicleSpeed_Kph_f32" 0 DISPLAY_IDENTIFIER DiagMgr7.ReceiverPorts.VehSpd.Kph_f32 /end MEASUREMENT
/begin MEASUREMENT DiagMgr8.HwTrq.HwNm_f32 "MICROSAR RTE" FLOAT32_IEEE NO_COMPU_METHOD 0 0 1.175494351e-38 3.402823466e+38 ECU_ADDRESS 0 SYMBOL_LINK "Rte_HwTrq_AnaHwTorque_HwNm_f32" 0 DISPLAY_IDENTIFIER DiagMgr8.ReceiverPorts.HwTrq.HwNm_f32 /end MEASUREMENT
/begin MEASUREMENT DiagMgr8.IgnCnt.Cnt_u16 "MICROSAR RTE" UWORD NO_COMPU_METHOD 0 0 0 65535 ECU_ADDRESS 0 SYMBOL_LINK "Rte_CDDInterface9_IgnCnt_Cnt_u16" 0 DISPLAY_IDENTIFIER DiagMgr8.ReceiverPorts.IgnCnt.Cnt_u16 /end MEASUREMENT
/begin MEASUREMENT DiagMgr8.MEC.Cnt_enum "MICROSAR RTE" UBYTE RTE_CM_ENUM_ManufModeType 0 0 0 2 ECU_ADDRESS 0 SYMBOL_LINK "Rte_CDDInterface9_NxtrMEC_Cnt_enum" 0 DISPLAY_IDENTIFIER DiagMgr8.ReceiverPorts.MEC.Cnt_enum /end MEASUREMENT
/begin MEASUREMENT DiagMgr8.MfgDiagInhibit.Cnt_lgc "MICROSAR RTE" UBYTE RTE_CM_BOOLEAN 0 0 0 255 ECU_ADDRESS 0 SYMBOL_LINK "Rte_CDDInterface9_MfgDiagInhibit_Cnt_lgc" 0 DISPLAY_IDENTIFIER DiagMgr8.ReceiverPorts.MfgDiagInhibit.Cnt_lgc /end MEASUREMENT
/begin MEASUREMENT DiagMgr8.MtrTrq.MtrNm_f32 "MICROSAR RTE" FLOAT32_IEEE NO_COMPU_METHOD 0 0 1.175494351e-38 3.402823466e+38 ECU_ADDRESS 0 SYMBOL_LINK "Rte_CtrldDisShtdn_CntDisMtrTrqCmdMRF_MtrNm_f32" 0 DISPLAY_IDENTIFIER DiagMgr8.ReceiverPorts.MtrTrq.MtrNm_f32 /end MEASUREMENT
/begin MEASUREMENT DiagMgr8.SystemState.Mode "MICROSAR RTE" UBYTE RTE_CM_ENUM_StaMd_Mode 0 0 0 255 ECU_ADDRESS 0 SYMBOL_LINK "Rte_ModeMachine_StaMd8_SystemState8_Mode" 0 DISPLAY_IDENTIFIER DiagMgr8.ModeRequirePorts.SystemState.Mode /end MEASUREMENT
/begin MEASUREMENT DiagMgr8.VehSpd.Kph_f32 "MICROSAR RTE" FLOAT32_IEEE NO_COMPU_METHOD 0 0 1.175494351e-38 3.402823466e+38 ECU_ADDRESS 0 SYMBOL_LINK "Rte_SignlCondn_VehicleSpeed_Kph_f32" 0 DISPLAY_IDENTIFIER DiagMgr8.ReceiverPorts.VehSpd.Kph_f32 /end MEASUREMENT
/begin MEASUREMENT DiagMgr9.HwTrq.HwNm_f32 "MICROSAR RTE" FLOAT32_IEEE NO_COMPU_METHOD 0 0 1.175494351e-38 3.402823466e+38 ECU_ADDRESS 0 SYMBOL_LINK "Rte_HwTrq_AnaHwTorque_HwNm_f32" 0 DISPLAY_IDENTIFIER DiagMgr9.ReceiverPorts.HwTrq.HwNm_f32 /end MEASUREMENT
/begin MEASUREMENT DiagMgr9.IgnCnt.Cnt_u16 "MICROSAR RTE" UWORD NO_COMPU_METHOD 0 0 0 65535 ECU_ADDRESS 0 SYMBOL_LINK "Rte_CDDInterface9_IgnCnt_Cnt_u16" 0 DISPLAY_IDENTIFIER DiagMgr9.ReceiverPorts.IgnCnt.Cnt_u16 /end MEASUREMENT
/begin MEASUREMENT DiagMgr9.MEC.Cnt_enum "MICROSAR RTE" UBYTE RTE_CM_ENUM_ManufModeType 0 0 0 2 ECU_ADDRESS 0 SYMBOL_LINK "Rte_CDDInterface9_NxtrMEC_Cnt_enum" 0 DISPLAY_IDENTIFIER DiagMgr9.ReceiverPorts.MEC.Cnt_enum /end MEASUREMENT
/begin MEASUREMENT DiagMgr9.MfgDiagInhibit.Cnt_lgc "MICROSAR RTE" UBYTE RTE_CM_BOOLEAN 0 0 0 255 ECU_ADDRESS 0 SYMBOL_LINK "Rte_CDDInterface9_MfgDiagInhibit_Cnt_lgc" 0 DISPLAY_IDENTIFIER DiagMgr9.ReceiverPorts.MfgDiagInhibit.Cnt_lgc /end MEASUREMENT
/begin MEASUREMENT DiagMgr9.MtrTrq.MtrNm_f32 "MICROSAR RTE" FLOAT32_IEEE NO_COMPU_METHOD 0 0 1.175494351e-38 3.402823466e+38 ECU_ADDRESS 0 SYMBOL_LINK "Rte_CtrldDisShtdn_CntDisMtrTrqCmdMRF_MtrNm_f32" 0 DISPLAY_IDENTIFIER DiagMgr9.ReceiverPorts.MtrTrq.MtrNm_f32 /end MEASUREMENT
/begin MEASUREMENT DiagMgr9.SystemState.Mode "MICROSAR RTE" UBYTE RTE_CM_ENUM_StaMd_Mode 0 0 0 255 ECU_ADDRESS 0 SYMBOL_LINK "Rte_ModeMachine_StaMd9_SystemState9_Mode" 0 DISPLAY_IDENTIFIER DiagMgr9.ModeRequirePorts.SystemState.Mode /end MEASUREMENT
/begin MEASUREMENT DiagMgr9.VehSpd.Kph_f32 "MICROSAR RTE" FLOAT32_IEEE NO_COMPU_METHOD 0 0 1.175494351e-38 3.402823466e+38 ECU_ADDRESS 0 SYMBOL_LINK "Rte_SignlCondn_VehicleSpeed_Kph_f32" 0 DISPLAY_IDENTIFIER DiagMgr9.ReceiverPorts.VehSpd.Kph_f32 /end MEASUREMENT
/begin MEASUREMENT DigPhsReasDiag.ExpectedOnTimeA.Cnt_u32 "MICROSAR RTE" ULONG NO_COMPU_METHOD 0 0 0 4294967295 ECU_ADDRESS 0 SYMBOL_LINK "Rte_CDDInterface10_ExpectedOnTimeA_Cnt_u32" 0 DISPLAY_IDENTIFIER DigPhsReasDiag.ReceiverPorts.ExpectedOnTimeA.Cnt_u32 /end MEASUREMENT
/begin MEASUREMENT DigPhsReasDiag.ExpectedOnTimeB.Cnt_u32 "MICROSAR RTE" ULONG NO_COMPU_METHOD 0 0 0 4294967295 ECU_ADDRESS 0 SYMBOL_LINK "Rte_CDDInterface10_ExpectedOnTimeB_Cnt_u32" 0 DISPLAY_IDENTIFIER DigPhsReasDiag.ReceiverPorts.ExpectedOnTimeB.Cnt_u32 /end MEASUREMENT
/begin MEASUREMENT DigPhsReasDiag.ExpectedOnTimeC.Cnt_u32 "MICROSAR RTE" ULONG NO_COMPU_METHOD 0 0 0 4294967295 ECU_ADDRESS 0 SYMBOL_LINK "Rte_CDDInterface10_ExpectedOnTimeC_Cnt_u32" 0 DISPLAY_IDENTIFIER DigPhsReasDiag.ReceiverPorts.ExpectedOnTimeC.Cnt_u32 /end MEASUREMENT
/begin MEASUREMENT DigPhsReasDiag.LRPRCorrectedMtrPosCaptured.Rev_f32 "MICROSAR RTE" FLOAT32_IEEE NO_COMPU_METHOD 0 0 1.175494351e-38 3.402823466e+38 ECU_ADDRESS 0 SYMBOL_LINK "Rte_MtrPos2_CorrectedMtrPos_Rev_f32" 0 DISPLAY_IDENTIFIER DigPhsReasDiag.ReceiverPorts.LRPRCorrectedMtrPosCaptured.Rev_f32 /end MEASUREMENT
/begin MEASUREMENT DigPhsReasDiag.LRPRModulationIndexCaptured.Uls_f32 "MICROSAR RTE" FLOAT32_IEEE NO_COMPU_METHOD 0 0 1.175494351e-38 3.402823466e+38 ECU_ADDRESS 0 SYMBOL_LINK "Rte_VltgCtrl_ModIdx_Uls_f32" 0 DISPLAY_IDENTIFIER DigPhsReasDiag.ReceiverPorts.LRPRModulationIndexCaptured.Uls_f32 /end MEASUREMENT
/begin MEASUREMENT DigPhsReasDiag.LRPRPhaseadvanceCaptured.Cnt_s16 "MICROSAR RTE" SWORD NO_COMPU_METHOD 0 0 -32768 32767 ECU_ADDRESS 0 SYMBOL_LINK "Rte_VltgCtrl_PhsAdv_Cnt_s16" 0 DISPLAY_IDENTIFIER DigPhsReasDiag.ReceiverPorts.LRPRPhaseadvanceCaptured.Cnt_s16 /end MEASUREMENT
/begin MEASUREMENT DigPhsReasDiag.MeasuredOnTimeA.Cnt_u32 "MICROSAR RTE" ULONG NO_COMPU_METHOD 0 0 0 4294967295 ECU_ADDRESS 0 SYMBOL_LINK "Rte_CDDInterface10_MeasuredOnTimeA_Cnt_u32" 0 DISPLAY_IDENTIFIER DigPhsReasDiag.ReceiverPorts.MeasuredOnTimeA.Cnt_u32 /end MEASUREMENT
/begin MEASUREMENT DigPhsReasDiag.MeasuredOnTimeB.Cnt_u32 "MICROSAR RTE" ULONG NO_COMPU_METHOD 0 0 0 4294967295 ECU_ADDRESS 0 SYMBOL_LINK "Rte_CDDInterface10_MeasuredOnTimeB_Cnt_u32" 0 DISPLAY_IDENTIFIER DigPhsReasDiag.ReceiverPorts.MeasuredOnTimeB.Cnt_u32 /end MEASUREMENT
/begin MEASUREMENT DigPhsReasDiag.MeasuredOnTimeC.Cnt_u32 "MICROSAR RTE" ULONG NO_COMPU_METHOD 0 0 0 4294967295 ECU_ADDRESS 0 SYMBOL_LINK "Rte_CDDInterface10_MeasuredOnTimeC_Cnt_u32" 0 DISPLAY_IDENTIFIER DigPhsReasDiag.ReceiverPorts.MeasuredOnTimeC.Cnt_u32 /end MEASUREMENT
/begin MEASUREMENT DigPhsReasDiag.MotorVelMRFUnfiltered.MtrRadpS_f32 "MICROSAR RTE" FLOAT32_IEEE NO_COMPU_METHOD 0 0 1.175494351e-38 3.402823466e+38 ECU_ADDRESS 0 SYMBOL_LINK "Rte_MtrVel_MRFMotorVelUnfiltered_MtrRadpS_f32" 0 DISPLAY_IDENTIFIER DigPhsReasDiag.ReceiverPorts.MotorVelMRFUnfiltered.MtrRadpS_f32 /end MEASUREMENT
/begin MEASUREMENT DigPhsReasDiag.MtrElecMechPolarity.Cnt_s08 "MICROSAR RTE" SBYTE NO_COMPU_METHOD 0 0 -128 127 ECU_ADDRESS 0 SYMBOL_LINK "Rte_Polarity_MtrElecMechPolarity_Cnt_s08" 0 DISPLAY_IDENTIFIER DigPhsReasDiag.ReceiverPorts.MtrElecMechPolarity.Cnt_s08 /end MEASUREMENT
/begin MEASUREMENT DigPhsReasDiag.PDActivateTest.Cnt_lgc "MICROSAR RTE" UBYTE RTE_CM_BOOLEAN 0 0 0 255 ECU_ADDRESS 0 SYMBOL_LINK "Rte_PhaseDscnt_PDActivateTest_Cnt_lgc" 0 DISPLAY_IDENTIFIER DigPhsReasDiag.ReceiverPorts.PDActivateTest.Cnt_lgc /end MEASUREMENT
/begin MEASUREMENT DigPhsReasDiag.SystemState.Mode "MICROSAR RTE" UBYTE RTE_CM_ENUM_StaMd_Mode 0 0 0 255 ECU_ADDRESS 0 SYMBOL_LINK "Rte_ModeMachine_StaMd11_SystemState11_Mode" 0 DISPLAY_IDENTIFIER DigPhsReasDiag.ModeRequirePorts.SystemState.Mode /end MEASUREMENT
/begin MEASUREMENT DrvDynCtrl.AssistDDFactor.Uls_f32 "MICROSAR RTE" FLOAT32_IEEE NO_COMPU_METHOD 0 0 1.175494351e-38 3.402823466e+38 ECU_ADDRESS 0 SYMBOL_LINK "Rte_DrvDynCtrl_AssistDDFactor_Uls_f32" 0 DISPLAY_IDENTIFIER DrvDynCtrl.SenderPorts.AssistDDFactor.Uls_f32 /end MEASUREMENT
/begin MEASUREMENT DrvDynCtrl.DDAstFactRqst.Uls_f32 "MICROSAR RTE" FLOAT32_IEEE NO_COMPU_METHOD 0 0 1.175494351e-38 3.402823466e+38 ECU_ADDRESS 0 SYMBOL_LINK "Rte_SrlComInput2_SrlComAssistScaleFactor_Uls_f32" 0 DISPLAY_IDENTIFIER DrvDynCtrl.ReceiverPorts.DDAstFactRqst.Uls_f32 /end MEASUREMENT
/begin MEASUREMENT DrvDynCtrl.DDDmpFactRqst.Uls_f32 "MICROSAR RTE" FLOAT32_IEEE NO_COMPU_METHOD 0 0 1.175494351e-38 3.402823466e+38 ECU_ADDRESS 0 SYMBOL_LINK "Rte_SrlComInput2_SrlComDampingScaleFactor_Uls_f32" 0 DISPLAY_IDENTIFIER DrvDynCtrl.ReceiverPorts.DDDmpFactRqst.Uls_f32 /end MEASUREMENT
/begin MEASUREMENT DrvDynCtrl.DDRtnFactRqst.Uls_f32 "MICROSAR RTE" FLOAT32_IEEE NO_COMPU_METHOD 0 0 1.175494351e-38 3.402823466e+38 ECU_ADDRESS 0 SYMBOL_LINK "Rte_SrlComInput2_SrlComReturnScaleFactor_Uls_f32" 0 DISPLAY_IDENTIFIER DrvDynCtrl.ReceiverPorts.DDRtnFactRqst.Uls_f32 /end MEASUREMENT
/begin MEASUREMENT DrvDynCtrl.DampingDDFactor.Uls_f32 "MICROSAR RTE" FLOAT32_IEEE NO_COMPU_METHOD 0 0 1.175494351e-38 3.402823466e+38 ECU_ADDRESS 0 SYMBOL_LINK "Rte_DrvDynCtrl_DampingDDFactor_Uls_f32" 0 DISPLAY_IDENTIFIER DrvDynCtrl.SenderPorts.DampingDDFactor.Uls_f32 /end MEASUREMENT
/begin MEASUREMENT DrvDynCtrl.DrvDynActive.Cnt_lgc "MICROSAR RTE" UBYTE RTE_CM_BOOLEAN 0 0 0 255 ECU_ADDRESS 0 SYMBOL_LINK "Rte_DrvDynamicsEnable_DrvDynActive_Cnt_lgc" 0 DISPLAY_IDENTIFIER DrvDynCtrl.ReceiverPorts.DrvDynActive.Cnt_lgc /end MEASUREMENT
/begin MEASUREMENT DrvDynCtrl.HwTrq.HwNm_f32 "MICROSAR RTE" FLOAT32_IEEE NO_COMPU_METHOD 0 0 1.175494351e-38 3.402823466e+38 ECU_ADDRESS 0 SYMBOL_LINK "Rte_Sweep_OutputHwTrq_HwNm_f32" 0 DISPLAY_IDENTIFIER DrvDynCtrl.ReceiverPorts.HwTrq.HwNm_f32 /end MEASUREMENT
/begin MEASUREMENT DrvDynCtrl.MtrVelCRF.MtrRadpS_f32 "MICROSAR RTE" FLOAT32_IEEE NO_COMPU_METHOD 0 0 1.175494351e-38 3.402823466e+38 ECU_ADDRESS 0 SYMBOL_LINK "Rte_MtrVel_CRFMotorVel_MtrRadpS_f32" 0 DISPLAY_IDENTIFIER DrvDynCtrl.ReceiverPorts.MtrVelCRF.MtrRadpS_f32 /end MEASUREMENT
/begin MEASUREMENT DrvDynCtrl.ReturnDDFactor.Uls_f32 "MICROSAR RTE" FLOAT32_IEEE NO_COMPU_METHOD 0 0 1.175494351e-38 3.402823466e+38 ECU_ADDRESS 0 SYMBOL_LINK "Rte_DrvDynCtrl_ReturnDDFactor_Uls_f32" 0 DISPLAY_IDENTIFIER DrvDynCtrl.SenderPorts.ReturnDDFactor.Uls_f32 /end MEASUREMENT
/begin MEASUREMENT DrvDynCtrl.VehSpd.Kph_f32 "MICROSAR RTE" FLOAT32_IEEE NO_COMPU_METHOD 0 0 1.175494351e-38 3.402823466e+38 ECU_ADDRESS 0 SYMBOL_LINK "Rte_SignlCondn_VehicleSpeed_Kph_f32" 0 DISPLAY_IDENTIFIER DrvDynCtrl.ReceiverPorts.VehSpd.Kph_f32 /end MEASUREMENT
/begin MEASUREMENT DrvDynamicsEnable.DDEnableRqst.Cnt_lgc "MICROSAR RTE" UBYTE RTE_CM_BOOLEAN 0 0 0 255 ECU_ADDRESS 0 SYMBOL_LINK "Rte_SrlComInput2_SrlComDrvDynEnable_Cnt_lgc" 0 DISPLAY_IDENTIFIER DrvDynamicsEnable.ReceiverPorts.DDEnableRqst.Cnt_lgc /end MEASUREMENT
/begin MEASUREMENT DrvDynamicsEnable.DDErrInterfaceActive.Cnt_lgc "MICROSAR RTE" UBYTE RTE_CM_BOOLEAN 0 0 0 255 ECU_ADDRESS 0 SYMBOL_LINK "Rte_SrlComInput2_SrlComDrvDynInvalid_Cnt_lgc" 0 DISPLAY_IDENTIFIER DrvDynamicsEnable.ReceiverPorts.DDErrInterfaceActive.Cnt_lgc /end MEASUREMENT
/begin MEASUREMENT DrvDynamicsEnable.DiagStatus.Cnt_lgc "MICROSAR RTE" UBYTE RTE_CM_BOOLEAN 0 0 0 255 ECU_ADDRESS 0 SYMBOL_LINK "Rte_DiagMgr10_DiagStsNonRecRmpToZeroFltPres_Cnt_lgc" 0 DISPLAY_IDENTIFIER DrvDynamicsEnable.ReceiverPorts.DiagStatus.Cnt_lgc /end MEASUREMENT
/begin MEASUREMENT DrvDynamicsEnable.DrvDynActive.Cnt_lgc "MICROSAR RTE" UBYTE RTE_CM_BOOLEAN 0 0 0 255 ECU_ADDRESS 0 SYMBOL_LINK "Rte_DrvDynamicsEnable_DrvDynActive_Cnt_lgc" 0 DISPLAY_IDENTIFIER DrvDynamicsEnable.SenderPorts.DrvDynActive.Cnt_lgc /end MEASUREMENT
/begin MEASUREMENT DrvDynamicsEnable.DrvDynInterfaceState.Cnt_u08 "MICROSAR RTE" UBYTE RTE_CM_ENUM_QU_SER_STMOM_STMOM_DV_ACT 0 0 0 255 ECU_ADDRESS 0 SYMBOL_LINK "Rte_DrvDynamicsEnable_DrvDynInterfaceState_Cnt_u08" 0 DISPLAY_IDENTIFIER DrvDynamicsEnable.SenderPorts.DrvDynInterfaceState.Cnt_u08 /end MEASUREMENT
/begin MEASUREMENT DrvDynamicsEnable.OpTrqOvRmpInEnable.Cnt_lgc "MICROSAR RTE" UBYTE RTE_CM_BOOLEAN 0 0 0 255 ECU_ADDRESS 0 SYMBOL_LINK "Rte_DrvDynamicsEnable_OpTrqOvRmpInEnable_Cnt_lgc" 0 DISPLAY_IDENTIFIER DrvDynamicsEnable.SenderPorts.OpTrqOvRmpInEnable.Cnt_lgc /end MEASUREMENT
/begin MEASUREMENT DrvDynamicsEnable.PrkAssistState.Cnt_u08 "MICROSAR RTE" UBYTE RTE_CM_ENUM_QU_SER_WSTA_EST_FTAX 0 0 0 255 ECU_ADDRESS 0 SYMBOL_LINK "Rte_ParkAssistEnable_PrkAssistState_Cnt_u08" 0 DISPLAY_IDENTIFIER DrvDynamicsEnable.ReceiverPorts.PrkAssistState.Cnt_u08 /end MEASUREMENT
/begin MEASUREMENT DrvDynamicsEnable.SystemState.Mode "MICROSAR RTE" UBYTE RTE_CM_ENUM_StaMd_Mode 0 0 0 255 ECU_ADDRESS 0 SYMBOL_LINK "Rte_ModeMachine_StaMd7_SystemState7_Mode" 0 DISPLAY_IDENTIFIER DrvDynamicsEnable.ModeRequirePorts.SystemState.Mode /end MEASUREMENT
/begin MEASUREMENT EOTActuatorMng.AssistEOTDamping.MtrNm_f32 "MICROSAR RTE" FLOAT32_IEEE NO_COMPU_METHOD 0 0 1.175494351e-38 3.402823466e+38 ECU_ADDRESS 0 SYMBOL_LINK "Rte_EOTActuatorMng_AssistEOTDamping_MtrNm_f32" 0 DISPLAY_IDENTIFIER EOTActuatorMng.SenderPorts.AssistEOTDamping.MtrNm_f32 /end MEASUREMENT
/begin MEASUREMENT EOTActuatorMng.AssistEOTGain.Uls_f32 "MICROSAR RTE" FLOAT32_IEEE NO_COMPU_METHOD 0 0 1.175494351e-38 3.402823466e+38 ECU_ADDRESS 0 SYMBOL_LINK "Rte_EOTActuatorMng_AssistEOTGain_Uls_f32" 0 DISPLAY_IDENTIFIER EOTActuatorMng.SenderPorts.AssistEOTGain.Uls_f32 /end MEASUREMENT
/begin MEASUREMENT EOTActuatorMng.AssistEOTLimit.MtrNm_f32 "MICROSAR RTE" FLOAT32_IEEE NO_COMPU_METHOD 0 0 1.175494351e-38 3.402823466e+38 ECU_ADDRESS 0 SYMBOL_LINK "Rte_EOTActuatorMng_AssistEOTLimit_MtrNm_f32" 0 DISPLAY_IDENTIFIER EOTActuatorMng.SenderPorts.AssistEOTLimit.MtrNm_f32 /end MEASUREMENT
/begin MEASUREMENT EOTActuatorMng.CcwEOT.HwDeg_f32 "MICROSAR RTE" FLOAT32_IEEE NO_COMPU_METHOD 0 0 1.175494351e-38 3.402823466e+38 ECU_ADDRESS 0 SYMBOL_LINK "Rte_LrnEOT_CCWPosition_HwDeg_f32" 0 DISPLAY_IDENTIFIER EOTActuatorMng.ReceiverPorts.CcwEOT.HwDeg_f32 /end MEASUREMENT
/begin MEASUREMENT EOTActuatorMng.CcwFound.Cnt_lgc "MICROSAR RTE" UBYTE RTE_CM_BOOLEAN 0 0 0 255 ECU_ADDRESS 0 SYMBOL_LINK "Rte_LrnEOT_CCWFound_Cnt_lgc" 0 DISPLAY_IDENTIFIER EOTActuatorMng.ReceiverPorts.CcwFound.Cnt_lgc /end MEASUREMENT
/begin MEASUREMENT EOTActuatorMng.CwEOT.HwDeg_f32 "MICROSAR RTE" FLOAT32_IEEE NO_COMPU_METHOD 0 0 1.175494351e-38 3.402823466e+38 ECU_ADDRESS 0 SYMBOL_LINK "Rte_LrnEOT_CWPosition_HwDeg_f32" 0 DISPLAY_IDENTIFIER EOTActuatorMng.ReceiverPorts.CwEOT.HwDeg_f32 /end MEASUREMENT
/begin MEASUREMENT EOTActuatorMng.CwFound.Cnt_lgc "MICROSAR RTE" UBYTE RTE_CM_BOOLEAN 0 0 0 255 ECU_ADDRESS 0 SYMBOL_LINK "Rte_LrnEOT_CWFound_Cnt_lgc" 0 DISPLAY_IDENTIFIER EOTActuatorMng.ReceiverPorts.CwFound.Cnt_lgc /end MEASUREMENT
/begin MEASUREMENT EOTActuatorMng.EOTDisable.Cnt_lgc "MICROSAR RTE" UBYTE RTE_CM_BOOLEAN 0 0 0 255 ECU_ADDRESS 0 SYMBOL_LINK "Rte_CDDInterface9_EOTImpactSrlComSvcDft_Cnt_lgc" 0 DISPLAY_IDENTIFIER EOTActuatorMng.ReceiverPorts.EOTDisable.Cnt_lgc /end MEASUREMENT
/begin MEASUREMENT EOTActuatorMng.HandWheelAuth.Uls_f32 "MICROSAR RTE" FLOAT32_IEEE NO_COMPU_METHOD 0 0 1.175494351e-38 3.402823466e+38 ECU_ADDRESS 0 SYMBOL_LINK "Rte_AbsHwPos_HandwheelAuthority_Uls_f32" 0 DISPLAY_IDENTIFIER EOTActuatorMng.ReceiverPorts.HandWheelAuth.Uls_f32 /end MEASUREMENT
/begin MEASUREMENT EOTActuatorMng.HandWheelPos.HwDeg_f32 "MICROSAR RTE" FLOAT32_IEEE NO_COMPU_METHOD 0 0 1.175494351e-38 3.402823466e+38 ECU_ADDRESS 0 SYMBOL_LINK "Rte_AbsHwPos_HandwheelPosition_HwDeg_f32" 0 DISPLAY_IDENTIFIER EOTActuatorMng.ReceiverPorts.HandWheelPos.HwDeg_f32 /end MEASUREMENT
/begin MEASUREMENT EOTActuatorMng.HwTorque.HwNm_f32 "MICROSAR RTE" FLOAT32_IEEE NO_COMPU_METHOD 0 0 1.175494351e-38 3.402823466e+38 ECU_ADDRESS 0 SYMBOL_LINK "Rte_Sweep_OutputHwTrq_HwNm_f32" 0 DISPLAY_IDENTIFIER EOTActuatorMng.ReceiverPorts.HwTorque.HwNm_f32 /end MEASUREMENT
/begin MEASUREMENT EOTActuatorMng.MotorVel.MtrRadpS_f32 "MICROSAR RTE" FLOAT32_IEEE NO_COMPU_METHOD 0 0 1.175494351e-38 3.402823466e+38 ECU_ADDRESS 0 SYMBOL_LINK "Rte_MtrVel_CRFMotorVel_MtrRadpS_f32" 0 DISPLAY_IDENTIFIER EOTActuatorMng.ReceiverPorts.MotorVel.MtrRadpS_f32 /end MEASUREMENT
/begin MEASUREMENT EOTActuatorMng.OutputRampMultLtd.Uls_f32 "MICROSAR RTE" FLOAT32_IEEE NO_COMPU_METHOD 0 0 1.175494351e-38 3.402823466e+38 ECU_ADDRESS 0 SYMBOL_LINK "Rte_LmtCod_OutputRampMultLtd_Uls_f32" 0 DISPLAY_IDENTIFIER EOTActuatorMng.ReceiverPorts.OutputRampMultLtd.Uls_f32 /end MEASUREMENT
/begin MEASUREMENT EOTActuatorMng.PreLimitTorque.MtrNm_f32 "MICROSAR RTE" FLOAT32_IEEE NO_COMPU_METHOD 0 0 1.175494351e-38 3.402823466e+38 ECU_ADDRESS 0 SYMBOL_LINK "Rte_AssistSumnLmt_PreLimitTorque_MtrNm_f32" 0 DISPLAY_IDENTIFIER EOTActuatorMng.ReceiverPorts.PreLimitTorque.MtrNm_f32 /end MEASUREMENT
/begin MEASUREMENT EOTActuatorMng.VehicleSpeed.Kph_f32 "MICROSAR RTE" FLOAT32_IEEE NO_COMPU_METHOD 0 0 1.175494351e-38 3.402823466e+38 ECU_ADDRESS 0 SYMBOL_LINK "Rte_SignlCondn_VehicleSpeed_Kph_f32" 0 DISPLAY_IDENTIFIER EOTActuatorMng.ReceiverPorts.VehicleSpeed.Kph_f32 /end MEASUREMENT
/begin MEASUREMENT EcuM.currentMode.currentMode "MICROSAR RTE" UBYTE RTE_CM_ENUM_EcuM_Mode 0 0 0 255 ECU_ADDRESS 0 SYMBOL_LINK "Rte_ModeMachine_EcuM_currentMode_currentMode" 0 DISPLAY_IDENTIFIER EcuM.ModeProvidePorts.currentMode.currentMode /end MEASUREMENT
/begin MEASUREMENT ElecPwr.ElecPower.Watts_f32 "MICROSAR RTE" FLOAT32_IEEE NO_COMPU_METHOD 0 0 1.175494351e-38 3.402823466e+38 ECU_ADDRESS 0 SYMBOL_LINK "Rte_ElecPwr_ElecPower_Watts_f32" 0 DISPLAY_IDENTIFIER ElecPwr.SenderPorts.ElecPower.Watts_f32 /end MEASUREMENT
/begin MEASUREMENT ElecPwr.EstR.Ohm_f32 "MICROSAR RTE" FLOAT32_IEEE NO_COMPU_METHOD 0 0 1.175494351e-38 3.402823466e+38 ECU_ADDRESS 0 SYMBOL_LINK "Rte_ParamComp_EstR_Ohm_f32" 0 DISPLAY_IDENTIFIER ElecPwr.ReceiverPorts.EstR.Ohm_f32 /end MEASUREMENT
/begin MEASUREMENT ElecPwr.ModIdx.Uls_f32 "MICROSAR RTE" FLOAT32_IEEE NO_COMPU_METHOD 0 0 1.175494351e-38 3.402823466e+38 ECU_ADDRESS 0 SYMBOL_LINK "Rte_VltgCtrl_ModIdx_Uls_f32" 0 DISPLAY_IDENTIFIER ElecPwr.ReceiverPorts.ModIdx.Uls_f32 /end MEASUREMENT
/begin MEASUREMENT ElecPwr.SupplyCur.Amp_f32 "MICROSAR RTE" FLOAT32_IEEE NO_COMPU_METHOD 0 0 1.175494351e-38 3.402823466e+38 ECU_ADDRESS 0 SYMBOL_LINK "Rte_ElecPwr_SupplyCur_Amp_f32" 0 DISPLAY_IDENTIFIER ElecPwr.SenderPorts.SupplyCur.Amp_f32 /end MEASUREMENT
/begin MEASUREMENT ElecPwr.TermA.Volt_f32 "This signal is intended to communicate any type voltage signal measured by the ecu.  This signal has a lower limit of 0 which reequires users of the signal to provide divide by 0 protection if it is used as a denominator in a calculation.  See Vecu port p" FLOAT32_IEEE NO_COMPU_METHOD 0 0 1.175494351e-38 3.402823466e+38 ECU_ADDRESS 0 SYMBOL_LINK "Rte_VltgCtrl_TermA_Volt_f32" 0 DISPLAY_IDENTIFIER ElecPwr.ReceiverPorts.TermA.Volt_f32 /end MEASUREMENT
/begin MEASUREMENT ElecPwr.TermXq.Uls_f32 "MICROSAR RTE" FLOAT32_IEEE NO_COMPU_METHOD 0 0 1.175494351e-38 3.402823466e+38 ECU_ADDRESS 0 SYMBOL_LINK "Rte_VltgCtrl_TermXq_Uls_f32" 0 DISPLAY_IDENTIFIER ElecPwr.ReceiverPorts.TermXq.Uls_f32 /end MEASUREMENT
/begin MEASUREMENT ElecPwr.TermZ.Uls_f32 "MICROSAR RTE" FLOAT32_IEEE NO_COMPU_METHOD 0 0 1.175494351e-38 3.402823466e+38 ECU_ADDRESS 0 SYMBOL_LINK "Rte_VltgCtrl_TermZ_Uls_f32" 0 DISPLAY_IDENTIFIER ElecPwr.ReceiverPorts.TermZ.Uls_f32 /end MEASUREMENT
/begin MEASUREMENT ElecPwr.UncorrPhsAdv.Cnt_s16 "MICROSAR RTE" SWORD NO_COMPU_METHOD 0 0 -32768 32767 ECU_ADDRESS 0 SYMBOL_LINK "Rte_VltgCtrl_UnCorrPhsAdv_Cnt_s16" 0 DISPLAY_IDENTIFIER ElecPwr.ReceiverPorts.UncorrPhsAdv.Cnt_s16 /end MEASUREMENT
/begin MEASUREMENT ElecPwr.Vecu.Volt_f32 "This port prototype is inteded to communicate voltage signals that represent the ecu supplied voltage.  This signal has a lower limit, which is non-zero, to allow users of the signal to use it as a denominator in an expression without requiring a divide b" FLOAT32_IEEE NO_COMPU_METHOD 0 0 1.175494351e-38 3.402823466e+38 ECU_ADDRESS 0 SYMBOL_LINK "Rte_BatteryVoltage_Vecu_Volt_f32" 0 DISPLAY_IDENTIFIER ElecPwr.ReceiverPorts.Vecu.Volt_f32 /end MEASUREMENT
/begin MEASUREMENT EtDmpFw.AssistEOTDamping.MtrNm_f32 "MICROSAR RTE" FLOAT32_IEEE NO_COMPU_METHOD 0 0 1.175494351e-38 3.402823466e+38 ECU_ADDRESS 0 SYMBOL_LINK "Rte_EOTActuatorMng_AssistEOTDamping_MtrNm_f32" 0 DISPLAY_IDENTIFIER EtDmpFw.ReceiverPorts.AssistEOTDamping.MtrNm_f32 /end MEASUREMENT
/begin MEASUREMENT EtDmpFw.CRFMtrVel.MtrRadpS_f32 "MICROSAR RTE" FLOAT32_IEEE NO_COMPU_METHOD 0 0 1.175494351e-38 3.402823466e+38 ECU_ADDRESS 0 SYMBOL_LINK "Rte_MtrVel_CRFMotorVel_MtrRadpS_f32" 0 DISPLAY_IDENTIFIER EtDmpFw.ReceiverPorts.CRFMtrVel.MtrRadpS_f32 /end MEASUREMENT
/begin MEASUREMENT EtDmpFw.EOTDampingLtd.MtrNm_f32 "MICROSAR RTE" FLOAT32_IEEE NO_COMPU_METHOD 0 0 1.175494351e-38 3.402823466e+38 ECU_ADDRESS 0 SYMBOL_LINK "Rte_EtDmpFw_EOTDampingLtd_MtrNm_f32" 0 DISPLAY_IDENTIFIER EtDmpFw.SenderPorts.EOTDampingLtd.MtrNm_f32 /end MEASUREMENT
/begin MEASUREMENT EtDmpFw.EOTDisable.Cnt_lgc "MICROSAR RTE" UBYTE RTE_CM_BOOLEAN 0 0 0 255 ECU_ADDRESS 0 SYMBOL_LINK "Rte_CDDInterface9_FirewallSrlComSrvDft_Cnt_lgc" 0 DISPLAY_IDENTIFIER EtDmpFw.ReceiverPorts.EOTDisable.Cnt_lgc /end MEASUREMENT
/begin MEASUREMENT EtDmpFw.HandwheelAuthority.Uls_f32 "MICROSAR RTE" FLOAT32_IEEE NO_COMPU_METHOD 0 0 1.175494351e-38 3.402823466e+38 ECU_ADDRESS 0 SYMBOL_LINK "Rte_AbsHwPos_HandwheelAuthority_Uls_f32" 0 DISPLAY_IDENTIFIER EtDmpFw.ReceiverPorts.HandwheelAuthority.Uls_f32 /end MEASUREMENT
/begin MEASUREMENT EtDmpFw.HandwheelPosition.HwDeg_f32 "MICROSAR RTE" FLOAT32_IEEE NO_COMPU_METHOD 0 0 1.175494351e-38 3.402823466e+38 ECU_ADDRESS 0 SYMBOL_LINK "Rte_AbsHwPos_HandwheelPosition_HwDeg_f32" 0 DISPLAY_IDENTIFIER EtDmpFw.ReceiverPorts.HandwheelPosition.HwDeg_f32 /end MEASUREMENT
/begin MEASUREMENT EtDmpFw.MEC_Counter.Cnt_enum "MICROSAR RTE" UBYTE RTE_CM_ENUM_ManufModeType 0 0 0 2 ECU_ADDRESS 0 SYMBOL_LINK "Rte_CDDInterface9_NxtrMEC_Cnt_enum" 0 DISPLAY_IDENTIFIER EtDmpFw.ReceiverPorts.MEC_Counter.Cnt_enum /end MEASUREMENT
/begin MEASUREMENT EtDmpFw.Vehicle_Speed.Kph_f32 "MICROSAR RTE" FLOAT32_IEEE NO_COMPU_METHOD 0 0 1.175494351e-38 3.402823466e+38 ECU_ADDRESS 0 SYMBOL_LINK "Rte_SignlCondn_VehicleSpeed_Kph_f32" 0 DISPLAY_IDENTIFIER EtDmpFw.ReceiverPorts.Vehicle_Speed.Kph_f32 /end MEASUREMENT
/begin MEASUREMENT FltInjection.MotorVelCRF.MtrRadpS_f32 "MICROSAR RTE" FLOAT32_IEEE NO_COMPU_METHOD 0 0 1.175494351e-38 3.402823466e+38 ECU_ADDRESS 0 SYMBOL_LINK "Rte_MtrVel_CRFMotorVel_MtrRadpS_f32" 0 DISPLAY_IDENTIFIER FltInjection.ReceiverPorts.MotorVelCRF.MtrRadpS_f32 /end MEASUREMENT
/begin MEASUREMENT FrqDepDmpnInrtCmp.BaseAssistCmd.MtrNm_f32 "MICROSAR RTE" FLOAT32_IEEE NO_COMPU_METHOD 0 0 1.175494351e-38 3.402823466e+38 ECU_ADDRESS 0 SYMBOL_LINK "Rte_Assist_BaseAssistCmd_MtrNm_f32" 0 DISPLAY_IDENTIFIER FrqDepDmpnInrtCmp.ReceiverPorts.BaseAssistCmd.MtrNm_f32 /end MEASUREMENT
/begin MEASUREMENT FrqDepDmpnInrtCmp.CRFMotorVel.MtrRadpS_f32 "MICROSAR RTE" FLOAT32_IEEE NO_COMPU_METHOD 0 0 1.175494351e-38 3.402823466e+38 ECU_ADDRESS 0 SYMBOL_LINK "Rte_MtrVel_CRFMotorVel_MtrRadpS_f32" 0 DISPLAY_IDENTIFIER FrqDepDmpnInrtCmp.ReceiverPorts.CRFMotorVel.MtrRadpS_f32 /end MEASUREMENT
/begin MEASUREMENT FrqDepDmpnInrtCmp.FreqDepDmpSrlComSvcDft.Cnt_lgc "MICROSAR RTE" UBYTE RTE_CM_BOOLEAN 0 0 0 255 ECU_ADDRESS 0 SYMBOL_LINK "Rte_CDDInterface9_FreqDepDmpSrlComSvcDft_Cnt_lgc" 0 DISPLAY_IDENTIFIER FrqDepDmpnInrtCmp.ReceiverPorts.FreqDepDmpSrlComSvcDft.Cnt_lgc /end MEASUREMENT
/begin MEASUREMENT FrqDepDmpnInrtCmp.FrqDepDmpnInrtCmp.MtrNm_f32 "MICROSAR RTE" FLOAT32_IEEE NO_COMPU_METHOD 0 0 1.175494351e-38 3.402823466e+38 ECU_ADDRESS 0 SYMBOL_LINK "Rte_FrqDepDmpnInrtCmp_FrqDepDmpnInrtCmp_MtrNm_f32" 0 DISPLAY_IDENTIFIER FrqDepDmpnInrtCmp.SenderPorts.FrqDepDmpnInrtCmp.MtrNm_f32 /end MEASUREMENT
/begin MEASUREMENT FrqDepDmpnInrtCmp.HwTorque.HwNm_f32 "MICROSAR RTE" FLOAT32_IEEE NO_COMPU_METHOD 0 0 1.175494351e-38 3.402823466e+38 ECU_ADDRESS 0 SYMBOL_LINK "Rte_Sweep_OutputHwTrq_HwNm_f32" 0 DISPLAY_IDENTIFIER FrqDepDmpnInrtCmp.ReceiverPorts.HwTorque.HwNm_f32 /end MEASUREMENT
/begin MEASUREMENT FrqDepDmpnInrtCmp.VehicleLonAccel.KphpS_f32 "MICROSAR RTE" FLOAT32_IEEE NO_COMPU_METHOD 0 0 1.175494351e-38 3.402823466e+38 ECU_ADDRESS 0 SYMBOL_LINK "Rte_FrqDepDmpnInrtCmp_VehicleLonAccel_KphpS_f32" 0 DISPLAY_IDENTIFIER FrqDepDmpnInrtCmp.ReceiverPorts.VehicleLonAccel.KphpS_f32 /end MEASUREMENT
/begin MEASUREMENT FrqDepDmpnInrtCmp.VehicleSpeed.Kph_f32 "MICROSAR RTE" FLOAT32_IEEE NO_COMPU_METHOD 0 0 1.175494351e-38 3.402823466e+38 ECU_ADDRESS 0 SYMBOL_LINK "Rte_SignlCondn_VehicleSpeed_Kph_f32" 0 DISPLAY_IDENTIFIER FrqDepDmpnInrtCmp.ReceiverPorts.VehicleSpeed.Kph_f32 /end MEASUREMENT
/begin MEASUREMENT FrqDepDmpnInrtCmp.WIRCmdAmpBlnd.MtrNm_f32 "MICROSAR RTE" FLOAT32_IEEE NO_COMPU_METHOD 0 0 1.175494351e-38 3.402823466e+38 ECU_ADDRESS 0 SYMBOL_LINK "Rte_FrqDepDmpnInrtCmp_WIRCmdAmpBlnd_MtrNm_f32" 0 DISPLAY_IDENTIFIER FrqDepDmpnInrtCmp.ReceiverPorts.WIRCmdAmpBlnd.MtrNm_f32 /end MEASUREMENT
/begin MEASUREMENT GenPosTraj.HwPosition.HwDeg_f32 "MICROSAR RTE" FLOAT32_IEEE NO_COMPU_METHOD 0 0 1.175494351e-38 3.402823466e+38 ECU_ADDRESS 0 SYMBOL_LINK "Rte_AbsHwPos_HandwheelPosition_HwDeg_f32" 0 DISPLAY_IDENTIFIER GenPosTraj.ReceiverPorts.HwPosition.HwDeg_f32 /end MEASUREMENT
/begin MEASUREMENT GenPosTraj.PosTrajEnable.Cnt_lgc "MICROSAR RTE" UBYTE RTE_CM_BOOLEAN 0 0 0 255 ECU_ADDRESS 0 SYMBOL_LINK "Rte_CDDInterface9_PosTrajEnable_Cnt_lgc" 0 DISPLAY_IDENTIFIER GenPosTraj.ReceiverPorts.PosTrajEnable.Cnt_lgc /end MEASUREMENT
/begin MEASUREMENT GenPosTraj.PosTrajHwAngle.HwDeg_f32 "MICROSAR RTE" FLOAT32_IEEE NO_COMPU_METHOD 0 0 1.175494351e-38 3.402823466e+38 ECU_ADDRESS 0 SYMBOL_LINK "Rte_GenPosTraj_PosTrajHwAngle_HwDeg_f32" 0 DISPLAY_IDENTIFIER GenPosTraj.SenderPorts.PosTrajHwAngle.HwDeg_f32 /end MEASUREMENT
/begin MEASUREMENT Gsod.Ana_Hw_Torque.HwNm_f32 "MICROSAR RTE" FLOAT32_IEEE NO_COMPU_METHOD 0 0 1.175494351e-38 3.402823466e+38 ECU_ADDRESS 0 SYMBOL_LINK "Rte_HwTrq_AnaHwTorque_HwNm_f32" 0 DISPLAY_IDENTIFIER Gsod.ReceiverPorts.Ana_Hw_Torque.HwNm_f32 /end MEASUREMENT
/begin MEASUREMENT Gsod.Corrected_MtrPos.Rev_f32 "MICROSAR RTE" FLOAT32_IEEE NO_COMPU_METHOD 0 0 1.175494351e-38 3.402823466e+38 ECU_ADDRESS 0 SYMBOL_LINK "Rte_MtrPos2_CorrectedMtrPos_Rev_f32" 0 DISPLAY_IDENTIFIER Gsod.ReceiverPorts.Corrected_MtrPos.Rev_f32 /end MEASUREMENT
/begin MEASUREMENT Gsod.Cum_Mtr_Pos_CRF.Deg_f32 "MICROSAR RTE" FLOAT32_IEEE NO_COMPU_METHOD 0 0 1.175494351e-38 3.402823466e+38 ECU_ADDRESS 0 SYMBOL_LINK "Rte_MtrPos_CumMtrPosCRF_Deg_f32" 0 DISPLAY_IDENTIFIER Gsod.ReceiverPorts.Cum_Mtr_Pos_CRF.Deg_f32 /end MEASUREMENT
/begin MEASUREMENT Gsod.MtrElecMech_Polarity.Cnt_s08 "MICROSAR RTE" SBYTE NO_COMPU_METHOD 0 0 -128 127 ECU_ADDRESS 0 SYMBOL_LINK "Rte_Polarity_MtrElecMechPolarity_Cnt_s08" 0 DISPLAY_IDENTIFIER Gsod.ReceiverPorts.MtrElecMech_Polarity.Cnt_s08 /end MEASUREMENT
/begin MEASUREMENT Gsod.SysC_Ana_Hw_Torque.HwNm_f32 "MICROSAR RTE" FLOAT32_IEEE NO_COMPU_METHOD 0 0 1.175494351e-38 3.402823466e+38 ECU_ADDRESS 0 SYMBOL_LINK "Rte_HwTrq_SysCAnaHwTorque_HwNm_f32" 0 DISPLAY_IDENTIFIER Gsod.ReceiverPorts.SysC_Ana_Hw_Torque.HwNm_f32 /end MEASUREMENT
/begin MEASUREMENT Gsod.SysC_Corrected_MtrPos.Rev_f32 "MICROSAR RTE" FLOAT32_IEEE NO_COMPU_METHOD 0 0 1.175494351e-38 3.402823466e+38 ECU_ADDRESS 0 SYMBOL_LINK "Rte_MtrPos2_SysCCorrectedMtrPos_Rev_f32" 0 DISPLAY_IDENTIFIER Gsod.ReceiverPorts.SysC_Corrected_MtrPos.Rev_f32 /end MEASUREMENT
/begin MEASUREMENT Gsod.SysC_Cum_Mtr_Pos_CRF.Deg_f32 "MICROSAR RTE" FLOAT32_IEEE NO_COMPU_METHOD 0 0 1.175494351e-38 3.402823466e+38 ECU_ADDRESS 0 SYMBOL_LINK "Rte_MtrPos_SysCCumMtrPosCRF_Deg_f32" 0 DISPLAY_IDENTIFIER Gsod.ReceiverPorts.SysC_Cum_Mtr_Pos_CRF.Deg_f32 /end MEASUREMENT
/begin MEASUREMENT Gsod.SysC_MtrElecMech_Polarity.Cnt_s32 "MICROSAR RTE" SLONG NO_COMPU_METHOD 0 0 -2147483648 2147483647 ECU_ADDRESS 0 SYMBOL_LINK "Rte_Polarity_SysC_MtrElecMechPolarity_Cnt_s32" 0 DISPLAY_IDENTIFIER Gsod.ReceiverPorts.SysC_MtrElecMech_Polarity.Cnt_s32 /end MEASUREMENT
/begin MEASUREMENT Gsod.SysC_Torque_Cmd_CRF.MtrNm_f32 "MICROSAR RTE" FLOAT32_IEEE NO_COMPU_METHOD 0 0 1.175494351e-38 3.402823466e+38 ECU_ADDRESS 0 SYMBOL_LINK "Rte_CtrldDisShtdn_SysC_CRFMtrTrqCmd_MtrNm_f32" 0 DISPLAY_IDENTIFIER Gsod.ReceiverPorts.SysC_Torque_Cmd_CRF.MtrNm_f32 /end MEASUREMENT
/begin MEASUREMENT Gsod.SysC_Torque_Cmd_MRF.MtrNm_f32 "MICROSAR RTE" FLOAT32_IEEE NO_COMPU_METHOD 0 0 1.175494351e-38 3.402823466e+38 ECU_ADDRESS 0 SYMBOL_LINK "Rte_CtrldDisShtdn_SysC_MRFMtrTrqCmd_MtrNm_f32" 0 DISPLAY_IDENTIFIER Gsod.ReceiverPorts.SysC_Torque_Cmd_MRF.MtrNm_f32 /end MEASUREMENT
/begin MEASUREMENT Gsod.SysC_Vecu.Volt_f32 "This port prototype is inteded to communicate voltage signals that represent the ecu supplied voltage.  This signal has a lower limit, which is non-zero, to allow users of the signal to use it as a denominator in an expression without requiring a divide b" FLOAT32_IEEE NO_COMPU_METHOD 0 0 1.175494351e-38 3.402823466e+38 ECU_ADDRESS 0 SYMBOL_LINK "Rte_BatteryVoltage_SysC_Vecu_Volt_f32" 0 DISPLAY_IDENTIFIER Gsod.ReceiverPorts.SysC_Vecu.Volt_f32 /end MEASUREMENT
/begin MEASUREMENT Gsod.SystemState.Mode "MICROSAR RTE" UBYTE RTE_CM_ENUM_StaMd_Mode 0 0 0 255 ECU_ADDRESS 0 SYMBOL_LINK "Rte_ModeMachine_StaMd8_SystemState8_Mode" 0 DISPLAY_IDENTIFIER Gsod.ModeRequirePorts.SystemState.Mode /end MEASUREMENT
/begin MEASUREMENT Gsod.Torque_Cmd_CRF.MtrNm_f32 "MICROSAR RTE" FLOAT32_IEEE NO_COMPU_METHOD 0 0 1.175494351e-38 3.402823466e+38 ECU_ADDRESS 0 SYMBOL_LINK "Rte_CtrldDisShtdn_CntDisMtrTrqCmdCRF_MtrNm_f32" 0 DISPLAY_IDENTIFIER Gsod.ReceiverPorts.Torque_Cmd_CRF.MtrNm_f32 /end MEASUREMENT
/begin MEASUREMENT Gsod.Torque_Cmd_MRF.MtrNm_f32 "MICROSAR RTE" FLOAT32_IEEE NO_COMPU_METHOD 0 0 1.175494351e-38 3.402823466e+38 ECU_ADDRESS 0 SYMBOL_LINK "Rte_CtrldDisShtdn_CntDisMtrTrqCmdMRF_MtrNm_f32" 0 DISPLAY_IDENTIFIER Gsod.ReceiverPorts.Torque_Cmd_MRF.MtrNm_f32 /end MEASUREMENT
/begin MEASUREMENT Gsod.Vecu.Volt_f32 "This port prototype is inteded to communicate voltage signals that represent the ecu supplied voltage.  This signal has a lower limit, which is non-zero, to allow users of the signal to use it as a denominator in an expression without requiring a divide b" FLOAT32_IEEE NO_COMPU_METHOD 0 0 1.175494351e-38 3.402823466e+38 ECU_ADDRESS 0 SYMBOL_LINK "Rte_BatteryVoltage_Vecu_Volt_f32" 0 DISPLAY_IDENTIFIER Gsod.ReceiverPorts.Vecu.Volt_f32 /end MEASUREMENT
/begin MEASUREMENT HiLoadStall.AssistStallLimit.MtrNm_f32 "MICROSAR RTE" FLOAT32_IEEE NO_COMPU_METHOD 0 0 1.175494351e-38 3.402823466e+38 ECU_ADDRESS 0 SYMBOL_LINK "Rte_HiLoadStall_AssistStallLimit_MtrNm_f32" 0 DISPLAY_IDENTIFIER HiLoadStall.SenderPorts.AssistStallLimit.MtrNm_f32 /end MEASUREMENT
/begin MEASUREMENT HiLoadStall.DftStallLimit.Cnt_lgc "MICROSAR RTE" UBYTE RTE_CM_BOOLEAN 0 0 0 255 ECU_ADDRESS 0 SYMBOL_LINK "Rte_CDDInterface9_EOTThermalSrlComSvcDft_Cnt_lgc" 0 DISPLAY_IDENTIFIER HiLoadStall.ReceiverPorts.DftStallLimit.Cnt_lgc /end MEASUREMENT
/begin MEASUREMENT HiLoadStall.MtrVelCRF.MtrRadpS_f32 "MICROSAR RTE" FLOAT32_IEEE NO_COMPU_METHOD 0 0 1.175494351e-38 3.402823466e+38 ECU_ADDRESS 0 SYMBOL_LINK "Rte_MtrVel_CRFMotorVel_MtrRadpS_f32" 0 DISPLAY_IDENTIFIER HiLoadStall.ReceiverPorts.MtrVelCRF.MtrRadpS_f32 /end MEASUREMENT
/begin MEASUREMENT HiLoadStall.PreLimitForStall.MtrNm_f32 "MICROSAR RTE" FLOAT32_IEEE NO_COMPU_METHOD 0 0 1.175494351e-38 3.402823466e+38 ECU_ADDRESS 0 SYMBOL_LINK "Rte_AssistSumnLmt_PreLimitForStall_MtrNm_f32" 0 DISPLAY_IDENTIFIER HiLoadStall.ReceiverPorts.PreLimitForStall.MtrNm_f32 /end MEASUREMENT
/begin MEASUREMENT HwPwUp.MtrDrvrInitComplete.Cnt_lgc "MICROSAR RTE" UBYTE RTE_CM_BOOLEAN 0 0 0 255 ECU_ADDRESS 0 SYMBOL_LINK "Rte_MtrDrvDiag_MtrDrvrInitComplete_Cnt_lgc" 0 DISPLAY_IDENTIFIER HwPwUp.ReceiverPorts.MtrDrvrInitComplete.Cnt_lgc /end MEASUREMENT
/begin MEASUREMENT HwPwUp.MtrDrvrInitStart.Cnt_lgc "MICROSAR RTE" UBYTE RTE_CM_BOOLEAN 0 0 0 255 ECU_ADDRESS 0 SYMBOL_LINK "Rte_HwPwUp_MtrDrvrInitStart_Cnt_lgc" 0 DISPLAY_IDENTIFIER HwPwUp.SenderPorts.MtrDrvrInitStart.Cnt_lgc /end MEASUREMENT
/begin MEASUREMENT HwPwUp.PwrDiscATestComplete.Cnt_lgc "MICROSAR RTE" UBYTE RTE_CM_BOOLEAN 0 0 0 255 ECU_ADDRESS 0 SYMBOL_LINK "Rte_Sa_BkCpPc_PwrDiscATestComplete_Cnt_lgc" 0 DISPLAY_IDENTIFIER HwPwUp.ReceiverPorts.PwrDiscATestComplete.Cnt_lgc /end MEASUREMENT
/begin MEASUREMENT HwPwUp.PwrDiscATestStart.Cnt_lgc "MICROSAR RTE" UBYTE RTE_CM_BOOLEAN 0 0 0 255 ECU_ADDRESS 0 SYMBOL_LINK "Rte_HwPwUp_PwrDiscATestStart_Cnt_lgc" 0 DISPLAY_IDENTIFIER HwPwUp.SenderPorts.PwrDiscATestStart.Cnt_lgc /end MEASUREMENT
/begin MEASUREMENT HwPwUp.PwrDiscBTestComplete.Cnt_lgc "MICROSAR RTE" UBYTE RTE_CM_BOOLEAN 0 0 0 255 ECU_ADDRESS 0 SYMBOL_LINK "Rte_Sa_BkCpPc_PwrDiscBTestComplete_Cnt_lgc" 0 DISPLAY_IDENTIFIER HwPwUp.ReceiverPorts.PwrDiscBTestComplete.Cnt_lgc /end MEASUREMENT
/begin MEASUREMENT HwPwUp.PwrDiscBTestStart.Cnt_lgc "MICROSAR RTE" UBYTE RTE_CM_BOOLEAN 0 0 0 255 ECU_ADDRESS 0 SYMBOL_LINK "Rte_HwPwUp_PwrDiscBTestStart_Cnt_lgc" 0 DISPLAY_IDENTIFIER HwPwUp.SenderPorts.PwrDiscBTestStart.Cnt_lgc /end MEASUREMENT
/begin MEASUREMENT HwPwUp.SystemState.Mode "MICROSAR RTE" UBYTE RTE_CM_ENUM_StaMd_Mode 0 0 0 255 ECU_ADDRESS 0 SYMBOL_LINK "Rte_ModeMachine_StaMd9_SystemState9_Mode" 0 DISPLAY_IDENTIFIER HwPwUp.ModeRequirePorts.SystemState.Mode /end MEASUREMENT
/begin MEASUREMENT HwPwUp.TMFTestComplete.Cnt_lgc "MICROSAR RTE" UBYTE RTE_CM_BOOLEAN 0 0 0 255 ECU_ADDRESS 0 SYMBOL_LINK "Rte_TmprlMon_TMFTestComplete_Cnt_lgc" 0 DISPLAY_IDENTIFIER HwPwUp.ReceiverPorts.TMFTestComplete.Cnt_lgc /end MEASUREMENT
/begin MEASUREMENT HwPwUp.TMFTestStart.Cnt_lgc "MICROSAR RTE" UBYTE RTE_CM_BOOLEAN 0 0 0 255 ECU_ADDRESS 0 SYMBOL_LINK "Rte_HwPwUp_TMFTestStart_Cnt_lgc" 0 DISPLAY_IDENTIFIER HwPwUp.SenderPorts.TMFTestStart.Cnt_lgc /end MEASUREMENT
/begin MEASUREMENT HwTrq.AbsPosStepSignal.Cnt_u08 "MICROSAR RTE" UBYTE NO_COMPU_METHOD 0 0 0 255 ECU_ADDRESS 0 SYMBOL_LINK "Rte_HwTrq_AbsPosStepSignal_Cnt_u08" 0 DISPLAY_IDENTIFIER HwTrq.ReceiverPorts.AbsPosStepSignal.Cnt_u08 /end MEASUREMENT
/begin MEASUREMENT HwTrq.AnaDiffHwTrq.Volt_f32 "This signal is intended to communicate any type voltage signal measured by the ecu.  This signal has a lower limit of 0 which reequires users of the signal to provide divide by 0 protection if it is used as a denominator in a calculation.  See Vecu port p" FLOAT32_IEEE NO_COMPU_METHOD 0 0 1.175494351e-38 3.402823466e+38 ECU_ADDRESS 0 SYMBOL_LINK "Rte_HwTrq_AnaDiffHwTrq_Volt_f32" 0 DISPLAY_IDENTIFIER HwTrq.SenderPorts.AnaDiffHwTrq.Volt_f32 /end MEASUREMENT
/begin MEASUREMENT HwTrq.AnaHwTorque.HwNm_f32 "MICROSAR RTE" FLOAT32_IEEE NO_COMPU_METHOD 0 0 1.175494351e-38 3.402823466e+38 ECU_ADDRESS 0 SYMBOL_LINK "Rte_HwTrq_AnaHwTorque_HwNm_f32" 0 DISPLAY_IDENTIFIER HwTrq.SenderPorts.AnaHwTorque.HwNm_f32 /end MEASUREMENT
/begin MEASUREMENT HwTrq.CntrlDisRampComplete.Cnt_lgc "MICROSAR RTE" UBYTE RTE_CM_BOOLEAN 0 0 0 255 ECU_ADDRESS 0 SYMBOL_LINK "Rte_CtrldDisShtdn_CtrldDmpStsCmp_Cnt_lgc" 0 DISPLAY_IDENTIFIER HwTrq.ReceiverPorts.CntrlDisRampComplete.Cnt_lgc /end MEASUREMENT
/begin MEASUREMENT HwTrq.EOLTrqStepData "MICROSAR RTE" FLOAT32_IEEE NO_COMPU_METHOD 0 0 1.175494351e-38 3.402823466e+38 MATRIX_DIM 10 1 1 ECU_ADDRESS 0 SYMBOL_LINK "Rte_HwTrq_EOLTrqStepData" 0 DISPLAY_IDENTIFIER HwTrq.PerInstanceMemories.EOLTrqStepData READ_WRITE /end MEASUREMENT
/begin MEASUREMENT HwTrq.HwTrqScaleData.HwTrqScalePerf_Cnt_lgc "MICROSAR RTE" UBYTE RTE_CM_BOOLEAN 0 0 0 255 ECU_ADDRESS 0 SYMBOL_LINK "Rte_HwTrq_HwTrqScaleData.HwTrqScalePerf_Cnt_lgc" 0 DISPLAY_IDENTIFIER HwTrq.PerInstanceMemories.HwTrqScaleData.HwTrqScalePerf_Cnt_lgc READ_WRITE /end MEASUREMENT
/begin MEASUREMENT HwTrq.HwTrqScaleData.HwTrqScale_VoltsPerDeg_f32 "MICROSAR RTE" FLOAT32_IEEE NO_COMPU_METHOD 0 0 1.175494351e-38 3.402823466e+38 ECU_ADDRESS 0 SYMBOL_LINK "Rte_HwTrq_HwTrqScaleData.HwTrqScale_VoltsPerDeg_f32" 0 DISPLAY_IDENTIFIER HwTrq.PerInstanceMemories.HwTrqScaleData.HwTrqScale_VoltsPerDeg_f32 READ_WRITE /end MEASUREMENT
/begin MEASUREMENT HwTrq.HwTrqScaleVal.VoltsPerDeg_f32 "MICROSAR RTE" FLOAT32_IEEE NO_COMPU_METHOD 0 0 1.175494351e-38 3.402823466e+38 ECU_ADDRESS 0 SYMBOL_LINK "Rte_HwTrq_HwTrqScaleVal_VoltsPerDeg_f32" 0 DISPLAY_IDENTIFIER HwTrq.SenderPorts.HwTrqScaleVal.VoltsPerDeg_f32 /end MEASUREMENT
/begin MEASUREMENT HwTrq.HwTrqTrimData.HwTrqTrimPerf_Cnt_lgc "MICROSAR RTE" UBYTE RTE_CM_BOOLEAN 0 0 0 255 ECU_ADDRESS 0 SYMBOL_LINK "Rte_HwTrq_HwTrqTrimData.HwTrqTrimPerf_Cnt_lgc" 0 DISPLAY_IDENTIFIER HwTrq.PerInstanceMemories.HwTrqTrimData.HwTrqTrimPerf_Cnt_lgc READ_WRITE /end MEASUREMENT
/begin MEASUREMENT HwTrq.HwTrqTrimData.HwTrqTrim_Volts_f32 "MICROSAR RTE" FLOAT32_IEEE NO_COMPU_METHOD 0 0 1.175494351e-38 3.402823466e+38 ECU_ADDRESS 0 SYMBOL_LINK "Rte_HwTrq_HwTrqTrimData.HwTrqTrim_Volts_f32" 0 DISPLAY_IDENTIFIER HwTrq.PerInstanceMemories.HwTrqTrimData.HwTrqTrim_Volts_f32 READ_WRITE /end MEASUREMENT
/begin MEASUREMENT HwTrq.HwTrqTrimData.T1Trim_Volts_f32 "MICROSAR RTE" FLOAT32_IEEE NO_COMPU_METHOD 0 0 1.175494351e-38 3.402823466e+38 ECU_ADDRESS 0 SYMBOL_LINK "Rte_HwTrq_HwTrqTrimData.T1Trim_Volts_f32" 0 DISPLAY_IDENTIFIER HwTrq.PerInstanceMemories.HwTrqTrimData.T1Trim_Volts_f32 READ_WRITE /end MEASUREMENT
/begin MEASUREMENT HwTrq.HwTrqTrimData.T2Trim_Volts_f32 "MICROSAR RTE" FLOAT32_IEEE NO_COMPU_METHOD 0 0 1.175494351e-38 3.402823466e+38 ECU_ADDRESS 0 SYMBOL_LINK "Rte_HwTrq_HwTrqTrimData.T2Trim_Volts_f32" 0 DISPLAY_IDENTIFIER HwTrq.PerInstanceMemories.HwTrqTrimData.T2Trim_Volts_f32 READ_WRITE /end MEASUREMENT
/begin MEASUREMENT HwTrq.MECCounter.Cnt_enum "MICROSAR RTE" UBYTE RTE_CM_ENUM_ManufModeType 0 0 0 2 ECU_ADDRESS 0 SYMBOL_LINK "Rte_CDDInterface9_NxtrMEC_Cnt_enum" 0 DISPLAY_IDENTIFIER HwTrq.ReceiverPorts.MECCounter.Cnt_enum /end MEASUREMENT
/begin MEASUREMENT HwTrq.SrlComHwTrqValid.Cnt_lgc "MICROSAR RTE" UBYTE RTE_CM_BOOLEAN 0 0 0 255 ECU_ADDRESS 0 SYMBOL_LINK "Rte_HwTrq_SrlComHwTrqValid_Cnt_lgc" 0 DISPLAY_IDENTIFIER HwTrq.SenderPorts.SrlComHwTrqValid.Cnt_lgc /end MEASUREMENT
/begin MEASUREMENT HwTrq.SysCAnaHwTorque.HwNm_f32 "MICROSAR RTE" FLOAT32_IEEE NO_COMPU_METHOD 0 0 1.175494351e-38 3.402823466e+38 ECU_ADDRESS 0 SYMBOL_LINK "Rte_HwTrq_SysCAnaHwTorque_HwNm_f32" 0 DISPLAY_IDENTIFIER HwTrq.SenderPorts.SysCAnaHwTorque.HwNm_f32 /end MEASUREMENT
/begin MEASUREMENT HwTrq.T1ADC.Volt_f32 "This signal is intended to communicate any type voltage signal measured by the ecu.  This signal has a lower limit of 0 which reequires users of the signal to provide divide by 0 protection if it is used as a denominator in a calculation.  See Vecu port p" FLOAT32_IEEE NO_COMPU_METHOD 0 0 1.175494351e-38 3.402823466e+38 ECU_ADDRESS 0 SYMBOL_LINK "Rte_IoHwAb7_T1ADC_Volt_f32" 0 DISPLAY_IDENTIFIER HwTrq.ReceiverPorts.T1ADC.Volt_f32 /end MEASUREMENT
/begin MEASUREMENT HwTrq.T1TrimVal.Volt_f32 "This signal is intended to communicate any type voltage signal measured by the ecu.  This signal has a lower limit of 0 which reequires users of the signal to provide divide by 0 protection if it is used as a denominator in a calculation.  See Vecu port p" FLOAT32_IEEE NO_COMPU_METHOD 0 0 1.175494351e-38 3.402823466e+38 ECU_ADDRESS 0 SYMBOL_LINK "Rte_HwTrq_T1TrimVal_Volt_f32" 0 DISPLAY_IDENTIFIER HwTrq.SenderPorts.T1TrimVal.Volt_f32 /end MEASUREMENT
/begin MEASUREMENT HwTrq.T2ADC.Volt_f32 "This signal is intended to communicate any type voltage signal measured by the ecu.  This signal has a lower limit of 0 which reequires users of the signal to provide divide by 0 protection if it is used as a denominator in a calculation.  See Vecu port p" FLOAT32_IEEE NO_COMPU_METHOD 0 0 1.175494351e-38 3.402823466e+38 ECU_ADDRESS 0 SYMBOL_LINK "Rte_IoHwAb7_T2ADC_Volt_f32" 0 DISPLAY_IDENTIFIER HwTrq.ReceiverPorts.T2ADC.Volt_f32 /end MEASUREMENT
/begin MEASUREMENT HwTrq.T2TrimVal.Volt_f32 "This signal is intended to communicate any type voltage signal measured by the ecu.  This signal has a lower limit of 0 which reequires users of the signal to provide divide by 0 protection if it is used as a denominator in a calculation.  See Vecu port p" FLOAT32_IEEE NO_COMPU_METHOD 0 0 1.175494351e-38 3.402823466e+38 ECU_ADDRESS 0 SYMBOL_LINK "Rte_HwTrq_T2TrimVal_Volt_f32" 0 DISPLAY_IDENTIFIER HwTrq.SenderPorts.T2TrimVal.Volt_f32 /end MEASUREMENT
/begin MEASUREMENT HwTrq2.AnaDiffHwTrq.Volt_f32 "This signal is intended to communicate any type voltage signal measured by the ecu.  This signal has a lower limit of 0 which reequires users of the signal to provide divide by 0 protection if it is used as a denominator in a calculation.  See Vecu port p" FLOAT32_IEEE NO_COMPU_METHOD 0 0 1.175494351e-38 3.402823466e+38 ECU_ADDRESS 0 SYMBOL_LINK "Rte_HwTrq_AnaDiffHwTrq_Volt_f32" 0 DISPLAY_IDENTIFIER HwTrq2.ReceiverPorts.AnaDiffHwTrq.Volt_f32 /end MEASUREMENT
/begin MEASUREMENT HwTrq2.AnaHwTorque.HwNm_f32 "MICROSAR RTE" FLOAT32_IEEE NO_COMPU_METHOD 0 0 1.175494351e-38 3.402823466e+38 ECU_ADDRESS 0 SYMBOL_LINK "Rte_HwTrq_AnaHwTorque_HwNm_f32" 0 DISPLAY_IDENTIFIER HwTrq2.ReceiverPorts.AnaHwTorque.HwNm_f32 /end MEASUREMENT
/begin MEASUREMENT HwTrq2.HwTrqScaleVal.VoltsPerDeg_f32 "MICROSAR RTE" FLOAT32_IEEE NO_COMPU_METHOD 0 0 1.175494351e-38 3.402823466e+38 ECU_ADDRESS 0 SYMBOL_LINK "Rte_HwTrq_HwTrqScaleVal_VoltsPerDeg_f32" 0 DISPLAY_IDENTIFIER HwTrq2.ReceiverPorts.HwTrqScaleVal.VoltsPerDeg_f32 /end MEASUREMENT
/begin MEASUREMENT HwTrq2.SysCT1ADC.Volt_f32 "This signal is intended to communicate any type voltage signal measured by the ecu.  This signal has a lower limit of 0 which reequires users of the signal to provide divide by 0 protection if it is used as a denominator in a calculation.  See Vecu port p" FLOAT32_IEEE NO_COMPU_METHOD 0 0 1.175494351e-38 3.402823466e+38 ECU_ADDRESS 0 SYMBOL_LINK "Rte_IoHwAb7_SysCT1ADC_Volt_f32" 0 DISPLAY_IDENTIFIER HwTrq2.ReceiverPorts.SysCT1ADC.Volt_f32 /end MEASUREMENT
/begin MEASUREMENT HwTrq2.SysCT2ADC.Volt_f32 "This signal is intended to communicate any type voltage signal measured by the ecu.  This signal has a lower limit of 0 which reequires users of the signal to provide divide by 0 protection if it is used as a denominator in a calculation.  See Vecu port p" FLOAT32_IEEE NO_COMPU_METHOD 0 0 1.175494351e-38 3.402823466e+38 ECU_ADDRESS 0 SYMBOL_LINK "Rte_IoHwAb7_SysCT2ADC_Volt_f32" 0 DISPLAY_IDENTIFIER HwTrq2.ReceiverPorts.SysCT2ADC.Volt_f32 /end MEASUREMENT
/begin MEASUREMENT HwTrq2.T1TrimVal.Volt_f32 "This signal is intended to communicate any type voltage signal measured by the ecu.  This signal has a lower limit of 0 which reequires users of the signal to provide divide by 0 protection if it is used as a denominator in a calculation.  See Vecu port p" FLOAT32_IEEE NO_COMPU_METHOD 0 0 1.175494351e-38 3.402823466e+38 ECU_ADDRESS 0 SYMBOL_LINK "Rte_HwTrq_T1TrimVal_Volt_f32" 0 DISPLAY_IDENTIFIER HwTrq2.ReceiverPorts.T1TrimVal.Volt_f32 /end MEASUREMENT
/begin MEASUREMENT HwTrq2.T2TrimVal.Volt_f32 "This signal is intended to communicate any type voltage signal measured by the ecu.  This signal has a lower limit of 0 which reequires users of the signal to provide divide by 0 protection if it is used as a denominator in a calculation.  See Vecu port p" FLOAT32_IEEE NO_COMPU_METHOD 0 0 1.175494351e-38 3.402823466e+38 ECU_ADDRESS 0 SYMBOL_LINK "Rte_HwTrq_T2TrimVal_Volt_f32" 0 DISPLAY_IDENTIFIER HwTrq2.ReceiverPorts.T2TrimVal.Volt_f32 /end MEASUREMENT
/begin MEASUREMENT HystAdd.HwTrq.HwNm_f32 "MICROSAR RTE" FLOAT32_IEEE NO_COMPU_METHOD 0 0 1.175494351e-38 3.402823466e+38 ECU_ADDRESS 0 SYMBOL_LINK "Rte_Sweep_OutputHwTrq_HwNm_f32" 0 DISPLAY_IDENTIFIER HystAdd.ReceiverPorts.HwTrq.HwNm_f32 /end MEASUREMENT
/begin MEASUREMENT HystAdd.HysAddHwTrq.HwNm_f32 "MICROSAR RTE" FLOAT32_IEEE NO_COMPU_METHOD 0 0 1.175494351e-38 3.402823466e+38 ECU_ADDRESS 0 SYMBOL_LINK "Rte_HystAdd_HysAddHwTrq_HwNm_f32" 0 DISPLAY_IDENTIFIER HystAdd.SenderPorts.HysAddHwTrq.HwNm_f32 /end MEASUREMENT
/begin MEASUREMENT HystAdd.HysAddSrlComSvcDft.Cnt_lgc "MICROSAR RTE" UBYTE RTE_CM_BOOLEAN 0 0 0 255 ECU_ADDRESS 0 SYMBOL_LINK "Rte_CDDInterface9_HysAddSrlComSvcDft_Cnt_lgc" 0 DISPLAY_IDENTIFIER HystAdd.ReceiverPorts.HysAddSrlComSvcDft.Cnt_lgc /end MEASUREMENT
/begin MEASUREMENT HystAdd.VehSpd.Kph_f32 "MICROSAR RTE" FLOAT32_IEEE NO_COMPU_METHOD 0 0 1.175494351e-38 3.402823466e+38 ECU_ADDRESS 0 SYMBOL_LINK "Rte_SignlCondn_VehicleSpeed_Kph_f32" 0 DISPLAY_IDENTIFIER HystAdd.ReceiverPorts.VehSpd.Kph_f32 /end MEASUREMENT
/begin MEASUREMENT HystComp.AssistMechTempEst.DegC_f32 "MICROSAR RTE" FLOAT32_IEEE NO_COMPU_METHOD 0 0 1.175494351e-38 3.402823466e+38 ECU_ADDRESS 0 SYMBOL_LINK "Rte_MtrTempEst_AssistMechTempEst_DegC_f32" 0 DISPLAY_IDENTIFIER HystComp.ReceiverPorts.AssistMechTempEst.DegC_f32 /end MEASUREMENT
/begin MEASUREMENT HystComp.BaseAssistCmd.MtrNm_f32 "MICROSAR RTE" FLOAT32_IEEE NO_COMPU_METHOD 0 0 1.175494351e-38 3.402823466e+38 ECU_ADDRESS 0 SYMBOL_LINK "Rte_Assist_BaseAssistCmd_MtrNm_f32" 0 DISPLAY_IDENTIFIER HystComp.ReceiverPorts.BaseAssistCmd.MtrNm_f32 /end MEASUREMENT
/begin MEASUREMENT HystComp.DefeatHystService.Cnt_lgc "MICROSAR RTE" UBYTE RTE_CM_BOOLEAN 0 0 0 255 ECU_ADDRESS 0 SYMBOL_LINK "Rte_CDDInterface9_HystCompSrlComSvcDft_Cnt_lgc" 0 DISPLAY_IDENTIFIER HystComp.ReceiverPorts.DefeatHystService.Cnt_lgc /end MEASUREMENT
/begin MEASUREMENT HystComp.FricOffset.HwNm_f32 "MICROSAR RTE" FLOAT32_IEEE NO_COMPU_METHOD 0 0 1.175494351e-38 3.402823466e+38 ECU_ADDRESS 0 SYMBOL_LINK "Rte_AvgFricLrn_FricOffset_HwNm_f32" 0 DISPLAY_IDENTIFIER HystComp.ReceiverPorts.FricOffset.HwNm_f32 /end MEASUREMENT
/begin MEASUREMENT HystComp.HwTorque.HwNm_f32 "MICROSAR RTE" FLOAT32_IEEE NO_COMPU_METHOD 0 0 1.175494351e-38 3.402823466e+38 ECU_ADDRESS 0 SYMBOL_LINK "Rte_Sweep_OutputHwTrq_HwNm_f32" 0 DISPLAY_IDENTIFIER HystComp.ReceiverPorts.HwTorque.HwNm_f32 /end MEASUREMENT
/begin MEASUREMENT HystComp.HysteresisComp.MtrNm_f32 "MICROSAR RTE" FLOAT32_IEEE NO_COMPU_METHOD 0 0 1.175494351e-38 3.402823466e+38 ECU_ADDRESS 0 SYMBOL_LINK "Rte_HystComp_HysteresisComp_MtrNm_f32" 0 DISPLAY_IDENTIFIER HystComp.SenderPorts.HysteresisComp.MtrNm_f32 /end MEASUREMENT
/begin GROUP CtrldDisShtdn.SystemState.Mode "MICROSAR RTE" /begin SUB_GROUP /end SUB_GROUP /begin FUNCTION_LIST /end FUNCTION_LIST /begin REF_CHARACTERISTIC /end REF_CHARACTERISTIC /begin REF_MEASUREMENT CtrldDisShtdn.SystemState.Mode /end REF_MEASUREMENT /end GROUP
/begin GROUP CurrentEst "MICROSAR RTE"
 /begin SUB_GROUP CurrentEst.InterRunnableVariables CurrentEst.ModeRequirePorts CurrentEst.ReceiverPorts CurrentEst.SenderPorts /end SUB_GROUP
 /begin FUNCTION_LIST /end FUNCTION_LIST
 /begin REF_CHARACTERISTIC /end REF_CHARACTERISTIC
 /begin REF_MEASUREMENT /end REF_MEASUREMENT
/end GROUP
/begin GROUP CurrentEst.EstPkCurr.AmpSq_f32 "MICROSAR RTE" /begin SUB_GROUP /end SUB_GROUP /begin FUNCTION_LIST /end FUNCTION_LIST /begin REF_CHARACTERISTIC /end REF_CHARACTERISTIC /begin REF_MEASUREMENT CurrentEst.EstPkCurr.AmpSq_f32 /end REF_MEASUREMENT /end GROUP
/begin GROUP CurrentEst.EstPkCurr_AmpSq_f32 "MICROSAR RTE" /begin SUB_GROUP /end SUB_GROUP /begin FUNCTION_LIST /end FUNCTION_LIST /begin REF_CHARACTERISTIC /end REF_CHARACTERISTIC /begin REF_MEASUREMENT CurrentEst.EstPkCurr_AmpSq_f32 /end REF_MEASUREMENT /end GROUP
/begin GROUP CurrentEst.EstR.Ohm_f32 "MICROSAR RTE" /begin SUB_GROUP /end SUB_GROUP /begin FUNCTION_LIST /end FUNCTION_LIST /begin REF_CHARACTERISTIC /end REF_CHARACTERISTIC /begin REF_MEASUREMENT CurrentEst.EstR.Ohm_f32 /end REF_MEASUREMENT /end GROUP
/begin GROUP CurrentEst.ExpIq.Amp_f32 "MICROSAR RTE" /begin SUB_GROUP /end SUB_GROUP /begin FUNCTION_LIST /end FUNCTION_LIST /begin REF_CHARACTERISTIC /end REF_CHARACTERISTIC /begin REF_MEASUREMENT CurrentEst.ExpIq.Amp_f32 /end REF_MEASUREMENT /end GROUP
/begin GROUP CurrentEst.FiltEstPkCurr.AmpSq_f32 "MICROSAR RTE" /begin SUB_GROUP /end SUB_GROUP /begin FUNCTION_LIST /end FUNCTION_LIST /begin REF_CHARACTERISTIC /end REF_CHARACTERISTIC /begin REF_MEASUREMENT CurrentEst.FiltEstPkCurr.AmpSq_f32 /end REF_MEASUREMENT /end GROUP
/begin GROUP CurrentEst.IdEst.Amp_f32 "MICROSAR RTE" /begin SUB_GROUP /end SUB_GROUP /begin FUNCTION_LIST /end FUNCTION_LIST /begin REF_CHARACTERISTIC /end REF_CHARACTERISTIC /begin REF_MEASUREMENT CurrentEst.IdEst.Amp_f32 /end REF_MEASUREMENT /end GROUP
/begin GROUP CurrentEst.InterRunnableVariables "MICROSAR RTE" /begin SUB_GROUP CurrentEst.EstPkCurr_AmpSq_f32 /end SUB_GROUP /begin FUNCTION_LIST /end FUNCTION_LIST /begin REF_CHARACTERISTIC /end REF_CHARACTERISTIC /begin REF_MEASUREMENT /end REF_MEASUREMENT /end GROUP
/begin GROUP CurrentEst.ModIdx.Uls_f32 "MICROSAR RTE" /begin SUB_GROUP /end SUB_GROUP /begin FUNCTION_LIST /end FUNCTION_LIST /begin REF_CHARACTERISTIC /end REF_CHARACTERISTIC /begin REF_MEASUREMENT CurrentEst.ModIdx.Uls_f32 /end REF_MEASUREMENT /end GROUP
/begin GROUP CurrentEst.ModeRequirePorts "MICROSAR RTE" /begin SUB_GROUP CurrentEst.SystemState.Mode /end SUB_GROUP /begin FUNCTION_LIST /end FUNCTION_LIST /begin REF_CHARACTERISTIC /end REF_CHARACTERISTIC /begin REF_MEASUREMENT /end REF_MEASUREMENT /end GROUP
/begin GROUP CurrentEst.ReceiverPorts "MICROSAR RTE"
 /begin SUB_GROUP CurrentEst.EstR.Ohm_f32 CurrentEst.ExpIq.Amp_f32 CurrentEst.ModIdx.Uls_f32 CurrentEst.TermXq.Uls_f32 CurrentEst.UncorrPhsAdv.Cnt_s16 CurrentEst.Vecu.Volt_f32 /end SUB_GROUP
 /begin FUNCTION_LIST /end FUNCTION_LIST
 /begin REF_CHARACTERISTIC /end REF_CHARACTERISTIC
 /begin REF_MEASUREMENT /end REF_MEASUREMENT
/end GROUP
/begin GROUP CurrentEst.SenderPorts "MICROSAR RTE"
 /begin SUB_GROUP CurrentEst.EstPkCurr.AmpSq_f32 CurrentEst.FiltEstPkCurr.AmpSq_f32 CurrentEst.IdEst.Amp_f32 /end SUB_GROUP
 /begin FUNCTION_LIST /end FUNCTION_LIST
 /begin REF_CHARACTERISTIC /end REF_CHARACTERISTIC
 /begin REF_MEASUREMENT /end REF_MEASUREMENT
/end GROUP
/begin GROUP CurrentEst.SystemState.Mode "MICROSAR RTE" /begin SUB_GROUP /end SUB_GROUP /begin FUNCTION_LIST /end FUNCTION_LIST /begin REF_CHARACTERISTIC /end REF_CHARACTERISTIC /begin REF_MEASUREMENT CurrentEst.SystemState.Mode /end REF_MEASUREMENT /end GROUP
/begin GROUP CurrentEst.TermXq.Uls_f32 "MICROSAR RTE" /begin SUB_GROUP /end SUB_GROUP /begin FUNCTION_LIST /end FUNCTION_LIST /begin REF_CHARACTERISTIC /end REF_CHARACTERISTIC /begin REF_MEASUREMENT CurrentEst.TermXq.Uls_f32 /end REF_MEASUREMENT /end GROUP
/begin GROUP CurrentEst.UncorrPhsAdv.Cnt_s16 "MICROSAR RTE" /begin SUB_GROUP /end SUB_GROUP /begin FUNCTION_LIST /end FUNCTION_LIST /begin REF_CHARACTERISTIC /end REF_CHARACTERISTIC /begin REF_MEASUREMENT CurrentEst.UncorrPhsAdv.Cnt_s16 /end REF_MEASUREMENT /end GROUP
/begin GROUP CurrentEst.Vecu.Volt_f32 "MICROSAR RTE" /begin SUB_GROUP /end SUB_GROUP /begin FUNCTION_LIST /end FUNCTION_LIST /begin REF_CHARACTERISTIC /end REF_CHARACTERISTIC /begin REF_MEASUREMENT CurrentEst.Vecu.Volt_f32 /end REF_MEASUREMENT /end GROUP
/begin GROUP CustPL "MICROSAR RTE"
 /begin SUB_GROUP CustPL.ModeRequirePorts CustPL.ReceiverPorts CustPL.SenderPorts /end SUB_GROUP
 /begin FUNCTION_LIST /end FUNCTION_LIST
 /begin REF_CHARACTERISTIC /end REF_CHARACTERISTIC
 /begin REF_MEASUREMENT /end REF_MEASUREMENT
/end GROUP
/begin GROUP CustPL.CASSISTMSA.Cnt_lgc "MICROSAR RTE" /begin SUB_GROUP /end SUB_GROUP /begin FUNCTION_LIST /end FUNCTION_LIST /begin REF_CHARACTERISTIC /end REF_CHARACTERISTIC /begin REF_MEASUREMENT CustPL.CASSISTMSA.Cnt_lgc /end REF_MEASUREMENT /end GROUP
/begin GROUP CustPL.CBATCURLIMITCUR.Amp_f32 "MICROSAR RTE" /begin SUB_GROUP /end SUB_GROUP /begin FUNCTION_LIST /end FUNCTION_LIST /begin REF_CHARACTERISTIC /end REF_CHARACTERISTIC /begin REF_MEASUREMENT CustPL.CBATCURLIMITCUR.Amp_f32 /end REF_MEASUREMENT /end GROUP
/begin GROUP CustPL.CCLMSAActive.Cnt_lgc "MICROSAR RTE" /begin SUB_GROUP /end SUB_GROUP /begin FUNCTION_LIST /end FUNCTION_LIST /begin REF_CHARACTERISTIC /end REF_CHARACTERISTIC /begin REF_MEASUREMENT CustPL.CCLMSAActive.Cnt_lgc /end REF_MEASUREMENT /end GROUP
/begin GROUP CustPL.CCLTrqRamp.Uls_f32 "MICROSAR RTE" /begin SUB_GROUP /end SUB_GROUP /begin FUNCTION_LIST /end FUNCTION_LIST /begin REF_CHARACTERISTIC /end REF_CHARACTERISTIC /begin REF_MEASUREMENT CustPL.CCLTrqRamp.Uls_f32 /end REF_MEASUREMENT /end GROUP
/begin GROUP CustPL.CVEHSPDCURLIMITCURRENT.Amp_f32 "MICROSAR RTE" /begin SUB_GROUP /end SUB_GROUP /begin FUNCTION_LIST /end FUNCTION_LIST /begin REF_CHARACTERISTIC /end REF_CHARACTERISTIC /begin REF_MEASUREMENT CustPL.CVEHSPDCURLIMITCURRENT.Amp_f32 /end REF_MEASUREMENT /end GROUP
/begin GROUP CustPL.CVEHSPDCURLIMITER.Cnt_lgc "MICROSAR RTE" /begin SUB_GROUP /end SUB_GROUP /begin FUNCTION_LIST /end FUNCTION_LIST /begin REF_CHARACTERISTIC /end REF_CHARACTERISTIC /begin REF_MEASUREMENT CustPL.CVEHSPDCURLIMITER.Cnt_lgc /end REF_MEASUREMENT /end GROUP
/begin GROUP CustPL.CVEHSPDCURLIMITSPEED.Kph_f32 "MICROSAR RTE" /begin SUB_GROUP /end SUB_GROUP /begin FUNCTION_LIST /end FUNCTION_LIST /begin REF_CHARACTERISTIC /end REF_CHARACTERISTIC /begin REF_MEASUREMENT CustPL.CVEHSPDCURLIMITSPEED.Kph_f32 /end REF_MEASUREMENT /end GROUP
/begin GROUP CustPL.CustCurrLmt.Amp_f32 "MICROSAR RTE" /begin SUB_GROUP /end SUB_GROUP /begin FUNCTION_LIST /end FUNCTION_LIST /begin REF_CHARACTERISTIC /end REF_CHARACTERISTIC /begin REF_MEASUREMENT CustPL.CustCurrLmt.Amp_f32 /end REF_MEASUREMENT /end GROUP
/begin GROUP CustPL.MSACommand.MSACmd_enum "MICROSAR RTE" /begin SUB_GROUP /end SUB_GROUP /begin FUNCTION_LIST /end FUNCTION_LIST /begin REF_CHARACTERISTIC /end REF_CHARACTERISTIC /begin REF_MEASUREMENT CustPL.MSACommand.MSACmd_enum /end REF_MEASUREMENT /end GROUP
/begin GROUP CustPL.ModeRequirePorts "MICROSAR RTE" /begin SUB_GROUP CustPL.SystemState.Mode /end SUB_GROUP /begin FUNCTION_LIST /end FUNCTION_LIST /begin REF_CHARACTERISTIC /end REF_CHARACTERISTIC /begin REF_MEASUREMENT /end REF_MEASUREMENT /end GROUP
/begin GROUP CustPL.ReceiverPorts "MICROSAR RTE"
 /begin SUB_GROUP CustPL.CASSISTMSA.Cnt_lgc CustPL.CBATCURLIMITCUR.Amp_f32 CustPL.CVEHSPDCURLIMITCURRENT.Amp_f32 CustPL.CVEHSPDCURLIMITER.Cnt_lgc CustPL.CVEHSPDCURLIMITSPEED.Kph_f32 CustPL.MSACommand.MSACmd_enum CustPL.SupplyCurrLmt.Amp_f32 CustPL.VehicleSpeed.Kph_f32 /end SUB_GROUP
 /begin FUNCTION_LIST /end FUNCTION_LIST
 /begin REF_CHARACTERISTIC /end REF_CHARACTERISTIC
 /begin REF_MEASUREMENT /end REF_MEASUREMENT
/end GROUP
/begin GROUP CustPL.SenderPorts "MICROSAR RTE"
 /begin SUB_GROUP CustPL.CCLMSAActive.Cnt_lgc CustPL.CCLTrqRamp.Uls_f32 CustPL.CustCurrLmt.Amp_f32 /end SUB_GROUP
 /begin FUNCTION_LIST /end FUNCTION_LIST
 /begin REF_CHARACTERISTIC /end REF_CHARACTERISTIC
 /begin REF_MEASUREMENT /end REF_MEASUREMENT
/end GROUP
/begin GROUP CustPL.SupplyCurrLmt.Amp_f32 "MICROSAR RTE" /begin SUB_GROUP /end SUB_GROUP /begin FUNCTION_LIST /end FUNCTION_LIST /begin REF_CHARACTERISTIC /end REF_CHARACTERISTIC /begin REF_MEASUREMENT CustPL.SupplyCurrLmt.Amp_f32 /end REF_MEASUREMENT /end GROUP
/begin GROUP CustPL.SystemState.Mode "MICROSAR RTE" /begin SUB_GROUP /end SUB_GROUP /begin FUNCTION_LIST /end FUNCTION_LIST /begin REF_CHARACTERISTIC /end REF_CHARACTERISTIC /begin REF_MEASUREMENT CustPL.SystemState.Mode /end REF_MEASUREMENT /end GROUP
/begin GROUP CustPL.VehicleSpeed.Kph_f32 "MICROSAR RTE" /begin SUB_GROUP /end SUB_GROUP /begin FUNCTION_LIST /end FUNCTION_LIST /begin REF_CHARACTERISTIC /end REF_CHARACTERISTIC /begin REF_MEASUREMENT CustPL.VehicleSpeed.Kph_f32 /end REF_MEASUREMENT /end GROUP
/begin GROUP Damping "MICROSAR RTE" /begin SUB_GROUP Damping.ReceiverPorts Damping.SenderPorts /end SUB_GROUP /begin FUNCTION_LIST /end FUNCTION_LIST /begin REF_CHARACTERISTIC /end REF_CHARACTERISTIC /begin REF_MEASUREMENT /end REF_MEASUREMENT /end GROUP
/begin GROUP Damping.AssistCmd.MtrNm_f32 "MICROSAR RTE" /begin SUB_GROUP /end SUB_GROUP /begin FUNCTION_LIST /end FUNCTION_LIST /begin REF_CHARACTERISTIC /end REF_CHARACTERISTIC /begin REF_MEASUREMENT Damping.AssistCmd.MtrNm_f32 /end REF_MEASUREMENT /end GROUP
/begin GROUP Damping.AssistMechTempEst.DegC_f32 "MICROSAR RTE" /begin SUB_GROUP /end SUB_GROUP /begin FUNCTION_LIST /end FUNCTION_LIST /begin REF_CHARACTERISTIC /end REF_CHARACTERISTIC /begin REF_MEASUREMENT Damping.AssistMechTempEst.DegC_f32 /end REF_MEASUREMENT /end GROUP
/begin GROUP Damping.CustomDamp.MtrNm_f32 "MICROSAR RTE" /begin SUB_GROUP /end SUB_GROUP /begin FUNCTION_LIST /end FUNCTION_LIST /begin REF_CHARACTERISTIC /end REF_CHARACTERISTIC /begin REF_MEASUREMENT Damping.CustomDamp.MtrNm_f32 /end REF_MEASUREMENT /end GROUP
/begin GROUP Damping.DampingCmd.MtrNm_f32 "MICROSAR RTE" /begin SUB_GROUP /end SUB_GROUP /begin FUNCTION_LIST /end FUNCTION_LIST /begin REF_CHARACTERISTIC /end REF_CHARACTERISTIC /begin REF_MEASUREMENT Damping.DampingCmd.MtrNm_f32 /end REF_MEASUREMENT /end GROUP
/begin GROUP Damping.DampingDDFactor.Uls_f32 "MICROSAR RTE" /begin SUB_GROUP /end SUB_GROUP /begin FUNCTION_LIST /end FUNCTION_LIST /begin REF_CHARACTERISTIC /end REF_CHARACTERISTIC /begin REF_MEASUREMENT Damping.DampingDDFactor.Uls_f32 /end REF_MEASUREMENT /end GROUP
/begin GROUP Damping.DefeatDampingSvc.Cnt_lgc "MICROSAR RTE" /begin SUB_GROUP /end SUB_GROUP /begin FUNCTION_LIST /end FUNCTION_LIST /begin REF_CHARACTERISTIC /end REF_CHARACTERISTIC /begin REF_MEASUREMENT Damping.DefeatDampingSvc.Cnt_lgc /end REF_MEASUREMENT /end GROUP
/begin GROUP Damping.HwTorque.HwNm_f32 "MICROSAR RTE" /begin SUB_GROUP /end SUB_GROUP /begin FUNCTION_LIST /end FUNCTION_LIST /begin REF_CHARACTERISTIC /end REF_CHARACTERISTIC /begin REF_MEASUREMENT Damping.HwTorque.HwNm_f32 /end REF_MEASUREMENT /end GROUP
/begin GROUP Damping.MotorVelCRF.MtrRadpS_f32 "MICROSAR RTE" /begin SUB_GROUP /end SUB_GROUP /begin FUNCTION_LIST /end FUNCTION_LIST /begin REF_CHARACTERISTIC /end REF_CHARACTERISTIC /begin REF_MEASUREMENT Damping.MotorVelCRF.MtrRadpS_f32 /end REF_MEASUREMENT /end GROUP
/begin GROUP Damping.ReceiverPorts "MICROSAR RTE"
 /begin SUB_GROUP Damping.AssistCmd.MtrNm_f32 Damping.AssistMechTempEst.DegC_f32 Damping.CustomDamp.MtrNm_f32 Damping.DampingDDFactor.Uls_f32 Damping.DefeatDampingSvc.Cnt_lgc Damping.HwTorque.HwNm_f32 Damping.MotorVelCRF.MtrRadpS_f32 Damping.VehicleSpeed.Kph_f32 /end SUB_GROUP
 /begin FUNCTION_LIST /end FUNCTION_LIST
 /begin REF_CHARACTERISTIC /end REF_CHARACTERISTIC
 /begin REF_MEASUREMENT /end REF_MEASUREMENT
/end GROUP
/begin GROUP Damping.SenderPorts "MICROSAR RTE" /begin SUB_GROUP Damping.DampingCmd.MtrNm_f32 /end SUB_GROUP /begin FUNCTION_LIST /end FUNCTION_LIST /begin REF_CHARACTERISTIC /end REF_CHARACTERISTIC /begin REF_MEASUREMENT /end REF_MEASUREMENT /end GROUP
/begin GROUP Damping.VehicleSpeed.Kph_f32 "MICROSAR RTE" /begin SUB_GROUP /end SUB_GROUP /begin FUNCTION_LIST /end FUNCTION_LIST /begin REF_CHARACTERISTIC /end REF_CHARACTERISTIC /begin REF_MEASUREMENT Damping.VehicleSpeed.Kph_f32 /end REF_MEASUREMENT /end GROUP
/begin GROUP DampingFirewall "MICROSAR RTE"
 /begin SUB_GROUP DampingFirewall.ModeRequirePorts DampingFirewall.ReceiverPorts DampingFirewall.SenderPorts /end SUB_GROUP
 /begin FUNCTION_LIST /end FUNCTION_LIST
 /begin REF_CHARACTERISTIC /end REF_CHARACTERISTIC
 /begin REF_MEASUREMENT /end REF_MEASUREMENT
/end GROUP
/begin GROUP DampingFirewall.AsstFirewallActive.Uls_f32 "MICROSAR RTE" /begin SUB_GROUP /end SUB_GROUP /begin FUNCTION_LIST /end FUNCTION_LIST /begin REF_CHARACTERISTIC /end REF_CHARACTERISTIC /begin REF_MEASUREMENT DampingFirewall.AsstFirewallActive.Uls_f32 /end REF_MEASUREMENT /end GROUP
/begin GROUP DampingFirewall.BaseAssistCmd.MtrNm_f32 "MICROSAR RTE" /begin SUB_GROUP /end SUB_GROUP /begin FUNCTION_LIST /end FUNCTION_LIST /begin REF_CHARACTERISTIC /end REF_CHARACTERISTIC /begin REF_MEASUREMENT DampingFirewall.BaseAssistCmd.MtrNm_f32 /end REF_MEASUREMENT /end GROUP
/begin GROUP DampingFirewall.CombinedDamping.MtrNm_f32 "MICROSAR RTE" /begin SUB_GROUP /end SUB_GROUP /begin FUNCTION_LIST /end FUNCTION_LIST /begin REF_CHARACTERISTIC /end REF_CHARACTERISTIC /begin REF_MEASUREMENT DampingFirewall.CombinedDamping.MtrNm_f32 /end REF_MEASUREMENT /end GROUP
/begin GROUP DampingFirewall.DampingCmd.MtrNm_f32 "MICROSAR RTE" /begin SUB_GROUP /end SUB_GROUP /begin FUNCTION_LIST /end FUNCTION_LIST /begin REF_CHARACTERISTIC /end REF_CHARACTERISTIC /begin REF_MEASUREMENT DampingFirewall.DampingCmd.MtrNm_f32 /end REF_MEASUREMENT /end GROUP
/begin GROUP DampingFirewall.Defeat_Damping_Svc.Cnt_lgc "MICROSAR RTE" /begin SUB_GROUP /end SUB_GROUP /begin FUNCTION_LIST /end FUNCTION_LIST /begin REF_CHARACTERISTIC /end REF_CHARACTERISTIC /begin REF_MEASUREMENT DampingFirewall.Defeat_Damping_Svc.Cnt_lgc /end REF_MEASUREMENT /end GROUP
/begin GROUP DampingFirewall.FreqDepDmpSrlComSvcDft.Cnt_lgc "MICROSAR RTE" /begin SUB_GROUP /end SUB_GROUP /begin FUNCTION_LIST /end FUNCTION_LIST /begin REF_CHARACTERISTIC /end REF_CHARACTERISTIC /begin REF_MEASUREMENT DampingFirewall.FreqDepDmpSrlComSvcDft.Cnt_lgc /end REF_MEASUREMENT /end GROUP
/begin GROUP DampingFirewall.HwTorque.HwNm_f32 "MICROSAR RTE" /begin SUB_GROUP /end SUB_GROUP /begin FUNCTION_LIST /end FUNCTION_LIST /begin REF_CHARACTERISTIC /end REF_CHARACTERISTIC /begin REF_MEASUREMENT DampingFirewall.HwTorque.HwNm_f32 /end REF_MEASUREMENT /end GROUP
/begin GROUP DampingFirewall.InertiaComp.MtrNm_f32 "MICROSAR RTE" /begin SUB_GROUP /end SUB_GROUP /begin FUNCTION_LIST /end FUNCTION_LIST /begin REF_CHARACTERISTIC /end REF_CHARACTERISTIC /begin REF_MEASUREMENT DampingFirewall.InertiaComp.MtrNm_f32 /end REF_MEASUREMENT /end GROUP
/begin GROUP DampingFirewall.MEC_Counter.Cnt_enum "MICROSAR RTE" /begin SUB_GROUP /end SUB_GROUP /begin FUNCTION_LIST /end FUNCTION_LIST /begin REF_CHARACTERISTIC /end REF_CHARACTERISTIC /begin REF_MEASUREMENT DampingFirewall.MEC_Counter.Cnt_enum /end REF_MEASUREMENT /end GROUP
/begin GROUP DampingFirewall.ModeRequirePorts "MICROSAR RTE" /begin SUB_GROUP DampingFirewall.SystemState.Mode /end SUB_GROUP /begin FUNCTION_LIST /end FUNCTION_LIST /begin REF_CHARACTERISTIC /end REF_CHARACTERISTIC /begin REF_MEASUREMENT /end REF_MEASUREMENT /end GROUP
/begin GROUP DampingFirewall.MtrVelCRF.MtrRadpS_f32 "MICROSAR RTE" /begin SUB_GROUP /end SUB_GROUP /begin FUNCTION_LIST /end FUNCTION_LIST /begin REF_CHARACTERISTIC /end REF_CHARACTERISTIC /begin REF_MEASUREMENT DampingFirewall.MtrVelCRF.MtrRadpS_f32 /end REF_MEASUREMENT /end GROUP
/begin GROUP DampingFirewall.ReceiverPorts "MICROSAR RTE"
 /begin SUB_GROUP DampingFirewall.AsstFirewallActive.Uls_f32 DampingFirewall.BaseAssistCmd.MtrNm_f32 DampingFirewall.DampingCmd.MtrNm_f32 DampingFirewall.Defeat_Damping_Svc.Cnt_lgc DampingFirewall.FreqDepDmpSrlComSvcDft.Cnt_lgc DampingFirewall.HwTorque.HwNm_f32 DampingFirewall.InertiaComp.MtrNm_f32 DampingFirewall.MEC_Counter.Cnt_enum DampingFirewall.MtrVelCRF.MtrRadpS_f32 DampingFirewall.VehicleLonAccel.KphpS_f32 DampingFirewall.VehicleSpeed.Kph_f32 DampingFirewall.WIRCmdAmpBlnd.MtrNm_f32 /end SUB_GROUP
 /begin FUNCTION_LIST /end FUNCTION_LIST
 /begin REF_CHARACTERISTIC /end REF_CHARACTERISTIC
 /begin REF_MEASUREMENT /end REF_MEASUREMENT
/end GROUP
/begin GROUP DampingFirewall.SenderPorts "MICROSAR RTE" /begin SUB_GROUP DampingFirewall.CombinedDamping.MtrNm_f32 /end SUB_GROUP /begin FUNCTION_LIST /end FUNCTION_LIST /begin REF_CHARACTERISTIC /end REF_CHARACTERISTIC /begin REF_MEASUREMENT /end REF_MEASUREMENT /end GROUP
/begin GROUP DampingFirewall.SystemState.Mode "MICROSAR RTE" /begin SUB_GROUP /end SUB_GROUP /begin FUNCTION_LIST /end FUNCTION_LIST /begin REF_CHARACTERISTIC /end REF_CHARACTERISTIC /begin REF_MEASUREMENT DampingFirewall.SystemState.Mode /end REF_MEASUREMENT /end GROUP
/begin GROUP DampingFirewall.VehicleLonAccel.KphpS_f32 "MICROSAR RTE" /begin SUB_GROUP /end SUB_GROUP /begin FUNCTION_LIST /end FUNCTION_LIST /begin REF_CHARACTERISTIC /end REF_CHARACTERISTIC /begin REF_MEASUREMENT DampingFirewall.VehicleLonAccel.KphpS_f32 /end REF_MEASUREMENT /end GROUP
/begin GROUP DampingFirewall.VehicleSpeed.Kph_f32 "MICROSAR RTE" /begin SUB_GROUP /end SUB_GROUP /begin FUNCTION_LIST /end FUNCTION_LIST /begin REF_CHARACTERISTIC /end REF_CHARACTERISTIC /begin REF_MEASUREMENT DampingFirewall.VehicleSpeed.Kph_f32 /end REF_MEASUREMENT /end GROUP
/begin GROUP DampingFirewall.WIRCmdAmpBlnd.MtrNm_f32 "MICROSAR RTE" /begin SUB_GROUP /end SUB_GROUP /begin FUNCTION_LIST /end FUNCTION_LIST /begin REF_CHARACTERISTIC /end REF_CHARACTERISTIC /begin REF_MEASUREMENT DampingFirewall.WIRCmdAmpBlnd.MtrNm_f32 /end REF_MEASUREMENT /end GROUP
/begin GROUP DemIf "MICROSAR RTE" /begin SUB_GROUP DemIf.ReceiverPorts /end SUB_GROUP /begin FUNCTION_LIST /end FUNCTION_LIST /begin REF_CHARACTERISTIC /end REF_CHARACTERISTIC /begin REF_MEASUREMENT /end REF_MEASUREMENT /end GROUP
/begin GROUP DemIf.ErrmBnU.Cnt_u8 "MICROSAR RTE" /begin SUB_GROUP /end SUB_GROUP /begin FUNCTION_LIST /end FUNCTION_LIST /begin REF_CHARACTERISTIC /end REF_CHARACTERISTIC /begin REF_MEASUREMENT DemIf.ErrmBnU.Cnt_u8 /end REF_MEASUREMENT /end GROUP
/begin GROUP DemIf.IlkErrmFzm.Cnt_u8 "MICROSAR RTE" /begin SUB_GROUP /end SUB_GROUP /begin FUNCTION_LIST /end FUNCTION_LIST /begin REF_CHARACTERISTIC /end REF_CHARACTERISTIC /begin REF_MEASUREMENT DemIf.IlkErrmFzm.Cnt_u8 /end REF_MEASUREMENT /end GROUP
/begin GROUP DemIf.ReceiverPorts "MICROSAR RTE"
 /begin SUB_GROUP DemIf.ErrmBnU.Cnt_u8 DemIf.IlkErrmFzm.Cnt_u8 DemIf.SrlComEngCrank.Cnt_lgc /end SUB_GROUP
 /begin FUNCTION_LIST /end FUNCTION_LIST
 /begin REF_CHARACTERISTIC /end REF_CHARACTERISTIC
 /begin REF_MEASUREMENT /end REF_MEASUREMENT
/end GROUP
/begin GROUP DemIf.SrlComEngCrank.Cnt_lgc "MICROSAR RTE" /begin SUB_GROUP /end SUB_GROUP /begin FUNCTION_LIST /end FUNCTION_LIST /begin REF_CHARACTERISTIC /end REF_CHARACTERISTIC /begin REF_MEASUREMENT DemIf.SrlComEngCrank.Cnt_lgc /end REF_MEASUREMENT /end GROUP
/begin GROUP DiagMgr10 "MICROSAR RTE"
 /begin SUB_GROUP DiagMgr10.ModeRequirePorts DiagMgr10.ReceiverPorts DiagMgr10.SenderPorts /end SUB_GROUP
 /begin FUNCTION_LIST /end FUNCTION_LIST
 /begin REF_CHARACTERISTIC /end REF_CHARACTERISTIC
 /begin REF_MEASUREMENT /end REF_MEASUREMENT
/end GROUP
/begin GROUP DiagMgr10.DiagRampRate.XpmS_f32 "MICROSAR RTE" /begin SUB_GROUP /end SUB_GROUP /begin FUNCTION_LIST /end FUNCTION_LIST /begin REF_CHARACTERISTIC /end REF_CHARACTERISTIC /begin REF_MEASUREMENT DiagMgr10.DiagRampRate.XpmS_f32 /end REF_MEASUREMENT /end GROUP
/begin GROUP DiagMgr10.DiagRampValue.Uls_f32 "MICROSAR RTE" /begin SUB_GROUP /end SUB_GROUP /begin FUNCTION_LIST /end FUNCTION_LIST /begin REF_CHARACTERISTIC /end REF_CHARACTERISTIC /begin REF_MEASUREMENT DiagMgr10.DiagRampValue.Uls_f32 /end REF_MEASUREMENT /end GROUP
/begin GROUP DiagMgr10.DiagRmpToZeroActive.Cnt_lgc "MICROSAR RTE" /begin SUB_GROUP /end SUB_GROUP /begin FUNCTION_LIST /end FUNCTION_LIST /begin REF_CHARACTERISTIC /end REF_CHARACTERISTIC /begin REF_MEASUREMENT DiagMgr10.DiagRmpToZeroActive.Cnt_lgc /end REF_MEASUREMENT /end GROUP
/begin GROUP DiagMgr10.DiagStsCtrldDisRmpPres.Cnt_lgc "MICROSAR RTE" /begin SUB_GROUP /end SUB_GROUP /begin FUNCTION_LIST /end FUNCTION_LIST /begin REF_CHARACTERISTIC /end REF_CHARACTERISTIC /begin REF_MEASUREMENT DiagMgr10.DiagStsCtrldDisRmpPres.Cnt_lgc /end REF_MEASUREMENT /end GROUP
/begin GROUP DiagMgr10.DiagStsDefTemp.Cnt_lgc "MICROSAR RTE" /begin SUB_GROUP /end SUB_GROUP /begin FUNCTION_LIST /end FUNCTION_LIST /begin REF_CHARACTERISTIC /end REF_CHARACTERISTIC /begin REF_MEASUREMENT DiagMgr10.DiagStsDefTemp.Cnt_lgc /end REF_MEASUREMENT /end GROUP
/begin GROUP DiagMgr10.DiagStsDefVehSpd.Cnt_lgc "MICROSAR RTE" /begin SUB_GROUP /end SUB_GROUP /begin FUNCTION_LIST /end FUNCTION_LIST /begin REF_CHARACTERISTIC /end REF_CHARACTERISTIC /begin REF_MEASUREMENT DiagMgr10.DiagStsDefVehSpd.Cnt_lgc /end REF_MEASUREMENT /end GROUP
/begin GROUP DiagMgr10.DiagStsHWASbSystmFltPres.Cnt_lgc "MICROSAR RTE" /begin SUB_GROUP /end SUB_GROUP /begin FUNCTION_LIST /end FUNCTION_LIST /begin REF_CHARACTERISTIC /end REF_CHARACTERISTIC /begin REF_MEASUREMENT DiagMgr10.DiagStsHWASbSystmFltPres.Cnt_lgc /end REF_MEASUREMENT /end GROUP
/begin GROUP DiagMgr10.DiagStsNonRecRmpToZeroFltPres.Cnt_lgc "MICROSAR RTE" /begin SUB_GROUP /end SUB_GROUP /begin FUNCTION_LIST /end FUNCTION_LIST /begin REF_CHARACTERISTIC /end REF_CHARACTERISTIC /begin REF_MEASUREMENT DiagMgr10.DiagStsNonRecRmpToZeroFltPres.Cnt_lgc /end REF_MEASUREMENT /end GROUP
/begin GROUP DiagMgr10.DiagStsRecRmpToZeroFltPres.Cnt_lgc "MICROSAR RTE" /begin SUB_GROUP /end SUB_GROUP /begin FUNCTION_LIST /end FUNCTION_LIST /begin REF_CHARACTERISTIC /end REF_CHARACTERISTIC /begin REF_MEASUREMENT DiagMgr10.DiagStsRecRmpToZeroFltPres.Cnt_lgc /end REF_MEASUREMENT /end GROUP
/begin GROUP DiagMgr10.DiagStsScomHWANotValid.Cnt_lgc "MICROSAR RTE" /begin SUB_GROUP /end SUB_GROUP /begin FUNCTION_LIST /end FUNCTION_LIST /begin REF_CHARACTERISTIC /end REF_CHARACTERISTIC /begin REF_MEASUREMENT DiagMgr10.DiagStsScomHWANotValid.Cnt_lgc /end REF_MEASUREMENT /end GROUP
/begin GROUP DiagMgr10.DiagStsWIRDisable.Cnt_lgc "MICROSAR RTE" /begin SUB_GROUP /end SUB_GROUP /begin FUNCTION_LIST /end FUNCTION_LIST /begin REF_CHARACTERISTIC /end REF_CHARACTERISTIC /begin REF_MEASUREMENT DiagMgr10.DiagStsWIRDisable.Cnt_lgc /end REF_MEASUREMENT /end GROUP
/begin GROUP DiagMgr10.HwTrq.HwNm_f32 "MICROSAR RTE" /begin SUB_GROUP /end SUB_GROUP /begin FUNCTION_LIST /end FUNCTION_LIST /begin REF_CHARACTERISTIC /end REF_CHARACTERISTIC /begin REF_MEASUREMENT DiagMgr10.HwTrq.HwNm_f32 /end REF_MEASUREMENT /end GROUP
/begin GROUP DiagMgr10.IgnCnt.Cnt_u16 "MICROSAR RTE" /begin SUB_GROUP /end SUB_GROUP /begin FUNCTION_LIST /end FUNCTION_LIST /begin REF_CHARACTERISTIC /end REF_CHARACTERISTIC /begin REF_MEASUREMENT DiagMgr10.IgnCnt.Cnt_u16 /end REF_MEASUREMENT /end GROUP
/begin GROUP DiagMgr10.MEC.Cnt_enum "MICROSAR RTE" /begin SUB_GROUP /end SUB_GROUP /begin FUNCTION_LIST /end FUNCTION_LIST /begin REF_CHARACTERISTIC /end REF_CHARACTERISTIC /begin REF_MEASUREMENT DiagMgr10.MEC.Cnt_enum /end REF_MEASUREMENT /end GROUP
/begin GROUP DiagMgr10.MfgDiagInhibit.Cnt_lgc "MICROSAR RTE" /begin SUB_GROUP /end SUB_GROUP /begin FUNCTION_LIST /end FUNCTION_LIST /begin REF_CHARACTERISTIC /end REF_CHARACTERISTIC /begin REF_MEASUREMENT DiagMgr10.MfgDiagInhibit.Cnt_lgc /end REF_MEASUREMENT /end GROUP
/begin GROUP DiagMgr10.ModeRequirePorts "MICROSAR RTE" /begin SUB_GROUP DiagMgr10.SystemState.Mode /end SUB_GROUP /begin FUNCTION_LIST /end FUNCTION_LIST /begin REF_CHARACTERISTIC /end REF_CHARACTERISTIC /begin REF_MEASUREMENT /end REF_MEASUREMENT /end GROUP
/begin GROUP DiagMgr10.MtrTrq.MtrNm_f32 "MICROSAR RTE" /begin SUB_GROUP /end SUB_GROUP /begin FUNCTION_LIST /end FUNCTION_LIST /begin REF_CHARACTERISTIC /end REF_CHARACTERISTIC /begin REF_MEASUREMENT DiagMgr10.MtrTrq.MtrNm_f32 /end REF_MEASUREMENT /end GROUP
/begin GROUP DiagMgr10.ReceiverPorts "MICROSAR RTE"
 /begin SUB_GROUP DiagMgr10.HwTrq.HwNm_f32 DiagMgr10.IgnCnt.Cnt_u16 DiagMgr10.MEC.Cnt_enum DiagMgr10.MfgDiagInhibit.Cnt_lgc DiagMgr10.MtrTrq.MtrNm_f32 DiagMgr10.VehSpd.Kph_f32 /end SUB_GROUP
 /begin FUNCTION_LIST /end FUNCTION_LIST
 /begin REF_CHARACTERISTIC /end REF_CHARACTERISTIC
 /begin REF_MEASUREMENT /end REF_MEASUREMENT
/end GROUP
/begin GROUP DiagMgr10.SenderPorts "MICROSAR RTE"
 /begin SUB_GROUP DiagMgr10.DiagRampRate.XpmS_f32 DiagMgr10.DiagRampValue.Uls_f32 DiagMgr10.DiagRmpToZeroActive.Cnt_lgc DiagMgr10.DiagStsCtrldDisRmpPres.Cnt_lgc DiagMgr10.DiagStsDefTemp.Cnt_lgc DiagMgr10.DiagStsDefVehSpd.Cnt_lgc DiagMgr10.DiagStsHWASbSystmFltPres.Cnt_lgc DiagMgr10.DiagStsNonRecRmpToZeroFltPres.Cnt_lgc DiagMgr10.DiagStsRecRmpToZeroFltPres.Cnt_lgc DiagMgr10.DiagStsScomHWANotValid.Cnt_lgc DiagMgr10.DiagStsWIRDisable.Cnt_lgc /end SUB_GROUP
 /begin FUNCTION_LIST /end FUNCTION_LIST
 /begin REF_CHARACTERISTIC /end REF_CHARACTERISTIC
 /begin REF_MEASUREMENT /end REF_MEASUREMENT
/end GROUP
/begin GROUP DiagMgr10.SystemState.Mode "MICROSAR RTE" /begin SUB_GROUP /end SUB_GROUP /begin FUNCTION_LIST /end FUNCTION_LIST /begin REF_CHARACTERISTIC /end REF_CHARACTERISTIC /begin REF_MEASUREMENT DiagMgr10.SystemState.Mode /end REF_MEASUREMENT /end GROUP
/begin GROUP DiagMgr10.VehSpd.Kph_f32 "MICROSAR RTE" /begin SUB_GROUP /end SUB_GROUP /begin FUNCTION_LIST /end FUNCTION_LIST /begin REF_CHARACTERISTIC /end REF_CHARACTERISTIC /begin REF_MEASUREMENT DiagMgr10.VehSpd.Kph_f32 /end REF_MEASUREMENT /end GROUP
/begin GROUP DiagMgr11 "MICROSAR RTE" /begin SUB_GROUP DiagMgr11.ModeRequirePorts DiagMgr11.ReceiverPorts /end SUB_GROUP /begin FUNCTION_LIST /end FUNCTION_LIST /begin REF_CHARACTERISTIC /end REF_CHARACTERISTIC /begin REF_MEASUREMENT /end REF_MEASUREMENT /end GROUP
/begin GROUP DiagMgr11.HwTrq.HwNm_f32 "MICROSAR RTE" /begin SUB_GROUP /end SUB_GROUP /begin FUNCTION_LIST /end FUNCTION_LIST /begin REF_CHARACTERISTIC /end REF_CHARACTERISTIC /begin REF_MEASUREMENT DiagMgr11.HwTrq.HwNm_f32 /end REF_MEASUREMENT /end GROUP
/begin GROUP DiagMgr11.IgnCnt.Cnt_u16 "MICROSAR RTE" /begin SUB_GROUP /end SUB_GROUP /begin FUNCTION_LIST /end FUNCTION_LIST /begin REF_CHARACTERISTIC /end REF_CHARACTERISTIC /begin REF_MEASUREMENT DiagMgr11.IgnCnt.Cnt_u16 /end REF_MEASUREMENT /end GROUP
/begin GROUP DiagMgr11.MEC.Cnt_enum "MICROSAR RTE" /begin SUB_GROUP /end SUB_GROUP /begin FUNCTION_LIST /end FUNCTION_LIST /begin REF_CHARACTERISTIC /end REF_CHARACTERISTIC /begin REF_MEASUREMENT DiagMgr11.MEC.Cnt_enum /end REF_MEASUREMENT /end GROUP
/begin GROUP DiagMgr11.MfgDiagInhibit.Cnt_lgc "MICROSAR RTE" /begin SUB_GROUP /end SUB_GROUP /begin FUNCTION_LIST /end FUNCTION_LIST /begin REF_CHARACTERISTIC /end REF_CHARACTERISTIC /begin REF_MEASUREMENT DiagMgr11.MfgDiagInhibit.Cnt_lgc /end REF_MEASUREMENT /end GROUP
/begin GROUP DiagMgr11.ModeRequirePorts "MICROSAR RTE" /begin SUB_GROUP DiagMgr11.SystemState.Mode /end SUB_GROUP /begin FUNCTION_LIST /end FUNCTION_LIST /begin REF_CHARACTERISTIC /end REF_CHARACTERISTIC /begin REF_MEASUREMENT /end REF_MEASUREMENT /end GROUP
/begin GROUP DiagMgr11.MtrTrq.MtrNm_f32 "MICROSAR RTE" /begin SUB_GROUP /end SUB_GROUP /begin FUNCTION_LIST /end FUNCTION_LIST /begin REF_CHARACTERISTIC /end REF_CHARACTERISTIC /begin REF_MEASUREMENT DiagMgr11.MtrTrq.MtrNm_f32 /end REF_MEASUREMENT /end GROUP
/begin GROUP DiagMgr11.ReceiverPorts "MICROSAR RTE"
 /begin SUB_GROUP DiagMgr11.HwTrq.HwNm_f32 DiagMgr11.IgnCnt.Cnt_u16 DiagMgr11.MEC.Cnt_enum DiagMgr11.MfgDiagInhibit.Cnt_lgc DiagMgr11.MtrTrq.MtrNm_f32 DiagMgr11.VehSpd.Kph_f32 /end SUB_GROUP
 /begin FUNCTION_LIST /end FUNCTION_LIST
 /begin REF_CHARACTERISTIC /end REF_CHARACTERISTIC
 /begin REF_MEASUREMENT /end REF_MEASUREMENT
/end GROUP
/begin GROUP DiagMgr11.SystemState.Mode "MICROSAR RTE" /begin SUB_GROUP /end SUB_GROUP /begin FUNCTION_LIST /end FUNCTION_LIST /begin REF_CHARACTERISTIC /end REF_CHARACTERISTIC /begin REF_MEASUREMENT DiagMgr11.SystemState.Mode /end REF_MEASUREMENT /end GROUP
/begin GROUP DiagMgr11.VehSpd.Kph_f32 "MICROSAR RTE" /begin SUB_GROUP /end SUB_GROUP /begin FUNCTION_LIST /end FUNCTION_LIST /begin REF_CHARACTERISTIC /end REF_CHARACTERISTIC /begin REF_MEASUREMENT DiagMgr11.VehSpd.Kph_f32 /end REF_MEASUREMENT /end GROUP
/begin GROUP DiagMgr7 "MICROSAR RTE" /begin SUB_GROUP DiagMgr7.ModeRequirePorts DiagMgr7.ReceiverPorts /end SUB_GROUP /begin FUNCTION_LIST /end FUNCTION_LIST /begin REF_CHARACTERISTIC /end REF_CHARACTERISTIC /begin REF_MEASUREMENT /end REF_MEASUREMENT /end GROUP
/begin GROUP DiagMgr7.HwTrq.HwNm_f32 "MICROSAR RTE" /begin SUB_GROUP /end SUB_GROUP /begin FUNCTION_LIST /end FUNCTION_LIST /begin REF_CHARACTERISTIC /end REF_CHARACTERISTIC /begin REF_MEASUREMENT DiagMgr7.HwTrq.HwNm_f32 /end REF_MEASUREMENT /end GROUP
/begin GROUP DiagMgr7.IgnCnt.Cnt_u16 "MICROSAR RTE" /begin SUB_GROUP /end SUB_GROUP /begin FUNCTION_LIST /end FUNCTION_LIST /begin REF_CHARACTERISTIC /end REF_CHARACTERISTIC /begin REF_MEASUREMENT DiagMgr7.IgnCnt.Cnt_u16 /end REF_MEASUREMENT /end GROUP
/begin GROUP DiagMgr7.MEC.Cnt_enum "MICROSAR RTE" /begin SUB_GROUP /end SUB_GROUP /begin FUNCTION_LIST /end FUNCTION_LIST /begin REF_CHARACTERISTIC /end REF_CHARACTERISTIC /begin REF_MEASUREMENT DiagMgr7.MEC.Cnt_enum /end REF_MEASUREMENT /end GROUP
/begin GROUP DiagMgr7.MfgDiagInhibit.Cnt_lgc "MICROSAR RTE" /begin SUB_GROUP /end SUB_GROUP /begin FUNCTION_LIST /end FUNCTION_LIST /begin REF_CHARACTERISTIC /end REF_CHARACTERISTIC /begin REF_MEASUREMENT DiagMgr7.MfgDiagInhibit.Cnt_lgc /end REF_MEASUREMENT /end GROUP
/begin GROUP DiagMgr7.ModeRequirePorts "MICROSAR RTE" /begin SUB_GROUP DiagMgr7.SystemState.Mode /end SUB_GROUP /begin FUNCTION_LIST /end FUNCTION_LIST /begin REF_CHARACTERISTIC /end REF_CHARACTERISTIC /begin REF_MEASUREMENT /end REF_MEASUREMENT /end GROUP
/begin GROUP DiagMgr7.MtrTrq.MtrNm_f32 "MICROSAR RTE" /begin SUB_GROUP /end SUB_GROUP /begin FUNCTION_LIST /end FUNCTION_LIST /begin REF_CHARACTERISTIC /end REF_CHARACTERISTIC /begin REF_MEASUREMENT DiagMgr7.MtrTrq.MtrNm_f32 /end REF_MEASUREMENT /end GROUP
/begin GROUP DiagMgr7.ReceiverPorts "MICROSAR RTE"
 /begin SUB_GROUP DiagMgr7.HwTrq.HwNm_f32 DiagMgr7.IgnCnt.Cnt_u16 DiagMgr7.MEC.Cnt_enum DiagMgr7.MfgDiagInhibit.Cnt_lgc DiagMgr7.MtrTrq.MtrNm_f32 DiagMgr7.VehSpd.Kph_f32 /end SUB_GROUP
 /begin FUNCTION_LIST /end FUNCTION_LIST
 /begin REF_CHARACTERISTIC /end REF_CHARACTERISTIC
 /begin REF_MEASUREMENT /end REF_MEASUREMENT
/end GROUP
/begin GROUP DiagMgr7.SystemState.Mode "MICROSAR RTE" /begin SUB_GROUP /end SUB_GROUP /begin FUNCTION_LIST /end FUNCTION_LIST /begin REF_CHARACTERISTIC /end REF_CHARACTERISTIC /begin REF_MEASUREMENT DiagMgr7.SystemState.Mode /end REF_MEASUREMENT /end GROUP
/begin GROUP DiagMgr7.VehSpd.Kph_f32 "MICROSAR RTE" /begin SUB_GROUP /end SUB_GROUP /begin FUNCTION_LIST /end FUNCTION_LIST /begin REF_CHARACTERISTIC /end REF_CHARACTERISTIC /begin REF_MEASUREMENT DiagMgr7.VehSpd.Kph_f32 /end REF_MEASUREMENT /end GROUP
/begin GROUP DiagMgr8 "MICROSAR RTE" /begin SUB_GROUP DiagMgr8.ModeRequirePorts DiagMgr8.ReceiverPorts /end SUB_GROUP /begin FUNCTION_LIST /end FUNCTION_LIST /begin REF_CHARACTERISTIC /end REF_CHARACTERISTIC /begin REF_MEASUREMENT /end REF_MEASUREMENT /end GROUP
/begin GROUP DiagMgr8.HwTrq.HwNm_f32 "MICROSAR RTE" /begin SUB_GROUP /end SUB_GROUP /begin FUNCTION_LIST /end FUNCTION_LIST /begin REF_CHARACTERISTIC /end REF_CHARACTERISTIC /begin REF_MEASUREMENT DiagMgr8.HwTrq.HwNm_f32 /end REF_MEASUREMENT /end GROUP
/begin GROUP DiagMgr8.IgnCnt.Cnt_u16 "MICROSAR RTE" /begin SUB_GROUP /end SUB_GROUP /begin FUNCTION_LIST /end FUNCTION_LIST /begin REF_CHARACTERISTIC /end REF_CHARACTERISTIC /begin REF_MEASUREMENT DiagMgr8.IgnCnt.Cnt_u16 /end REF_MEASUREMENT /end GROUP
/begin GROUP DiagMgr8.MEC.Cnt_enum "MICROSAR RTE" /begin SUB_GROUP /end SUB_GROUP /begin FUNCTION_LIST /end FUNCTION_LIST /begin REF_CHARACTERISTIC /end REF_CHARACTERISTIC /begin REF_MEASUREMENT DiagMgr8.MEC.Cnt_enum /end REF_MEASUREMENT /end GROUP
/begin GROUP DiagMgr8.MfgDiagInhibit.Cnt_lgc "MICROSAR RTE" /begin SUB_GROUP /end SUB_GROUP /begin FUNCTION_LIST /end FUNCTION_LIST /begin REF_CHARACTERISTIC /end REF_CHARACTERISTIC /begin REF_MEASUREMENT DiagMgr8.MfgDiagInhibit.Cnt_lgc /end REF_MEASUREMENT /end GROUP
/begin GROUP DiagMgr8.ModeRequirePorts "MICROSAR RTE" /begin SUB_GROUP DiagMgr8.SystemState.Mode /end SUB_GROUP /begin FUNCTION_LIST /end FUNCTION_LIST /begin REF_CHARACTERISTIC /end REF_CHARACTERISTIC /begin REF_MEASUREMENT /end REF_MEASUREMENT /end GROUP
/begin GROUP DiagMgr8.MtrTrq.MtrNm_f32 "MICROSAR RTE" /begin SUB_GROUP /end SUB_GROUP /begin FUNCTION_LIST /end FUNCTION_LIST /begin REF_CHARACTERISTIC /end REF_CHARACTERISTIC /begin REF_MEASUREMENT DiagMgr8.MtrTrq.MtrNm_f32 /end REF_MEASUREMENT /end GROUP
/begin GROUP DiagMgr8.ReceiverPorts "MICROSAR RTE"
 /begin SUB_GROUP DiagMgr8.HwTrq.HwNm_f32 DiagMgr8.IgnCnt.Cnt_u16 DiagMgr8.MEC.Cnt_enum DiagMgr8.MfgDiagInhibit.Cnt_lgc DiagMgr8.MtrTrq.MtrNm_f32 DiagMgr8.VehSpd.Kph_f32 /end SUB_GROUP
 /begin FUNCTION_LIST /end FUNCTION_LIST
 /begin REF_CHARACTERISTIC /end REF_CHARACTERISTIC
 /begin REF_MEASUREMENT /end REF_MEASUREMENT
/end GROUP
/begin GROUP DiagMgr8.SystemState.Mode "MICROSAR RTE" /begin SUB_GROUP /end SUB_GROUP /begin FUNCTION_LIST /end FUNCTION_LIST /begin REF_CHARACTERISTIC /end REF_CHARACTERISTIC /begin REF_MEASUREMENT DiagMgr8.SystemState.Mode /end REF_MEASUREMENT /end GROUP
/begin GROUP DiagMgr8.VehSpd.Kph_f32 "MICROSAR RTE" /begin SUB_GROUP /end SUB_GROUP /begin FUNCTION_LIST /end FUNCTION_LIST /begin REF_CHARACTERISTIC /end REF_CHARACTERISTIC /begin REF_MEASUREMENT DiagMgr8.VehSpd.Kph_f32 /end REF_MEASUREMENT /end GROUP
/begin GROUP DiagMgr9 "MICROSAR RTE" /begin SUB_GROUP DiagMgr9.ModeRequirePorts DiagMgr9.ReceiverPorts /end SUB_GROUP /begin FUNCTION_LIST /end FUNCTION_LIST /begin REF_CHARACTERISTIC /end REF_CHARACTERISTIC /begin REF_MEASUREMENT /end REF_MEASUREMENT /end GROUP
/begin GROUP DiagMgr9.HwTrq.HwNm_f32 "MICROSAR RTE" /begin SUB_GROUP /end SUB_GROUP /begin FUNCTION_LIST /end FUNCTION_LIST /begin REF_CHARACTERISTIC /end REF_CHARACTERISTIC /begin REF_MEASUREMENT DiagMgr9.HwTrq.HwNm_f32 /end REF_MEASUREMENT /end GROUP
/begin GROUP DiagMgr9.IgnCnt.Cnt_u16 "MICROSAR RTE" /begin SUB_GROUP /end SUB_GROUP /begin FUNCTION_LIST /end FUNCTION_LIST /begin REF_CHARACTERISTIC /end REF_CHARACTERISTIC /begin REF_MEASUREMENT DiagMgr9.IgnCnt.Cnt_u16 /end REF_MEASUREMENT /end GROUP
/begin GROUP DiagMgr9.MEC.Cnt_enum "MICROSAR RTE" /begin SUB_GROUP /end SUB_GROUP /begin FUNCTION_LIST /end FUNCTION_LIST /begin REF_CHARACTERISTIC /end REF_CHARACTERISTIC /begin REF_MEASUREMENT DiagMgr9.MEC.Cnt_enum /end REF_MEASUREMENT /end GROUP
/begin GROUP DiagMgr9.MfgDiagInhibit.Cnt_lgc "MICROSAR RTE" /begin SUB_GROUP /end SUB_GROUP /begin FUNCTION_LIST /end FUNCTION_LIST /begin REF_CHARACTERISTIC /end REF_CHARACTERISTIC /begin REF_MEASUREMENT DiagMgr9.MfgDiagInhibit.Cnt_lgc /end REF_MEASUREMENT /end GROUP
/begin GROUP DiagMgr9.ModeRequirePorts "MICROSAR RTE" /begin SUB_GROUP DiagMgr9.SystemState.Mode /end SUB_GROUP /begin FUNCTION_LIST /end FUNCTION_LIST /begin REF_CHARACTERISTIC /end REF_CHARACTERISTIC /begin REF_MEASUREMENT /end REF_MEASUREMENT /end GROUP
/begin GROUP DiagMgr9.MtrTrq.MtrNm_f32 "MICROSAR RTE" /begin SUB_GROUP /end SUB_GROUP /begin FUNCTION_LIST /end FUNCTION_LIST /begin REF_CHARACTERISTIC /end REF_CHARACTERISTIC /begin REF_MEASUREMENT DiagMgr9.MtrTrq.MtrNm_f32 /end REF_MEASUREMENT /end GROUP
/begin GROUP DiagMgr9.ReceiverPorts "MICROSAR RTE"
 /begin SUB_GROUP DiagMgr9.HwTrq.HwNm_f32 DiagMgr9.IgnCnt.Cnt_u16 DiagMgr9.MEC.Cnt_enum DiagMgr9.MfgDiagInhibit.Cnt_lgc DiagMgr9.MtrTrq.MtrNm_f32 DiagMgr9.VehSpd.Kph_f32 /end SUB_GROUP
 /begin FUNCTION_LIST /end FUNCTION_LIST
 /begin REF_CHARACTERISTIC /end REF_CHARACTERISTIC
 /begin REF_MEASUREMENT /end REF_MEASUREMENT
/end GROUP
/begin GROUP DiagMgr9.SystemState.Mode "MICROSAR RTE" /begin SUB_GROUP /end SUB_GROUP /begin FUNCTION_LIST /end FUNCTION_LIST /begin REF_CHARACTERISTIC /end REF_CHARACTERISTIC /begin REF_MEASUREMENT DiagMgr9.SystemState.Mode /end REF_MEASUREMENT /end GROUP
/begin GROUP DiagMgr9.VehSpd.Kph_f32 "MICROSAR RTE" /begin SUB_GROUP /end SUB_GROUP /begin FUNCTION_LIST /end FUNCTION_LIST /begin REF_CHARACTERISTIC /end REF_CHARACTERISTIC /begin REF_MEASUREMENT DiagMgr9.VehSpd.Kph_f32 /end REF_MEASUREMENT /end GROUP
/begin GROUP DigPhsReasDiag "MICROSAR RTE"
 /begin SUB_GROUP DigPhsReasDiag.ModeRequirePorts DigPhsReasDiag.ReceiverPorts /end SUB_GROUP
 /begin FUNCTION_LIST /end FUNCTION_LIST
 /begin REF_CHARACTERISTIC /end REF_CHARACTERISTIC
 /begin REF_MEASUREMENT /end REF_MEASUREMENT
/end GROUP
/begin GROUP DigPhsReasDiag.ExpectedOnTimeA.Cnt_u32 "MICROSAR RTE" /begin SUB_GROUP /end SUB_GROUP /begin FUNCTION_LIST /end FUNCTION_LIST /begin REF_CHARACTERISTIC /end REF_CHARACTERISTIC /begin REF_MEASUREMENT DigPhsReasDiag.ExpectedOnTimeA.Cnt_u32 /end REF_MEASUREMENT /end GROUP
/begin GROUP DigPhsReasDiag.ExpectedOnTimeB.Cnt_u32 "MICROSAR RTE" /begin SUB_GROUP /end SUB_GROUP /begin FUNCTION_LIST /end FUNCTION_LIST /begin REF_CHARACTERISTIC /end REF_CHARACTERISTIC /begin REF_MEASUREMENT DigPhsReasDiag.ExpectedOnTimeB.Cnt_u32 /end REF_MEASUREMENT /end GROUP
/begin GROUP DigPhsReasDiag.ExpectedOnTimeC.Cnt_u32 "MICROSAR RTE" /begin SUB_GROUP /end SUB_GROUP /begin FUNCTION_LIST /end FUNCTION_LIST /begin REF_CHARACTERISTIC /end REF_CHARACTERISTIC /begin REF_MEASUREMENT DigPhsReasDiag.ExpectedOnTimeC.Cnt_u32 /end REF_MEASUREMENT /end GROUP
/begin GROUP DigPhsReasDiag.LRPRCorrectedMtrPosCaptured.Rev_f32 "MICROSAR RTE" /begin SUB_GROUP /end SUB_GROUP /begin FUNCTION_LIST /end FUNCTION_LIST /begin REF_CHARACTERISTIC /end REF_CHARACTERISTIC /begin REF_MEASUREMENT DigPhsReasDiag.LRPRCorrectedMtrPosCaptured.Rev_f32 /end REF_MEASUREMENT /end GROUP
/begin GROUP DigPhsReasDiag.LRPRModulationIndexCaptured.Uls_f32 "MICROSAR RTE" /begin SUB_GROUP /end SUB_GROUP /begin FUNCTION_LIST /end FUNCTION_LIST /begin REF_CHARACTERISTIC /end REF_CHARACTERISTIC /begin REF_MEASUREMENT DigPhsReasDiag.LRPRModulationIndexCaptured.Uls_f32 /end REF_MEASUREMENT /end GROUP
/begin GROUP DigPhsReasDiag.LRPRPhaseadvanceCaptured.Cnt_s16 "MICROSAR RTE" /begin SUB_GROUP /end SUB_GROUP /begin FUNCTION_LIST /end FUNCTION_LIST /begin REF_CHARACTERISTIC /end REF_CHARACTERISTIC /begin REF_MEASUREMENT DigPhsReasDiag.LRPRPhaseadvanceCaptured.Cnt_s16 /end REF_MEASUREMENT /end GROUP
/begin GROUP DigPhsReasDiag.MeasuredOnTimeA.Cnt_u32 "MICROSAR RTE" /begin SUB_GROUP /end SUB_GROUP /begin FUNCTION_LIST /end FUNCTION_LIST /begin REF_CHARACTERISTIC /end REF_CHARACTERISTIC /begin REF_MEASUREMENT DigPhsReasDiag.MeasuredOnTimeA.Cnt_u32 /end REF_MEASUREMENT /end GROUP
/begin GROUP DigPhsReasDiag.MeasuredOnTimeB.Cnt_u32 "MICROSAR RTE" /begin SUB_GROUP /end SUB_GROUP /begin FUNCTION_LIST /end FUNCTION_LIST /begin REF_CHARACTERISTIC /end REF_CHARACTERISTIC /begin REF_MEASUREMENT DigPhsReasDiag.MeasuredOnTimeB.Cnt_u32 /end REF_MEASUREMENT /end GROUP
/begin GROUP DigPhsReasDiag.MeasuredOnTimeC.Cnt_u32 "MICROSAR RTE" /begin SUB_GROUP /end SUB_GROUP /begin FUNCTION_LIST /end FUNCTION_LIST /begin REF_CHARACTERISTIC /end REF_CHARACTERISTIC /begin REF_MEASUREMENT DigPhsReasDiag.MeasuredOnTimeC.Cnt_u32 /end REF_MEASUREMENT /end GROUP
/begin GROUP DigPhsReasDiag.ModeRequirePorts "MICROSAR RTE" /begin SUB_GROUP DigPhsReasDiag.SystemState.Mode /end SUB_GROUP /begin FUNCTION_LIST /end FUNCTION_LIST /begin REF_CHARACTERISTIC /end REF_CHARACTERISTIC /begin REF_MEASUREMENT /end REF_MEASUREMENT /end GROUP
/begin GROUP DigPhsReasDiag.MotorVelMRFUnfiltered.MtrRadpS_f32 "MICROSAR RTE" /begin SUB_GROUP /end SUB_GROUP /begin FUNCTION_LIST /end FUNCTION_LIST /begin REF_CHARACTERISTIC /end REF_CHARACTERISTIC /begin REF_MEASUREMENT DigPhsReasDiag.MotorVelMRFUnfiltered.MtrRadpS_f32 /end REF_MEASUREMENT /end GROUP
/begin GROUP DigPhsReasDiag.MtrElecMechPolarity.Cnt_s08 "MICROSAR RTE" /begin SUB_GROUP /end SUB_GROUP /begin FUNCTION_LIST /end FUNCTION_LIST /begin REF_CHARACTERISTIC /end REF_CHARACTERISTIC /begin REF_MEASUREMENT DigPhsReasDiag.MtrElecMechPolarity.Cnt_s08 /end REF_MEASUREMENT /end GROUP
/begin GROUP DigPhsReasDiag.PDActivateTest.Cnt_lgc "MICROSAR RTE" /begin SUB_GROUP /end SUB_GROUP /begin FUNCTION_LIST /end FUNCTION_LIST /begin REF_CHARACTERISTIC /end REF_CHARACTERISTIC /begin REF_MEASUREMENT DigPhsReasDiag.PDActivateTest.Cnt_lgc /end REF_MEASUREMENT /end GROUP
/begin GROUP DigPhsReasDiag.ReceiverPorts "MICROSAR RTE"
 /begin SUB_GROUP DigPhsReasDiag.ExpectedOnTimeA.Cnt_u32 DigPhsReasDiag.ExpectedOnTimeB.Cnt_u32 DigPhsReasDiag.ExpectedOnTimeC.Cnt_u32 DigPhsReasDiag.LRPRCorrectedMtrPosCaptured.Rev_f32 DigPhsReasDiag.LRPRModulationIndexCaptured.Uls_f32 DigPhsReasDiag.LRPRPhaseadvanceCaptured.Cnt_s16 DigPhsReasDiag.MeasuredOnTimeA.Cnt_u32 DigPhsReasDiag.MeasuredOnTimeB.Cnt_u32 DigPhsReasDiag.MeasuredOnTimeC.Cnt_u32 DigPhsReasDiag.MotorVelMRFUnfiltered.MtrRadpS_f32 DigPhsReasDiag.MtrElecMechPolarity.Cnt_s08 DigPhsReasDiag.PDActivateTest.Cnt_lgc /end SUB_GROUP
 /begin FUNCTION_LIST /end FUNCTION_LIST
 /begin REF_CHARACTERISTIC /end REF_CHARACTERISTIC
 /begin REF_MEASUREMENT /end REF_MEASUREMENT
/end GROUP
/begin GROUP DigPhsReasDiag.SystemState.Mode "MICROSAR RTE" /begin SUB_GROUP /end SUB_GROUP /begin FUNCTION_LIST /end FUNCTION_LIST /begin REF_CHARACTERISTIC /end REF_CHARACTERISTIC /begin REF_MEASUREMENT DigPhsReasDiag.SystemState.Mode /end REF_MEASUREMENT /end GROUP
/begin GROUP DrvDynCtrl "MICROSAR RTE" /begin SUB_GROUP DrvDynCtrl.ReceiverPorts DrvDynCtrl.SenderPorts /end SUB_GROUP /begin FUNCTION_LIST /end FUNCTION_LIST /begin REF_CHARACTERISTIC /end REF_CHARACTERISTIC /begin REF_MEASUREMENT /end REF_MEASUREMENT /end GROUP
/begin GROUP DrvDynCtrl.AssistDDFactor.Uls_f32 "MICROSAR RTE" /begin SUB_GROUP /end SUB_GROUP /begin FUNCTION_LIST /end FUNCTION_LIST /begin REF_CHARACTERISTIC /end REF_CHARACTERISTIC /begin REF_MEASUREMENT DrvDynCtrl.AssistDDFactor.Uls_f32 /end REF_MEASUREMENT /end GROUP
/begin GROUP DrvDynCtrl.DDAstFactRqst.Uls_f32 "MICROSAR RTE" /begin SUB_GROUP /end SUB_GROUP /begin FUNCTION_LIST /end FUNCTION_LIST /begin REF_CHARACTERISTIC /end REF_CHARACTERISTIC /begin REF_MEASUREMENT DrvDynCtrl.DDAstFactRqst.Uls_f32 /end REF_MEASUREMENT /end GROUP
/begin GROUP DrvDynCtrl.DDDmpFactRqst.Uls_f32 "MICROSAR RTE" /begin SUB_GROUP /end SUB_GROUP /begin FUNCTION_LIST /end FUNCTION_LIST /begin REF_CHARACTERISTIC /end REF_CHARACTERISTIC /begin REF_MEASUREMENT DrvDynCtrl.DDDmpFactRqst.Uls_f32 /end REF_MEASUREMENT /end GROUP
/begin GROUP DrvDynCtrl.DDRtnFactRqst.Uls_f32 "MICROSAR RTE" /begin SUB_GROUP /end SUB_GROUP /begin FUNCTION_LIST /end FUNCTION_LIST /begin REF_CHARACTERISTIC /end REF_CHARACTERISTIC /begin REF_MEASUREMENT DrvDynCtrl.DDRtnFactRqst.Uls_f32 /end REF_MEASUREMENT /end GROUP
/begin GROUP DrvDynCtrl.DampingDDFactor.Uls_f32 "MICROSAR RTE" /begin SUB_GROUP /end SUB_GROUP /begin FUNCTION_LIST /end FUNCTION_LIST /begin REF_CHARACTERISTIC /end REF_CHARACTERISTIC /begin REF_MEASUREMENT DrvDynCtrl.DampingDDFactor.Uls_f32 /end REF_MEASUREMENT /end GROUP
/begin GROUP DrvDynCtrl.DrvDynActive.Cnt_lgc "MICROSAR RTE" /begin SUB_GROUP /end SUB_GROUP /begin FUNCTION_LIST /end FUNCTION_LIST /begin REF_CHARACTERISTIC /end REF_CHARACTERISTIC /begin REF_MEASUREMENT DrvDynCtrl.DrvDynActive.Cnt_lgc /end REF_MEASUREMENT /end GROUP
/begin GROUP DrvDynCtrl.HwTrq.HwNm_f32 "MICROSAR RTE" /begin SUB_GROUP /end SUB_GROUP /begin FUNCTION_LIST /end FUNCTION_LIST /begin REF_CHARACTERISTIC /end REF_CHARACTERISTIC /begin REF_MEASUREMENT DrvDynCtrl.HwTrq.HwNm_f32 /end REF_MEASUREMENT /end GROUP
/begin GROUP DrvDynCtrl.MtrVelCRF.MtrRadpS_f32 "MICROSAR RTE" /begin SUB_GROUP /end SUB_GROUP /begin FUNCTION_LIST /end FUNCTION_LIST /begin REF_CHARACTERISTIC /end REF_CHARACTERISTIC /begin REF_MEASUREMENT DrvDynCtrl.MtrVelCRF.MtrRadpS_f32 /end REF_MEASUREMENT /end GROUP
/begin GROUP DrvDynCtrl.ReceiverPorts "MICROSAR RTE"
 /begin SUB_GROUP DrvDynCtrl.DDAstFactRqst.Uls_f32 DrvDynCtrl.DDDmpFactRqst.Uls_f32 DrvDynCtrl.DDRtnFactRqst.Uls_f32 DrvDynCtrl.DrvDynActive.Cnt_lgc DrvDynCtrl.HwTrq.HwNm_f32 DrvDynCtrl.MtrVelCRF.MtrRadpS_f32 DrvDynCtrl.VehSpd.Kph_f32 /end SUB_GROUP
 /begin FUNCTION_LIST /end FUNCTION_LIST
 /begin REF_CHARACTERISTIC /end REF_CHARACTERISTIC
 /begin REF_MEASUREMENT /end REF_MEASUREMENT
/end GROUP
/begin GROUP DrvDynCtrl.ReturnDDFactor.Uls_f32 "MICROSAR RTE" /begin SUB_GROUP /end SUB_GROUP /begin FUNCTION_LIST /end FUNCTION_LIST /begin REF_CHARACTERISTIC /end REF_CHARACTERISTIC /begin REF_MEASUREMENT DrvDynCtrl.ReturnDDFactor.Uls_f32 /end REF_MEASUREMENT /end GROUP
/begin GROUP DrvDynCtrl.SenderPorts "MICROSAR RTE"
 /begin SUB_GROUP DrvDynCtrl.AssistDDFactor.Uls_f32 DrvDynCtrl.DampingDDFactor.Uls_f32 DrvDynCtrl.ReturnDDFactor.Uls_f32 /end SUB_GROUP
 /begin FUNCTION_LIST /end FUNCTION_LIST
 /begin REF_CHARACTERISTIC /end REF_CHARACTERISTIC
 /begin REF_MEASUREMENT /end REF_MEASUREMENT
/end GROUP
/begin GROUP DrvDynCtrl.VehSpd.Kph_f32 "MICROSAR RTE" /begin SUB_GROUP /end SUB_GROUP /begin FUNCTION_LIST /end FUNCTION_LIST /begin REF_CHARACTERISTIC /end REF_CHARACTERISTIC /begin REF_MEASUREMENT DrvDynCtrl.VehSpd.Kph_f32 /end REF_MEASUREMENT /end GROUP
/begin GROUP DrvDynamicsEnable "MICROSAR RTE"
 /begin SUB_GROUP DrvDynamicsEnable.ModeRequirePorts DrvDynamicsEnable.ReceiverPorts DrvDynamicsEnable.SenderPorts /end SUB_GROUP
 /begin FUNCTION_LIST /end FUNCTION_LIST
 /begin REF_CHARACTERISTIC /end REF_CHARACTERISTIC
 /begin REF_MEASUREMENT /end REF_MEASUREMENT
/end GROUP
/begin GROUP DrvDynamicsEnable.DDEnableRqst.Cnt_lgc "MICROSAR RTE" /begin SUB_GROUP /end SUB_GROUP /begin FUNCTION_LIST /end FUNCTION_LIST /begin REF_CHARACTERISTIC /end REF_CHARACTERISTIC /begin REF_MEASUREMENT DrvDynamicsEnable.DDEnableRqst.Cnt_lgc /end REF_MEASUREMENT /end GROUP
/begin GROUP DrvDynamicsEnable.DDErrInterfaceActive.Cnt_lgc "MICROSAR RTE" /begin SUB_GROUP /end SUB_GROUP /begin FUNCTION_LIST /end FUNCTION_LIST /begin REF_CHARACTERISTIC /end REF_CHARACTERISTIC /begin REF_MEASUREMENT DrvDynamicsEnable.DDErrInterfaceActive.Cnt_lgc /end REF_MEASUREMENT /end GROUP
/begin GROUP DrvDynamicsEnable.DiagStatus.Cnt_lgc "MICROSAR RTE" /begin SUB_GROUP /end SUB_GROUP /begin FUNCTION_LIST /end FUNCTION_LIST /begin REF_CHARACTERISTIC /end REF_CHARACTERISTIC /begin REF_MEASUREMENT DrvDynamicsEnable.DiagStatus.Cnt_lgc /end REF_MEASUREMENT /end GROUP
/begin GROUP DrvDynamicsEnable.DrvDynActive.Cnt_lgc "MICROSAR RTE" /begin SUB_GROUP /end SUB_GROUP /begin FUNCTION_LIST /end FUNCTION_LIST /begin REF_CHARACTERISTIC /end REF_CHARACTERISTIC /begin REF_MEASUREMENT DrvDynamicsEnable.DrvDynActive.Cnt_lgc /end REF_MEASUREMENT /end GROUP
/begin GROUP DrvDynamicsEnable.DrvDynInterfaceState.Cnt_u08 "MICROSAR RTE" /begin SUB_GROUP /end SUB_GROUP /begin FUNCTION_LIST /end FUNCTION_LIST /begin REF_CHARACTERISTIC /end REF_CHARACTERISTIC /begin REF_MEASUREMENT DrvDynamicsEnable.DrvDynInterfaceState.Cnt_u08 /end REF_MEASUREMENT /end GROUP
/begin GROUP DrvDynamicsEnable.ModeRequirePorts "MICROSAR RTE" /begin SUB_GROUP DrvDynamicsEnable.SystemState.Mode /end SUB_GROUP /begin FUNCTION_LIST /end FUNCTION_LIST /begin REF_CHARACTERISTIC /end REF_CHARACTERISTIC /begin REF_MEASUREMENT /end REF_MEASUREMENT /end GROUP
/begin GROUP DrvDynamicsEnable.OpTrqOvRmpInEnable.Cnt_lgc "MICROSAR RTE" /begin SUB_GROUP /end SUB_GROUP /begin FUNCTION_LIST /end FUNCTION_LIST /begin REF_CHARACTERISTIC /end REF_CHARACTERISTIC /begin REF_MEASUREMENT DrvDynamicsEnable.OpTrqOvRmpInEnable.Cnt_lgc /end REF_MEASUREMENT /end GROUP
/begin GROUP DrvDynamicsEnable.PrkAssistState.Cnt_u08 "MICROSAR RTE" /begin SUB_GROUP /end SUB_GROUP /begin FUNCTION_LIST /end FUNCTION_LIST /begin REF_CHARACTERISTIC /end REF_CHARACTERISTIC /begin REF_MEASUREMENT DrvDynamicsEnable.PrkAssistState.Cnt_u08 /end REF_MEASUREMENT /end GROUP
/begin GROUP DrvDynamicsEnable.ReceiverPorts "MICROSAR RTE"
 /begin SUB_GROUP DrvDynamicsEnable.DDEnableRqst.Cnt_lgc DrvDynamicsEnable.DDErrInterfaceActive.Cnt_lgc DrvDynamicsEnable.DiagStatus.Cnt_lgc DrvDynamicsEnable.PrkAssistState.Cnt_u08 /end SUB_GROUP
 /begin FUNCTION_LIST /end FUNCTION_LIST
 /begin REF_CHARACTERISTIC /end REF_CHARACTERISTIC
 /begin REF_MEASUREMENT /end REF_MEASUREMENT
/end GROUP
/begin GROUP DrvDynamicsEnable.SenderPorts "MICROSAR RTE"
 /begin SUB_GROUP DrvDynamicsEnable.DrvDynActive.Cnt_lgc DrvDynamicsEnable.DrvDynInterfaceState.Cnt_u08 DrvDynamicsEnable.OpTrqOvRmpInEnable.Cnt_lgc /end SUB_GROUP
 /begin FUNCTION_LIST /end FUNCTION_LIST
 /begin REF_CHARACTERISTIC /end REF_CHARACTERISTIC
 /begin REF_MEASUREMENT /end REF_MEASUREMENT
/end GROUP
/begin GROUP DrvDynamicsEnable.SystemState.Mode "MICROSAR RTE" /begin SUB_GROUP /end SUB_GROUP /begin FUNCTION_LIST /end FUNCTION_LIST /begin REF_CHARACTERISTIC /end REF_CHARACTERISTIC /begin REF_MEASUREMENT DrvDynamicsEnable.SystemState.Mode /end REF_MEASUREMENT /end GROUP
/begin GROUP EOTActuatorMng "MICROSAR RTE" /begin SUB_GROUP EOTActuatorMng.ReceiverPorts EOTActuatorMng.SenderPorts /end SUB_GROUP /begin FUNCTION_LIST /end FUNCTION_LIST /begin REF_CHARACTERISTIC /end REF_CHARACTERISTIC /begin REF_MEASUREMENT /end REF_MEASUREMENT /end GROUP
/begin GROUP EOTActuatorMng.AssistEOTDamping.MtrNm_f32 "MICROSAR RTE" /begin SUB_GROUP /end SUB_GROUP /begin FUNCTION_LIST /end FUNCTION_LIST /begin REF_CHARACTERISTIC /end REF_CHARACTERISTIC /begin REF_MEASUREMENT EOTActuatorMng.AssistEOTDamping.MtrNm_f32 /end REF_MEASUREMENT /end GROUP
/begin GROUP EOTActuatorMng.AssistEOTGain.Uls_f32 "MICROSAR RTE" /begin SUB_GROUP /end SUB_GROUP /begin FUNCTION_LIST /end FUNCTION_LIST /begin REF_CHARACTERISTIC /end REF_CHARACTERISTIC /begin REF_MEASUREMENT EOTActuatorMng.AssistEOTGain.Uls_f32 /end REF_MEASUREMENT /end GROUP
/begin GROUP EOTActuatorMng.AssistEOTLimit.MtrNm_f32 "MICROSAR RTE" /begin SUB_GROUP /end SUB_GROUP /begin FUNCTION_LIST /end FUNCTION_LIST /begin REF_CHARACTERISTIC /end REF_CHARACTERISTIC /begin REF_MEASUREMENT EOTActuatorMng.AssistEOTLimit.MtrNm_f32 /end REF_MEASUREMENT /end GROUP
/begin GROUP EOTActuatorMng.CcwEOT.HwDeg_f32 "MICROSAR RTE" /begin SUB_GROUP /end SUB_GROUP /begin FUNCTION_LIST /end FUNCTION_LIST /begin REF_CHARACTERISTIC /end REF_CHARACTERISTIC /begin REF_MEASUREMENT EOTActuatorMng.CcwEOT.HwDeg_f32 /end REF_MEASUREMENT /end GROUP
/begin GROUP EOTActuatorMng.CcwFound.Cnt_lgc "MICROSAR RTE" /begin SUB_GROUP /end SUB_GROUP /begin FUNCTION_LIST /end FUNCTION_LIST /begin REF_CHARACTERISTIC /end REF_CHARACTERISTIC /begin REF_MEASUREMENT EOTActuatorMng.CcwFound.Cnt_lgc /end REF_MEASUREMENT /end GROUP
/begin GROUP EOTActuatorMng.CwEOT.HwDeg_f32 "MICROSAR RTE" /begin SUB_GROUP /end SUB_GROUP /begin FUNCTION_LIST /end FUNCTION_LIST /begin REF_CHARACTERISTIC /end REF_CHARACTERISTIC /begin REF_MEASUREMENT EOTActuatorMng.CwEOT.HwDeg_f32 /end REF_MEASUREMENT /end GROUP
/begin GROUP EOTActuatorMng.CwFound.Cnt_lgc "MICROSAR RTE" /begin SUB_GROUP /end SUB_GROUP /begin FUNCTION_LIST /end FUNCTION_LIST /begin REF_CHARACTERISTIC /end REF_CHARACTERISTIC /begin REF_MEASUREMENT EOTActuatorMng.CwFound.Cnt_lgc /end REF_MEASUREMENT /end GROUP
/begin GROUP EOTActuatorMng.EOTDisable.Cnt_lgc "MICROSAR RTE" /begin SUB_GROUP /end SUB_GROUP /begin FUNCTION_LIST /end FUNCTION_LIST /begin REF_CHARACTERISTIC /end REF_CHARACTERISTIC /begin REF_MEASUREMENT EOTActuatorMng.EOTDisable.Cnt_lgc /end REF_MEASUREMENT /end GROUP
/begin GROUP EOTActuatorMng.HandWheelAuth.Uls_f32 "MICROSAR RTE" /begin SUB_GROUP /end SUB_GROUP /begin FUNCTION_LIST /end FUNCTION_LIST /begin REF_CHARACTERISTIC /end REF_CHARACTERISTIC /begin REF_MEASUREMENT EOTActuatorMng.HandWheelAuth.Uls_f32 /end REF_MEASUREMENT /end GROUP
/begin GROUP EOTActuatorMng.HandWheelPos.HwDeg_f32 "MICROSAR RTE" /begin SUB_GROUP /end SUB_GROUP /begin FUNCTION_LIST /end FUNCTION_LIST /begin REF_CHARACTERISTIC /end REF_CHARACTERISTIC /begin REF_MEASUREMENT EOTActuatorMng.HandWheelPos.HwDeg_f32 /end REF_MEASUREMENT /end GROUP
/begin GROUP EOTActuatorMng.HwTorque.HwNm_f32 "MICROSAR RTE" /begin SUB_GROUP /end SUB_GROUP /begin FUNCTION_LIST /end FUNCTION_LIST /begin REF_CHARACTERISTIC /end REF_CHARACTERISTIC /begin REF_MEASUREMENT EOTActuatorMng.HwTorque.HwNm_f32 /end REF_MEASUREMENT /end GROUP
/begin GROUP EOTActuatorMng.MotorVel.MtrRadpS_f32 "MICROSAR RTE" /begin SUB_GROUP /end SUB_GROUP /begin FUNCTION_LIST /end FUNCTION_LIST /begin REF_CHARACTERISTIC /end REF_CHARACTERISTIC /begin REF_MEASUREMENT EOTActuatorMng.MotorVel.MtrRadpS_f32 /end REF_MEASUREMENT /end GROUP
/begin GROUP EOTActuatorMng.OutputRampMultLtd.Uls_f32 "MICROSAR RTE" /begin SUB_GROUP /end SUB_GROUP /begin FUNCTION_LIST /end FUNCTION_LIST /begin REF_CHARACTERISTIC /end REF_CHARACTERISTIC /begin REF_MEASUREMENT EOTActuatorMng.OutputRampMultLtd.Uls_f32 /end REF_MEASUREMENT /end GROUP
/begin GROUP EOTActuatorMng.PreLimitTorque.MtrNm_f32 "MICROSAR RTE" /begin SUB_GROUP /end SUB_GROUP /begin FUNCTION_LIST /end FUNCTION_LIST /begin REF_CHARACTERISTIC /end REF_CHARACTERISTIC /begin REF_MEASUREMENT EOTActuatorMng.PreLimitTorque.MtrNm_f32 /end REF_MEASUREMENT /end GROUP
/begin GROUP EOTActuatorMng.ReceiverPorts "MICROSAR RTE"
 /begin SUB_GROUP EOTActuatorMng.CcwEOT.HwDeg_f32 EOTActuatorMng.CcwFound.Cnt_lgc EOTActuatorMng.CwEOT.HwDeg_f32 EOTActuatorMng.CwFound.Cnt_lgc EOTActuatorMng.EOTDisable.Cnt_lgc EOTActuatorMng.HandWheelAuth.Uls_f32 EOTActuatorMng.HandWheelPos.HwDeg_f32 EOTActuatorMng.HwTorque.HwNm_f32 EOTActuatorMng.MotorVel.MtrRadpS_f32 EOTActuatorMng.OutputRampMultLtd.Uls_f32 EOTActuatorMng.PreLimitTorque.MtrNm_f32 EOTActuatorMng.VehicleSpeed.Kph_f32 /end SUB_GROUP
 /begin FUNCTION_LIST /end FUNCTION_LIST
 /begin REF_CHARACTERISTIC /end REF_CHARACTERISTIC
 /begin REF_MEASUREMENT /end REF_MEASUREMENT
/end GROUP
/begin GROUP EOTActuatorMng.SenderPorts "MICROSAR RTE"
 /begin SUB_GROUP EOTActuatorMng.AssistEOTDamping.MtrNm_f32 EOTActuatorMng.AssistEOTGain.Uls_f32 EOTActuatorMng.AssistEOTLimit.MtrNm_f32 /end SUB_GROUP
 /begin FUNCTION_LIST /end FUNCTION_LIST
 /begin REF_CHARACTERISTIC /end REF_CHARACTERISTIC
 /begin REF_MEASUREMENT /end REF_MEASUREMENT
/end GROUP
/begin GROUP EOTActuatorMng.VehicleSpeed.Kph_f32 "MICROSAR RTE" /begin SUB_GROUP /end SUB_GROUP /begin FUNCTION_LIST /end FUNCTION_LIST /begin REF_CHARACTERISTIC /end REF_CHARACTERISTIC /begin REF_MEASUREMENT EOTActuatorMng.VehicleSpeed.Kph_f32 /end REF_MEASUREMENT /end GROUP
/begin GROUP EcuM "MICROSAR RTE" /begin SUB_GROUP EcuM.ModeProvidePorts /end SUB_GROUP /begin FUNCTION_LIST /end FUNCTION_LIST /begin REF_CHARACTERISTIC /end REF_CHARACTERISTIC /begin REF_MEASUREMENT /end REF_MEASUREMENT /end GROUP
/begin GROUP EcuM.ModeProvidePorts "MICROSAR RTE" /begin SUB_GROUP EcuM.currentMode.currentMode /end SUB_GROUP /begin FUNCTION_LIST /end FUNCTION_LIST /begin REF_CHARACTERISTIC /end REF_CHARACTERISTIC /begin REF_MEASUREMENT /end REF_MEASUREMENT /end GROUP
/begin GROUP EcuM.currentMode.currentMode "MICROSAR RTE" /begin SUB_GROUP /end SUB_GROUP /begin FUNCTION_LIST /end FUNCTION_LIST /begin REF_CHARACTERISTIC /end REF_CHARACTERISTIC /begin REF_MEASUREMENT EcuM.currentMode.currentMode /end REF_MEASUREMENT /end GROUP
/begin GROUP ElecPwr "MICROSAR RTE" /begin SUB_GROUP ElecPwr.ReceiverPorts ElecPwr.SenderPorts /end SUB_GROUP /begin FUNCTION_LIST /end FUNCTION_LIST /begin REF_CHARACTERISTIC /end REF_CHARACTERISTIC /begin REF_MEASUREMENT /end REF_MEASUREMENT /end GROUP
/begin GROUP ElecPwr.ElecPower.Watts_f32 "MICROSAR RTE" /begin SUB_GROUP /end SUB_GROUP /begin FUNCTION_LIST /end FUNCTION_LIST /begin REF_CHARACTERISTIC /end REF_CHARACTERISTIC /begin REF_MEASUREMENT ElecPwr.ElecPower.Watts_f32 /end REF_MEASUREMENT /end GROUP
/begin GROUP ElecPwr.EstR.Ohm_f32 "MICROSAR RTE" /begin SUB_GROUP /end SUB_GROUP /begin FUNCTION_LIST /end FUNCTION_LIST /begin REF_CHARACTERISTIC /end REF_CHARACTERISTIC /begin REF_MEASUREMENT ElecPwr.EstR.Ohm_f32 /end REF_MEASUREMENT /end GROUP
/begin GROUP ElecPwr.ModIdx.Uls_f32 "MICROSAR RTE" /begin SUB_GROUP /end SUB_GROUP /begin FUNCTION_LIST /end FUNCTION_LIST /begin REF_CHARACTERISTIC /end REF_CHARACTERISTIC /begin REF_MEASUREMENT ElecPwr.ModIdx.Uls_f32 /end REF_MEASUREMENT /end GROUP
/begin GROUP ElecPwr.ReceiverPorts "MICROSAR RTE"
 /begin SUB_GROUP ElecPwr.EstR.Ohm_f32 ElecPwr.ModIdx.Uls_f32 ElecPwr.TermA.Volt_f32 ElecPwr.TermXq.Uls_f32 ElecPwr.TermZ.Uls_f32 ElecPwr.UncorrPhsAdv.Cnt_s16 ElecPwr.Vecu.Volt_f32 /end SUB_GROUP
 /begin FUNCTION_LIST /end FUNCTION_LIST
 /begin REF_CHARACTERISTIC /end REF_CHARACTERISTIC
 /begin REF_MEASUREMENT /end REF_MEASUREMENT
/end GROUP
/begin GROUP ElecPwr.SenderPorts "MICROSAR RTE" /begin SUB_GROUP ElecPwr.ElecPower.Watts_f32 ElecPwr.SupplyCur.Amp_f32 /end SUB_GROUP /begin FUNCTION_LIST /end FUNCTION_LIST /begin REF_CHARACTERISTIC /end REF_CHARACTERISTIC /begin REF_MEASUREMENT /end REF_MEASUREMENT /end GROUP
/begin GROUP ElecPwr.SupplyCur.Amp_f32 "MICROSAR RTE" /begin SUB_GROUP /end SUB_GROUP /begin FUNCTION_LIST /end FUNCTION_LIST /begin REF_CHARACTERISTIC /end REF_CHARACTERISTIC /begin REF_MEASUREMENT ElecPwr.SupplyCur.Amp_f32 /end REF_MEASUREMENT /end GROUP
/begin GROUP ElecPwr.TermA.Volt_f32 "MICROSAR RTE" /begin SUB_GROUP /end SUB_GROUP /begin FUNCTION_LIST /end FUNCTION_LIST /begin REF_CHARACTERISTIC /end REF_CHARACTERISTIC /begin REF_MEASUREMENT ElecPwr.TermA.Volt_f32 /end REF_MEASUREMENT /end GROUP
/begin GROUP ElecPwr.TermXq.Uls_f32 "MICROSAR RTE" /begin SUB_GROUP /end SUB_GROUP /begin FUNCTION_LIST /end FUNCTION_LIST /begin REF_CHARACTERISTIC /end REF_CHARACTERISTIC /begin REF_MEASUREMENT ElecPwr.TermXq.Uls_f32 /end REF_MEASUREMENT /end GROUP
/begin GROUP ElecPwr.TermZ.Uls_f32 "MICROSAR RTE" /begin SUB_GROUP /end SUB_GROUP /begin FUNCTION_LIST /end FUNCTION_LIST /begin REF_CHARACTERISTIC /end REF_CHARACTERISTIC /begin REF_MEASUREMENT ElecPwr.TermZ.Uls_f32 /end REF_MEASUREMENT /end GROUP
/begin GROUP ElecPwr.UncorrPhsAdv.Cnt_s16 "MICROSAR RTE" /begin SUB_GROUP /end SUB_GROUP /begin FUNCTION_LIST /end FUNCTION_LIST /begin REF_CHARACTERISTIC /end REF_CHARACTERISTIC /begin REF_MEASUREMENT ElecPwr.UncorrPhsAdv.Cnt_s16 /end REF_MEASUREMENT /end GROUP
/begin GROUP ElecPwr.Vecu.Volt_f32 "MICROSAR RTE" /begin SUB_GROUP /end SUB_GROUP /begin FUNCTION_LIST /end FUNCTION_LIST /begin REF_CHARACTERISTIC /end REF_CHARACTERISTIC /begin REF_MEASUREMENT ElecPwr.Vecu.Volt_f32 /end REF_MEASUREMENT /end GROUP
/begin GROUP EtDmpFw "MICROSAR RTE" /begin SUB_GROUP EtDmpFw.ReceiverPorts EtDmpFw.SenderPorts /end SUB_GROUP /begin FUNCTION_LIST /end FUNCTION_LIST /begin REF_CHARACTERISTIC /end REF_CHARACTERISTIC /begin REF_MEASUREMENT /end REF_MEASUREMENT /end GROUP
/begin GROUP EtDmpFw.AssistEOTDamping.MtrNm_f32 "MICROSAR RTE" /begin SUB_GROUP /end SUB_GROUP /begin FUNCTION_LIST /end FUNCTION_LIST /begin REF_CHARACTERISTIC /end REF_CHARACTERISTIC /begin REF_MEASUREMENT EtDmpFw.AssistEOTDamping.MtrNm_f32 /end REF_MEASUREMENT /end GROUP
/begin GROUP EtDmpFw.CRFMtrVel.MtrRadpS_f32 "MICROSAR RTE" /begin SUB_GROUP /end SUB_GROUP /begin FUNCTION_LIST /end FUNCTION_LIST /begin REF_CHARACTERISTIC /end REF_CHARACTERISTIC /begin REF_MEASUREMENT EtDmpFw.CRFMtrVel.MtrRadpS_f32 /end REF_MEASUREMENT /end GROUP
/begin GROUP EtDmpFw.EOTDampingLtd.MtrNm_f32 "MICROSAR RTE" /begin SUB_GROUP /end SUB_GROUP /begin FUNCTION_LIST /end FUNCTION_LIST /begin REF_CHARACTERISTIC /end REF_CHARACTERISTIC /begin REF_MEASUREMENT EtDmpFw.EOTDampingLtd.MtrNm_f32 /end REF_MEASUREMENT /end GROUP
/begin GROUP EtDmpFw.EOTDisable.Cnt_lgc "MICROSAR RTE" /begin SUB_GROUP /end SUB_GROUP /begin FUNCTION_LIST /end FUNCTION_LIST /begin REF_CHARACTERISTIC /end REF_CHARACTERISTIC /begin REF_MEASUREMENT EtDmpFw.EOTDisable.Cnt_lgc /end REF_MEASUREMENT /end GROUP
/begin GROUP EtDmpFw.HandwheelAuthority.Uls_f32 "MICROSAR RTE" /begin SUB_GROUP /end SUB_GROUP /begin FUNCTION_LIST /end FUNCTION_LIST /begin REF_CHARACTERISTIC /end REF_CHARACTERISTIC /begin REF_MEASUREMENT EtDmpFw.HandwheelAuthority.Uls_f32 /end REF_MEASUREMENT /end GROUP
/begin GROUP EtDmpFw.HandwheelPosition.HwDeg_f32 "MICROSAR RTE" /begin SUB_GROUP /end SUB_GROUP /begin FUNCTION_LIST /end FUNCTION_LIST /begin REF_CHARACTERISTIC /end REF_CHARACTERISTIC /begin REF_MEASUREMENT EtDmpFw.HandwheelPosition.HwDeg_f32 /end REF_MEASUREMENT /end GROUP
/begin GROUP EtDmpFw.MEC_Counter.Cnt_enum "MICROSAR RTE" /begin SUB_GROUP /end SUB_GROUP /begin FUNCTION_LIST /end FUNCTION_LIST /begin REF_CHARACTERISTIC /end REF_CHARACTERISTIC /begin REF_MEASUREMENT EtDmpFw.MEC_Counter.Cnt_enum /end REF_MEASUREMENT /end GROUP
/begin GROUP EtDmpFw.ReceiverPorts "MICROSAR RTE"
 /begin SUB_GROUP EtDmpFw.AssistEOTDamping.MtrNm_f32 EtDmpFw.CRFMtrVel.MtrRadpS_f32 EtDmpFw.EOTDisable.Cnt_lgc EtDmpFw.HandwheelAuthority.Uls_f32 EtDmpFw.HandwheelPosition.HwDeg_f32 EtDmpFw.MEC_Counter.Cnt_enum EtDmpFw.Vehicle_Speed.Kph_f32 /end SUB_GROUP
 /begin FUNCTION_LIST /end FUNCTION_LIST
 /begin REF_CHARACTERISTIC /end REF_CHARACTERISTIC
 /begin REF_MEASUREMENT /end REF_MEASUREMENT
/end GROUP
/begin GROUP EtDmpFw.SenderPorts "MICROSAR RTE" /begin SUB_GROUP EtDmpFw.EOTDampingLtd.MtrNm_f32 /end SUB_GROUP /begin FUNCTION_LIST /end FUNCTION_LIST /begin REF_CHARACTERISTIC /end REF_CHARACTERISTIC /begin REF_MEASUREMENT /end REF_MEASUREMENT /end GROUP
/begin GROUP EtDmpFw.Vehicle_Speed.Kph_f32 "MICROSAR RTE" /begin SUB_GROUP /end SUB_GROUP /begin FUNCTION_LIST /end FUNCTION_LIST /begin REF_CHARACTERISTIC /end REF_CHARACTERISTIC /begin REF_MEASUREMENT EtDmpFw.Vehicle_Speed.Kph_f32 /end REF_MEASUREMENT /end GROUP
/begin GROUP FltInjection "MICROSAR RTE" /begin SUB_GROUP FltInjection.ReceiverPorts /end SUB_GROUP /begin FUNCTION_LIST /end FUNCTION_LIST /begin REF_CHARACTERISTIC /end REF_CHARACTERISTIC /begin REF_MEASUREMENT /end REF_MEASUREMENT /end GROUP
/begin GROUP FltInjection.MotorVelCRF.MtrRadpS_f32 "MICROSAR RTE" /begin SUB_GROUP /end SUB_GROUP /begin FUNCTION_LIST /end FUNCTION_LIST /begin REF_CHARACTERISTIC /end REF_CHARACTERISTIC /begin REF_MEASUREMENT FltInjection.MotorVelCRF.MtrRadpS_f32 /end REF_MEASUREMENT /end GROUP
/begin GROUP FltInjection.ReceiverPorts "MICROSAR RTE" /begin SUB_GROUP FltInjection.MotorVelCRF.MtrRadpS_f32 /end SUB_GROUP /begin FUNCTION_LIST /end FUNCTION_LIST /begin REF_CHARACTERISTIC /end REF_CHARACTERISTIC /begin REF_MEASUREMENT /end REF_MEASUREMENT /end GROUP
/begin GROUP FrqDepDmpnInrtCmp "MICROSAR RTE"
 /begin SUB_GROUP FrqDepDmpnInrtCmp.ReceiverPorts FrqDepDmpnInrtCmp.SenderPorts /end SUB_GROUP
 /begin FUNCTION_LIST /end FUNCTION_LIST
 /begin REF_CHARACTERISTIC /end REF_CHARACTERISTIC
 /begin REF_MEASUREMENT /end REF_MEASUREMENT
/end GROUP
/begin GROUP FrqDepDmpnInrtCmp.BaseAssistCmd.MtrNm_f32 "MICROSAR RTE" /begin SUB_GROUP /end SUB_GROUP /begin FUNCTION_LIST /end FUNCTION_LIST /begin REF_CHARACTERISTIC /end REF_CHARACTERISTIC /begin REF_MEASUREMENT FrqDepDmpnInrtCmp.BaseAssistCmd.MtrNm_f32 /end REF_MEASUREMENT /end GROUP
/begin GROUP FrqDepDmpnInrtCmp.CRFMotorVel.MtrRadpS_f32 "MICROSAR RTE" /begin SUB_GROUP /end SUB_GROUP /begin FUNCTION_LIST /end FUNCTION_LIST /begin REF_CHARACTERISTIC /end REF_CHARACTERISTIC /begin REF_MEASUREMENT FrqDepDmpnInrtCmp.CRFMotorVel.MtrRadpS_f32 /end REF_MEASUREMENT /end GROUP
/begin GROUP FrqDepDmpnInrtCmp.FreqDepDmpSrlComSvcDft.Cnt_lgc "MICROSAR RTE" /begin SUB_GROUP /end SUB_GROUP /begin FUNCTION_LIST /end FUNCTION_LIST /begin REF_CHARACTERISTIC /end REF_CHARACTERISTIC /begin REF_MEASUREMENT FrqDepDmpnInrtCmp.FreqDepDmpSrlComSvcDft.Cnt_lgc /end REF_MEASUREMENT /end GROUP
/begin GROUP FrqDepDmpnInrtCmp.FrqDepDmpnInrtCmp.MtrNm_f32 "MICROSAR RTE" /begin SUB_GROUP /end SUB_GROUP /begin FUNCTION_LIST /end FUNCTION_LIST /begin REF_CHARACTERISTIC /end REF_CHARACTERISTIC /begin REF_MEASUREMENT FrqDepDmpnInrtCmp.FrqDepDmpnInrtCmp.MtrNm_f32 /end REF_MEASUREMENT /end GROUP
/begin GROUP FrqDepDmpnInrtCmp.HwTorque.HwNm_f32 "MICROSAR RTE" /begin SUB_GROUP /end SUB_GROUP /begin FUNCTION_LIST /end FUNCTION_LIST /begin REF_CHARACTERISTIC /end REF_CHARACTERISTIC /begin REF_MEASUREMENT FrqDepDmpnInrtCmp.HwTorque.HwNm_f32 /end REF_MEASUREMENT /end GROUP
/begin GROUP FrqDepDmpnInrtCmp.ReceiverPorts "MICROSAR RTE"
 /begin SUB_GROUP FrqDepDmpnInrtCmp.BaseAssistCmd.MtrNm_f32 FrqDepDmpnInrtCmp.CRFMotorVel.MtrRadpS_f32 FrqDepDmpnInrtCmp.FreqDepDmpSrlComSvcDft.Cnt_lgc FrqDepDmpnInrtCmp.HwTorque.HwNm_f32 FrqDepDmpnInrtCmp.VehicleLonAccel.KphpS_f32 FrqDepDmpnInrtCmp.VehicleSpeed.Kph_f32 FrqDepDmpnInrtCmp.WIRCmdAmpBlnd.MtrNm_f32 /end SUB_GROUP
 /begin FUNCTION_LIST /end FUNCTION_LIST
 /begin REF_CHARACTERISTIC /end REF_CHARACTERISTIC
 /begin REF_MEASUREMENT /end REF_MEASUREMENT
/end GROUP
/begin GROUP FrqDepDmpnInrtCmp.SenderPorts "MICROSAR RTE" /begin SUB_GROUP FrqDepDmpnInrtCmp.FrqDepDmpnInrtCmp.MtrNm_f32 /end SUB_GROUP /begin FUNCTION_LIST /end FUNCTION_LIST /begin REF_CHARACTERISTIC /end REF_CHARACTERISTIC /begin REF_MEASUREMENT /end REF_MEASUREMENT /end GROUP
/begin GROUP FrqDepDmpnInrtCmp.VehicleLonAccel.KphpS_f32 "MICROSAR RTE" /begin SUB_GROUP /end SUB_GROUP /begin FUNCTION_LIST /end FUNCTION_LIST /begin REF_CHARACTERISTIC /end REF_CHARACTERISTIC /begin REF_MEASUREMENT FrqDepDmpnInrtCmp.VehicleLonAccel.KphpS_f32 /end REF_MEASUREMENT /end GROUP
/begin GROUP FrqDepDmpnInrtCmp.VehicleSpeed.Kph_f32 "MICROSAR RTE" /begin SUB_GROUP /end SUB_GROUP /begin FUNCTION_LIST /end FUNCTION_LIST /begin REF_CHARACTERISTIC /end REF_CHARACTERISTIC /begin REF_MEASUREMENT FrqDepDmpnInrtCmp.VehicleSpeed.Kph_f32 /end REF_MEASUREMENT /end GROUP
/begin GROUP FrqDepDmpnInrtCmp.WIRCmdAmpBlnd.MtrNm_f32 "MICROSAR RTE" /begin SUB_GROUP /end SUB_GROUP /begin FUNCTION_LIST /end FUNCTION_LIST /begin REF_CHARACTERISTIC /end REF_CHARACTERISTIC /begin REF_MEASUREMENT FrqDepDmpnInrtCmp.WIRCmdAmpBlnd.MtrNm_f32 /end REF_MEASUREMENT /end GROUP
/begin GROUP GenPosTraj "MICROSAR RTE" /begin SUB_GROUP GenPosTraj.ReceiverPorts GenPosTraj.SenderPorts /end SUB_GROUP /begin FUNCTION_LIST /end FUNCTION_LIST /begin REF_CHARACTERISTIC /end REF_CHARACTERISTIC /begin REF_MEASUREMENT /end REF_MEASUREMENT /end GROUP
/begin GROUP GenPosTraj.HwPosition.HwDeg_f32 "MICROSAR RTE" /begin SUB_GROUP /end SUB_GROUP /begin FUNCTION_LIST /end FUNCTION_LIST /begin REF_CHARACTERISTIC /end REF_CHARACTERISTIC /begin REF_MEASUREMENT GenPosTraj.HwPosition.HwDeg_f32 /end REF_MEASUREMENT /end GROUP
/begin GROUP GenPosTraj.PosTrajEnable.Cnt_lgc "MICROSAR RTE" /begin SUB_GROUP /end SUB_GROUP /begin FUNCTION_LIST /end FUNCTION_LIST /begin REF_CHARACTERISTIC /end REF_CHARACTERISTIC /begin REF_MEASUREMENT GenPosTraj.PosTrajEnable.Cnt_lgc /end REF_MEASUREMENT /end GROUP
/begin GROUP GenPosTraj.PosTrajHwAngle.HwDeg_f32 "MICROSAR RTE" /begin SUB_GROUP /end SUB_GROUP /begin FUNCTION_LIST /end FUNCTION_LIST /begin REF_CHARACTERISTIC /end REF_CHARACTERISTIC /begin REF_MEASUREMENT GenPosTraj.PosTrajHwAngle.HwDeg_f32 /end REF_MEASUREMENT /end GROUP
/begin GROUP GenPosTraj.ReceiverPorts "MICROSAR RTE"
 /begin SUB_GROUP GenPosTraj.HwPosition.HwDeg_f32 GenPosTraj.PosTrajEnable.Cnt_lgc /end SUB_GROUP
 /begin FUNCTION_LIST /end FUNCTION_LIST
 /begin REF_CHARACTERISTIC /end REF_CHARACTERISTIC
 /begin REF_MEASUREMENT /end REF_MEASUREMENT
/end GROUP
/begin GROUP GenPosTraj.SenderPorts "MICROSAR RTE" /begin SUB_GROUP GenPosTraj.PosTrajHwAngle.HwDeg_f32 /end SUB_GROUP /begin FUNCTION_LIST /end FUNCTION_LIST /begin REF_CHARACTERISTIC /end REF_CHARACTERISTIC /begin REF_MEASUREMENT /end REF_MEASUREMENT /end GROUP
/begin GROUP Gsod "MICROSAR RTE" /begin SUB_GROUP Gsod.ModeRequirePorts Gsod.ReceiverPorts /end SUB_GROUP /begin FUNCTION_LIST /end FUNCTION_LIST /begin REF_CHARACTERISTIC /end REF_CHARACTERISTIC /begin REF_MEASUREMENT /end REF_MEASUREMENT /end GROUP
/begin GROUP Gsod.Ana_Hw_Torque.HwNm_f32 "MICROSAR RTE" /begin SUB_GROUP /end SUB_GROUP /begin FUNCTION_LIST /end FUNCTION_LIST /begin REF_CHARACTERISTIC /end REF_CHARACTERISTIC /begin REF_MEASUREMENT Gsod.Ana_Hw_Torque.HwNm_f32 /end REF_MEASUREMENT /end GROUP
/begin GROUP Gsod.Corrected_MtrPos.Rev_f32 "MICROSAR RTE" /begin SUB_GROUP /end SUB_GROUP /begin FUNCTION_LIST /end FUNCTION_LIST /begin REF_CHARACTERISTIC /end REF_CHARACTERISTIC /begin REF_MEASUREMENT Gsod.Corrected_MtrPos.Rev_f32 /end REF_MEASUREMENT /end GROUP
/begin GROUP Gsod.Cum_Mtr_Pos_CRF.Deg_f32 "MICROSAR RTE" /begin SUB_GROUP /end SUB_GROUP /begin FUNCTION_LIST /end FUNCTION_LIST /begin REF_CHARACTERISTIC /end REF_CHARACTERISTIC /begin REF_MEASUREMENT Gsod.Cum_Mtr_Pos_CRF.Deg_f32 /end REF_MEASUREMENT /end GROUP
/begin GROUP Gsod.ModeRequirePorts "MICROSAR RTE" /begin SUB_GROUP Gsod.SystemState.Mode /end SUB_GROUP /begin FUNCTION_LIST /end FUNCTION_LIST /begin REF_CHARACTERISTIC /end REF_CHARACTERISTIC /begin REF_MEASUREMENT /end REF_MEASUREMENT /end GROUP
/begin GROUP Gsod.MtrElecMech_Polarity.Cnt_s08 "MICROSAR RTE" /begin SUB_GROUP /end SUB_GROUP /begin FUNCTION_LIST /end FUNCTION_LIST /begin REF_CHARACTERISTIC /end REF_CHARACTERISTIC /begin REF_MEASUREMENT Gsod.MtrElecMech_Polarity.Cnt_s08 /end REF_MEASUREMENT /end GROUP
/begin GROUP Gsod.ReceiverPorts "MICROSAR RTE"
 /begin SUB_GROUP Gsod.Ana_Hw_Torque.HwNm_f32 Gsod.Corrected_MtrPos.Rev_f32 Gsod.Cum_Mtr_Pos_CRF.Deg_f32 Gsod.MtrElecMech_Polarity.Cnt_s08 Gsod.SysC_Ana_Hw_Torque.HwNm_f32 Gsod.SysC_Corrected_MtrPos.Rev_f32 Gsod.SysC_Cum_Mtr_Pos_CRF.Deg_f32 Gsod.SysC_MtrElecMech_Polarity.Cnt_s32 Gsod.SysC_Torque_Cmd_CRF.MtrNm_f32 Gsod.SysC_Torque_Cmd_MRF.MtrNm_f32 Gsod.SysC_Vecu.Volt_f32 Gsod.Torque_Cmd_CRF.MtrNm_f32 Gsod.Torque_Cmd_MRF.MtrNm_f32 Gsod.Vecu.Volt_f32 /end SUB_GROUP
 /begin FUNCTION_LIST /end FUNCTION_LIST
 /begin REF_CHARACTERISTIC /end REF_CHARACTERISTIC
 /begin REF_MEASUREMENT /end REF_MEASUREMENT
/end GROUP
/begin GROUP Gsod.SysC_Ana_Hw_Torque.HwNm_f32 "MICROSAR RTE" /begin SUB_GROUP /end SUB_GROUP /begin FUNCTION_LIST /end FUNCTION_LIST /begin REF_CHARACTERISTIC /end REF_CHARACTERISTIC /begin REF_MEASUREMENT Gsod.SysC_Ana_Hw_Torque.HwNm_f32 /end REF_MEASUREMENT /end GROUP
/begin GROUP Gsod.SysC_Corrected_MtrPos.Rev_f32 "MICROSAR RTE" /begin SUB_GROUP /end SUB_GROUP /begin FUNCTION_LIST /end FUNCTION_LIST /begin REF_CHARACTERISTIC /end REF_CHARACTERISTIC /begin REF_MEASUREMENT Gsod.SysC_Corrected_MtrPos.Rev_f32 /end REF_MEASUREMENT /end GROUP
/begin GROUP Gsod.SysC_Cum_Mtr_Pos_CRF.Deg_f32 "MICROSAR RTE" /begin SUB_GROUP /end SUB_GROUP /begin FUNCTION_LIST /end FUNCTION_LIST /begin REF_CHARACTERISTIC /end REF_CHARACTERISTIC /begin REF_MEASUREMENT Gsod.SysC_Cum_Mtr_Pos_CRF.Deg_f32 /end REF_MEASUREMENT /end GROUP
/begin GROUP Gsod.SysC_MtrElecMech_Polarity.Cnt_s32 "MICROSAR RTE" /begin SUB_GROUP /end SUB_GROUP /begin FUNCTION_LIST /end FUNCTION_LIST /begin REF_CHARACTERISTIC /end REF_CHARACTERISTIC /begin REF_MEASUREMENT Gsod.SysC_MtrElecMech_Polarity.Cnt_s32 /end REF_MEASUREMENT /end GROUP
/begin GROUP Gsod.SysC_Torque_Cmd_CRF.MtrNm_f32 "MICROSAR RTE" /begin SUB_GROUP /end SUB_GROUP /begin FUNCTION_LIST /end FUNCTION_LIST /begin REF_CHARACTERISTIC /end REF_CHARACTERISTIC /begin REF_MEASUREMENT Gsod.SysC_Torque_Cmd_CRF.MtrNm_f32 /end REF_MEASUREMENT /end GROUP
/begin GROUP Gsod.SysC_Torque_Cmd_MRF.MtrNm_f32 "MICROSAR RTE" /begin SUB_GROUP /end SUB_GROUP /begin FUNCTION_LIST /end FUNCTION_LIST /begin REF_CHARACTERISTIC /end REF_CHARACTERISTIC /begin REF_MEASUREMENT Gsod.SysC_Torque_Cmd_MRF.MtrNm_f32 /end REF_MEASUREMENT /end GROUP
/begin GROUP Gsod.SysC_Vecu.Volt_f32 "MICROSAR RTE" /begin SUB_GROUP /end SUB_GROUP /begin FUNCTION_LIST /end FUNCTION_LIST /begin REF_CHARACTERISTIC /end REF_CHARACTERISTIC /begin REF_MEASUREMENT Gsod.SysC_Vecu.Volt_f32 /end REF_MEASUREMENT /end GROUP
/begin GROUP Gsod.SystemState.Mode "MICROSAR RTE" /begin SUB_GROUP /end SUB_GROUP /begin FUNCTION_LIST /end FUNCTION_LIST /begin REF_CHARACTERISTIC /end REF_CHARACTERISTIC /begin REF_MEASUREMENT Gsod.SystemState.Mode /end REF_MEASUREMENT /end GROUP
/begin GROUP Gsod.Torque_Cmd_CRF.MtrNm_f32 "MICROSAR RTE" /begin SUB_GROUP /end SUB_GROUP /begin FUNCTION_LIST /end FUNCTION_LIST /begin REF_CHARACTERISTIC /end REF_CHARACTERISTIC /begin REF_MEASUREMENT Gsod.Torque_Cmd_CRF.MtrNm_f32 /end REF_MEASUREMENT /end GROUP
/begin GROUP Gsod.Torque_Cmd_MRF.MtrNm_f32 "MICROSAR RTE" /begin SUB_GROUP /end SUB_GROUP /begin FUNCTION_LIST /end FUNCTION_LIST /begin REF_CHARACTERISTIC /end REF_CHARACTERISTIC /begin REF_MEASUREMENT Gsod.Torque_Cmd_MRF.MtrNm_f32 /end REF_MEASUREMENT /end GROUP
/begin GROUP Gsod.Vecu.Volt_f32 "MICROSAR RTE" /begin SUB_GROUP /end SUB_GROUP /begin FUNCTION_LIST /end FUNCTION_LIST /begin REF_CHARACTERISTIC /end REF_CHARACTERISTIC /begin REF_MEASUREMENT Gsod.Vecu.Volt_f32 /end REF_MEASUREMENT /end GROUP
/begin GROUP HiLoadStall "MICROSAR RTE" /begin SUB_GROUP HiLoadStall.ReceiverPorts HiLoadStall.SenderPorts /end SUB_GROUP /begin FUNCTION_LIST /end FUNCTION_LIST /begin REF_CHARACTERISTIC /end REF_CHARACTERISTIC /begin REF_MEASUREMENT /end REF_MEASUREMENT /end GROUP
/begin GROUP HiLoadStall.AssistStallLimit.MtrNm_f32 "MICROSAR RTE" /begin SUB_GROUP /end SUB_GROUP /begin FUNCTION_LIST /end FUNCTION_LIST /begin REF_CHARACTERISTIC /end REF_CHARACTERISTIC /begin REF_MEASUREMENT HiLoadStall.AssistStallLimit.MtrNm_f32 /end REF_MEASUREMENT /end GROUP
/begin GROUP HiLoadStall.DftStallLimit.Cnt_lgc "MICROSAR RTE" /begin SUB_GROUP /end SUB_GROUP /begin FUNCTION_LIST /end FUNCTION_LIST /begin REF_CHARACTERISTIC /end REF_CHARACTERISTIC /begin REF_MEASUREMENT HiLoadStall.DftStallLimit.Cnt_lgc /end REF_MEASUREMENT /end GROUP
/begin GROUP HiLoadStall.MtrVelCRF.MtrRadpS_f32 "MICROSAR RTE" /begin SUB_GROUP /end SUB_GROUP /begin FUNCTION_LIST /end FUNCTION_LIST /begin REF_CHARACTERISTIC /end REF_CHARACTERISTIC /begin REF_MEASUREMENT HiLoadStall.MtrVelCRF.MtrRadpS_f32 /end REF_MEASUREMENT /end GROUP
/begin GROUP HiLoadStall.PreLimitForStall.MtrNm_f32 "MICROSAR RTE" /begin SUB_GROUP /end SUB_GROUP /begin FUNCTION_LIST /end FUNCTION_LIST /begin REF_CHARACTERISTIC /end REF_CHARACTERISTIC /begin REF_MEASUREMENT HiLoadStall.PreLimitForStall.MtrNm_f32 /end REF_MEASUREMENT /end GROUP
/begin GROUP HiLoadStall.ReceiverPorts "MICROSAR RTE"
 /begin SUB_GROUP HiLoadStall.DftStallLimit.Cnt_lgc HiLoadStall.MtrVelCRF.MtrRadpS_f32 HiLoadStall.PreLimitForStall.MtrNm_f32 /end SUB_GROUP
 /begin FUNCTION_LIST /end FUNCTION_LIST
 /begin REF_CHARACTERISTIC /end REF_CHARACTERISTIC
 /begin REF_MEASUREMENT /end REF_MEASUREMENT
/end GROUP
/begin GROUP HiLoadStall.SenderPorts "MICROSAR RTE" /begin SUB_GROUP HiLoadStall.AssistStallLimit.MtrNm_f32 /end SUB_GROUP /begin FUNCTION_LIST /end FUNCTION_LIST /begin REF_CHARACTERISTIC /end REF_CHARACTERISTIC /begin REF_MEASUREMENT /end REF_MEASUREMENT /end GROUP
/begin GROUP HwPwUp "MICROSAR RTE"
 /begin SUB_GROUP HwPwUp.ModeRequirePorts HwPwUp.ReceiverPorts HwPwUp.SenderPorts /end SUB_GROUP
 /begin FUNCTION_LIST /end FUNCTION_LIST
 /begin REF_CHARACTERISTIC /end REF_CHARACTERISTIC
 /begin REF_MEASUREMENT /end REF_MEASUREMENT
/end GROUP
/begin GROUP HwPwUp.ModeRequirePorts "MICROSAR RTE" /begin SUB_GROUP HwPwUp.SystemState.Mode /end SUB_GROUP /begin FUNCTION_LIST /end FUNCTION_LIST /begin REF_CHARACTERISTIC /end REF_CHARACTERISTIC /begin REF_MEASUREMENT /end REF_MEASUREMENT /end GROUP
/begin GROUP HwPwUp.MtrDrvrInitComplete.Cnt_lgc "MICROSAR RTE" /begin SUB_GROUP /end SUB_GROUP /begin FUNCTION_LIST /end FUNCTION_LIST /begin REF_CHARACTERISTIC /end REF_CHARACTERISTIC /begin REF_MEASUREMENT HwPwUp.MtrDrvrInitComplete.Cnt_lgc /end REF_MEASUREMENT /end GROUP
/begin GROUP HwPwUp.MtrDrvrInitStart.Cnt_lgc "MICROSAR RTE" /begin SUB_GROUP /end SUB_GROUP /begin FUNCTION_LIST /end FUNCTION_LIST /begin REF_CHARACTERISTIC /end REF_CHARACTERISTIC /begin REF_MEASUREMENT HwPwUp.MtrDrvrInitStart.Cnt_lgc /end REF_MEASUREMENT /end GROUP
/begin GROUP HwPwUp.PwrDiscATestComplete.Cnt_lgc "MICROSAR RTE" /begin SUB_GROUP /end SUB_GROUP /begin FUNCTION_LIST /end FUNCTION_LIST /begin REF_CHARACTERISTIC /end REF_CHARACTERISTIC /begin REF_MEASUREMENT HwPwUp.PwrDiscATestComplete.Cnt_lgc /end REF_MEASUREMENT /end GROUP
/begin GROUP HwPwUp.PwrDiscATestStart.Cnt_lgc "MICROSAR RTE" /begin SUB_GROUP /end SUB_GROUP /begin FUNCTION_LIST /end FUNCTION_LIST /begin REF_CHARACTERISTIC /end REF_CHARACTERISTIC /begin REF_MEASUREMENT HwPwUp.PwrDiscATestStart.Cnt_lgc /end REF_MEASUREMENT /end GROUP
/begin GROUP HwPwUp.PwrDiscBTestComplete.Cnt_lgc "MICROSAR RTE" /begin SUB_GROUP /end SUB_GROUP /begin FUNCTION_LIST /end FUNCTION_LIST /begin REF_CHARACTERISTIC /end REF_CHARACTERISTIC /begin REF_MEASUREMENT HwPwUp.PwrDiscBTestComplete.Cnt_lgc /end REF_MEASUREMENT /end GROUP
/begin GROUP HwPwUp.PwrDiscBTestStart.Cnt_lgc "MICROSAR RTE" /begin SUB_GROUP /end SUB_GROUP /begin FUNCTION_LIST /end FUNCTION_LIST /begin REF_CHARACTERISTIC /end REF_CHARACTERISTIC /begin REF_MEASUREMENT HwPwUp.PwrDiscBTestStart.Cnt_lgc /end REF_MEASUREMENT /end GROUP
/begin GROUP HwPwUp.ReceiverPorts "MICROSAR RTE"
 /begin SUB_GROUP HwPwUp.MtrDrvrInitComplete.Cnt_lgc HwPwUp.PwrDiscATestComplete.Cnt_lgc HwPwUp.PwrDiscBTestComplete.Cnt_lgc HwPwUp.TMFTestComplete.Cnt_lgc /end SUB_GROUP
 /begin FUNCTION_LIST /end FUNCTION_LIST
 /begin REF_CHARACTERISTIC /end REF_CHARACTERISTIC
 /begin REF_MEASUREMENT /end REF_MEASUREMENT
/end GROUP
/begin GROUP HwPwUp.SenderPorts "MICROSAR RTE"
 /begin SUB_GROUP HwPwUp.MtrDrvrInitStart.Cnt_lgc HwPwUp.PwrDiscATestStart.Cnt_lgc HwPwUp.PwrDiscBTestStart.Cnt_lgc HwPwUp.TMFTestStart.Cnt_lgc /end SUB_GROUP
 /begin FUNCTION_LIST /end FUNCTION_LIST
 /begin REF_CHARACTERISTIC /end REF_CHARACTERISTIC
 /begin REF_MEASUREMENT /end REF_MEASUREMENT
/end GROUP
/begin GROUP HwPwUp.SystemState.Mode "MICROSAR RTE" /begin SUB_GROUP /end SUB_GROUP /begin FUNCTION_LIST /end FUNCTION_LIST /begin REF_CHARACTERISTIC /end REF_CHARACTERISTIC /begin REF_MEASUREMENT HwPwUp.SystemState.Mode /end REF_MEASUREMENT /end GROUP
/begin GROUP HwPwUp.TMFTestComplete.Cnt_lgc "MICROSAR RTE" /begin SUB_GROUP /end SUB_GROUP /begin FUNCTION_LIST /end FUNCTION_LIST /begin REF_CHARACTERISTIC /end REF_CHARACTERISTIC /begin REF_MEASUREMENT HwPwUp.TMFTestComplete.Cnt_lgc /end REF_MEASUREMENT /end GROUP
/begin GROUP HwPwUp.TMFTestStart.Cnt_lgc "MICROSAR RTE" /begin SUB_GROUP /end SUB_GROUP /begin FUNCTION_LIST /end FUNCTION_LIST /begin REF_CHARACTERISTIC /end REF_CHARACTERISTIC /begin REF_MEASUREMENT HwPwUp.TMFTestStart.Cnt_lgc /end REF_MEASUREMENT /end GROUP
/begin GROUP HwTrq "MICROSAR RTE"
 /begin SUB_GROUP HwTrq.PerInstanceMemories HwTrq.ReceiverPorts HwTrq.SenderPorts /end SUB_GROUP
 /begin FUNCTION_LIST /end FUNCTION_LIST
 /begin REF_CHARACTERISTIC /end REF_CHARACTERISTIC
 /begin REF_MEASUREMENT /end REF_MEASUREMENT
/end GROUP
/begin GROUP HwTrq.AbsPosStepSignal.Cnt_u08 "MICROSAR RTE" /begin SUB_GROUP /end SUB_GROUP /begin FUNCTION_LIST /end FUNCTION_LIST /begin REF_CHARACTERISTIC /end REF_CHARACTERISTIC /begin REF_MEASUREMENT HwTrq.AbsPosStepSignal.Cnt_u08 /end REF_MEASUREMENT /end GROUP
/begin GROUP HwTrq.AnaDiffHwTrq.Volt_f32 "MICROSAR RTE" /begin SUB_GROUP /end SUB_GROUP /begin FUNCTION_LIST /end FUNCTION_LIST /begin REF_CHARACTERISTIC /end REF_CHARACTERISTIC /begin REF_MEASUREMENT HwTrq.AnaDiffHwTrq.Volt_f32 /end REF_MEASUREMENT /end GROUP
/begin GROUP HwTrq.AnaHwTorque.HwNm_f32 "MICROSAR RTE" /begin SUB_GROUP /end SUB_GROUP /begin FUNCTION_LIST /end FUNCTION_LIST /begin REF_CHARACTERISTIC /end REF_CHARACTERISTIC /begin REF_MEASUREMENT HwTrq.AnaHwTorque.HwNm_f32 /end REF_MEASUREMENT /end GROUP
/begin GROUP HwTrq.CntrlDisRampComplete.Cnt_lgc "MICROSAR RTE" /begin SUB_GROUP /end SUB_GROUP /begin FUNCTION_LIST /end FUNCTION_LIST /begin REF_CHARACTERISTIC /end REF_CHARACTERISTIC /begin REF_MEASUREMENT HwTrq.CntrlDisRampComplete.Cnt_lgc /end REF_MEASUREMENT /end GROUP
/begin GROUP HwTrq.EOLTrqStepData "MICROSAR RTE" /begin SUB_GROUP /end SUB_GROUP /begin FUNCTION_LIST /end FUNCTION_LIST /begin REF_CHARACTERISTIC /end REF_CHARACTERISTIC /begin REF_MEASUREMENT HwTrq.EOLTrqStepData /end REF_MEASUREMENT /end GROUP
/begin GROUP HwTrq.HwTrqScaleData "MICROSAR RTE" /begin SUB_GROUP /end SUB_GROUP /begin FUNCTION_LIST /end FUNCTION_LIST /begin REF_CHARACTERISTIC /end REF_CHARACTERISTIC
 /begin REF_MEASUREMENT HwTrq.HwTrqScaleData.HwTrqScalePerf_Cnt_lgc HwTrq.HwTrqScaleData.HwTrqScale_VoltsPerDeg_f32 /end REF_MEASUREMENT
/end GROUP
/begin GROUP HwTrq.HwTrqScaleVal.VoltsPerDeg_f32 "MICROSAR RTE" /begin SUB_GROUP /end SUB_GROUP /begin FUNCTION_LIST /end FUNCTION_LIST /begin REF_CHARACTERISTIC /end REF_CHARACTERISTIC /begin REF_MEASUREMENT HwTrq.HwTrqScaleVal.VoltsPerDeg_f32 /end REF_MEASUREMENT /end GROUP
/begin GROUP HwTrq.HwTrqTrimData "MICROSAR RTE" /begin SUB_GROUP /end SUB_GROUP /begin FUNCTION_LIST /end FUNCTION_LIST /begin REF_CHARACTERISTIC /end REF_CHARACTERISTIC
 /begin REF_MEASUREMENT HwTrq.HwTrqTrimData.HwTrqTrimPerf_Cnt_lgc HwTrq.HwTrqTrimData.HwTrqTrim_Volts_f32 HwTrq.HwTrqTrimData.T1Trim_Volts_f32 HwTrq.HwTrqTrimData.T2Trim_Volts_f32 /end REF_MEASUREMENT
/end GROUP
/begin GROUP HwTrq.MECCounter.Cnt_enum "MICROSAR RTE" /begin SUB_GROUP /end SUB_GROUP /begin FUNCTION_LIST /end FUNCTION_LIST /begin REF_CHARACTERISTIC /end REF_CHARACTERISTIC /begin REF_MEASUREMENT HwTrq.MECCounter.Cnt_enum /end REF_MEASUREMENT /end GROUP
/begin GROUP HwTrq.PerInstanceMemories "MICROSAR RTE"
 /begin SUB_GROUP HwTrq.EOLTrqStepData HwTrq.HwTrqScaleData HwTrq.HwTrqTrimData /end SUB_GROUP
 /begin FUNCTION_LIST /end FUNCTION_LIST
 /begin REF_CHARACTERISTIC /end REF_CHARACTERISTIC
 /begin REF_MEASUREMENT /end REF_MEASUREMENT
/end GROUP
/begin GROUP HwTrq.ReceiverPorts "MICROSAR RTE"
 /begin SUB_GROUP HwTrq.AbsPosStepSignal.Cnt_u08 HwTrq.CntrlDisRampComplete.Cnt_lgc HwTrq.MECCounter.Cnt_enum HwTrq.T1ADC.Volt_f32 HwTrq.T2ADC.Volt_f32 /end SUB_GROUP
 /begin FUNCTION_LIST /end FUNCTION_LIST
 /begin REF_CHARACTERISTIC /end REF_CHARACTERISTIC
 /begin REF_MEASUREMENT /end REF_MEASUREMENT
/end GROUP
/begin GROUP HwTrq.SenderPorts "MICROSAR RTE"
 /begin SUB_GROUP HwTrq.AnaDiffHwTrq.Volt_f32 HwTrq.AnaHwTorque.HwNm_f32 HwTrq.HwTrqScaleVal.VoltsPerDeg_f32 HwTrq.SrlComHwTrqValid.Cnt_lgc HwTrq.SysCAnaHwTorque.HwNm_f32 HwTrq.T1TrimVal.Volt_f32 HwTrq.T2TrimVal.Volt_f32 /end SUB_GROUP
 /begin FUNCTION_LIST /end FUNCTION_LIST
 /begin REF_CHARACTERISTIC /end REF_CHARACTERISTIC
 /begin REF_MEASUREMENT /end REF_MEASUREMENT
/end GROUP
/begin GROUP HwTrq.SrlComHwTrqValid.Cnt_lgc "MICROSAR RTE" /begin SUB_GROUP /end SUB_GROUP /begin FUNCTION_LIST /end FUNCTION_LIST /begin REF_CHARACTERISTIC /end REF_CHARACTERISTIC /begin REF_MEASUREMENT HwTrq.SrlComHwTrqValid.Cnt_lgc /end REF_MEASUREMENT /end GROUP
/begin GROUP HwTrq.SysCAnaHwTorque.HwNm_f32 "MICROSAR RTE" /begin SUB_GROUP /end SUB_GROUP /begin FUNCTION_LIST /end FUNCTION_LIST /begin REF_CHARACTERISTIC /end REF_CHARACTERISTIC /begin REF_MEASUREMENT HwTrq.SysCAnaHwTorque.HwNm_f32 /end REF_MEASUREMENT /end GROUP
/begin GROUP HwTrq.T1ADC.Volt_f32 "MICROSAR RTE" /begin SUB_GROUP /end SUB_GROUP /begin FUNCTION_LIST /end FUNCTION_LIST /begin REF_CHARACTERISTIC /end REF_CHARACTERISTIC /begin REF_MEASUREMENT HwTrq.T1ADC.Volt_f32 /end REF_MEASUREMENT /end GROUP
/begin GROUP HwTrq.T1TrimVal.Volt_f32 "MICROSAR RTE" /begin SUB_GROUP /end SUB_GROUP /begin FUNCTION_LIST /end FUNCTION_LIST /begin REF_CHARACTERISTIC /end REF_CHARACTERISTIC /begin REF_MEASUREMENT HwTrq.T1TrimVal.Volt_f32 /end REF_MEASUREMENT /end GROUP
/begin GROUP HwTrq.T2ADC.Volt_f32 "MICROSAR RTE" /begin SUB_GROUP /end SUB_GROUP /begin FUNCTION_LIST /end FUNCTION_LIST /begin REF_CHARACTERISTIC /end REF_CHARACTERISTIC /begin REF_MEASUREMENT HwTrq.T2ADC.Volt_f32 /end REF_MEASUREMENT /end GROUP
/begin GROUP HwTrq.T2TrimVal.Volt_f32 "MICROSAR RTE" /begin SUB_GROUP /end SUB_GROUP /begin FUNCTION_LIST /end FUNCTION_LIST /begin REF_CHARACTERISTIC /end REF_CHARACTERISTIC /begin REF_MEASUREMENT HwTrq.T2TrimVal.Volt_f32 /end REF_MEASUREMENT /end GROUP
/begin GROUP HwTrq2 "MICROSAR RTE" /begin SUB_GROUP HwTrq2.ReceiverPorts /end SUB_GROUP /begin FUNCTION_LIST /end FUNCTION_LIST /begin REF_CHARACTERISTIC /end REF_CHARACTERISTIC /begin REF_MEASUREMENT /end REF_MEASUREMENT /end GROUP
/begin GROUP HwTrq2.AnaDiffHwTrq.Volt_f32 "MICROSAR RTE" /begin SUB_GROUP /end SUB_GROUP /begin FUNCTION_LIST /end FUNCTION_LIST /begin REF_CHARACTERISTIC /end REF_CHARACTERISTIC /begin REF_MEASUREMENT HwTrq2.AnaDiffHwTrq.Volt_f32 /end REF_MEASUREMENT /end GROUP
/begin GROUP HwTrq2.AnaHwTorque.HwNm_f32 "MICROSAR RTE" /begin SUB_GROUP /end SUB_GROUP /begin FUNCTION_LIST /end FUNCTION_LIST /begin REF_CHARACTERISTIC /end REF_CHARACTERISTIC /begin REF_MEASUREMENT HwTrq2.AnaHwTorque.HwNm_f32 /end REF_MEASUREMENT /end GROUP
/begin GROUP HwTrq2.HwTrqScaleVal.VoltsPerDeg_f32 "MICROSAR RTE" /begin SUB_GROUP /end SUB_GROUP /begin FUNCTION_LIST /end FUNCTION_LIST /begin REF_CHARACTERISTIC /end REF_CHARACTERISTIC /begin REF_MEASUREMENT HwTrq2.HwTrqScaleVal.VoltsPerDeg_f32 /end REF_MEASUREMENT /end GROUP
/begin GROUP HwTrq2.ReceiverPorts "MICROSAR RTE"
 /begin SUB_GROUP HwTrq2.AnaDiffHwTrq.Volt_f32 HwTrq2.AnaHwTorque.HwNm_f32 HwTrq2.HwTrqScaleVal.VoltsPerDeg_f32 HwTrq2.SysCT1ADC.Volt_f32 HwTrq2.SysCT2ADC.Volt_f32 HwTrq2.T1TrimVal.Volt_f32 HwTrq2.T2TrimVal.Volt_f32 /end SUB_GROUP
 /begin FUNCTION_LIST /end FUNCTION_LIST
 /begin REF_CHARACTERISTIC /end REF_CHARACTERISTIC
 /begin REF_MEASUREMENT /end REF_MEASUREMENT
/end GROUP
/begin GROUP HwTrq2.SysCT1ADC.Volt_f32 "MICROSAR RTE" /begin SUB_GROUP /end SUB_GROUP /begin FUNCTION_LIST /end FUNCTION_LIST /begin REF_CHARACTERISTIC /end REF_CHARACTERISTIC /begin REF_MEASUREMENT HwTrq2.SysCT1ADC.Volt_f32 /end REF_MEASUREMENT /end GROUP
/begin GROUP HwTrq2.SysCT2ADC.Volt_f32 "MICROSAR RTE" /begin SUB_GROUP /end SUB_GROUP /begin FUNCTION_LIST /end FUNCTION_LIST /begin REF_CHARACTERISTIC /end REF_CHARACTERISTIC /begin REF_MEASUREMENT HwTrq2.SysCT2ADC.Volt_f32 /end REF_MEASUREMENT /end GROUP
/begin GROUP HwTrq2.T1TrimVal.Volt_f32 "MICROSAR RTE" /begin SUB_GROUP /end SUB_GROUP /begin FUNCTION_LIST /end FUNCTION_LIST /begin REF_CHARACTERISTIC /end REF_CHARACTERISTIC /begin REF_MEASUREMENT HwTrq2.T1TrimVal.Volt_f32 /end REF_MEASUREMENT /end GROUP
/begin GROUP HwTrq2.T2TrimVal.Volt_f32 "MICROSAR RTE" /begin SUB_GROUP /end SUB_GROUP /begin FUNCTION_LIST /end FUNCTION_LIST /begin REF_CHARACTERISTIC /end REF_CHARACTERISTIC /begin REF_MEASUREMENT HwTrq2.T2TrimVal.Volt_f32 /end REF_MEASUREMENT /end GROUP
/begin GROUP HystAdd "MICROSAR RTE" /begin SUB_GROUP HystAdd.ReceiverPorts HystAdd.SenderPorts /end SUB_GROUP /begin FUNCTION_LIST /end FUNCTION_LIST /begin REF_CHARACTERISTIC /end REF_CHARACTERISTIC /begin REF_MEASUREMENT /end REF_MEASUREMENT /end GROUP
/begin GROUP HystAdd.HwTrq.HwNm_f32 "MICROSAR RTE" /begin SUB_GROUP /end SUB_GROUP /begin FUNCTION_LIST /end FUNCTION_LIST /begin REF_CHARACTERISTIC /end REF_CHARACTERISTIC /begin REF_MEASUREMENT HystAdd.HwTrq.HwNm_f32 /end REF_MEASUREMENT /end GROUP
/begin GROUP HystAdd.HysAddHwTrq.HwNm_f32 "MICROSAR RTE" /begin SUB_GROUP /end SUB_GROUP /begin FUNCTION_LIST /end FUNCTION_LIST /begin REF_CHARACTERISTIC /end REF_CHARACTERISTIC /begin REF_MEASUREMENT HystAdd.HysAddHwTrq.HwNm_f32 /end REF_MEASUREMENT /end GROUP
/begin GROUP HystAdd.HysAddSrlComSvcDft.Cnt_lgc "MICROSAR RTE" /begin SUB_GROUP /end SUB_GROUP /begin FUNCTION_LIST /end FUNCTION_LIST /begin REF_CHARACTERISTIC /end REF_CHARACTERISTIC /begin REF_MEASUREMENT HystAdd.HysAddSrlComSvcDft.Cnt_lgc /end REF_MEASUREMENT /end GROUP
/begin GROUP HystAdd.ReceiverPorts "MICROSAR RTE"
 /begin SUB_GROUP HystAdd.HwTrq.HwNm_f32 HystAdd.HysAddSrlComSvcDft.Cnt_lgc HystAdd.VehSpd.Kph_f32 /end SUB_GROUP
 /begin FUNCTION_LIST /end FUNCTION_LIST
 /begin REF_CHARACTERISTIC /end REF_CHARACTERISTIC
 /begin REF_MEASUREMENT /end REF_MEASUREMENT
/end GROUP
/begin GROUP HystAdd.SenderPorts "MICROSAR RTE" /begin SUB_GROUP HystAdd.HysAddHwTrq.HwNm_f32 /end SUB_GROUP /begin FUNCTION_LIST /end FUNCTION_LIST /begin REF_CHARACTERISTIC /end REF_CHARACTERISTIC /begin REF_MEASUREMENT /end REF_MEASUREMENT /end GROUP
/begin GROUP HystAdd.VehSpd.Kph_f32 "MICROSAR RTE" /begin SUB_GROUP /end SUB_GROUP /begin FUNCTION_LIST /end FUNCTION_LIST /begin REF_CHARACTERISTIC /end REF_CHARACTERISTIC /begin REF_MEASUREMENT HystAdd.VehSpd.Kph_f32 /end REF_MEASUREMENT /end GROUP
/begin GROUP HystComp "MICROSAR RTE" /begin SUB_GROUP HystComp.ReceiverPorts HystComp.SenderPorts /end SUB_GROUP /begin FUNCTION_LIST /end FUNCTION_LIST /begin REF_CHARACTERISTIC /end REF_CHARACTERISTIC /begin REF_MEASUREMENT /end REF_MEASUREMENT /end GROUP
/begin GROUP HystComp.AssistMechTempEst.DegC_f32 "MICROSAR RTE" /begin SUB_GROUP /end SUB_GROUP /begin FUNCTION_LIST /end FUNCTION_LIST /begin REF_CHARACTERISTIC /end REF_CHARACTERISTIC /begin REF_MEASUREMENT HystComp.AssistMechTempEst.DegC_f32 /end REF_MEASUREMENT /end GROUP
/begin GROUP HystComp.BaseAssistCmd.MtrNm_f32 "MICROSAR RTE" /begin SUB_GROUP /end SUB_GROUP /begin FUNCTION_LIST /end FUNCTION_LIST /begin REF_CHARACTERISTIC /end REF_CHARACTERISTIC /begin REF_MEASUREMENT HystComp.BaseAssistCmd.MtrNm_f32 /end REF_MEASUREMENT /end GROUP
/begin GROUP HystComp.DefeatHystService.Cnt_lgc "MICROSAR RTE" /begin SUB_GROUP /end SUB_GROUP /begin FUNCTION_LIST /end FUNCTION_LIST /begin REF_CHARACTERISTIC /end REF_CHARACTERISTIC /begin REF_MEASUREMENT HystComp.DefeatHystService.Cnt_lgc /end REF_MEASUREMENT /end GROUP
/begin GROUP HystComp.FricOffset.HwNm_f32 "MICROSAR RTE" /begin SUB_GROUP /end SUB_GROUP /begin FUNCTION_LIST /end FUNCTION_LIST /begin REF_CHARACTERISTIC /end REF_CHARACTERISTIC /begin REF_MEASUREMENT HystComp.FricOffset.HwNm_f32 /end REF_MEASUREMENT /end GROUP
/begin GROUP HystComp.HwTorque.HwNm_f32 "MICROSAR RTE" /begin SUB_GROUP /end SUB_GROUP /begin FUNCTION_LIST /end FUNCTION_LIST /begin REF_CHARACTERISTIC /end REF_CHARACTERISTIC /begin REF_MEASUREMENT HystComp.HwTorque.HwNm_f32 /end REF_MEASUREMENT /end GROUP
/begin GROUP HystComp.HysteresisComp.MtrNm_f32 "MICROSAR RTE" /begin SUB_GROUP /end SUB_GROUP /begin FUNCTION_LIST /end FUNCTION_LIST /begin REF_CHARACTERISTIC /end REF_CHARACTERISTIC /begin REF_MEASUREMENT HystComp.HysteresisComp.MtrNm_f32 /end REF_MEASUREMENT /end GROUP
/begin RECORD_LAYOUT RTE_RL_ULONG FNC_VALUES 1 ULONG ROW_DIR DIRECT /end RECORD_LAYOUT
/begin RECORD_LAYOUT RTE_RL_SBYTE FNC_VALUES 1 SBYTE ROW_DIR DIRECT /end RECORD_LAYOUT
/**********************************************************************************************************************
* COMPU_METHOD / COMPU_VTAB_RANGE
*********************************************************************************************************************/
/begin COMPU_METHOD RTE_CM_BOOLEAN "" TAB_VERB "%3.1" "" COMPU_TAB_REF RTE_CM_BOOLEAN /end COMPU_METHOD
/begin COMPU_VTAB_RANGE RTE_CM_BOOLEAN "" 2 0 0 "false" 1 255 "true" /end COMPU_VTAB_RANGE
/begin COMPU_METHOD RTE_CM_ENUM_StaMd_Mode "" TAB_VERB "%.1" "" COMPU_TAB_REF RTE_CM_ENUM_StaMd_Mode /end COMPU_METHOD
/begin COMPU_VTAB_RANGE RTE_CM_ENUM_StaMd_Mode "" 5 0 0 "RTE_MODE_StaMd_Mode_DISABLE" 1 1 "RTE_MODE_StaMd_Mode_OFF" 2 2 "RTE_MODE_StaMd_Mode_OPERATE" 3 3 "RTE_MODE_StaMd_Mode_WARMINIT" 4 4 "RTE_TRANSITION_StaMd_Mode" /end COMPU_VTAB_RANGE
/begin COMPU_METHOD RTE_CM_ENUM_QU_SER_STMOM_STMOM_DV_ACT "" TAB_VERB "%.1" "" COMPU_TAB_REF RTE_CM_ENUM_QU_SER_STMOM_STMOM_DV_ACT /end COMPU_METHOD
/begin COMPU_VTAB_RANGE RTE_CM_ENUM_QU_SER_STMOM_STMOM_DV_ACT "" 7 32 32 "Cx20_Schnittstelle_verfuegbar___funktionsbereit" 33 33 "Cx21_Schnittstelle_aktiv" 96 96 "Cx60_Service_nicht_verfuegbar___Fehler" 128 128 "Cx80_Schnittstelle_wird_initialisiert" 224 224 "CxE0_Service_nicht_verfuegbar___Standby___PMA" 225 225 "CxE1_Service_nicht_verfuegbar___Standby___EPS_Status" 255 255 "CxFF_Signal_ungueltig" /end COMPU_VTAB_RANGE
/begin COMPU_METHOD RTE_CM_ENUM_ManufModeType "" TAB_VERB "%.1" "" COMPU_TAB_REF RTE_CM_ENUM_ManufModeType /end COMPU_METHOD
/begin COMPU_VTAB_RANGE RTE_CM_ENUM_ManufModeType "" 3 0 0 "ProductionMode" 1 1 "ManufacturingMode" 2 2 "EngineeringMode" /end COMPU_VTAB_RANGE
/begin COMPU_METHOD RTE_CM_ENUM_MSA_Cmd_Type "" TAB_VERB "%.1" "" COMPU_TAB_REF RTE_CM_ENUM_MSA_Cmd_Type /end COMPU_METHOD
/begin COMPU_VTAB_RANGE RTE_CM_ENUM_MSA_Cmd_Type "" 4 0 0 "MSA_STOP_ANNOUNCEMENT" 1 1 "MSA_STOP_COMMAND" 2 2 "MSA_START_ANNOUNCEMENT" 3 3 "MSA_ENGINE_RUN" /end COMPU_VTAB_RANGE
/begin COMPU_METHOD RTE_CM_ENUM_CTR_ERRM_BN_U "" TAB_VERB "%.1" "" COMPU_TAB_REF RTE_CM_ENUM_CTR_ERRM_BN_U /end COMPU_METHOD
/begin COMPU_VTAB_RANGE RTE_CM_ENUM_CTR_ERRM_BN_U "" 9 0 0 "Cb0xxxx1_Unterspannung_Normalbetrieb" 0 0 "Cb0xxxx0_Keine_Unterspannung_Normalbetrieb" 0 0 "Cb0xxx1x_Unterspannung_MSA_Start" 0 0 "Cb0xxx0x_Keine_Unterspannung_MSA_Start" 0 0 "Cb0xx1xx_Ueberspannung" 0 0 "Cb0xx0xx_Keine_Ueberspannung" 61 61 "Cx3D_nicht_verfuegbar" 62 62 "Cx3E_Fehler" 63 63 "Cx3F_Signal_ungueltig" /end COMPU_VTAB_RANGE
/begin COMPU_METHOD RTE_CM_ENUM_ST_ILK_ERRM_FZM "" TAB_VERB "%.1" "" COMPU_TAB_REF RTE_CM_ENUM_ST_ILK_ERRM_FZM /end COMPU_METHOD
/begin COMPU_VTAB_RANGE RTE_CM_ENUM_ST_ILK_ERRM_FZM "" 4 0 0 "Cx0_Fehlerspeicherfreigabe" 1 1 "Cx1_Fehlerspeichersperre" 2 2 "Cx2_Reserve" 3 3 "Cx3_Signal_ungueltig" /end COMPU_VTAB_RANGE
/begin COMPU_METHOD RTE_CM_ENUM_QU_SER_WSTA_EST_FTAX "" TAB_VERB "%.1" "" COMPU_TAB_REF RTE_CM_ENUM_QU_SER_WSTA_EST_FTAX /end COMPU_METHOD
/begin COMPU_VTAB_RANGE RTE_CM_ENUM_QU_SER_WSTA_EST_FTAX "" 10 32 32 "Cx20_Schnittstelle_verfuegbar___funktionsbereit" 33 33 "Cx21_Schnittstelle_aktiv" 96 96 "Cx60_Service_nicht_verfuegbar___Fehler" 128 128 "Cx80_Schnittstelle_wird_initialisiert" 224 224 "CxE0_Funktion_in_Rueckfallebene___V_Fzg_____0" 226 226 "CxE2_Funktion_in_Rueckfallebene___Hands_On" 227 227 "CxE3_Funktion_in_Rueckfallebene___EPS_Status" 228 228 "CxE4_Schnittstelle_inaktiv___Stillstandsnaher_Bereich_verlassen" 231 231 "CxE7_Schnittstelle_aktiv_degradiert" 255 255 "CxFF_Signal_ungueltig" /end COMPU_VTAB_RANGE
/begin COMPU_METHOD RTE_CM_ENUM_EcuM_Mode "" TAB_VERB "%.1" "" COMPU_TAB_REF RTE_CM_ENUM_EcuM_Mode /end COMPU_METHOD
/begin COMPU_VTAB_RANGE RTE_CM_ENUM_EcuM_Mode "" 7 0 0 "RTE_MODE_EcuM_Mode_POST_RUN" 1 1 "RTE_MODE_EcuM_Mode_RUN" 2 2 "RTE_MODE_EcuM_Mode_SHUTDOWN" 3 3 "RTE_MODE_EcuM_Mode_SLEEP" 4 4 "RTE_MODE_EcuM_Mode_STARTUP" 5 5 "RTE_MODE_EcuM_Mode_WAKE_SLEEP" 6 6 "RTE_TRANSITION_EcuM_Mode" /end COMPU_VTAB_RANGE
