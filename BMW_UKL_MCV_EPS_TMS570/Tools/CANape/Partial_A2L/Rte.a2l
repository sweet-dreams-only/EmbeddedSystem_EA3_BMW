/**********************************************************************************************************************
* COPYRIGHT
* Copyright (c) 2006-2011 by Vctr Informatik GmbH. All rights reserved.
* This software is copyright protected and proprietary to Vctr Informatik GmbH.
* Vctr Informatik GmbH grants to you only those rights as set out in the license conditions.
* All other rights remain with Vctr Informatik GmbH.
* FILE DESCRIPTION
* File: Rte.a2l
* Workspace: c:/Build/BMW/ses_dev_ea3/BMW_MCV_UKL_EPS_TMS570_F40_Working/BMW_UKL_MCV_EPS_TMS570/Tools/AsrProject/Config/DCF/EPS.dcf
* ECU-Project: EPS
* Generated at: Fri Jun 2 16:47:41 2017
* Generator: MICROSAR RTE Generator Version 2.19.1
* License: License CBD1010124 valid for CBD1010124 Nxtr Package: BMW MSR SIP BAC3.0 Micro: TI TMS570 TMS570LS30306 Compiler: Code Composer Studio 4.9.0
* Description: MICROSAR RTE A2L file
*********************************************************************************************************************/
/**********************************************************************************************************************
* MEASUREMENT
*********************************************************************************************************************/
/begin MEASUREMENT AbsHwPos.AlignedCumMtrPosMRF.Deg_f32 "MICROSAR RTE" FLOAT32_IEEE NO_COMPU_METHOD 0 0 1.175494351e-38 3.402823466e+38 ECU_ADDRESS 0 SYMBOL_LINK "Rte_MtrPos_AlignedCumMtrPosMRF_Deg_f32" 0 DISPLAY_IDENTIFIER AbsHwPos.ReceiverPorts.AlignedCumMtrPosMRF.Deg_f32 /end MEASUREMENT
/begin MEASUREMENT AbsHwPos.AlignedHwPos.HwDeg_f32 "MICROSAR RTE" FLOAT32_IEEE NO_COMPU_METHOD 0 0 1.175494351e-38 3.402823466e+38 ECU_ADDRESS 0 SYMBOL_LINK "Rte_AbsHwPos_AlignedHwPos_HwDeg_f32" 0 DISPLAY_IDENTIFIER AbsHwPos.SenderPorts.AlignedHwPos.HwDeg_f32 /end MEASUREMENT
/begin MEASUREMENT AbsHwPos.DefeatKinIntTest.Cnt_lgc "MICROSAR RTE" UBYTE RTE_CM_BOOLEAN 0 0 0 255 ECU_ADDRESS 0 SYMBOL_LINK "Rte_CDDInterface9_KinIntDiagSrlComSvcDft_Cnt_lgc" 0 DISPLAY_IDENTIFIER AbsHwPos.ReceiverPorts.DefeatKinIntTest.Cnt_lgc /end MEASUREMENT
/begin MEASUREMENT AbsHwPos.DiagStsDefHwPos.Cnt_lgc "MICROSAR RTE" UBYTE RTE_CM_BOOLEAN 0 0 0 255 ECU_ADDRESS 0 SYMBOL_LINK "Rte_DiagMgr10_DiagStsHWASbSystmFltPres_Cnt_lgc" 0 DISPLAY_IDENTIFIER AbsHwPos.ReceiverPorts.DiagStsDefHwPos.Cnt_lgc /end MEASUREMENT
/begin MEASUREMENT AbsHwPos.DiagStsDefVehSpd.Cnt_lgc "MICROSAR RTE" UBYTE RTE_CM_BOOLEAN 0 0 0 255 ECU_ADDRESS 0 SYMBOL_LINK "Rte_DiagMgr10_DiagStsDefVehSpd_Cnt_lgc" 0 DISPLAY_IDENTIFIER AbsHwPos.ReceiverPorts.DiagStsDefVehSpd.Cnt_lgc /end MEASUREMENT
/begin MEASUREMENT AbsHwPos.DiagStsHwPosDis.Cnt_lgc "MICROSAR RTE" UBYTE RTE_CM_BOOLEAN 0 0 0 255 ECU_ADDRESS 0 SYMBOL_LINK "Rte_DiagMgr10_DiagStsScomHWANotValid_Cnt_lgc" 0 DISPLAY_IDENTIFIER AbsHwPos.ReceiverPorts.DiagStsHwPosDis.Cnt_lgc /end MEASUREMENT
/begin MEASUREMENT AbsHwPos.HandwheelAuthority.Uls_f32 "MICROSAR RTE" FLOAT32_IEEE NO_COMPU_METHOD 0 0 1.175494351e-38 3.402823466e+38 ECU_ADDRESS 0 SYMBOL_LINK "Rte_AbsHwPos_HandwheelAuthority_Uls_f32" 0 DISPLAY_IDENTIFIER AbsHwPos.SenderPorts.HandwheelAuthority.Uls_f32 /end MEASUREMENT
/begin MEASUREMENT AbsHwPos.HandwheelPosition.HwDeg_f32 "MICROSAR RTE" FLOAT32_IEEE NO_COMPU_METHOD 0 0 1.175494351e-38 3.402823466e+38 ECU_ADDRESS 0 SYMBOL_LINK "Rte_AbsHwPos_HandwheelPosition_HwDeg_f32" 0 DISPLAY_IDENTIFIER AbsHwPos.SenderPorts.HandwheelPosition.HwDeg_f32 /end MEASUREMENT
/begin MEASUREMENT AbsHwPos.HwTargetAuthority.Uls_f32 "MICROSAR RTE" FLOAT32_IEEE NO_COMPU_METHOD 0 0 1.175494351e-38 3.402823466e+38 ECU_ADDRESS 0 SYMBOL_LINK "Rte_AbsHwPos_HwTargetAuthority_Uls_f32" 0 DISPLAY_IDENTIFIER AbsHwPos.SenderPorts.HwTargetAuthority.Uls_f32 /end MEASUREMENT
/begin MEASUREMENT AbsHwPos.ICMMtrPosMRF.Deg_f32 "MICROSAR RTE" FLOAT32_IEEE NO_COMPU_METHOD 0 0 1.175494351e-38 3.402823466e+38 ECU_ADDRESS 0 SYMBOL_LINK "Rte_AbsHwPos_ICMMtrPosMRF_Deg_f32" 0 DISPLAY_IDENTIFIER AbsHwPos.SenderPorts.ICMMtrPosMRF.Deg_f32 /end MEASUREMENT
/begin MEASUREMENT AbsHwPos.ICMRevOffsetCRF.Rev_s16 "MICROSAR RTE" SWORD NO_COMPU_METHOD 0 0 -32768 32767 ECU_ADDRESS 0 SYMBOL_LINK "Rte_SrlComInput2_SrlComCRFRevOffset_Rev_s16" 0 DISPLAY_IDENTIFIER AbsHwPos.ReceiverPorts.ICMRevOffsetCRF.Rev_s16 /end MEASUREMENT
/begin MEASUREMENT AbsHwPos.ICMRevOffsetStatus.Cnt_u08 "MICROSAR RTE" UBYTE RTE_CM_ENUM_ST_OFFS_QUAD_EPS 0 0 0 15 ECU_ADDRESS 0 SYMBOL_LINK "Rte_SrlComInput2_SrlComRevOffsetSts_Cnt_u08" 0 DISPLAY_IDENTIFIER AbsHwPos.ReceiverPorts.ICMRevOffsetStatus.Cnt_u08 /end MEASUREMENT
/begin MEASUREMENT AbsHwPos.LTRckCntrComplete.Cnt_lgc "MICROSAR RTE" UBYTE RTE_CM_BOOLEAN 0 0 0 255 ECU_ADDRESS 0 SYMBOL_LINK "Rte_LnRkCr_LTRackCntrComplete_Cnt_lgc" 0 DISPLAY_IDENTIFIER AbsHwPos.ReceiverPorts.LTRckCntrComplete.Cnt_lgc /end MEASUREMENT
/begin MEASUREMENT AbsHwPos.LTVehCenterComplete.Cnt_lgc "MICROSAR RTE" UBYTE RTE_CM_BOOLEAN 0 0 0 255 ECU_ADDRESS 0 SYMBOL_LINK "Rte_AbsHwPos_LTVehCenterComplete_Cnt_lgc" 0 DISPLAY_IDENTIFIER AbsHwPos.SenderPorts.LTVehCenterComplete.Cnt_lgc /end MEASUREMENT
/begin MEASUREMENT AbsHwPos.Polarity.Cnt_s08 "MICROSAR RTE" SBYTE NO_COMPU_METHOD 0 0 -128 127 ECU_ADDRESS 0 SYMBOL_LINK "Rte_Polarity_AssistAssyPolarity_Cnt_s08" 0 DISPLAY_IDENTIFIER AbsHwPos.ReceiverPorts.Polarity.Cnt_s08 /end MEASUREMENT
/begin MEASUREMENT AbsHwPos.RackCenter.HwDeg_f32 "MICROSAR RTE" FLOAT32_IEEE NO_COMPU_METHOD 0 0 1.175494351e-38 3.402823466e+38 ECU_ADDRESS 0 SYMBOL_LINK "Rte_LnRkCr_RackCenter_HwDeg_f32" 0 DISPLAY_IDENTIFIER AbsHwPos.ReceiverPorts.RackCenter.HwDeg_f32 /end MEASUREMENT
/begin MEASUREMENT AbsHwPos.RacktoVehCntrOffset.Cnt_u16 "MICROSAR RTE" UWORD NO_COMPU_METHOD 0 0 0 65535 ECU_ADDRESS 0 SYMBOL_LINK "Rte_AbsHwPos_RacktoVehCntrOffset_Cnt_u16" 0 DISPLAY_IDENTIFIER AbsHwPos.SenderPorts.RacktoVehCntrOffset.Cnt_u16 /end MEASUREMENT
/begin MEASUREMENT AbsHwPos.RevOffsetState.Cnt_u08 "MICROSAR RTE" UBYTE NO_COMPU_METHOD 0 0 0 255 ECU_ADDRESS 0 SYMBOL_LINK "Rte_AbsHwPos_RevOffsetState_Cnt_u08" 0 DISPLAY_IDENTIFIER AbsHwPos.SenderPorts.RevOffsetState.Cnt_u08 /end MEASUREMENT
/begin MEASUREMENT AbsHwPos.SrlComHwPos.HwDeg_f32 "MICROSAR RTE" FLOAT32_IEEE NO_COMPU_METHOD 0 0 1.175494351e-38 3.402823466e+38 ECU_ADDRESS 0 SYMBOL_LINK "Rte_AbsHwPos_SrlComHwPos_HwDeg_f32" 0 DISPLAY_IDENTIFIER AbsHwPos.SenderPorts.SrlComHwPos.HwDeg_f32 /end MEASUREMENT
/begin MEASUREMENT AbsHwPos.TCMtrPosOffsMRF.Deg_f32 "MICROSAR RTE" FLOAT32_IEEE NO_COMPU_METHOD 0 0 1.175494351e-38 3.402823466e+38 ECU_ADDRESS 0 SYMBOL_LINK "Rte_TurnsCounter_TCMtrPosOffsMRF_Deg_f32" 0 DISPLAY_IDENTIFIER AbsHwPos.ReceiverPorts.TCMtrPosOffsMRF.Deg_f32 /end MEASUREMENT
/begin MEASUREMENT AbsHwPos.TorqueCmdCRF.MtrNm_f32 "MICROSAR RTE" FLOAT32_IEEE NO_COMPU_METHOD 0 0 1.175494351e-38 3.402823466e+38 ECU_ADDRESS 0 SYMBOL_LINK "Rte_CtrldDisShtdn_CntDisMtrTrqCmdCRF_MtrNm_f32" 0 DISPLAY_IDENTIFIER AbsHwPos.ReceiverPorts.TorqueCmdCRF.MtrNm_f32 /end MEASUREMENT
/begin MEASUREMENT AbsHwPos.Trim.LTVehCntrComplete "MICROSAR RTE" UBYTE RTE_CM_BOOLEAN 0 0 0 255 ECU_ADDRESS 0 SYMBOL_LINK "Rte_AbsHwPos_Trim.LTVehCntrComplete" 0 DISPLAY_IDENTIFIER AbsHwPos.PerInstanceMemories.Trim.LTVehCntrComplete READ_WRITE /end MEASUREMENT
/begin MEASUREMENT AbsHwPos.Trim.R_LTVehCntrComplete "MICROSAR RTE" UBYTE NO_COMPU_METHOD 0 0 0 255 ECU_ADDRESS 0 SYMBOL_LINK "Rte_AbsHwPos_Trim.R_LTVehCntrComplete" 0 DISPLAY_IDENTIFIER AbsHwPos.PerInstanceMemories.Trim.R_LTVehCntrComplete READ_WRITE /end MEASUREMENT
/begin MEASUREMENT AbsHwPos.Trim.R_RacktoVehCntrOffset "MICROSAR RTE" UWORD NO_COMPU_METHOD 0 0 0 65535 ECU_ADDRESS 0 SYMBOL_LINK "Rte_AbsHwPos_Trim.R_RacktoVehCntrOffset" 0 DISPLAY_IDENTIFIER AbsHwPos.PerInstanceMemories.Trim.R_RacktoVehCntrOffset READ_WRITE /end MEASUREMENT
/begin MEASUREMENT AbsHwPos.Trim.R_VehCntrOffset "MICROSAR RTE" ULONG NO_COMPU_METHOD 0 0 0 4294967295 ECU_ADDRESS 0 SYMBOL_LINK "Rte_AbsHwPos_Trim.R_VehCntrOffset" 0 DISPLAY_IDENTIFIER AbsHwPos.PerInstanceMemories.Trim.R_VehCntrOffset READ_WRITE /end MEASUREMENT
/begin MEASUREMENT AbsHwPos.Trim.RacktoVehCntrOffset "MICROSAR RTE" UWORD NO_COMPU_METHOD 0 0 0 65535 ECU_ADDRESS 0 SYMBOL_LINK "Rte_AbsHwPos_Trim.RacktoVehCntrOffset" 0 DISPLAY_IDENTIFIER AbsHwPos.PerInstanceMemories.Trim.RacktoVehCntrOffset READ_WRITE /end MEASUREMENT
/begin MEASUREMENT AbsHwPos.Trim.VehCntrOffset "MICROSAR RTE" FLOAT32_IEEE NO_COMPU_METHOD 0 0 1.175494351e-38 3.402823466e+38 ECU_ADDRESS 0 SYMBOL_LINK "Rte_AbsHwPos_Trim.VehCntrOffset" 0 DISPLAY_IDENTIFIER AbsHwPos.PerInstanceMemories.Trim.VehCntrOffset READ_WRITE /end MEASUREMENT
/begin MEASUREMENT AbsHwPos.TurnsCntrValidity.Cnt_enum "MICROSAR RTE" UBYTE RTE_CM_ENUM_TurnsCntrValStateType 0 0 0 255 ECU_ADDRESS 0 SYMBOL_LINK "Rte_TurnsCounter_TurnsCntrValidity_Cnt_enum" 0 DISPLAY_IDENTIFIER AbsHwPos.ReceiverPorts.TurnsCntrValidity.Cnt_enum /end MEASUREMENT
/begin MEASUREMENT AbsHwPos.VehicleSpeed.Kph_f32 "MICROSAR RTE" FLOAT32_IEEE NO_COMPU_METHOD 0 0 1.175494351e-38 3.402823466e+38 ECU_ADDRESS 0 SYMBOL_LINK "Rte_SignlCondn_VehicleSpeed_Kph_f32" 0 DISPLAY_IDENTIFIER AbsHwPos.ReceiverPorts.VehicleSpeed.Kph_f32 /end MEASUREMENT
/begin MEASUREMENT ActivePull.DisableLearning.Cnt_lgc "MICROSAR RTE" UBYTE RTE_CM_BOOLEAN 0 0 0 255 ECU_ADDRESS 0 SYMBOL_LINK "Rte_CDDInterface9_ActPullCompLrnSrlComSvcDft_Cnt_lgc" 0 DISPLAY_IDENTIFIER ActivePull.ReceiverPorts.DisableLearning.Cnt_lgc /end MEASUREMENT
/begin MEASUREMENT ActivePull.DisableOutput.Cnt_lgc "MICROSAR RTE" UBYTE RTE_CM_BOOLEAN 0 0 0 255 ECU_ADDRESS 0 SYMBOL_LINK "Rte_CDDInterface9_PullCompSrlComSvcDft_Cnt_lgc" 0 DISPLAY_IDENTIFIER ActivePull.ReceiverPorts.DisableOutput.Cnt_lgc /end MEASUREMENT
/begin MEASUREMENT ActivePull.EstLatAcc.MpSecSq_f32 "MICROSAR RTE" FLOAT32_IEEE NO_COMPU_METHOD 0 0 1.175494351e-38 3.402823466e+38 ECU_ADDRESS 0 SYMBOL_LINK "Rte_SignlCondn_EstimdLatAcce_MpSecSq_f32" 0 DISPLAY_IDENTIFIER ActivePull.ReceiverPorts.EstLatAcc.MpSecSq_f32 /end MEASUREMENT
/begin MEASUREMENT ActivePull.HandwheelAuthority.Uls_f32 "MICROSAR RTE" FLOAT32_IEEE NO_COMPU_METHOD 0 0 1.175494351e-38 3.402823466e+38 ECU_ADDRESS 0 SYMBOL_LINK "Rte_AbsHwPos_HandwheelAuthority_Uls_f32" 0 DISPLAY_IDENTIFIER ActivePull.ReceiverPorts.HandwheelAuthority.Uls_f32 /end MEASUREMENT
/begin MEASUREMENT ActivePull.HandwheelPosition.HwDeg_f32 "MICROSAR RTE" FLOAT32_IEEE NO_COMPU_METHOD 0 0 1.175494351e-38 3.402823466e+38 ECU_ADDRESS 0 SYMBOL_LINK "Rte_AbsHwPos_HandwheelPosition_HwDeg_f32" 0 DISPLAY_IDENTIFIER ActivePull.ReceiverPorts.HandwheelPosition.HwDeg_f32 /end MEASUREMENT
/begin MEASUREMENT ActivePull.HandwheelVelocity.HwRadpS_f32 "MICROSAR RTE" FLOAT32_IEEE NO_COMPU_METHOD 0 0 1.175494351e-38 3.402823466e+38 ECU_ADDRESS 0 SYMBOL_LINK "Rte_MtrVel_HandwheelVel_HwRadpS_f32" 0 DISPLAY_IDENTIFIER ActivePull.ReceiverPorts.HandwheelVelocity.HwRadpS_f32 /end MEASUREMENT
/begin MEASUREMENT ActivePull.HwTorque.HwNm_f32 "MICROSAR RTE" FLOAT32_IEEE NO_COMPU_METHOD 0 0 1.175494351e-38 3.402823466e+38 ECU_ADDRESS 0 SYMBOL_LINK "Rte_Sweep_OutputHwTrq_HwNm_f32" 0 DISPLAY_IDENTIFIER ActivePull.ReceiverPorts.HwTorque.HwNm_f32 /end MEASUREMENT
/begin MEASUREMENT ActivePull.PullCmpCustLrngDi.Cnt_lgc "MICROSAR RTE" UBYTE RTE_CM_BOOLEAN 0 0 0 255 ECU_ADDRESS 0 SYMBOL_LINK "Rte_ActivePull_PullCmpCustLrngDi_Cnt_lgc" 0 DISPLAY_IDENTIFIER ActivePull.ReceiverPorts.PullCmpCustLrngDi.Cnt_lgc /end MEASUREMENT
/begin MEASUREMENT ActivePull.PullCmpEna.Cnt_lgc "MICROSAR RTE" UBYTE RTE_CM_BOOLEAN 0 0 0 255 ECU_ADDRESS 0 SYMBOL_LINK "Rte_VehCfg_CPLCOMPIF_Cnt_lgc" 0 DISPLAY_IDENTIFIER ActivePull.ReceiverPorts.PullCmpEna.Cnt_lgc /end MEASUREMENT
/begin MEASUREMENT ActivePull.PullCmpLTComp_HwNm_f32 "MICROSAR RTE" FLOAT32_IEEE NO_COMPU_METHOD 0 0 1.175494351e-38 3.402823466e+38 ECU_ADDRESS 0 SYMBOL_LINK "Rte_ActivePull_PullCmpLTComp_HwNm_f32" 0 DISPLAY_IDENTIFIER ActivePull.PerInstanceMemories.PullCmpLTComp_HwNm_f32 READ_WRITE /end MEASUREMENT
/begin MEASUREMENT ActivePull.PullCmpLongTermIntgtrSt.HwNm_f32 "MICROSAR RTE" FLOAT32_IEEE NO_COMPU_METHOD 0 0 1.175494351e-38 3.402823466e+38 ECU_ADDRESS 0 SYMBOL_LINK "Rte_ActivePull_PullCmpLongTermIntgtrSt_HwNm_f32" 0 DISPLAY_IDENTIFIER ActivePull.SenderPorts.PullCmpLongTermIntgtrSt.HwNm_f32 /end MEASUREMENT
/begin MEASUREMENT ActivePull.PullCmpLongTermIntgtrStOffs.HwNm_f32 "MICROSAR RTE" FLOAT32_IEEE NO_COMPU_METHOD 0 0 1.175494351e-38 3.402823466e+38 ECU_ADDRESS 0 SYMBOL_LINK "Rte_ActivePull_PullCmpLongTermIntgtrStOffs_HwNm_f32" 0 DISPLAY_IDENTIFIER ActivePull.ReceiverPorts.PullCmpLongTermIntgtrStOffs.HwNm_f32 /end MEASUREMENT
/begin MEASUREMENT ActivePull.PullCmpShoTermIntgtrSt.HwNm_f32 "MICROSAR RTE" FLOAT32_IEEE NO_COMPU_METHOD 0 0 1.175494351e-38 3.402823466e+38 ECU_ADDRESS 0 SYMBOL_LINK "Rte_ActivePull_PullCmpShoTermIntgtrSt_HwNm_f32" 0 DISPLAY_IDENTIFIER ActivePull.SenderPorts.PullCmpShoTermIntgtrSt.HwNm_f32 /end MEASUREMENT
/begin MEASUREMENT ActivePull.PullCmpShoTermIntgtrStOffs.HwNm_f32 "MICROSAR RTE" FLOAT32_IEEE NO_COMPU_METHOD 0 0 1.175494351e-38 3.402823466e+38 ECU_ADDRESS 0 SYMBOL_LINK "Rte_ActivePull_PullCmpShoTermIntgtrStOffs_HwNm_f32" 0 DISPLAY_IDENTIFIER ActivePull.ReceiverPorts.PullCmpShoTermIntgtrStOffs.HwNm_f32 /end MEASUREMENT
/begin MEASUREMENT ActivePull.PullCompCmd.MtrNm_f32 "MICROSAR RTE" FLOAT32_IEEE NO_COMPU_METHOD 0 0 1.175494351e-38 3.402823466e+38 ECU_ADDRESS 0 SYMBOL_LINK "Rte_ActivePull_PullCompCmd_MtrNm_f32" 0 DISPLAY_IDENTIFIER ActivePull.SenderPorts.PullCompCmd.MtrNm_f32 /end MEASUREMENT
/begin MEASUREMENT ActivePull.SystemState.Mode "MICROSAR RTE" UBYTE RTE_CM_ENUM_StaMd_Mode 0 0 0 255 ECU_ADDRESS 0 SYMBOL_LINK "Rte_ModeMachine_StaMd9_SystemState9_Mode" 0 DISPLAY_IDENTIFIER ActivePull.ModeRequirePorts.SystemState.Mode /end MEASUREMENT
/begin MEASUREMENT ActivePull.VehicleSpeed.Kph_f32 "MICROSAR RTE" FLOAT32_IEEE NO_COMPU_METHOD 0 0 1.175494351e-38 3.402823466e+38 ECU_ADDRESS 0 SYMBOL_LINK "Rte_SignlCondn_VehicleSpeed_Kph_f32" 0 DISPLAY_IDENTIFIER ActivePull.ReceiverPorts.VehicleSpeed.Kph_f32 /end MEASUREMENT
/begin MEASUREMENT ActivePull.VehicleSpeedValid.Cnt_lgc "MICROSAR RTE" UBYTE RTE_CM_BOOLEAN 0 0 0 255 ECU_ADDRESS 0 SYMBOL_LINK "Rte_SignlCondn_VehicleSpeedValid_Cnt_lgc" 0 DISPLAY_IDENTIFIER ActivePull.ReceiverPorts.VehicleSpeedValid.Cnt_lgc /end MEASUREMENT
/begin MEASUREMENT ActivePull.VehicleYawRate.DegpS_f32 "MICROSAR RTE" FLOAT32_IEEE NO_COMPU_METHOD 0 0 1.175494351e-38 3.402823466e+38 ECU_ADDRESS 0 SYMBOL_LINK "Rte_SrlComInput2_SrlComVehYawRate_DegpS_f32" 0 DISPLAY_IDENTIFIER ActivePull.ReceiverPorts.VehicleYawRate.DegpS_f32 /end MEASUREMENT
/begin MEASUREMENT ApXcp.ActiveTunOvrPtrAddr.Cnt_u32 "MICROSAR RTE" ULONG NO_COMPU_METHOD 0 0 0 4294967295 ECU_ADDRESS 0 SYMBOL_LINK "Rte_ApXcp_ActiveTunOvrPtrAddr_Cnt_u32" 0 DISPLAY_IDENTIFIER ApXcp.SenderPorts.ActiveTunOvrPtrAddr.Cnt_u32 /end MEASUREMENT
/begin MEASUREMENT ApXcp.ActiveTunPers.Cnt_u16 "MICROSAR RTE" UWORD NO_COMPU_METHOD 0 0 0 65535 ECU_ADDRESS 0 SYMBOL_LINK "Rte_TuningSelAuth_ActiveTunPers_Cnt_u16" 0 DISPLAY_IDENTIFIER ApXcp.ReceiverPorts.ActiveTunPers.Cnt_u16 /end MEASUREMENT
/begin MEASUREMENT ApXcp.ActiveTunSet.Cnt_u16 "MICROSAR RTE" UWORD NO_COMPU_METHOD 0 0 0 65535 ECU_ADDRESS 0 SYMBOL_LINK "Rte_TuningSelAuth_ActiveTunSet_Cnt_u16" 0 DISPLAY_IDENTIFIER ApXcp.ReceiverPorts.ActiveTunSet.Cnt_u16 /end MEASUREMENT
/begin MEASUREMENT ApXcp.DesiredTunPers.Cnt_u16 "MICROSAR RTE" UWORD NO_COMPU_METHOD 0 0 0 65535 ECU_ADDRESS 0 SYMBOL_LINK "Rte_VehCfg_DesiredTunPers_Cnt_u16" 0 DISPLAY_IDENTIFIER ApXcp.ReceiverPorts.DesiredTunPers.Cnt_u16 /end MEASUREMENT
/begin MEASUREMENT ApXcp.DesiredTunSet.Cnt_u16 "MICROSAR RTE" UWORD NO_COMPU_METHOD 0 0 0 65535 ECU_ADDRESS 0 SYMBOL_LINK "Rte_VehCfg_DesiredTunSet_Cnt_u16" 0 DISPLAY_IDENTIFIER ApXcp.ReceiverPorts.DesiredTunSet.Cnt_u16 /end MEASUREMENT
/begin MEASUREMENT ApXcp.TuningSessionActPtr.Cnt_u8 "MICROSAR RTE" UBYTE RTE_CM_ENUM_TuningSessionAddrPtrEnum 0 0 0 255 ECU_ADDRESS 0 SYMBOL_LINK "Rte_ApXcp_TuningSessionActPtr_Cnt_u8" 0 DISPLAY_IDENTIFIER ApXcp.SenderPorts.TuningSessionActPtr.Cnt_u8 /end MEASUREMENT
/begin MEASUREMENT Ap_BmwTqOvrlCdng.DrvDynActive.Cnt_lgc "MICROSAR RTE" UBYTE RTE_CM_BOOLEAN 0 0 0 255 ECU_ADDRESS 0 SYMBOL_LINK "Rte_DrvDynamicsEnable_DrvDynActive_Cnt_lgc" 0 DISPLAY_IDENTIFIER Ap_BmwTqOvrlCdng.ReceiverPorts.DrvDynActive.Cnt_lgc /end MEASUREMENT
/begin MEASUREMENT Ap_BmwTqOvrlCdng.DrvgDynErrIfActv.Cnt_lgc "MICROSAR RTE" UBYTE RTE_CM_BOOLEAN 0 0 0 255 ECU_ADDRESS 0 SYMBOL_LINK "Rte_SrlComInput2_SrlComDrvDynInvalid_Cnt_lgc" 0 DISPLAY_IDENTIFIER Ap_BmwTqOvrlCdng.ReceiverPorts.DrvgDynErrIfActv.Cnt_lgc /end MEASUREMENT
/begin MEASUREMENT Ap_BmwTqOvrlCdng.DrvgDynIfSt.Cnt_u08 "MICROSAR RTE" UBYTE RTE_CM_ENUM_QU_SER_STMOM_STMOM_DV_ACT 0 0 0 255 ECU_ADDRESS 0 SYMBOL_LINK "Rte_DrvDynamicsEnable_DrvDynInterfaceState_Cnt_u08" 0 DISPLAY_IDENTIFIER Ap_BmwTqOvrlCdng.ReceiverPorts.DrvgDynIfSt.Cnt_u08 /end MEASUREMENT
/begin MEASUREMENT Ap_BmwTqOvrlCdng.OpTrqOvRmpInEnable.Cnt_lgc "MICROSAR RTE" UBYTE RTE_CM_BOOLEAN 0 0 0 255 ECU_ADDRESS 0 SYMBOL_LINK "Rte_DrvDynamicsEnable_OpTrqOvRmpInEnable_Cnt_lgc" 0 DISPLAY_IDENTIFIER Ap_BmwTqOvrlCdng.ReceiverPorts.OpTrqOvRmpInEnable.Cnt_lgc /end MEASUREMENT
/begin MEASUREMENT Ap_BmwTqOvrlCdng.OutpTqOvrl.MtrNm_f32 "MICROSAR RTE" FLOAT32_IEEE NO_COMPU_METHOD 0 0 1.175494351e-38 3.402823466e+38 ECU_ADDRESS 0 SYMBOL_LINK "Rte_Ap_BmwTqOvrlCdng_OutpTqOvrl_MtrNm_f32" 0 DISPLAY_IDENTIFIER Ap_BmwTqOvrlCdng.SenderPorts.OutpTqOvrl.MtrNm_f32 /end MEASUREMENT
/begin MEASUREMENT Ap_BmwTqOvrlCdng.SerlComTarSteerTqDrvrActr.MtrNm_f32 "MICROSAR RTE" FLOAT32_IEEE NO_COMPU_METHOD 0 0 1.175494351e-38 3.402823466e+38 ECU_ADDRESS 0 SYMBOL_LINK "Rte_SrlComInput2_SerlComTarSteerTqDrvrActr_MtrNm_f32" 0 DISPLAY_IDENTIFIER Ap_BmwTqOvrlCdng.ReceiverPorts.SerlComTarSteerTqDrvrActr.MtrNm_f32 /end MEASUREMENT
/begin MEASUREMENT Ap_BmwTqOvrlCdng.VehicleSpeed.Kph_f32 "MICROSAR RTE" FLOAT32_IEEE NO_COMPU_METHOD 0 0 1.175494351e-38 3.402823466e+38 ECU_ADDRESS 0 SYMBOL_LINK "Rte_SignlCondn_VehicleSpeed_Kph_f32" 0 DISPLAY_IDENTIFIER Ap_BmwTqOvrlCdng.ReceiverPorts.VehicleSpeed.Kph_f32 /end MEASUREMENT
/begin MEASUREMENT Ap_TJADamp.CustomDamp.MtrNm_f32 "MICROSAR RTE" FLOAT32_IEEE NO_COMPU_METHOD 0 0 1.175494351e-38 3.402823466e+38 ECU_ADDRESS 0 SYMBOL_LINK "Rte_Ap_TJADamp_CustomDamp_MtrNm_f32" 0 DISPLAY_IDENTIFIER Ap_TJADamp.SenderPorts.CustomDamp.MtrNm_f32 /end MEASUREMENT
/begin MEASUREMENT Ap_TJADamp.MtrVelCRF.MtrRadpS_f32 "MICROSAR RTE" FLOAT32_IEEE NO_COMPU_METHOD 0 0 1.175494351e-38 3.402823466e+38 ECU_ADDRESS 0 SYMBOL_LINK "Rte_MtrVel_CRFMotorVel_MtrRadpS_f32" 0 DISPLAY_IDENTIFIER Ap_TJADamp.ReceiverPorts.MtrVelCRF.MtrRadpS_f32 /end MEASUREMENT
/begin MEASUREMENT Ap_TJADamp.TJADampSclRqst.Uls_f32 "MICROSAR RTE" FLOAT32_IEEE NO_COMPU_METHOD 0 0 1.175494351e-38 3.402823466e+38 ECU_ADDRESS 0 SYMBOL_LINK "Rte_SrlComInput2_TJADampSclRqst_Uls_f32" 0 DISPLAY_IDENTIFIER Ap_TJADamp.ReceiverPorts.TJADampSclRqst.Uls_f32 /end MEASUREMENT
/begin MEASUREMENT Ap_TJADamp.VehicleSpeed.Kph_f32 "MICROSAR RTE" FLOAT32_IEEE NO_COMPU_METHOD 0 0 1.175494351e-38 3.402823466e+38 ECU_ADDRESS 0 SYMBOL_LINK "Rte_SignlCondn_VehicleSpeed_Kph_f32" 0 DISPLAY_IDENTIFIER Ap_TJADamp.ReceiverPorts.VehicleSpeed.Kph_f32 /end MEASUREMENT
/begin MEASUREMENT Assist.AssistDDFactor.Uls_f32 "MICROSAR RTE" FLOAT32_IEEE NO_COMPU_METHOD 0 0 1.175494351e-38 3.402823466e+38 ECU_ADDRESS 0 SYMBOL_LINK "Rte_DrvDynCtrl_AssistDDFactor_Uls_f32" 0 DISPLAY_IDENTIFIER Assist.ReceiverPorts.AssistDDFactor.Uls_f32 /end MEASUREMENT
/begin MEASUREMENT Assist.BaseAssistCmd.MtrNm_f32 "MICROSAR RTE" FLOAT32_IEEE NO_COMPU_METHOD 0 0 1.175494351e-38 3.402823466e+38 ECU_ADDRESS 0 SYMBOL_LINK "Rte_Assist_BaseAssistCmd_MtrNm_f32" 0 DISPLAY_IDENTIFIER Assist.SenderPorts.BaseAssistCmd.MtrNm_f32 /end MEASUREMENT
/begin MEASUREMENT Assist.DftAsstTbl.Cnt_lgc "MICROSAR RTE" UBYTE RTE_CM_BOOLEAN 0 0 0 255 ECU_ADDRESS 0 SYMBOL_LINK "Rte_CDDInterface9_DftAsstTbl_Cnt_lgc" 0 DISPLAY_IDENTIFIER Assist.ReceiverPorts.DftAsstTbl.Cnt_lgc /end MEASUREMENT
/begin MEASUREMENT Assist.DutyCycleLevel.Uls_f32 "MICROSAR RTE" FLOAT32_IEEE NO_COMPU_METHOD 0 0 1.175494351e-38 3.402823466e+38 ECU_ADDRESS 0 SYMBOL_LINK "Rte_ThrmlDutyCycle_DutyCycleLevel_Uls_f32" 0 DISPLAY_IDENTIFIER Assist.ReceiverPorts.DutyCycleLevel.Uls_f32 /end MEASUREMENT
/begin MEASUREMENT Assist.DwnldAsstGain.Uls_f32 "MICROSAR RTE" FLOAT32_IEEE NO_COMPU_METHOD 0 0 1.175494351e-38 3.402823466e+38 ECU_ADDRESS 0 SYMBOL_LINK "Rte_CDDInterface9_DwnldAsstGain_Uls_f32" 0 DISPLAY_IDENTIFIER Assist.ReceiverPorts.DwnldAsstGain.Uls_f32 /end MEASUREMENT
/begin MEASUREMENT Assist.HwTrq.HwNm_f32 "MICROSAR RTE" FLOAT32_IEEE NO_COMPU_METHOD 0 0 1.175494351e-38 3.402823466e+38 ECU_ADDRESS 0 SYMBOL_LINK "Rte_Sweep_OutputHwTrq_HwNm_f32" 0 DISPLAY_IDENTIFIER Assist.ReceiverPorts.HwTrq.HwNm_f32 /end MEASUREMENT
/begin MEASUREMENT Assist.HwTrqHysAdd.HwNm_f32 "MICROSAR RTE" FLOAT32_IEEE NO_COMPU_METHOD 0 0 1.175494351e-38 3.402823466e+38 ECU_ADDRESS 0 SYMBOL_LINK "Rte_HystAdd_HysAddHwTrq_HwNm_f32" 0 DISPLAY_IDENTIFIER Assist.ReceiverPorts.HwTrqHysAdd.HwNm_f32 /end MEASUREMENT
/begin MEASUREMENT Assist.IpTrqOvr.HwNm_f32 "MICROSAR RTE" FLOAT32_IEEE NO_COMPU_METHOD 0 0 1.175494351e-38 3.402823466e+38 ECU_ADDRESS 0 SYMBOL_LINK "Rte_Assist_IpTrqOvr_HwNm_f32" 0 DISPLAY_IDENTIFIER Assist.ReceiverPorts.IpTrqOvr.HwNm_f32 /end MEASUREMENT
/begin MEASUREMENT Assist.VehSpd.Kph_f32 "MICROSAR RTE" FLOAT32_IEEE NO_COMPU_METHOD 0 0 1.175494351e-38 3.402823466e+38 ECU_ADDRESS 0 SYMBOL_LINK "Rte_SignlCondn_VehicleSpeed_Kph_f32" 0 DISPLAY_IDENTIFIER Assist.ReceiverPorts.VehSpd.Kph_f32 /end MEASUREMENT
/begin MEASUREMENT Assist.WIRCmdAmpBlnd.MtrNm_f32 "MICROSAR RTE" FLOAT32_IEEE NO_COMPU_METHOD 0 0 1.175494351e-38 3.402823466e+38 ECU_ADDRESS 0 SYMBOL_LINK "Rte_Assist_WIRCmdAmpBlnd_MtrNm_f32" 0 DISPLAY_IDENTIFIER Assist.ReceiverPorts.WIRCmdAmpBlnd.MtrNm_f32 /end MEASUREMENT
/begin MEASUREMENT AssistFirewall.AsstFirewallActive.Uls_f32 "MICROSAR RTE" FLOAT32_IEEE NO_COMPU_METHOD 0 0 1.175494351e-38 3.402823466e+38 ECU_ADDRESS 0 SYMBOL_LINK "Rte_AssistFirewall_AsstFirewallActive_Uls_f32" 0 DISPLAY_IDENTIFIER AssistFirewall.SenderPorts.AsstFirewallActive.Uls_f32 /end MEASUREMENT
/begin MEASUREMENT AssistFirewall.BaseAssistCmd.MtrNm_f32 "MICROSAR RTE" FLOAT32_IEEE NO_COMPU_METHOD 0 0 1.175494351e-38 3.402823466e+38 ECU_ADDRESS 0 SYMBOL_LINK "Rte_Assist_BaseAssistCmd_MtrNm_f32" 0 DISPLAY_IDENTIFIER AssistFirewall.ReceiverPorts.BaseAssistCmd.MtrNm_f32 /end MEASUREMENT
/begin MEASUREMENT AssistFirewall.CombinedAssist.MtrNm_f32 "MICROSAR RTE" FLOAT32_IEEE NO_COMPU_METHOD 0 0 1.175494351e-38 3.402823466e+38 ECU_ADDRESS 0 SYMBOL_LINK "Rte_AssistFirewall_CombinedAssist_MtrNm_f32" 0 DISPLAY_IDENTIFIER AssistFirewall.SenderPorts.CombinedAssist.MtrNm_f32 /end MEASUREMENT
/begin MEASUREMENT AssistFirewall.Defeat_AsstTbl_Service.Cnt_lgc "MICROSAR RTE" UBYTE RTE_CM_BOOLEAN 0 0 0 255 ECU_ADDRESS 0 SYMBOL_LINK "Rte_CDDInterface9_FirewallSrlComSrvDft_Cnt_lgc" 0 DISPLAY_IDENTIFIER AssistFirewall.ReceiverPorts.Defeat_AsstTbl_Service.Cnt_lgc /end MEASUREMENT
/begin MEASUREMENT AssistFirewall.HighFreqAssist.MtrNm_f32 "MICROSAR RTE" FLOAT32_IEEE NO_COMPU_METHOD 0 0 1.175494351e-38 3.402823466e+38 ECU_ADDRESS 0 SYMBOL_LINK "Rte_TrqBasedInrtCmp_HighFreqAssist_MtrNm_f32" 0 DISPLAY_IDENTIFIER AssistFirewall.ReceiverPorts.HighFreqAssist.MtrNm_f32 /end MEASUREMENT
/begin MEASUREMENT AssistFirewall.HwTorque.HwNm_f32 "MICROSAR RTE" FLOAT32_IEEE NO_COMPU_METHOD 0 0 1.175494351e-38 3.402823466e+38 ECU_ADDRESS 0 SYMBOL_LINK "Rte_Sweep_OutputHwTrq_HwNm_f32" 0 DISPLAY_IDENTIFIER AssistFirewall.ReceiverPorts.HwTorque.HwNm_f32 /end MEASUREMENT
/begin MEASUREMENT AssistFirewall.HysteresisComp.MtrNm_f32 "MICROSAR RTE" FLOAT32_IEEE NO_COMPU_METHOD 0 0 1.175494351e-38 3.402823466e+38 ECU_ADDRESS 0 SYMBOL_LINK "Rte_HystComp_HysteresisComp_MtrNm_f32" 0 DISPLAY_IDENTIFIER AssistFirewall.ReceiverPorts.HysteresisComp.MtrNm_f32 /end MEASUREMENT
/begin MEASUREMENT AssistFirewall.MEC_Counter.Cnt_enum "MICROSAR RTE" UBYTE RTE_CM_ENUM_ManufModeType 0 0 0 2 ECU_ADDRESS 0 SYMBOL_LINK "Rte_CDDInterface9_NxtrMEC_Cnt_enum" 0 DISPLAY_IDENTIFIER AssistFirewall.ReceiverPorts.MEC_Counter.Cnt_enum /end MEASUREMENT
/begin MEASUREMENT AssistFirewall.SystemState.Mode "MICROSAR RTE" UBYTE RTE_CM_ENUM_StaMd_Mode 0 0 0 255 ECU_ADDRESS 0 SYMBOL_LINK "Rte_ModeMachine_StaMd_SystemState_Mode" 0 DISPLAY_IDENTIFIER AssistFirewall.ModeRequirePorts.SystemState.Mode /end MEASUREMENT
/begin MEASUREMENT AssistFirewall.VehicleSpeed.Kph_f32 "MICROSAR RTE" FLOAT32_IEEE NO_COMPU_METHOD 0 0 1.175494351e-38 3.402823466e+38 ECU_ADDRESS 0 SYMBOL_LINK "Rte_SignlCondn_VehicleSpeed_Kph_f32" 0 DISPLAY_IDENTIFIER AssistFirewall.ReceiverPorts.VehicleSpeed.Kph_f32 /end MEASUREMENT
/begin MEASUREMENT AssistSumnLmt.AssistCmd.MtrNm_f32 "MICROSAR RTE" FLOAT32_IEEE NO_COMPU_METHOD 0 0 1.175494351e-38 3.402823466e+38 ECU_ADDRESS 0 SYMBOL_LINK "Rte_StabilityComp_AssistCmd_MtrNm_f32" 0 DISPLAY_IDENTIFIER AssistSumnLmt.ReceiverPorts.AssistCmd.MtrNm_f32 /end MEASUREMENT
/begin MEASUREMENT AssistSumnLmt.AssistPowerLimit.MtrNm_f32 "MICROSAR RTE" FLOAT32_IEEE NO_COMPU_METHOD 0 0 1.175494351e-38 3.402823466e+38 ECU_ADDRESS 0 SYMBOL_LINK "Rte_PwrLmtFunc_AssistPowerLimit_MtrNm_f32" 0 DISPLAY_IDENTIFIER AssistSumnLmt.ReceiverPorts.AssistPowerLimit.MtrNm_f32 /end MEASUREMENT
/begin MEASUREMENT AssistSumnLmt.CombinedDamping.MtrNm_f32 "MICROSAR RTE" FLOAT32_IEEE NO_COMPU_METHOD 0 0 1.175494351e-38 3.402823466e+38 ECU_ADDRESS 0 SYMBOL_LINK "Rte_DampingFirewall_CombinedDamping_MtrNm_f32" 0 DISPLAY_IDENTIFIER AssistSumnLmt.ReceiverPorts.CombinedDamping.MtrNm_f32 /end MEASUREMENT
/begin MEASUREMENT AssistSumnLmt.DefeatLimitService.Cnt_lgc "MICROSAR RTE" UBYTE RTE_CM_BOOLEAN 0 0 0 255 ECU_ADDRESS 0 SYMBOL_LINK "Rte_CDDInterface9_LimitSrlComSvcDft_Cnt_lgc" 0 DISPLAY_IDENTIFIER AssistSumnLmt.ReceiverPorts.DefeatLimitService.Cnt_lgc /end MEASUREMENT
/begin MEASUREMENT AssistSumnLmt.EOTDampingLtd.MtrNm_f32 "MICROSAR RTE" FLOAT32_IEEE NO_COMPU_METHOD 0 0 1.175494351e-38 3.402823466e+38 ECU_ADDRESS 0 SYMBOL_LINK "Rte_EtDmpFw_EOTDampingLtd_MtrNm_f32" 0 DISPLAY_IDENTIFIER AssistSumnLmt.ReceiverPorts.EOTDampingLtd.MtrNm_f32 /end MEASUREMENT
/begin MEASUREMENT AssistSumnLmt.EOTGainLtd.Uls_f32 "MICROSAR RTE" FLOAT32_IEEE NO_COMPU_METHOD 0 0 1.175494351e-38 3.402823466e+38 ECU_ADDRESS 0 SYMBOL_LINK "Rte_LmtCod_EOTGainLtd_Uls_f32" 0 DISPLAY_IDENTIFIER AssistSumnLmt.ReceiverPorts.EOTGainLtd.Uls_f32 /end MEASUREMENT
/begin MEASUREMENT AssistSumnLmt.EOTLimitLtd.MtrNm_f32 "MICROSAR RTE" FLOAT32_IEEE NO_COMPU_METHOD 0 0 1.175494351e-38 3.402823466e+38 ECU_ADDRESS 0 SYMBOL_LINK "Rte_LmtCod_EOTLimitLtd_MtrNm_f32" 0 DISPLAY_IDENTIFIER AssistSumnLmt.ReceiverPorts.EOTLimitLtd.MtrNm_f32 /end MEASUREMENT
/begin MEASUREMENT AssistSumnLmt.LimitPercentFiltered.Uls_f32 "MICROSAR RTE" FLOAT32_IEEE NO_COMPU_METHOD 0 0 1.175494351e-38 3.402823466e+38 ECU_ADDRESS 0 SYMBOL_LINK "Rte_AssistSumnLmt_LimitPercentFiltered_Uls_f32" 0 DISPLAY_IDENTIFIER AssistSumnLmt.SenderPorts.LimitPercentFiltered.Uls_f32 /end MEASUREMENT
/begin MEASUREMENT AssistSumnLmt.LimitedReturn.MtrNm_f32 "MICROSAR RTE" FLOAT32_IEEE NO_COMPU_METHOD 0 0 1.175494351e-38 3.402823466e+38 ECU_ADDRESS 0 SYMBOL_LINK "Rte_ReturnFirewall_LimitedReturn_MtrNm_f32" 0 DISPLAY_IDENTIFIER AssistSumnLmt.ReceiverPorts.LimitedReturn.MtrNm_f32 /end MEASUREMENT
/begin MEASUREMENT AssistSumnLmt.LrnPnCtrDisable.Cnt_lgc "MICROSAR RTE" UBYTE RTE_CM_BOOLEAN 0 0 0 255 ECU_ADDRESS 0 SYMBOL_LINK "Rte_PrkAstMfgServCh2_SysCLnPnCtrCCDisable_Cnt_lgc" 0 DISPLAY_IDENTIFIER AssistSumnLmt.ReceiverPorts.LrnPnCtrDisable.Cnt_lgc /end MEASUREMENT
/begin MEASUREMENT AssistSumnLmt.LrnPnCtrEnable.Cnt_lgc "MICROSAR RTE" UBYTE RTE_CM_BOOLEAN 0 0 0 255 ECU_ADDRESS 0 SYMBOL_LINK "Rte_CDDInterface9_LrnPnCenterEnable_Cnt_lgc" 0 DISPLAY_IDENTIFIER AssistSumnLmt.ReceiverPorts.LrnPnCtrEnable.Cnt_lgc /end MEASUREMENT
/begin MEASUREMENT AssistSumnLmt.LrnPnCtrTCmd.MtrNm_f32 "MICROSAR RTE" FLOAT32_IEEE NO_COMPU_METHOD 0 0 1.175494351e-38 3.402823466e+38 ECU_ADDRESS 0 SYMBOL_LINK "Rte_LktoLkStr_LrnPnCntrCmd_MtrNm_f32" 0 DISPLAY_IDENTIFIER AssistSumnLmt.ReceiverPorts.LrnPnCtrTCmd.MtrNm_f32 /end MEASUREMENT
/begin MEASUREMENT AssistSumnLmt.OutpTqOvrl.MtrNm_f32 "MICROSAR RTE" FLOAT32_IEEE NO_COMPU_METHOD 0 0 1.175494351e-38 3.402823466e+38 ECU_ADDRESS 0 SYMBOL_LINK "Rte_Ap_BmwTqOvrlCdng_OutpTqOvrl_MtrNm_f32" 0 DISPLAY_IDENTIFIER AssistSumnLmt.ReceiverPorts.OutpTqOvrl.MtrNm_f32 /end MEASUREMENT
/begin MEASUREMENT AssistSumnLmt.OutputRampMultLtd.Uls_f32 "MICROSAR RTE" FLOAT32_IEEE NO_COMPU_METHOD 0 0 1.175494351e-38 3.402823466e+38 ECU_ADDRESS 0 SYMBOL_LINK "Rte_LmtCod_OutputRampMultLtd_Uls_f32" 0 DISPLAY_IDENTIFIER AssistSumnLmt.ReceiverPorts.OutputRampMultLtd.Uls_f32 /end MEASUREMENT
/begin MEASUREMENT AssistSumnLmt.PostLimitTorque.MtrNm_f32 "MICROSAR RTE" FLOAT32_IEEE NO_COMPU_METHOD 0 0 1.175494351e-38 3.402823466e+38 ECU_ADDRESS 0 SYMBOL_LINK "Rte_AssistSumnLmt_PostLimitTorque_MtrNm_f32" 0 DISPLAY_IDENTIFIER AssistSumnLmt.SenderPorts.PostLimitTorque.MtrNm_f32 /end MEASUREMENT
/begin MEASUREMENT AssistSumnLmt.PowerLimitPerc.Uls_f32 "MICROSAR RTE" FLOAT32_IEEE NO_COMPU_METHOD 0 0 1.175494351e-38 3.402823466e+38 ECU_ADDRESS 0 SYMBOL_LINK "Rte_PwrLmtFunc_PowerLimitPerc_Uls_f32" 0 DISPLAY_IDENTIFIER AssistSumnLmt.ReceiverPorts.PowerLimitPerc.Uls_f32 /end MEASUREMENT
/begin MEASUREMENT AssistSumnLmt.PreLimitForPower.MtrNm_f32 "MICROSAR RTE" FLOAT32_IEEE NO_COMPU_METHOD 0 0 1.175494351e-38 3.402823466e+38 ECU_ADDRESS 0 SYMBOL_LINK "Rte_AssistSumnLmt_PreLimitForPower_MtrNm_f32" 0 DISPLAY_IDENTIFIER AssistSumnLmt.SenderPorts.PreLimitForPower.MtrNm_f32 /end MEASUREMENT
/begin MEASUREMENT AssistSumnLmt.PreLimitForStall.MtrNm_f32 "MICROSAR RTE" FLOAT32_IEEE NO_COMPU_METHOD 0 0 1.175494351e-38 3.402823466e+38 ECU_ADDRESS 0 SYMBOL_LINK "Rte_AssistSumnLmt_PreLimitForStall_MtrNm_f32" 0 DISPLAY_IDENTIFIER AssistSumnLmt.SenderPorts.PreLimitForStall.MtrNm_f32 /end MEASUREMENT
/begin MEASUREMENT AssistSumnLmt.PreLimitTorque.MtrNm_f32 "MICROSAR RTE" FLOAT32_IEEE NO_COMPU_METHOD 0 0 1.175494351e-38 3.402823466e+38 ECU_ADDRESS 0 SYMBOL_LINK "Rte_AssistSumnLmt_PreLimitTorque_MtrNm_f32" 0 DISPLAY_IDENTIFIER AssistSumnLmt.SenderPorts.PreLimitTorque.MtrNm_f32 /end MEASUREMENT
/begin MEASUREMENT AssistSumnLmt.PrkAssistCmd.MtrNm_f32 "MICROSAR RTE" FLOAT32_IEEE NO_COMPU_METHOD 0 0 1.175494351e-38 3.402823466e+38 ECU_ADDRESS 0 SYMBOL_LINK "Rte_PosServo_PosSrvoCmd_MtrNm_f32" 0 DISPLAY_IDENTIFIER AssistSumnLmt.ReceiverPorts.PrkAssistCmd.MtrNm_f32 /end MEASUREMENT
/begin MEASUREMENT AssistSumnLmt.PrkAssistDisable.Cnt_lgc "MICROSAR RTE" UBYTE RTE_CM_BOOLEAN 0 0 0 255 ECU_ADDRESS 0 SYMBOL_LINK "Rte_PrkAstMfgServCh2_SysCPosServCCDisable_Cnt_lgc" 0 DISPLAY_IDENTIFIER AssistSumnLmt.ReceiverPorts.PrkAssistDisable.Cnt_lgc /end MEASUREMENT
/begin MEASUREMENT AssistSumnLmt.PullCompCmd.MtrNm_f32 "MICROSAR RTE" FLOAT32_IEEE NO_COMPU_METHOD 0 0 1.175494351e-38 3.402823466e+38 ECU_ADDRESS 0 SYMBOL_LINK "Rte_ActivePull_PullCompCmd_MtrNm_f32" 0 DISPLAY_IDENTIFIER AssistSumnLmt.ReceiverPorts.PullCompCmd.MtrNm_f32 /end MEASUREMENT
/begin MEASUREMENT AssistSumnLmt.StallLimitLtd.MtrNm_f32 "MICROSAR RTE" FLOAT32_IEEE NO_COMPU_METHOD 0 0 1.175494351e-38 3.402823466e+38 ECU_ADDRESS 0 SYMBOL_LINK "Rte_LmtCod_StallLimitLtd_MtrNm_f32" 0 DISPLAY_IDENTIFIER AssistSumnLmt.ReceiverPorts.StallLimitLtd.MtrNm_f32 /end MEASUREMENT
/begin MEASUREMENT AssistSumnLmt.SystemState.Mode "MICROSAR RTE" UBYTE RTE_CM_ENUM_StaMd_Mode 0 0 0 255 ECU_ADDRESS 0 SYMBOL_LINK "Rte_ModeMachine_StaMd_SystemState_Mode" 0 DISPLAY_IDENTIFIER AssistSumnLmt.ModeRequirePorts.SystemState.Mode /end MEASUREMENT
/begin MEASUREMENT AssistSumnLmt.ThermLimitPerc.Uls_f32 "MICROSAR RTE" FLOAT32_IEEE NO_COMPU_METHOD 0 0 1.175494351e-38 3.402823466e+38 ECU_ADDRESS 0 SYMBOL_LINK "Rte_ThrmlDutyCycle_ThermLimitPerc_Uls_f32" 0 DISPLAY_IDENTIFIER AssistSumnLmt.ReceiverPorts.ThermLimitPerc.Uls_f32 /end MEASUREMENT
/begin MEASUREMENT AssistSumnLmt.ThermalLimitLtd.MtrNm_f32 "MICROSAR RTE" FLOAT32_IEEE NO_COMPU_METHOD 0 0 1.175494351e-38 3.402823466e+38 ECU_ADDRESS 0 SYMBOL_LINK "Rte_LmtCod_ThermalLimitLtd_MtrNm_f32" 0 DISPLAY_IDENTIFIER AssistSumnLmt.ReceiverPorts.ThermalLimitLtd.MtrNm_f32 /end MEASUREMENT
/begin MEASUREMENT AssistSumnLmt.TrqOscCmd.MtrNm_f32 "MICROSAR RTE" FLOAT32_IEEE NO_COMPU_METHOD 0 0 1.175494351e-38 3.402823466e+38 ECU_ADDRESS 0 SYMBOL_LINK "Rte_TrqOsc_TrqOscCmd_MtrNm_f32" 0 DISPLAY_IDENTIFIER AssistSumnLmt.ReceiverPorts.TrqOscCmd.MtrNm_f32 /end MEASUREMENT
/begin MEASUREMENT AssistSumnLmt.VehSpdLimitLtd.MtrNm_f32 "MICROSAR RTE" FLOAT32_IEEE NO_COMPU_METHOD 0 0 1.175494351e-38 3.402823466e+38 ECU_ADDRESS 0 SYMBOL_LINK "Rte_LmtCod_VehSpdLimitLtd_MtrNm_f32" 0 DISPLAY_IDENTIFIER AssistSumnLmt.ReceiverPorts.VehSpdLimitLtd.MtrNm_f32 /end MEASUREMENT
/begin MEASUREMENT AssistSumnLmt.VehicleSpeed.Kph_f32 "MICROSAR RTE" FLOAT32_IEEE NO_COMPU_METHOD 0 0 1.175494351e-38 3.402823466e+38 ECU_ADDRESS 0 SYMBOL_LINK "Rte_SignlCondn_VehicleSpeed_Kph_f32" 0 DISPLAY_IDENTIFIER AssistSumnLmt.ReceiverPorts.VehicleSpeed.Kph_f32 /end MEASUREMENT
/begin MEASUREMENT AssistSumnLmt.WhlImbRejCmd.MtrNm_f32 "MICROSAR RTE" FLOAT32_IEEE NO_COMPU_METHOD 0 0 1.175494351e-38 3.402823466e+38 ECU_ADDRESS 0 SYMBOL_LINK "Rte_AssistSumnLmt_WhlImbRejCmd_MtrNm_f32" 0 DISPLAY_IDENTIFIER AssistSumnLmt.ReceiverPorts.WhlImbRejCmd.MtrNm_f32 /end MEASUREMENT
/begin MEASUREMENT AvgFricLrn.AvgFricLrnData.EOLFric_HwNm_f32 "MICROSAR RTE" FLOAT32_IEEE NO_COMPU_METHOD 0 0 1.175494351e-38 3.402823466e+38 ECU_ADDRESS 0 SYMBOL_LINK "Rte_AvgFricLrn_AvgFricLrnData.EOLFric_HwNm_f32" 0 DISPLAY_IDENTIFIER AvgFricLrn.PerInstanceMemories.AvgFricLrnData.EOLFric_HwNm_f32 READ_WRITE /end MEASUREMENT
/begin MEASUREMENT AvgFricLrn.AvgFricLrnData.EnableFricLearning_Cnt_lgc "MICROSAR RTE" UBYTE RTE_CM_BOOLEAN 0 0 0 255 ECU_ADDRESS 0 SYMBOL_LINK "Rte_AvgFricLrn_AvgFricLrnData.EnableFricLearning_Cnt_lgc" 0 DISPLAY_IDENTIFIER AvgFricLrn.PerInstanceMemories.AvgFricLrnData.EnableFricLearning_Cnt_lgc READ_WRITE /end MEASUREMENT
/begin MEASUREMENT AvgFricLrn.AvgFricLrnData.EnableFricOffsetOutput_Cnt_lgc "MICROSAR RTE" UBYTE RTE_CM_BOOLEAN 0 0 0 255 ECU_ADDRESS 0 SYMBOL_LINK "Rte_AvgFricLrn_AvgFricLrnData.EnableFricOffsetOutput_Cnt_lgc" 0 DISPLAY_IDENTIFIER AvgFricLrn.PerInstanceMemories.AvgFricLrnData.EnableFricOffsetOutput_Cnt_lgc READ_WRITE /end MEASUREMENT
/begin MEASUREMENT AvgFricLrn.AvgFricLrnData.FricOffset_HwNm_f32 "MICROSAR RTE" FLOAT32_IEEE NO_COMPU_METHOD 0 0 1.175494351e-38 3.402823466e+38 ECU_ADDRESS 0 SYMBOL_LINK "Rte_AvgFricLrn_AvgFricLrnData.FricOffset_HwNm_f32" 0 DISPLAY_IDENTIFIER AvgFricLrn.PerInstanceMemories.AvgFricLrnData.FricOffset_HwNm_f32 READ_WRITE /end MEASUREMENT
/begin MEASUREMENT AvgFricLrn.AvgFricLrnData.OpMode_Cnt_enum "MICROSAR RTE" UBYTE NO_COMPU_METHOD 0 0 0 255 ECU_ADDRESS 0 SYMBOL_LINK "Rte_AvgFricLrn_AvgFricLrnData.OpMode_Cnt_enum" 0 DISPLAY_IDENTIFIER AvgFricLrn.PerInstanceMemories.AvgFricLrnData.OpMode_Cnt_enum READ_WRITE /end MEASUREMENT
/begin MEASUREMENT AvgFricLrn.AvgFricLrnData.RangeCounter_Cnt_u16 "MICROSAR RTE" UWORD NO_COMPU_METHOD 0 0 0 65535 MATRIX_DIM 8 3 1 ECU_ADDRESS 0 SYMBOL_LINK "Rte_AvgFricLrn_AvgFricLrnData.RangeCounter_Cnt_u16" 0 DISPLAY_IDENTIFIER AvgFricLrn.PerInstanceMemories.AvgFricLrnData.RangeCounter_Cnt_u16 READ_WRITE /end MEASUREMENT
/begin MEASUREMENT AvgFricLrn.AvgFricLrnData.Theta_HwNm_f32 "MICROSAR RTE" FLOAT32_IEEE NO_COMPU_METHOD 0 0 1.175494351e-38 3.402823466e+38 MATRIX_DIM 8 4 1 ECU_ADDRESS 0 SYMBOL_LINK "Rte_AvgFricLrn_AvgFricLrnData.Theta_HwNm_f32" 0 DISPLAY_IDENTIFIER AvgFricLrn.PerInstanceMemories.AvgFricLrnData.Theta_HwNm_f32 READ_WRITE /end MEASUREMENT
/begin MEASUREMENT AvgFricLrn.AvgFricLrnData.VehLearnedFric_HwNm_f32 "MICROSAR RTE" FLOAT32_IEEE NO_COMPU_METHOD 0 0 1.175494351e-38 3.402823466e+38 MATRIX_DIM 4 1 1 ECU_ADDRESS 0 SYMBOL_LINK "Rte_AvgFricLrn_AvgFricLrnData.VehLearnedFric_HwNm_f32" 0 DISPLAY_IDENTIFIER AvgFricLrn.PerInstanceMemories.AvgFricLrnData.VehLearnedFric_HwNm_f32 READ_WRITE /end MEASUREMENT
/begin MEASUREMENT AvgFricLrn.CRFMtrTrq.MtrNm_f32 "MICROSAR RTE" FLOAT32_IEEE NO_COMPU_METHOD 0 0 1.175494351e-38 3.402823466e+38 ECU_ADDRESS 0 SYMBOL_LINK "Rte_CtrldDisShtdn_CntDisMtrTrqCmdCRF_MtrNm_f32" 0 DISPLAY_IDENTIFIER AvgFricLrn.ReceiverPorts.CRFMtrTrq.MtrNm_f32 /end MEASUREMENT
/begin MEASUREMENT AvgFricLrn.DefeatFricLearning.Cnt_lgc "MICROSAR RTE" UBYTE RTE_CM_BOOLEAN 0 0 0 255 ECU_ADDRESS 0 SYMBOL_LINK "Rte_CDDInterface9_AvgFrcLrnSrlComSvcDft_Cnt_lgc" 0 DISPLAY_IDENTIFIER AvgFricLrn.ReceiverPorts.DefeatFricLearning.Cnt_lgc /end MEASUREMENT
/begin MEASUREMENT AvgFricLrn.EstFric.HwNm_f32 "MICROSAR RTE" FLOAT32_IEEE NO_COMPU_METHOD 0 0 1.175494351e-38 3.402823466e+38 ECU_ADDRESS 0 SYMBOL_LINK "Rte_AvgFricLrn_EstFric_HwNm_f32" 0 DISPLAY_IDENTIFIER AvgFricLrn.SenderPorts.EstFric.HwNm_f32 /end MEASUREMENT
/begin MEASUREMENT AvgFricLrn.FricLrnCustEna.Cnt_lgc "MICROSAR RTE" UBYTE RTE_CM_BOOLEAN 0 0 0 255 ECU_ADDRESS 0 SYMBOL_LINK "Rte_VehCfg_CFRCOMPIF_Cnt_lgc" 0 DISPLAY_IDENTIFIER AvgFricLrn.ReceiverPorts.FricLrnCustEna.Cnt_lgc /end MEASUREMENT
/begin MEASUREMENT AvgFricLrn.FricOffset.HwNm_f32 "MICROSAR RTE" FLOAT32_IEEE NO_COMPU_METHOD 0 0 1.175494351e-38 3.402823466e+38 ECU_ADDRESS 0 SYMBOL_LINK "Rte_AvgFricLrn_FricOffset_HwNm_f32" 0 DISPLAY_IDENTIFIER AvgFricLrn.SenderPorts.FricOffset.HwNm_f32 /end MEASUREMENT
/begin MEASUREMENT AvgFricLrn.HwAng.HwDeg_f32 "MICROSAR RTE" FLOAT32_IEEE NO_COMPU_METHOD 0 0 1.175494351e-38 3.402823466e+38 ECU_ADDRESS 0 SYMBOL_LINK "Rte_AbsHwPos_HandwheelPosition_HwDeg_f32" 0 DISPLAY_IDENTIFIER AvgFricLrn.ReceiverPorts.HwAng.HwDeg_f32 /end MEASUREMENT
/begin MEASUREMENT AvgFricLrn.HwPosAuthority.Uls_f32 "MICROSAR RTE" FLOAT32_IEEE NO_COMPU_METHOD 0 0 1.175494351e-38 3.402823466e+38 ECU_ADDRESS 0 SYMBOL_LINK "Rte_AbsHwPos_HandwheelAuthority_Uls_f32" 0 DISPLAY_IDENTIFIER AvgFricLrn.ReceiverPorts.HwPosAuthority.Uls_f32 /end MEASUREMENT
/begin MEASUREMENT AvgFricLrn.HwTrq.HwNm_f32 "MICROSAR RTE" FLOAT32_IEEE NO_COMPU_METHOD 0 0 1.175494351e-38 3.402823466e+38 ECU_ADDRESS 0 SYMBOL_LINK "Rte_Sweep_OutputHwTrq_HwNm_f32" 0 DISPLAY_IDENTIFIER AvgFricLrn.ReceiverPorts.HwTrq.HwNm_f32 /end MEASUREMENT
/begin MEASUREMENT AvgFricLrn.HwVel.HwRadpS_f32 "MICROSAR RTE" FLOAT32_IEEE NO_COMPU_METHOD 0 0 1.175494351e-38 3.402823466e+38 ECU_ADDRESS 0 SYMBOL_LINK "Rte_MtrVel_HandwheelVel_HwRadpS_f32" 0 DISPLAY_IDENTIFIER AvgFricLrn.ReceiverPorts.HwVel.HwRadpS_f32 /end MEASUREMENT
/begin MEASUREMENT AvgFricLrn.LatAcc.MpSecSq_f32 "MICROSAR RTE" FLOAT32_IEEE NO_COMPU_METHOD 0 0 1.175494351e-38 3.402823466e+38 ECU_ADDRESS 0 SYMBOL_LINK "Rte_SrlComInput2_SrlComVehLatAccel_MpSecSq_f32" 0 DISPLAY_IDENTIFIER AvgFricLrn.ReceiverPorts.LatAcc.MpSecSq_f32 /end MEASUREMENT
/begin MEASUREMENT AvgFricLrn.SatEstFric.HwNm_f32 "MICROSAR RTE" FLOAT32_IEEE NO_COMPU_METHOD 0 0 1.175494351e-38 3.402823466e+38 ECU_ADDRESS 0 SYMBOL_LINK "Rte_AvgFricLrn_SatEstFric_HwNm_f32" 0 DISPLAY_IDENTIFIER AvgFricLrn.SenderPorts.SatEstFric.HwNm_f32 /end MEASUREMENT
/begin MEASUREMENT AvgFricLrn.SystemState.Mode "MICROSAR RTE" UBYTE RTE_CM_ENUM_StaMd_Mode 0 0 0 255 ECU_ADDRESS 0 SYMBOL_LINK "Rte_ModeMachine_StaMd9_SystemState9_Mode" 0 DISPLAY_IDENTIFIER AvgFricLrn.ModeRequirePorts.SystemState.Mode /end MEASUREMENT
/begin MEASUREMENT AvgFricLrn.Temperature.DegC_f32 "MICROSAR RTE" FLOAT32_IEEE NO_COMPU_METHOD 0 0 1.175494351e-38 3.402823466e+38 ECU_ADDRESS 0 SYMBOL_LINK "Rte_MtrTempEst_AssistMechTempEst_DegC_f32" 0 DISPLAY_IDENTIFIER AvgFricLrn.ReceiverPorts.Temperature.DegC_f32 /end MEASUREMENT
/begin MEASUREMENT AvgFricLrn.VehSpd.Kph_f32 "MICROSAR RTE" FLOAT32_IEEE NO_COMPU_METHOD 0 0 1.175494351e-38 3.402823466e+38 ECU_ADDRESS 0 SYMBOL_LINK "Rte_SignlCondn_VehicleSpeed_Kph_f32" 0 DISPLAY_IDENTIFIER AvgFricLrn.ReceiverPorts.VehSpd.Kph_f32 /end MEASUREMENT
/begin MEASUREMENT AvgFricLrn.VehicleSpeedValid.Cnt_lgc "MICROSAR RTE" UBYTE RTE_CM_BOOLEAN 0 0 0 255 ECU_ADDRESS 0 SYMBOL_LINK "Rte_SignlCondn_VehicleSpeedValid_Cnt_lgc" 0 DISPLAY_IDENTIFIER AvgFricLrn.ReceiverPorts.VehicleSpeedValid.Cnt_lgc /end MEASUREMENT
/begin MEASUREMENT BVDiag.Batt.Volt_f32 "This signal is intended to communicate any type voltage signal measured by the ecu.  This signal has a lower limit of 0 which reequires users of the signal to provide divide by 0 protection if it is used as a denominator in a calculation.  See Vecu port p" FLOAT32_IEEE NO_COMPU_METHOD 0 0 1.175494351e-38 3.402823466e+38 ECU_ADDRESS 0 SYMBOL_LINK "Rte_IoHwAb7_Batt_Volt_f32" 0 DISPLAY_IDENTIFIER BVDiag.ReceiverPorts.Batt.Volt_f32 /end MEASUREMENT
/begin MEASUREMENT BVDiag.CCLMSAActive.Cnt_lgc "MICROSAR RTE" UBYTE RTE_CM_BOOLEAN 0 0 0 255 ECU_ADDRESS 0 SYMBOL_LINK "Rte_CustPL_CCLMSAActive_Cnt_lgc" 0 DISPLAY_IDENTIFIER BVDiag.ReceiverPorts.CCLMSAActive.Cnt_lgc /end MEASUREMENT
/begin MEASUREMENT BatteryVoltage.Batt.Volt_f32 "This signal is intended to communicate any type voltage signal measured by the ecu.  This signal has a lower limit of 0 which reequires users of the signal to provide divide by 0 protection if it is used as a denominator in a calculation.  See Vecu port p" FLOAT32_IEEE NO_COMPU_METHOD 0 0 1.175494351e-38 3.402823466e+38 ECU_ADDRESS 0 SYMBOL_LINK "Rte_IoHwAb7_Batt_Volt_f32" 0 DISPLAY_IDENTIFIER BatteryVoltage.ReceiverPorts.Batt.Volt_f32 /end MEASUREMENT
/begin MEASUREMENT BatteryVoltage.BattSwitched.Volt_f32 "This signal is intended to communicate any type voltage signal measured by the ecu.  This signal has a lower limit of 0 which reequires users of the signal to provide divide by 0 protection if it is used as a denominator in a calculation.  See Vecu port p" FLOAT32_IEEE NO_COMPU_METHOD 0 0 1.175494351e-38 3.402823466e+38 ECU_ADDRESS 0 SYMBOL_LINK "Rte_IoHwAb7_BattSwitched_Volt_f32" 0 DISPLAY_IDENTIFIER BatteryVoltage.ReceiverPorts.BattSwitched.Volt_f32 /end MEASUREMENT
/begin MEASUREMENT BatteryVoltage.SysCVSwitch.Volt_f32 "This signal is intended to communicate any type voltage signal measured by the ecu.  This signal has a lower limit of 0 which reequires users of the signal to provide divide by 0 protection if it is used as a denominator in a calculation.  See Vecu port p" FLOAT32_IEEE NO_COMPU_METHOD 0 0 1.175494351e-38 3.402823466e+38 ECU_ADDRESS 0 SYMBOL_LINK "Rte_IoHwAb7_SysCVSwitch_Volt_f32" 0 DISPLAY_IDENTIFIER BatteryVoltage.ReceiverPorts.SysCVSwitch.Volt_f32 /end MEASUREMENT
/begin MEASUREMENT BatteryVoltage.SysC_Vecu.Volt_f32 "This port prototype is inteded to communicate voltage signals that represent the ecu supplied voltage.  This signal has a lower limit, which is non-zero, to allow users of the signal to use it as a denominator in an expression without requiring a divide b" FLOAT32_IEEE NO_COMPU_METHOD 0 0 1.175494351e-38 3.402823466e+38 ECU_ADDRESS 0 SYMBOL_LINK "Rte_BatteryVoltage_SysC_Vecu_Volt_f32" 0 DISPLAY_IDENTIFIER BatteryVoltage.SenderPorts.SysC_Vecu.Volt_f32 /end MEASUREMENT
/begin MEASUREMENT BatteryVoltage.SystemState.Mode "MICROSAR RTE" UBYTE RTE_CM_ENUM_StaMd_Mode 0 0 0 255 ECU_ADDRESS 0 SYMBOL_LINK "Rte_ModeMachine_StaMd7_SystemState7_Mode" 0 DISPLAY_IDENTIFIER BatteryVoltage.ModeRequirePorts.SystemState.Mode /end MEASUREMENT
/begin MEASUREMENT BatteryVoltage.Vecu.Volt_f32 "This port prototype is inteded to communicate voltage signals that represent the ecu supplied voltage.  This signal has a lower limit, which is non-zero, to allow users of the signal to use it as a denominator in an expression without requiring a divide b" FLOAT32_IEEE NO_COMPU_METHOD 0 0 1.175494351e-38 3.402823466e+38 ECU_ADDRESS 0 SYMBOL_LINK "Rte_BatteryVoltage_Vecu_Volt_f32" 0 DISPLAY_IDENTIFIER BatteryVoltage.SenderPorts.Vecu.Volt_f32 /end MEASUREMENT
/begin MEASUREMENT BatteryVoltage.VswitchClosed.Cnt_lgc "MICROSAR RTE" UBYTE RTE_CM_BOOLEAN 0 0 0 255 ECU_ADDRESS 0 SYMBOL_LINK "Rte_BatteryVoltage_VswitchClosed_Cnt_lgc" 0 DISPLAY_IDENTIFIER BatteryVoltage.SenderPorts.VswitchClosed.Cnt_lgc /end MEASUREMENT
/begin MEASUREMENT BmwHaptcFb.HaptcFbEnable.Cnt_lgc "MICROSAR RTE" UBYTE RTE_CM_BOOLEAN 0 0 0 255 ECU_ADDRESS 0 SYMBOL_LINK "Rte_VehCfg_CEVIIF_Cnt_lgc" 0 DISPLAY_IDENTIFIER BmwHaptcFb.ReceiverPorts.HaptcFbEnable.Cnt_lgc /end MEASUREMENT
/begin MEASUREMENT BmwHaptcFb.HaptcFbIntenNr.Cnt_u16 "MICROSAR RTE" UWORD NO_COMPU_METHOD 0 0 0 65535 ECU_ADDRESS 0 SYMBOL_LINK "Rte_SrlComInput_HaptcFbIntenNr_Cnt_u16" 0 DISPLAY_IDENTIFIER BmwHaptcFb.ReceiverPorts.HaptcFbIntenNr.Cnt_u16 /end MEASUREMENT
/begin MEASUREMENT BmwHaptcFb.HaptcFbIntenSigVld.Cnt_lgc "MICROSAR RTE" UBYTE RTE_CM_BOOLEAN 0 0 0 255 ECU_ADDRESS 0 SYMBOL_LINK "Rte_SrlComInput_HaptcFbIntenSigVld_Cnt_lgc" 0 DISPLAY_IDENTIFIER BmwHaptcFb.ReceiverPorts.HaptcFbIntenSigVld.Cnt_lgc /end MEASUREMENT
/begin MEASUREMENT BmwHaptcFb.HaptcFbPatNr.Cnt_u16 "MICROSAR RTE" UWORD NO_COMPU_METHOD 0 0 0 65535 ECU_ADDRESS 0 SYMBOL_LINK "Rte_SrlComInput_HaptcFbPatNr_Cnt_u16" 0 DISPLAY_IDENTIFIER BmwHaptcFb.ReceiverPorts.HaptcFbPatNr.Cnt_u16 /end MEASUREMENT
/begin MEASUREMENT BmwHaptcFb.HaptcFbPatSigVld.Cnt_lgc "MICROSAR RTE" UBYTE RTE_CM_BOOLEAN 0 0 0 255 ECU_ADDRESS 0 SYMBOL_LINK "Rte_SrlComInput_HaptcFbPatSigVld_Cnt_lgc" 0 DISPLAY_IDENTIFIER BmwHaptcFb.ReceiverPorts.HaptcFbPatSigVld.Cnt_lgc /end MEASUREMENT
/begin MEASUREMENT BmwHaptcFb.HaptcFbSt.Cnt_u08 "MICROSAR RTE" UBYTE NO_COMPU_METHOD 0 0 0 255 ECU_ADDRESS 0 SYMBOL_LINK "Rte_BmwHaptcFb_HaptcFbSt_Cnt_u08" 0 DISPLAY_IDENTIFIER BmwHaptcFb.SenderPorts.HaptcFbSt.Cnt_u08 /end MEASUREMENT
/begin MEASUREMENT BmwHaptcFb.PostLimitTrq.MtrNm_f32 "MICROSAR RTE" FLOAT32_IEEE NO_COMPU_METHOD 0 0 1.175494351e-38 3.402823466e+38 ECU_ADDRESS 0 SYMBOL_LINK "Rte_AssistSumnLmt_PostLimitTorque_MtrNm_f32" 0 DISPLAY_IDENTIFIER BmwHaptcFb.ReceiverPorts.PostLimitTrq.MtrNm_f32 /end MEASUREMENT
/begin MEASUREMENT BmwHaptcFb.PreLimitTrq.MtrNm_f32 "MICROSAR RTE" FLOAT32_IEEE NO_COMPU_METHOD 0 0 1.175494351e-38 3.402823466e+38 ECU_ADDRESS 0 SYMBOL_LINK "Rte_AssistSumnLmt_PreLimitTorque_MtrNm_f32" 0 DISPLAY_IDENTIFIER BmwHaptcFb.ReceiverPorts.PreLimitTrq.MtrNm_f32 /end MEASUREMENT
/begin MEASUREMENT BmwHaptcFb.SystemState.Mode "MICROSAR RTE" UBYTE RTE_CM_ENUM_StaMd_Mode 0 0 0 255 ECU_ADDRESS 0 SYMBOL_LINK "Rte_ModeMachine_StaMd9_SystemState9_Mode" 0 DISPLAY_IDENTIFIER BmwHaptcFb.ModeRequirePorts.SystemState.Mode /end MEASUREMENT
/begin MEASUREMENT BmwHaptcFb.TrqOscActv.Cnt_lgc "MICROSAR RTE" UBYTE RTE_CM_BOOLEAN 0 0 0 255 ECU_ADDRESS 0 SYMBOL_LINK "Rte_TrqOsc_TrqOscActv_Cnt_lgc" 0 DISPLAY_IDENTIFIER BmwHaptcFb.ReceiverPorts.TrqOscActv.Cnt_lgc /end MEASUREMENT
/begin MEASUREMENT BmwHaptcFb.TrqOscAmp.MtrNm_f32 "MICROSAR RTE" FLOAT32_IEEE NO_COMPU_METHOD 0 0 1.175494351e-38 3.402823466e+38 ECU_ADDRESS 0 SYMBOL_LINK "Rte_BmwHaptcFb_TrqOscAmp_MtrNm_f32" 0 DISPLAY_IDENTIFIER BmwHaptcFb.SenderPorts.TrqOscAmp.MtrNm_f32 /end MEASUREMENT
/begin MEASUREMENT BmwHaptcFb.TrqOscDCExceeded.Cnt_lgc "MICROSAR RTE" UBYTE RTE_CM_BOOLEAN 0 0 0 255 ECU_ADDRESS 0 SYMBOL_LINK "Rte_TrqOsc_TrqOscDCExceeded_Cnt_lgc" 0 DISPLAY_IDENTIFIER BmwHaptcFb.ReceiverPorts.TrqOscDCExceeded.Cnt_lgc /end MEASUREMENT
/begin MEASUREMENT BmwHaptcFb.TrqOscEnable.Cnt_lgc "MICROSAR RTE" UBYTE RTE_CM_BOOLEAN 0 0 0 255 ECU_ADDRESS 0 SYMBOL_LINK "Rte_BmwHaptcFb_TrqOscEnable_Cnt_lgc" 0 DISPLAY_IDENTIFIER BmwHaptcFb.SenderPorts.TrqOscEnable.Cnt_lgc /end MEASUREMENT
/begin MEASUREMENT BmwHaptcFb.TrqOscFallingRampRate.MtrNmpS_f32 "MICROSAR RTE" FLOAT32_IEEE NO_COMPU_METHOD 0 0 1.175494351e-38 3.402823466e+38 ECU_ADDRESS 0 SYMBOL_LINK "Rte_BmwHaptcFb_TrqOscFallingRampRate_MtrNmpS_f32" 0 DISPLAY_IDENTIFIER BmwHaptcFb.SenderPorts.TrqOscFallingRampRate.MtrNmpS_f32 /end MEASUREMENT
/begin MEASUREMENT BmwHaptcFb.TrqOscFreq.Hz_f32 "MICROSAR RTE" FLOAT32_IEEE NO_COMPU_METHOD 0 0 1.175494351e-38 3.402823466e+38 ECU_ADDRESS 0 SYMBOL_LINK "Rte_BmwHaptcFb_TrqOscFreq_Hz_f32" 0 DISPLAY_IDENTIFIER BmwHaptcFb.SenderPorts.TrqOscFreq.Hz_f32 /end MEASUREMENT
/begin MEASUREMENT BmwHaptcFb.TrqOscRisngRampRate.MtrNmpS_f32 "MICROSAR RTE" FLOAT32_IEEE NO_COMPU_METHOD 0 0 1.175494351e-38 3.402823466e+38 ECU_ADDRESS 0 SYMBOL_LINK "Rte_BmwHaptcFb_TrqOscRisngRampRate_MtrNmpS_f32" 0 DISPLAY_IDENTIFIER BmwHaptcFb.SenderPorts.TrqOscRisngRampRate.MtrNmpS_f32 /end MEASUREMENT
/begin MEASUREMENT BmwHaptcFb.VehicleSpeed.Kph_f32 "MICROSAR RTE" FLOAT32_IEEE NO_COMPU_METHOD 0 0 1.175494351e-38 3.402823466e+38 ECU_ADDRESS 0 SYMBOL_LINK "Rte_SignlCondn_VehicleSpeed_Kph_f32" 0 DISPLAY_IDENTIFIER BmwHaptcFb.ReceiverPorts.VehicleSpeed.Kph_f32 /end MEASUREMENT
/begin MEASUREMENT BmwHaptcFb.VehicleSpeedValid.Cnt_lgc "MICROSAR RTE" UBYTE RTE_CM_BOOLEAN 0 0 0 255 ECU_ADDRESS 0 SYMBOL_LINK "Rte_SignlCondn_VehicleSpeedValid_Cnt_lgc" 0 DISPLAY_IDENTIFIER BmwHaptcFb.ReceiverPorts.VehicleSpeedValid.Cnt_lgc /end MEASUREMENT
/begin MEASUREMENT BmwRtnArbn.BasicRtnCmd.MtrNm_f32 "MICROSAR RTE" FLOAT32_IEEE NO_COMPU_METHOD 0 0 1.175494351e-38 3.402823466e+38 ECU_ADDRESS 0 SYMBOL_LINK "Rte_Return_ReturnCmd_MtrNm_f32" 0 DISPLAY_IDENTIFIER BmwRtnArbn.ReceiverPorts.BasicRtnCmd.MtrNm_f32 /end MEASUREMENT
/begin MEASUREMENT BmwRtnArbn.DefeatReturnSvc.Cnt_lgc "MICROSAR RTE" UBYTE RTE_CM_BOOLEAN 0 0 0 255 ECU_ADDRESS 0 SYMBOL_LINK "Rte_CDDInterface9_ReturnSrlComSvcDft_Cnt_lgc" 0 DISPLAY_IDENTIFIER BmwRtnArbn.ReceiverPorts.DefeatReturnSvc.Cnt_lgc /end MEASUREMENT
/begin MEASUREMENT BmwRtnArbn.DiagStsHwPosDis.Cnt_lgc "MICROSAR RTE" UBYTE RTE_CM_BOOLEAN 0 0 0 255 ECU_ADDRESS 0 SYMBOL_LINK "Rte_DiagMgr10_DiagStsHWASbSystmFltPres_Cnt_lgc" 0 DISPLAY_IDENTIFIER BmwRtnArbn.ReceiverPorts.DiagStsHwPosDis.Cnt_lgc /end MEASUREMENT
/begin MEASUREMENT BmwRtnArbn.EnableCVR.Cnt_lgc "MICROSAR RTE" UBYTE RTE_CM_BOOLEAN 0 0 0 255 ECU_ADDRESS 0 SYMBOL_LINK "Rte_VehCfg_CSELRETURN_Cnt_lgc" 0 DISPLAY_IDENTIFIER BmwRtnArbn.ReceiverPorts.EnableCVR.Cnt_lgc /end MEASUREMENT
/begin MEASUREMENT BmwRtnArbn.HandwheelAuthority.Uls_f32 "MICROSAR RTE" FLOAT32_IEEE NO_COMPU_METHOD 0 0 1.175494351e-38 3.402823466e+38 ECU_ADDRESS 0 SYMBOL_LINK "Rte_AbsHwPos_HandwheelAuthority_Uls_f32" 0 DISPLAY_IDENTIFIER BmwRtnArbn.ReceiverPorts.HandwheelAuthority.Uls_f32 /end MEASUREMENT
/begin MEASUREMENT BmwRtnArbn.HandwheelPosition.HwDeg_f32 "MICROSAR RTE" FLOAT32_IEEE NO_COMPU_METHOD 0 0 1.175494351e-38 3.402823466e+38 ECU_ADDRESS 0 SYMBOL_LINK "Rte_AbsHwPos_HandwheelPosition_HwDeg_f32" 0 DISPLAY_IDENTIFIER BmwRtnArbn.ReceiverPorts.HandwheelPosition.HwDeg_f32 /end MEASUREMENT
/begin MEASUREMENT BmwRtnArbn.HandwheelVelocity.HwRadpS_f32 "MICROSAR RTE" FLOAT32_IEEE NO_COMPU_METHOD 0 0 1.175494351e-38 3.402823466e+38 ECU_ADDRESS 0 SYMBOL_LINK "Rte_MtrVel_HandwheelVel_HwRadpS_f32" 0 DISPLAY_IDENTIFIER BmwRtnArbn.ReceiverPorts.HandwheelVelocity.HwRadpS_f32 /end MEASUREMENT
/begin MEASUREMENT BmwRtnArbn.HwTorque.HwNm_f32 "MICROSAR RTE" FLOAT32_IEEE NO_COMPU_METHOD 0 0 1.175494351e-38 3.402823466e+38 ECU_ADDRESS 0 SYMBOL_LINK "Rte_Sweep_OutputHwTrq_HwNm_f32" 0 DISPLAY_IDENTIFIER BmwRtnArbn.ReceiverPorts.HwTorque.HwNm_f32 /end MEASUREMENT
/begin MEASUREMENT BmwRtnArbn.MRFMtrTrqCmdScl.MtrNm_f32 "MICROSAR RTE" FLOAT32_IEEE NO_COMPU_METHOD 0 0 1.175494351e-38 3.402823466e+38 ECU_ADDRESS 0 SYMBOL_LINK "Rte_TrqCmdScl_MRFMtrTrqCmdScl_MtrNm_f32" 0 DISPLAY_IDENTIFIER BmwRtnArbn.ReceiverPorts.MRFMtrTrqCmdScl.MtrNm_f32 /end MEASUREMENT
/begin MEASUREMENT BmwRtnArbn.PAReturnSclFct.Uls_f32 "MICROSAR RTE" FLOAT32_IEEE NO_COMPU_METHOD 0 0 1.175494351e-38 3.402823466e+38 ECU_ADDRESS 0 SYMBOL_LINK "Rte_PosServo_PosSrvoReturnSclFct_Uls_f32" 0 DISPLAY_IDENTIFIER BmwRtnArbn.ReceiverPorts.PAReturnSclFct.Uls_f32 /end MEASUREMENT
/begin MEASUREMENT BmwRtnArbn.ReturnCmd.MtrNm_f32 "MICROSAR RTE" FLOAT32_IEEE NO_COMPU_METHOD 0 0 1.175494351e-38 3.402823466e+38 ECU_ADDRESS 0 SYMBOL_LINK "Rte_BmwRtnArbn_ReturnCmd_MtrNm_f32" 0 DISPLAY_IDENTIFIER BmwRtnArbn.SenderPorts.ReturnCmd.MtrNm_f32 /end MEASUREMENT
/begin MEASUREMENT BmwRtnArbn.ReturnDDFactor.Uls_f32 "MICROSAR RTE" FLOAT32_IEEE NO_COMPU_METHOD 0 0 1.175494351e-38 3.402823466e+38 ECU_ADDRESS 0 SYMBOL_LINK "Rte_DrvDynCtrl_ReturnDDFactor_Uls_f32" 0 DISPLAY_IDENTIFIER BmwRtnArbn.ReceiverPorts.ReturnDDFactor.Uls_f32 /end MEASUREMENT
/begin MEASUREMENT BmwRtnArbn.ReturnOffset.HwDeg_f32 "MICROSAR RTE" FLOAT32_IEEE NO_COMPU_METHOD 0 0 1.175494351e-38 3.402823466e+38 ECU_ADDRESS 0 SYMBOL_LINK "Rte_SrlComInput_ReturnOffset_HwDeg_f32" 0 DISPLAY_IDENTIFIER BmwRtnArbn.ReceiverPorts.ReturnOffset.HwDeg_f32 /end MEASUREMENT
/begin MEASUREMENT BmwRtnArbn.VehicleSpeed.Kph_f32 "MICROSAR RTE" FLOAT32_IEEE NO_COMPU_METHOD 0 0 1.175494351e-38 3.402823466e+38 ECU_ADDRESS 0 SYMBOL_LINK "Rte_SignlCondn_VehicleSpeed_Kph_f32" 0 DISPLAY_IDENTIFIER BmwRtnArbn.ReceiverPorts.VehicleSpeed.Kph_f32 /end MEASUREMENT
/begin MEASUREMENT CDDInterface10.CommOffset.Cnt_u16 "MICROSAR RTE" UWORD NO_COMPU_METHOD 0 0 0 65535 ECU_ADDRESS 0 SYMBOL_LINK "Rte_MtrCtrlOpConv_CommutationOffset_Cnt_u16" 0 DISPLAY_IDENTIFIER CDDInterface10.ReceiverPorts.CommOffset.Cnt_u16 /end MEASUREMENT
/begin MEASUREMENT CDDInterface10.DeadTimeComp.Uls_f32 "MICROSAR RTE" FLOAT32_IEEE NO_COMPU_METHOD 0 0 1.175494351e-38 3.402823466e+38 ECU_ADDRESS 0 SYMBOL_LINK "Rte_MtrCtrlOpConv_DeadTimeComp_Uls_f32" 0 DISPLAY_IDENTIFIER CDDInterface10.ReceiverPorts.DeadTimeComp.Uls_f32 /end MEASUREMENT
/begin MEASUREMENT CDDInterface10.DutyCycleSmall.Cnt_u16 "MICROSAR RTE" UWORD NO_COMPU_METHOD 0 0 0 65535 ECU_ADDRESS 0 SYMBOL_LINK "Rte_CDDInterface10_DutyCycleSmall_Cnt_u16" 0 DISPLAY_IDENTIFIER CDDInterface10.SenderPorts.DutyCycleSmall.Cnt_u16 /end MEASUREMENT
/begin MEASUREMENT CDDInterface10.ExpectedOnTimeA.Cnt_u32 "MICROSAR RTE" ULONG NO_COMPU_METHOD 0 0 0 4294967295 ECU_ADDRESS 0 SYMBOL_LINK "Rte_CDDInterface10_ExpectedOnTimeA_Cnt_u32" 0 DISPLAY_IDENTIFIER CDDInterface10.SenderPorts.ExpectedOnTimeA.Cnt_u32 READ_WRITE /end MEASUREMENT
/begin MEASUREMENT CDDInterface10.ExpectedOnTimeB.Cnt_u32 "MICROSAR RTE" ULONG NO_COMPU_METHOD 0 0 0 4294967295 ECU_ADDRESS 0 SYMBOL_LINK "Rte_CDDInterface10_ExpectedOnTimeB_Cnt_u32" 0 DISPLAY_IDENTIFIER CDDInterface10.SenderPorts.ExpectedOnTimeB.Cnt_u32 READ_WRITE /end MEASUREMENT
/begin MEASUREMENT CDDInterface10.ExpectedOnTimeC.Cnt_u32 "MICROSAR RTE" ULONG NO_COMPU_METHOD 0 0 0 4294967295 ECU_ADDRESS 0 SYMBOL_LINK "Rte_CDDInterface10_ExpectedOnTimeC_Cnt_u32" 0 DISPLAY_IDENTIFIER CDDInterface10.SenderPorts.ExpectedOnTimeC.Cnt_u32 READ_WRITE /end MEASUREMENT
/begin MEASUREMENT CDDInterface10.FETFaultPhase.Cnt_enum "MICROSAR RTE" UBYTE RTE_CM_ENUM_FETPHASETYPE_ENUM 0 0 0 255 ECU_ADDRESS 0 SYMBOL_LINK "Rte_MtrDrvDiag_FETFaultPhase_Cnt_enum" 0 DISPLAY_IDENTIFIER CDDInterface10.ReceiverPorts.FETFaultPhase.Cnt_enum /end MEASUREMENT
/begin MEASUREMENT CDDInterface10.FETFaultType.Cnt_enum "MICROSAR RTE" UBYTE RTE_CM_ENUM_FETFAULTTYPE_ENUM 0 0 0 255 ECU_ADDRESS 0 SYMBOL_LINK "Rte_MtrDrvDiag_FETFaultType_Cnt_enum" 0 DISPLAY_IDENTIFIER CDDInterface10.ReceiverPorts.FETFaultType.Cnt_enum /end MEASUREMENT
/begin MEASUREMENT CDDInterface10.MeasuredOnTimeA.Cnt_u32 "MICROSAR RTE" ULONG NO_COMPU_METHOD 0 0 0 4294967295 ECU_ADDRESS 0 SYMBOL_LINK "Rte_CDDInterface10_MeasuredOnTimeA_Cnt_u32" 0 DISPLAY_IDENTIFIER CDDInterface10.SenderPorts.MeasuredOnTimeA.Cnt_u32 READ_WRITE /end MEASUREMENT
/begin MEASUREMENT CDDInterface10.MeasuredOnTimeB.Cnt_u32 "MICROSAR RTE" ULONG NO_COMPU_METHOD 0 0 0 4294967295 ECU_ADDRESS 0 SYMBOL_LINK "Rte_CDDInterface10_MeasuredOnTimeB_Cnt_u32" 0 DISPLAY_IDENTIFIER CDDInterface10.SenderPorts.MeasuredOnTimeB.Cnt_u32 READ_WRITE /end MEASUREMENT
/begin MEASUREMENT CDDInterface10.MeasuredOnTimeC.Cnt_u32 "MICROSAR RTE" ULONG NO_COMPU_METHOD 0 0 0 4294967295 ECU_ADDRESS 0 SYMBOL_LINK "Rte_CDDInterface10_MeasuredOnTimeC_Cnt_u32" 0 DISPLAY_IDENTIFIER CDDInterface10.SenderPorts.MeasuredOnTimeC.Cnt_u32 READ_WRITE /end MEASUREMENT
/begin MEASUREMENT CDDInterface10.ModIdxFinal.Uls_f32 "MICROSAR RTE" FLOAT32_IEEE NO_COMPU_METHOD 0 0 1.175494351e-38 3.402823466e+38 ECU_ADDRESS 0 SYMBOL_LINK "Rte_MtrCtrlOpConv_ModulationIndexFinal_Uls_f32" 0 DISPLAY_IDENTIFIER CDDInterface10.ReceiverPorts.ModIdxFinal.Uls_f32 /end MEASUREMENT
/begin MEASUREMENT CDDInterface10.MtrElecMechPolarity.Cnt_s08 "MICROSAR RTE" SBYTE NO_COMPU_METHOD 0 0 -128 127 ECU_ADDRESS 0 SYMBOL_LINK "Rte_Polarity_MtrElecMechPolarity_Cnt_s08" 0 DISPLAY_IDENTIFIER CDDInterface10.ReceiverPorts.MtrElecMechPolarity.Cnt_s08 /end MEASUREMENT
/begin MEASUREMENT CDDInterface10.MtrTrqCmdSign.Cnt_s16 "MICROSAR RTE" SWORD NO_COMPU_METHOD 0 0 -32768 32767 ECU_ADDRESS 0 SYMBOL_LINK "Rte_MtrCtrlOpConv_MtrTrqCmdSign_Cnt_s16" 0 DISPLAY_IDENTIFIER CDDInterface10.ReceiverPorts.MtrTrqCmdSign.Cnt_s16 /end MEASUREMENT
/begin MEASUREMENT CDDInterface10.PhaseAdvFinal.Cnt_u16 "MICROSAR RTE" UWORD NO_COMPU_METHOD 0 0 0 65535 ECU_ADDRESS 0 SYMBOL_LINK "Rte_MtrCtrlOpConv_PhaseAdvanceFinal_Cnt_u16" 0 DISPLAY_IDENTIFIER CDDInterface10.ReceiverPorts.PhaseAdvFinal.Cnt_u16 /end MEASUREMENT
/begin MEASUREMENT CDDInterface9.ActPullCompLrnSrlComSvcDft.Cnt_lgc "MICROSAR RTE" UBYTE RTE_CM_BOOLEAN 0 0 0 255 ECU_ADDRESS 0 SYMBOL_LINK "Rte_CDDInterface9_ActPullCompLrnSrlComSvcDft_Cnt_lgc" 0 DISPLAY_IDENTIFIER CDDInterface9.SenderPorts.ActPullCompLrnSrlComSvcDft.Cnt_lgc /end MEASUREMENT
/begin MEASUREMENT CDDInterface9.AvgFrcLrnSrlComSvcDft.Cnt_lgc "MICROSAR RTE" UBYTE RTE_CM_BOOLEAN 0 0 0 255 ECU_ADDRESS 0 SYMBOL_LINK "Rte_CDDInterface9_AvgFrcLrnSrlComSvcDft_Cnt_lgc" 0 DISPLAY_IDENTIFIER CDDInterface9.SenderPorts.AvgFrcLrnSrlComSvcDft.Cnt_lgc /end MEASUREMENT
/begin MEASUREMENT CDDInterface9.DampingSrlComSvcDft.Cnt_lgc "MICROSAR RTE" UBYTE RTE_CM_BOOLEAN 0 0 0 255 ECU_ADDRESS 0 SYMBOL_LINK "Rte_CDDInterface9_DampingSrlComSvcDft_Cnt_lgc" 0 DISPLAY_IDENTIFIER CDDInterface9.SenderPorts.DampingSrlComSvcDft.Cnt_lgc /end MEASUREMENT
/begin MEASUREMENT CDDInterface9.DftAsstTbl.Cnt_lgc "MICROSAR RTE" UBYTE RTE_CM_BOOLEAN 0 0 0 255 ECU_ADDRESS 0 SYMBOL_LINK "Rte_CDDInterface9_DftAsstTbl_Cnt_lgc" 0 DISPLAY_IDENTIFIER CDDInterface9.SenderPorts.DftAsstTbl.Cnt_lgc /end MEASUREMENT
/begin MEASUREMENT CDDInterface9.DrivingDynSrlComSvcDft.Cnt_lgc "MICROSAR RTE" UBYTE RTE_CM_BOOLEAN 0 0 0 255 ECU_ADDRESS 0 SYMBOL_LINK "Rte_CDDInterface9_DrivingDynSrlComSvcDft_Cnt_lgc" 0 DISPLAY_IDENTIFIER CDDInterface9.SenderPorts.DrivingDynSrlComSvcDft.Cnt_lgc /end MEASUREMENT
/begin MEASUREMENT CDDInterface9.DwnldAsstGain.Uls_f32 "MICROSAR RTE" FLOAT32_IEEE NO_COMPU_METHOD 0 0 1.175494351e-38 3.402823466e+38 ECU_ADDRESS 0 SYMBOL_LINK "Rte_CDDInterface9_DwnldAsstGain_Uls_f32" 0 DISPLAY_IDENTIFIER CDDInterface9.SenderPorts.DwnldAsstGain.Uls_f32 /end MEASUREMENT
/begin MEASUREMENT CDDInterface9.EOTImpactSrlComSvcDft.Cnt_lgc "MICROSAR RTE" UBYTE RTE_CM_BOOLEAN 0 0 0 255 ECU_ADDRESS 0 SYMBOL_LINK "Rte_CDDInterface9_EOTImpactSrlComSvcDft_Cnt_lgc" 0 DISPLAY_IDENTIFIER CDDInterface9.SenderPorts.EOTImpactSrlComSvcDft.Cnt_lgc /end MEASUREMENT
/begin MEASUREMENT CDDInterface9.EOTThermalSrlComSvcDft.Cnt_lgc "MICROSAR RTE" UBYTE RTE_CM_BOOLEAN 0 0 0 255 ECU_ADDRESS 0 SYMBOL_LINK "Rte_CDDInterface9_EOTThermalSrlComSvcDft_Cnt_lgc" 0 DISPLAY_IDENTIFIER CDDInterface9.SenderPorts.EOTThermalSrlComSvcDft.Cnt_lgc /end MEASUREMENT
/begin MEASUREMENT CDDInterface9.EngONSrlComSvcDft.Cnt_lgc "MICROSAR RTE" UBYTE RTE_CM_BOOLEAN 0 0 0 255 ECU_ADDRESS 0 SYMBOL_LINK "Rte_CDDInterface9_EngONSrlComSvcDft_Cnt_lgc" 0 DISPLAY_IDENTIFIER CDDInterface9.SenderPorts.EngONSrlComSvcDft.Cnt_lgc /end MEASUREMENT
/begin MEASUREMENT CDDInterface9.FirewallSrlComSrvDft.Cnt_lgc "MICROSAR RTE" UBYTE RTE_CM_BOOLEAN 0 0 0 255 ECU_ADDRESS 0 SYMBOL_LINK "Rte_CDDInterface9_FirewallSrlComSrvDft_Cnt_lgc" 0 DISPLAY_IDENTIFIER CDDInterface9.SenderPorts.FirewallSrlComSrvDft.Cnt_lgc /end MEASUREMENT
/begin MEASUREMENT CDDInterface9.FreqDepDmpSrlComSvcDft.Cnt_lgc "MICROSAR RTE" UBYTE RTE_CM_BOOLEAN 0 0 0 255 ECU_ADDRESS 0 SYMBOL_LINK "Rte_CDDInterface9_FreqDepDmpSrlComSvcDft_Cnt_lgc" 0 DISPLAY_IDENTIFIER CDDInterface9.SenderPorts.FreqDepDmpSrlComSvcDft.Cnt_lgc /end MEASUREMENT
/begin MEASUREMENT CDDInterface9.HysAddSrlComSvcDft.Cnt_lgc "MICROSAR RTE" UBYTE RTE_CM_BOOLEAN 0 0 0 255 ECU_ADDRESS 0 SYMBOL_LINK "Rte_CDDInterface9_HysAddSrlComSvcDft_Cnt_lgc" 0 DISPLAY_IDENTIFIER CDDInterface9.SenderPorts.HysAddSrlComSvcDft.Cnt_lgc /end MEASUREMENT
/begin MEASUREMENT CDDInterface9.HystCompSrlComSvcDft.Cnt_lgc "MICROSAR RTE" UBYTE RTE_CM_BOOLEAN 0 0 0 255 ECU_ADDRESS 0 SYMBOL_LINK "Rte_CDDInterface9_HystCompSrlComSvcDft_Cnt_lgc" 0 DISPLAY_IDENTIFIER CDDInterface9.SenderPorts.HystCompSrlComSvcDft.Cnt_lgc /end MEASUREMENT
/begin MEASUREMENT CDDInterface9.IgnCnt.Cnt_u16 "MICROSAR RTE" UWORD NO_COMPU_METHOD 0 0 0 65535 ECU_ADDRESS 0 SYMBOL_LINK "Rte_CDDInterface9_IgnCnt_Cnt_u16" 0 DISPLAY_IDENTIFIER CDDInterface9.SenderPorts.IgnCnt.Cnt_u16 /end MEASUREMENT
/begin MEASUREMENT CDDInterface9.KinIntDiagSrlComSvcDft.Cnt_lgc "MICROSAR RTE" UBYTE RTE_CM_BOOLEAN 0 0 0 255 ECU_ADDRESS 0 SYMBOL_LINK "Rte_CDDInterface9_KinIntDiagSrlComSvcDft_Cnt_lgc" 0 DISPLAY_IDENTIFIER CDDInterface9.SenderPorts.KinIntDiagSrlComSvcDft.Cnt_lgc /end MEASUREMENT
/begin MEASUREMENT CDDInterface9.LimitSrlComSvcDft.Cnt_lgc "MICROSAR RTE" UBYTE RTE_CM_BOOLEAN 0 0 0 255 ECU_ADDRESS 0 SYMBOL_LINK "Rte_CDDInterface9_LimitSrlComSvcDft_Cnt_lgc" 0 DISPLAY_IDENTIFIER CDDInterface9.SenderPorts.LimitSrlComSvcDft.Cnt_lgc /end MEASUREMENT
/begin MEASUREMENT CDDInterface9.LrnPnCenterEnable.Cnt_lgc "MICROSAR RTE" UBYTE RTE_CM_BOOLEAN 0 0 0 255 ECU_ADDRESS 0 SYMBOL_LINK "Rte_CDDInterface9_LrnPnCenterEnable_Cnt_lgc" 0 DISPLAY_IDENTIFIER CDDInterface9.SenderPorts.LrnPnCenterEnable.Cnt_lgc /end MEASUREMENT
/begin MEASUREMENT CDDInterface9.MfgDiagInhibit.Cnt_lgc "MICROSAR RTE" UBYTE RTE_CM_BOOLEAN 0 0 0 255 ECU_ADDRESS 0 SYMBOL_LINK "Rte_CDDInterface9_MfgDiagInhibit_Cnt_lgc" 0 DISPLAY_IDENTIFIER CDDInterface9.SenderPorts.MfgDiagInhibit.Cnt_lgc /end MEASUREMENT
/begin MEASUREMENT CDDInterface9.ModIdxSrlComSvcDft.Cnt_lgc "MICROSAR RTE" UBYTE RTE_CM_BOOLEAN 0 0 0 255 ECU_ADDRESS 0 SYMBOL_LINK "Rte_CDDInterface9_ModIdxSrlComSvcDft_Cnt_lgc" 0 DISPLAY_IDENTIFIER CDDInterface9.SenderPorts.ModIdxSrlComSvcDft.Cnt_lgc /end MEASUREMENT
/begin MEASUREMENT CDDInterface9.MtrParmNrmLrnSrlComSvcDft.Cnt_lgc "MICROSAR RTE" UBYTE RTE_CM_BOOLEAN 0 0 0 255 ECU_ADDRESS 0 SYMBOL_LINK "Rte_CDDInterface9_MtrParmNrmLrnSrlComSvcDft_Cnt_lgc" 0 DISPLAY_IDENTIFIER CDDInterface9.SenderPorts.MtrParmNrmLrnSrlComSvcDft.Cnt_lgc /end MEASUREMENT
/begin MEASUREMENT CDDInterface9.MtrVelNrmLrnSrlComSvcDft.Cnt_lgc "MICROSAR RTE" UBYTE RTE_CM_BOOLEAN 0 0 0 255 ECU_ADDRESS 0 SYMBOL_LINK "Rte_CDDInterface9_MtrVelNrmLrnSrlComSvcDft_Cnt_lgc" 0 DISPLAY_IDENTIFIER CDDInterface9.SenderPorts.MtrVelNrmLrnSrlComSvcDft.Cnt_lgc /end MEASUREMENT
/begin MEASUREMENT CDDInterface9.MultIgnSrlComSvcDft.Cnt_lgc "MICROSAR RTE" UBYTE RTE_CM_BOOLEAN 0 0 0 255 ECU_ADDRESS 0 SYMBOL_LINK "Rte_CDDInterface9_MultIgnSrlComSvcDft_Cnt_lgc" 0 DISPLAY_IDENTIFIER CDDInterface9.SenderPorts.MultIgnSrlComSvcDft.Cnt_lgc /end MEASUREMENT
/begin MEASUREMENT CDDInterface9.NxtrMEC.Cnt_enum "MICROSAR RTE" UBYTE RTE_CM_ENUM_ManufModeType 0 0 0 2 ECU_ADDRESS 0 SYMBOL_LINK "Rte_CDDInterface9_NxtrMEC_Cnt_enum" 0 DISPLAY_IDENTIFIER CDDInterface9.SenderPorts.NxtrMEC.Cnt_enum /end MEASUREMENT
/begin MEASUREMENT CDDInterface9.OscTrajEnable.Cnt_lgc "MICROSAR RTE" UBYTE RTE_CM_BOOLEAN 0 0 0 255 ECU_ADDRESS 0 SYMBOL_LINK "Rte_CDDInterface9_OscTrajEnable_Cnt_lgc" 0 DISPLAY_IDENTIFIER CDDInterface9.SenderPorts.OscTrajEnable.Cnt_lgc /end MEASUREMENT
/begin MEASUREMENT CDDInterface9.ParkAstSrlComSvcDft.Cnt_lgc "MICROSAR RTE" UBYTE RTE_CM_BOOLEAN 0 0 0 255 ECU_ADDRESS 0 SYMBOL_LINK "Rte_CDDInterface9_ParkAstSrlComSvcDft_Cnt_lgc" 0 DISPLAY_IDENTIFIER CDDInterface9.SenderPorts.ParkAstSrlComSvcDft.Cnt_lgc /end MEASUREMENT
/begin MEASUREMENT CDDInterface9.PosTrajEnable.Cnt_lgc "MICROSAR RTE" UBYTE RTE_CM_BOOLEAN 0 0 0 255 ECU_ADDRESS 0 SYMBOL_LINK "Rte_CDDInterface9_PosTrajEnable_Cnt_lgc" 0 DISPLAY_IDENTIFIER CDDInterface9.SenderPorts.PosTrajEnable.Cnt_lgc /end MEASUREMENT
/begin MEASUREMENT CDDInterface9.PullCompSrlComSvcDft.Cnt_lgc "MICROSAR RTE" UBYTE RTE_CM_BOOLEAN 0 0 0 255 ECU_ADDRESS 0 SYMBOL_LINK "Rte_CDDInterface9_PullCompSrlComSvcDft_Cnt_lgc" 0 DISPLAY_IDENTIFIER CDDInterface9.SenderPorts.PullCompSrlComSvcDft.Cnt_lgc /end MEASUREMENT
/begin MEASUREMENT CDDInterface9.ReturnSrlComSvcDft.Cnt_lgc "MICROSAR RTE" UBYTE RTE_CM_BOOLEAN 0 0 0 255 ECU_ADDRESS 0 SYMBOL_LINK "Rte_CDDInterface9_ReturnSrlComSvcDft_Cnt_lgc" 0 DISPLAY_IDENTIFIER CDDInterface9.SenderPorts.ReturnSrlComSvcDft.Cnt_lgc /end MEASUREMENT
/begin MEASUREMENT CDDInterface9.RxMsgsSrlComSvcDft.Cnt_lgc "MICROSAR RTE" UBYTE RTE_CM_BOOLEAN 0 0 0 255 ECU_ADDRESS 0 SYMBOL_LINK "Rte_CDDInterface9_RxMsgsSrlComSvcDft_Cnt_lgc" 0 DISPLAY_IDENTIFIER CDDInterface9.SenderPorts.RxMsgsSrlComSvcDft.Cnt_lgc /end MEASUREMENT
/begin MEASUREMENT CDDInterface9.SrlComSvcDft.Cnt_b32 "MICROSAR RTE" ULONG NO_COMPU_METHOD 0 0 0 4294967295 ECU_ADDRESS 0 SYMBOL_LINK "Rte_CDDInterface9_SrlComSvcDft_Cnt_b32" 0 DISPLAY_IDENTIFIER CDDInterface9.SenderPorts.SrlComSvcDft.Cnt_b32 /end MEASUREMENT
/begin MEASUREMENT CDDInterface9.TcActivePN.Cnt_u32 "MICROSAR RTE" ULONG NO_COMPU_METHOD 0 0 0 4294967295 ECU_ADDRESS 0 SYMBOL_LINK "Rte_TurnsCounter_TcActivePN_Cnt_u32" 0 DISPLAY_IDENTIFIER CDDInterface9.ReceiverPorts.TcActivePN.Cnt_u32 /end MEASUREMENT
/begin MEASUREMENT CDDInterface9.TcActivePNVldCnt.Cnt_u32 "MICROSAR RTE" ULONG NO_COMPU_METHOD 0 0 0 4294967295 ECU_ADDRESS 0 SYMBOL_LINK "Rte_TurnsCounter_TcActivePNVldCnt_Cnt_u32" 0 DISPLAY_IDENTIFIER CDDInterface9.ReceiverPorts.TcActivePNVldCnt.Cnt_u32 /end MEASUREMENT
/begin MEASUREMENT CDDInterface9.TcFlashErrors.Cnt_u08 "MICROSAR RTE" UBYTE NO_COMPU_METHOD 0 0 0 255 ECU_ADDRESS 0 SYMBOL_LINK "Rte_CDDInterface9_TcFlashErrors_Cnt_u08" 0 DISPLAY_IDENTIFIER CDDInterface9.SenderPorts.TcFlashErrors.Cnt_u08 /end MEASUREMENT
/begin MEASUREMENT CDDInterface9.TcFlashVerify.Cnt_lgc "MICROSAR RTE" UBYTE RTE_CM_BOOLEAN 0 0 0 255 ECU_ADDRESS 0 SYMBOL_LINK "Rte_CDDInterface9_TcFlashVerify_Cnt_lgc" 0 DISPLAY_IDENTIFIER CDDInterface9.SenderPorts.TcFlashVerify.Cnt_lgc /end MEASUREMENT
/begin MEASUREMENT CDDInterface9.ThermalDCSrlComSvcDft.Cnt_lgc "MICROSAR RTE" UBYTE RTE_CM_BOOLEAN 0 0 0 255 ECU_ADDRESS 0 SYMBOL_LINK "Rte_CDDInterface9_ThermalDCSrlComSvcDft_Cnt_lgc" 0 DISPLAY_IDENTIFIER CDDInterface9.SenderPorts.ThermalDCSrlComSvcDft.Cnt_lgc /end MEASUREMENT
/begin MEASUREMENT CDDInterface9.TrqRmpSrlComSvcDft.Cnt_lgc "MICROSAR RTE" UBYTE RTE_CM_BOOLEAN 0 0 0 255 ECU_ADDRESS 0 SYMBOL_LINK "Rte_CDDInterface9_TrqRmpSrlComSvcDft_Cnt_lgc" 0 DISPLAY_IDENTIFIER CDDInterface9.SenderPorts.TrqRmpSrlComSvcDft.Cnt_lgc /end MEASUREMENT
/begin MEASUREMENT CDDInterface9.WhlImbRejSrlComSvcDft.Cnt_lgc "MICROSAR RTE" UBYTE RTE_CM_BOOLEAN 0 0 0 255 ECU_ADDRESS 0 SYMBOL_LINK "Rte_CDDInterface9_WhlImbRejSrlComSvcDft_Cnt_lgc" 0 DISPLAY_IDENTIFIER CDDInterface9.SenderPorts.WhlImbRejSrlComSvcDft.Cnt_lgc /end MEASUREMENT
/begin MEASUREMENT CtrlTemp.AmbTemp.DegC_f32 "MICROSAR RTE" FLOAT32_IEEE NO_COMPU_METHOD 0 0 1.175494351e-38 3.402823466e+38 ECU_ADDRESS 0 SYMBOL_LINK "Rte_CtrlTemp_AmbTemp_DegC_f32" 0 DISPLAY_IDENTIFIER CtrlTemp.ReceiverPorts.AmbTemp.DegC_f32 /end MEASUREMENT
/begin MEASUREMENT CtrlTemp.DiagStsTempRdPrf.Cnt_lgc "MICROSAR RTE" UBYTE RTE_CM_BOOLEAN 0 0 0 255 ECU_ADDRESS 0 SYMBOL_LINK "Rte_DiagMgr10_DiagStsDefTemp_Cnt_lgc" 0 DISPLAY_IDENTIFIER CtrlTemp.ReceiverPorts.DiagStsTempRdPrf.Cnt_lgc /end MEASUREMENT
/begin MEASUREMENT CtrlTemp.FiltMeasTemp.DegC_f32 "MICROSAR RTE" FLOAT32_IEEE NO_COMPU_METHOD 0 0 1.175494351e-38 3.402823466e+38 ECU_ADDRESS 0 SYMBOL_LINK "Rte_CtrlTemp_FiltMeasTemp_DegC_f32" 0 DISPLAY_IDENTIFIER CtrlTemp.SenderPorts.FiltMeasTemp.DegC_f32 /end MEASUREMENT
/begin MEASUREMENT CtrlTemp.TemperatureADC.Volt_f32 "This signal is intended to communicate any type voltage signal measured by the ecu.  This signal has a lower limit of 0 which reequires users of the signal to provide divide by 0 protection if it is used as a denominator in a calculation.  See Vecu port p" FLOAT32_IEEE NO_COMPU_METHOD 0 0 1.175494351e-38 3.402823466e+38 ECU_ADDRESS 0 SYMBOL_LINK "Rte_IoHwAb7_TemperatureADC_Volt_f32" 0 DISPLAY_IDENTIFIER CtrlTemp.ReceiverPorts.TemperatureADC.Volt_f32 /end MEASUREMENT
/begin MEASUREMENT CtrldDisShtdn.AssistAssyPolarity.Cnt_s08 "MICROSAR RTE" SBYTE NO_COMPU_METHOD 0 0 -128 127 ECU_ADDRESS 0 SYMBOL_LINK "Rte_Polarity_AssistAssyPolarity_Cnt_s08" 0 DISPLAY_IDENTIFIER CtrldDisShtdn.ReceiverPorts.AssistAssyPolarity.Cnt_s08 /end MEASUREMENT
/begin MEASUREMENT CtrldDisShtdn.CRFMtrVel.MtrRadpS_f32 "MICROSAR RTE" FLOAT32_IEEE NO_COMPU_METHOD 0 0 1.175494351e-38 3.402823466e+38 ECU_ADDRESS 0 SYMBOL_LINK "Rte_MtrVel_CRFMotorVel_MtrRadpS_f32" 0 DISPLAY_IDENTIFIER CtrldDisShtdn.ReceiverPorts.CRFMtrVel.MtrRadpS_f32 /end MEASUREMENT
/begin MEASUREMENT CtrldDisShtdn.CntDisMtrTrqCmdCRF.MtrNm_f32 "MICROSAR RTE" FLOAT32_IEEE NO_COMPU_METHOD 0 0 1.175494351e-38 3.402823466e+38 ECU_ADDRESS 0 SYMBOL_LINK "Rte_CtrldDisShtdn_CntDisMtrTrqCmdCRF_MtrNm_f32" 0 DISPLAY_IDENTIFIER CtrldDisShtdn.SenderPorts.CntDisMtrTrqCmdCRF.MtrNm_f32 /end MEASUREMENT
/begin MEASUREMENT CtrldDisShtdn.CntDisMtrTrqCmdMRF.MtrNm_f32 "MICROSAR RTE" FLOAT32_IEEE NO_COMPU_METHOD 0 0 1.175494351e-38 3.402823466e+38 ECU_ADDRESS 0 SYMBOL_LINK "Rte_CtrldDisShtdn_CntDisMtrTrqCmdMRF_MtrNm_f32" 0 DISPLAY_IDENTIFIER CtrldDisShtdn.SenderPorts.CntDisMtrTrqCmdMRF.MtrNm_f32 /end MEASUREMENT
/begin MEASUREMENT CtrldDisShtdn.CtrldDmpStsCmp.Cnt_lgc "MICROSAR RTE" UBYTE RTE_CM_BOOLEAN 0 0 0 255 ECU_ADDRESS 0 SYMBOL_LINK "Rte_CtrldDisShtdn_CtrldDmpStsCmp_Cnt_lgc" 0 DISPLAY_IDENTIFIER CtrldDisShtdn.SenderPorts.CtrldDmpStsCmp.Cnt_lgc /end MEASUREMENT
/begin MEASUREMENT CtrldDisShtdn.DiagStsF2Active.Cnt_lgc "MICROSAR RTE" UBYTE RTE_CM_BOOLEAN 0 0 0 255 ECU_ADDRESS 0 SYMBOL_LINK "Rte_DiagMgr10_DiagStsCtrldDisRmpPres_Cnt_lgc" 0 DISPLAY_IDENTIFIER CtrldDisShtdn.ReceiverPorts.DiagStsF2Active.Cnt_lgc /end MEASUREMENT
/begin MEASUREMENT CtrldDisShtdn.SumLimTrqCmd.MtrNm_f32 "MICROSAR RTE" FLOAT32_IEEE NO_COMPU_METHOD 0 0 1.175494351e-38 3.402823466e+38 ECU_ADDRESS 0 SYMBOL_LINK "Rte_Sweep2_OutputMtrTrq_MtrNm_f32" 0 DISPLAY_IDENTIFIER CtrldDisShtdn.ReceiverPorts.SumLimTrqCmd.MtrNm_f32 /end MEASUREMENT
/begin MEASUREMENT CtrldDisShtdn.SysC_CRFMtrTrqCmd.MtrNm_f32 "MICROSAR RTE" FLOAT32_IEEE NO_COMPU_METHOD 0 0 1.175494351e-38 3.402823466e+38 ECU_ADDRESS 0 SYMBOL_LINK "Rte_CtrldDisShtdn_SysC_CRFMtrTrqCmd_MtrNm_f32" 0 DISPLAY_IDENTIFIER CtrldDisShtdn.SenderPorts.SysC_CRFMtrTrqCmd.MtrNm_f32 /end MEASUREMENT
/begin MEASUREMENT CtrldDisShtdn.SysC_MRFMtrTrqCmd.MtrNm_f32 "MICROSAR RTE" FLOAT32_IEEE NO_COMPU_METHOD 0 0 1.175494351e-38 3.402823466e+38 ECU_ADDRESS 0 SYMBOL_LINK "Rte_CtrldDisShtdn_SysC_MRFMtrTrqCmd_MtrNm_f32" 0 DISPLAY_IDENTIFIER CtrldDisShtdn.SenderPorts.SysC_MRFMtrTrqCmd.MtrNm_f32 /end MEASUREMENT
/**********************************************************************************************************************
* GROUP
*********************************************************************************************************************/
/begin GROUP AbsHwPos "MICROSAR RTE"
 /begin SUB_GROUP AbsHwPos.PerInstanceMemories AbsHwPos.ReceiverPorts AbsHwPos.SenderPorts /end SUB_GROUP
 /begin FUNCTION_LIST /end FUNCTION_LIST
 /begin REF_CHARACTERISTIC /end REF_CHARACTERISTIC
 /begin REF_MEASUREMENT /end REF_MEASUREMENT
/end GROUP
/begin GROUP AbsHwPos.AlignedCumMtrPosMRF.Deg_f32 "MICROSAR RTE" /begin SUB_GROUP /end SUB_GROUP /begin FUNCTION_LIST /end FUNCTION_LIST /begin REF_CHARACTERISTIC /end REF_CHARACTERISTIC /begin REF_MEASUREMENT AbsHwPos.AlignedCumMtrPosMRF.Deg_f32 /end REF_MEASUREMENT /end GROUP
/begin GROUP AbsHwPos.AlignedHwPos.HwDeg_f32 "MICROSAR RTE" /begin SUB_GROUP /end SUB_GROUP /begin FUNCTION_LIST /end FUNCTION_LIST /begin REF_CHARACTERISTIC /end REF_CHARACTERISTIC /begin REF_MEASUREMENT AbsHwPos.AlignedHwPos.HwDeg_f32 /end REF_MEASUREMENT /end GROUP
/begin GROUP AbsHwPos.DefeatKinIntTest.Cnt_lgc "MICROSAR RTE" /begin SUB_GROUP /end SUB_GROUP /begin FUNCTION_LIST /end FUNCTION_LIST /begin REF_CHARACTERISTIC /end REF_CHARACTERISTIC /begin REF_MEASUREMENT AbsHwPos.DefeatKinIntTest.Cnt_lgc /end REF_MEASUREMENT /end GROUP
/begin GROUP AbsHwPos.DiagStsDefHwPos.Cnt_lgc "MICROSAR RTE" /begin SUB_GROUP /end SUB_GROUP /begin FUNCTION_LIST /end FUNCTION_LIST /begin REF_CHARACTERISTIC /end REF_CHARACTERISTIC /begin REF_MEASUREMENT AbsHwPos.DiagStsDefHwPos.Cnt_lgc /end REF_MEASUREMENT /end GROUP
/begin GROUP AbsHwPos.DiagStsDefVehSpd.Cnt_lgc "MICROSAR RTE" /begin SUB_GROUP /end SUB_GROUP /begin FUNCTION_LIST /end FUNCTION_LIST /begin REF_CHARACTERISTIC /end REF_CHARACTERISTIC /begin REF_MEASUREMENT AbsHwPos.DiagStsDefVehSpd.Cnt_lgc /end REF_MEASUREMENT /end GROUP
/begin GROUP AbsHwPos.DiagStsHwPosDis.Cnt_lgc "MICROSAR RTE" /begin SUB_GROUP /end SUB_GROUP /begin FUNCTION_LIST /end FUNCTION_LIST /begin REF_CHARACTERISTIC /end REF_CHARACTERISTIC /begin REF_MEASUREMENT AbsHwPos.DiagStsHwPosDis.Cnt_lgc /end REF_MEASUREMENT /end GROUP
/begin GROUP AbsHwPos.HandwheelAuthority.Uls_f32 "MICROSAR RTE" /begin SUB_GROUP /end SUB_GROUP /begin FUNCTION_LIST /end FUNCTION_LIST /begin REF_CHARACTERISTIC /end REF_CHARACTERISTIC /begin REF_MEASUREMENT AbsHwPos.HandwheelAuthority.Uls_f32 /end REF_MEASUREMENT /end GROUP
/begin GROUP AbsHwPos.HandwheelPosition.HwDeg_f32 "MICROSAR RTE" /begin SUB_GROUP /end SUB_GROUP /begin FUNCTION_LIST /end FUNCTION_LIST /begin REF_CHARACTERISTIC /end REF_CHARACTERISTIC /begin REF_MEASUREMENT AbsHwPos.HandwheelPosition.HwDeg_f32 /end REF_MEASUREMENT /end GROUP
/begin GROUP AbsHwPos.HwTargetAuthority.Uls_f32 "MICROSAR RTE" /begin SUB_GROUP /end SUB_GROUP /begin FUNCTION_LIST /end FUNCTION_LIST /begin REF_CHARACTERISTIC /end REF_CHARACTERISTIC /begin REF_MEASUREMENT AbsHwPos.HwTargetAuthority.Uls_f32 /end REF_MEASUREMENT /end GROUP
/begin GROUP AbsHwPos.ICMMtrPosMRF.Deg_f32 "MICROSAR RTE" /begin SUB_GROUP /end SUB_GROUP /begin FUNCTION_LIST /end FUNCTION_LIST /begin REF_CHARACTERISTIC /end REF_CHARACTERISTIC /begin REF_MEASUREMENT AbsHwPos.ICMMtrPosMRF.Deg_f32 /end REF_MEASUREMENT /end GROUP
/begin GROUP AbsHwPos.ICMRevOffsetCRF.Rev_s16 "MICROSAR RTE" /begin SUB_GROUP /end SUB_GROUP /begin FUNCTION_LIST /end FUNCTION_LIST /begin REF_CHARACTERISTIC /end REF_CHARACTERISTIC /begin REF_MEASUREMENT AbsHwPos.ICMRevOffsetCRF.Rev_s16 /end REF_MEASUREMENT /end GROUP
/begin GROUP AbsHwPos.ICMRevOffsetStatus.Cnt_u08 "MICROSAR RTE" /begin SUB_GROUP /end SUB_GROUP /begin FUNCTION_LIST /end FUNCTION_LIST /begin REF_CHARACTERISTIC /end REF_CHARACTERISTIC /begin REF_MEASUREMENT AbsHwPos.ICMRevOffsetStatus.Cnt_u08 /end REF_MEASUREMENT /end GROUP
/begin GROUP AbsHwPos.LTRckCntrComplete.Cnt_lgc "MICROSAR RTE" /begin SUB_GROUP /end SUB_GROUP /begin FUNCTION_LIST /end FUNCTION_LIST /begin REF_CHARACTERISTIC /end REF_CHARACTERISTIC /begin REF_MEASUREMENT AbsHwPos.LTRckCntrComplete.Cnt_lgc /end REF_MEASUREMENT /end GROUP
/begin GROUP AbsHwPos.LTVehCenterComplete.Cnt_lgc "MICROSAR RTE" /begin SUB_GROUP /end SUB_GROUP /begin FUNCTION_LIST /end FUNCTION_LIST /begin REF_CHARACTERISTIC /end REF_CHARACTERISTIC /begin REF_MEASUREMENT AbsHwPos.LTVehCenterComplete.Cnt_lgc /end REF_MEASUREMENT /end GROUP
/begin GROUP AbsHwPos.PerInstanceMemories "MICROSAR RTE" /begin SUB_GROUP AbsHwPos.Trim /end SUB_GROUP /begin FUNCTION_LIST /end FUNCTION_LIST /begin REF_CHARACTERISTIC /end REF_CHARACTERISTIC /begin REF_MEASUREMENT /end REF_MEASUREMENT /end GROUP
/begin GROUP AbsHwPos.Polarity.Cnt_s08 "MICROSAR RTE" /begin SUB_GROUP /end SUB_GROUP /begin FUNCTION_LIST /end FUNCTION_LIST /begin REF_CHARACTERISTIC /end REF_CHARACTERISTIC /begin REF_MEASUREMENT AbsHwPos.Polarity.Cnt_s08 /end REF_MEASUREMENT /end GROUP
/begin GROUP AbsHwPos.RackCenter.HwDeg_f32 "MICROSAR RTE" /begin SUB_GROUP /end SUB_GROUP /begin FUNCTION_LIST /end FUNCTION_LIST /begin REF_CHARACTERISTIC /end REF_CHARACTERISTIC /begin REF_MEASUREMENT AbsHwPos.RackCenter.HwDeg_f32 /end REF_MEASUREMENT /end GROUP
/begin GROUP AbsHwPos.RacktoVehCntrOffset.Cnt_u16 "MICROSAR RTE" /begin SUB_GROUP /end SUB_GROUP /begin FUNCTION_LIST /end FUNCTION_LIST /begin REF_CHARACTERISTIC /end REF_CHARACTERISTIC /begin REF_MEASUREMENT AbsHwPos.RacktoVehCntrOffset.Cnt_u16 /end REF_MEASUREMENT /end GROUP
/begin GROUP AbsHwPos.ReceiverPorts "MICROSAR RTE"
 /begin SUB_GROUP AbsHwPos.AlignedCumMtrPosMRF.Deg_f32 AbsHwPos.DefeatKinIntTest.Cnt_lgc AbsHwPos.DiagStsDefHwPos.Cnt_lgc AbsHwPos.DiagStsDefVehSpd.Cnt_lgc AbsHwPos.DiagStsHwPosDis.Cnt_lgc AbsHwPos.ICMRevOffsetCRF.Rev_s16 AbsHwPos.ICMRevOffsetStatus.Cnt_u08 AbsHwPos.LTRckCntrComplete.Cnt_lgc AbsHwPos.Polarity.Cnt_s08 AbsHwPos.RackCenter.HwDeg_f32 AbsHwPos.TCMtrPosOffsMRF.Deg_f32 AbsHwPos.TorqueCmdCRF.MtrNm_f32 AbsHwPos.TurnsCntrValidity.Cnt_enum AbsHwPos.VehicleSpeed.Kph_f32 /end SUB_GROUP
 /begin FUNCTION_LIST /end FUNCTION_LIST
 /begin REF_CHARACTERISTIC /end REF_CHARACTERISTIC
 /begin REF_MEASUREMENT /end REF_MEASUREMENT
/end GROUP
/begin GROUP AbsHwPos.RevOffsetState.Cnt_u08 "MICROSAR RTE" /begin SUB_GROUP /end SUB_GROUP /begin FUNCTION_LIST /end FUNCTION_LIST /begin REF_CHARACTERISTIC /end REF_CHARACTERISTIC /begin REF_MEASUREMENT AbsHwPos.RevOffsetState.Cnt_u08 /end REF_MEASUREMENT /end GROUP
/begin GROUP AbsHwPos.SenderPorts "MICROSAR RTE"
 /begin SUB_GROUP AbsHwPos.AlignedHwPos.HwDeg_f32 AbsHwPos.HandwheelAuthority.Uls_f32 AbsHwPos.HandwheelPosition.HwDeg_f32 AbsHwPos.HwTargetAuthority.Uls_f32 AbsHwPos.ICMMtrPosMRF.Deg_f32 AbsHwPos.LTVehCenterComplete.Cnt_lgc AbsHwPos.RacktoVehCntrOffset.Cnt_u16 AbsHwPos.RevOffsetState.Cnt_u08 AbsHwPos.SrlComHwPos.HwDeg_f32 /end SUB_GROUP
 /begin FUNCTION_LIST /end FUNCTION_LIST
 /begin REF_CHARACTERISTIC /end REF_CHARACTERISTIC
 /begin REF_MEASUREMENT /end REF_MEASUREMENT
/end GROUP
/begin GROUP AbsHwPos.SrlComHwPos.HwDeg_f32 "MICROSAR RTE" /begin SUB_GROUP /end SUB_GROUP /begin FUNCTION_LIST /end FUNCTION_LIST /begin REF_CHARACTERISTIC /end REF_CHARACTERISTIC /begin REF_MEASUREMENT AbsHwPos.SrlComHwPos.HwDeg_f32 /end REF_MEASUREMENT /end GROUP
/begin GROUP AbsHwPos.TCMtrPosOffsMRF.Deg_f32 "MICROSAR RTE" /begin SUB_GROUP /end SUB_GROUP /begin FUNCTION_LIST /end FUNCTION_LIST /begin REF_CHARACTERISTIC /end REF_CHARACTERISTIC /begin REF_MEASUREMENT AbsHwPos.TCMtrPosOffsMRF.Deg_f32 /end REF_MEASUREMENT /end GROUP
/begin GROUP AbsHwPos.TorqueCmdCRF.MtrNm_f32 "MICROSAR RTE" /begin SUB_GROUP /end SUB_GROUP /begin FUNCTION_LIST /end FUNCTION_LIST /begin REF_CHARACTERISTIC /end REF_CHARACTERISTIC /begin REF_MEASUREMENT AbsHwPos.TorqueCmdCRF.MtrNm_f32 /end REF_MEASUREMENT /end GROUP
/begin GROUP AbsHwPos.Trim "MICROSAR RTE" /begin SUB_GROUP /end SUB_GROUP /begin FUNCTION_LIST /end FUNCTION_LIST /begin REF_CHARACTERISTIC /end REF_CHARACTERISTIC
 /begin REF_MEASUREMENT AbsHwPos.Trim.LTVehCntrComplete AbsHwPos.Trim.R_LTVehCntrComplete AbsHwPos.Trim.R_RacktoVehCntrOffset AbsHwPos.Trim.R_VehCntrOffset AbsHwPos.Trim.RacktoVehCntrOffset AbsHwPos.Trim.VehCntrOffset /end REF_MEASUREMENT
/end GROUP
/begin GROUP AbsHwPos.TurnsCntrValidity.Cnt_enum "MICROSAR RTE" /begin SUB_GROUP /end SUB_GROUP /begin FUNCTION_LIST /end FUNCTION_LIST /begin REF_CHARACTERISTIC /end REF_CHARACTERISTIC /begin REF_MEASUREMENT AbsHwPos.TurnsCntrValidity.Cnt_enum /end REF_MEASUREMENT /end GROUP
/begin GROUP AbsHwPos.VehicleSpeed.Kph_f32 "MICROSAR RTE" /begin SUB_GROUP /end SUB_GROUP /begin FUNCTION_LIST /end FUNCTION_LIST /begin REF_CHARACTERISTIC /end REF_CHARACTERISTIC /begin REF_MEASUREMENT AbsHwPos.VehicleSpeed.Kph_f32 /end REF_MEASUREMENT /end GROUP
/begin GROUP ActivePull "MICROSAR RTE"
 /begin SUB_GROUP ActivePull.ModeRequirePorts ActivePull.PerInstanceMemories ActivePull.ReceiverPorts ActivePull.SenderPorts /end SUB_GROUP
 /begin FUNCTION_LIST /end FUNCTION_LIST
 /begin REF_CHARACTERISTIC /end REF_CHARACTERISTIC
 /begin REF_MEASUREMENT /end REF_MEASUREMENT
/end GROUP
/begin GROUP ActivePull.DisableLearning.Cnt_lgc "MICROSAR RTE" /begin SUB_GROUP /end SUB_GROUP /begin FUNCTION_LIST /end FUNCTION_LIST /begin REF_CHARACTERISTIC /end REF_CHARACTERISTIC /begin REF_MEASUREMENT ActivePull.DisableLearning.Cnt_lgc /end REF_MEASUREMENT /end GROUP
/begin GROUP ActivePull.DisableOutput.Cnt_lgc "MICROSAR RTE" /begin SUB_GROUP /end SUB_GROUP /begin FUNCTION_LIST /end FUNCTION_LIST /begin REF_CHARACTERISTIC /end REF_CHARACTERISTIC /begin REF_MEASUREMENT ActivePull.DisableOutput.Cnt_lgc /end REF_MEASUREMENT /end GROUP
/begin GROUP ActivePull.EstLatAcc.MpSecSq_f32 "MICROSAR RTE" /begin SUB_GROUP /end SUB_GROUP /begin FUNCTION_LIST /end FUNCTION_LIST /begin REF_CHARACTERISTIC /end REF_CHARACTERISTIC /begin REF_MEASUREMENT ActivePull.EstLatAcc.MpSecSq_f32 /end REF_MEASUREMENT /end GROUP
/begin GROUP ActivePull.HandwheelAuthority.Uls_f32 "MICROSAR RTE" /begin SUB_GROUP /end SUB_GROUP /begin FUNCTION_LIST /end FUNCTION_LIST /begin REF_CHARACTERISTIC /end REF_CHARACTERISTIC /begin REF_MEASUREMENT ActivePull.HandwheelAuthority.Uls_f32 /end REF_MEASUREMENT /end GROUP
/begin GROUP ActivePull.HandwheelPosition.HwDeg_f32 "MICROSAR RTE" /begin SUB_GROUP /end SUB_GROUP /begin FUNCTION_LIST /end FUNCTION_LIST /begin REF_CHARACTERISTIC /end REF_CHARACTERISTIC /begin REF_MEASUREMENT ActivePull.HandwheelPosition.HwDeg_f32 /end REF_MEASUREMENT /end GROUP
/begin GROUP ActivePull.HandwheelVelocity.HwRadpS_f32 "MICROSAR RTE" /begin SUB_GROUP /end SUB_GROUP /begin FUNCTION_LIST /end FUNCTION_LIST /begin REF_CHARACTERISTIC /end REF_CHARACTERISTIC /begin REF_MEASUREMENT ActivePull.HandwheelVelocity.HwRadpS_f32 /end REF_MEASUREMENT /end GROUP
/begin GROUP ActivePull.HwTorque.HwNm_f32 "MICROSAR RTE" /begin SUB_GROUP /end SUB_GROUP /begin FUNCTION_LIST /end FUNCTION_LIST /begin REF_CHARACTERISTIC /end REF_CHARACTERISTIC /begin REF_MEASUREMENT ActivePull.HwTorque.HwNm_f32 /end REF_MEASUREMENT /end GROUP
/begin GROUP ActivePull.ModeRequirePorts "MICROSAR RTE" /begin SUB_GROUP ActivePull.SystemState.Mode /end SUB_GROUP /begin FUNCTION_LIST /end FUNCTION_LIST /begin REF_CHARACTERISTIC /end REF_CHARACTERISTIC /begin REF_MEASUREMENT /end REF_MEASUREMENT /end GROUP
/begin GROUP ActivePull.PerInstanceMemories "MICROSAR RTE" /begin SUB_GROUP ActivePull.PullCmpLTComp_HwNm_f32 /end SUB_GROUP /begin FUNCTION_LIST /end FUNCTION_LIST /begin REF_CHARACTERISTIC /end REF_CHARACTERISTIC /begin REF_MEASUREMENT /end REF_MEASUREMENT /end GROUP
/begin GROUP ActivePull.PullCmpCustLrngDi.Cnt_lgc "MICROSAR RTE" /begin SUB_GROUP /end SUB_GROUP /begin FUNCTION_LIST /end FUNCTION_LIST /begin REF_CHARACTERISTIC /end REF_CHARACTERISTIC /begin REF_MEASUREMENT ActivePull.PullCmpCustLrngDi.Cnt_lgc /end REF_MEASUREMENT /end GROUP
/begin GROUP ActivePull.PullCmpEna.Cnt_lgc "MICROSAR RTE" /begin SUB_GROUP /end SUB_GROUP /begin FUNCTION_LIST /end FUNCTION_LIST /begin REF_CHARACTERISTIC /end REF_CHARACTERISTIC /begin REF_MEASUREMENT ActivePull.PullCmpEna.Cnt_lgc /end REF_MEASUREMENT /end GROUP
/begin GROUP ActivePull.PullCmpLTComp_HwNm_f32 "MICROSAR RTE" /begin SUB_GROUP /end SUB_GROUP /begin FUNCTION_LIST /end FUNCTION_LIST /begin REF_CHARACTERISTIC /end REF_CHARACTERISTIC /begin REF_MEASUREMENT ActivePull.PullCmpLTComp_HwNm_f32 /end REF_MEASUREMENT /end GROUP
/begin GROUP ActivePull.PullCmpLongTermIntgtrSt.HwNm_f32 "MICROSAR RTE" /begin SUB_GROUP /end SUB_GROUP /begin FUNCTION_LIST /end FUNCTION_LIST /begin REF_CHARACTERISTIC /end REF_CHARACTERISTIC /begin REF_MEASUREMENT ActivePull.PullCmpLongTermIntgtrSt.HwNm_f32 /end REF_MEASUREMENT /end GROUP
/begin GROUP ActivePull.PullCmpLongTermIntgtrStOffs.HwNm_f32 "MICROSAR RTE" /begin SUB_GROUP /end SUB_GROUP /begin FUNCTION_LIST /end FUNCTION_LIST /begin REF_CHARACTERISTIC /end REF_CHARACTERISTIC /begin REF_MEASUREMENT ActivePull.PullCmpLongTermIntgtrStOffs.HwNm_f32 /end REF_MEASUREMENT /end GROUP
/begin GROUP ActivePull.PullCmpShoTermIntgtrSt.HwNm_f32 "MICROSAR RTE" /begin SUB_GROUP /end SUB_GROUP /begin FUNCTION_LIST /end FUNCTION_LIST /begin REF_CHARACTERISTIC /end REF_CHARACTERISTIC /begin REF_MEASUREMENT ActivePull.PullCmpShoTermIntgtrSt.HwNm_f32 /end REF_MEASUREMENT /end GROUP
/begin GROUP ActivePull.PullCmpShoTermIntgtrStOffs.HwNm_f32 "MICROSAR RTE" /begin SUB_GROUP /end SUB_GROUP /begin FUNCTION_LIST /end FUNCTION_LIST /begin REF_CHARACTERISTIC /end REF_CHARACTERISTIC /begin REF_MEASUREMENT ActivePull.PullCmpShoTermIntgtrStOffs.HwNm_f32 /end REF_MEASUREMENT /end GROUP
/begin GROUP ActivePull.PullCompCmd.MtrNm_f32 "MICROSAR RTE" /begin SUB_GROUP /end SUB_GROUP /begin FUNCTION_LIST /end FUNCTION_LIST /begin REF_CHARACTERISTIC /end REF_CHARACTERISTIC /begin REF_MEASUREMENT ActivePull.PullCompCmd.MtrNm_f32 /end REF_MEASUREMENT /end GROUP
/begin GROUP ActivePull.ReceiverPorts "MICROSAR RTE"
 /begin SUB_GROUP ActivePull.DisableLearning.Cnt_lgc ActivePull.DisableOutput.Cnt_lgc ActivePull.EstLatAcc.MpSecSq_f32 ActivePull.HandwheelAuthority.Uls_f32 ActivePull.HandwheelPosition.HwDeg_f32 ActivePull.HandwheelVelocity.HwRadpS_f32 ActivePull.HwTorque.HwNm_f32 ActivePull.PullCmpCustLrngDi.Cnt_lgc ActivePull.PullCmpEna.Cnt_lgc ActivePull.PullCmpLongTermIntgtrStOffs.HwNm_f32 ActivePull.PullCmpShoTermIntgtrStOffs.HwNm_f32 ActivePull.VehicleSpeed.Kph_f32 ActivePull.VehicleSpeedValid.Cnt_lgc ActivePull.VehicleYawRate.DegpS_f32 /end SUB_GROUP
 /begin FUNCTION_LIST /end FUNCTION_LIST
 /begin REF_CHARACTERISTIC /end REF_CHARACTERISTIC
 /begin REF_MEASUREMENT /end REF_MEASUREMENT
/end GROUP
/begin GROUP ActivePull.SenderPorts "MICROSAR RTE"
 /begin SUB_GROUP ActivePull.PullCmpLongTermIntgtrSt.HwNm_f32 ActivePull.PullCmpShoTermIntgtrSt.HwNm_f32 ActivePull.PullCompCmd.MtrNm_f32 /end SUB_GROUP
 /begin FUNCTION_LIST /end FUNCTION_LIST
 /begin REF_CHARACTERISTIC /end REF_CHARACTERISTIC
 /begin REF_MEASUREMENT /end REF_MEASUREMENT
/end GROUP
/begin GROUP ActivePull.SystemState.Mode "MICROSAR RTE" /begin SUB_GROUP /end SUB_GROUP /begin FUNCTION_LIST /end FUNCTION_LIST /begin REF_CHARACTERISTIC /end REF_CHARACTERISTIC /begin REF_MEASUREMENT ActivePull.SystemState.Mode /end REF_MEASUREMENT /end GROUP
/begin GROUP ActivePull.VehicleSpeed.Kph_f32 "MICROSAR RTE" /begin SUB_GROUP /end SUB_GROUP /begin FUNCTION_LIST /end FUNCTION_LIST /begin REF_CHARACTERISTIC /end REF_CHARACTERISTIC /begin REF_MEASUREMENT ActivePull.VehicleSpeed.Kph_f32 /end REF_MEASUREMENT /end GROUP
/begin GROUP ActivePull.VehicleSpeedValid.Cnt_lgc "MICROSAR RTE" /begin SUB_GROUP /end SUB_GROUP /begin FUNCTION_LIST /end FUNCTION_LIST /begin REF_CHARACTERISTIC /end REF_CHARACTERISTIC /begin REF_MEASUREMENT ActivePull.VehicleSpeedValid.Cnt_lgc /end REF_MEASUREMENT /end GROUP
/begin GROUP ActivePull.VehicleYawRate.DegpS_f32 "MICROSAR RTE" /begin SUB_GROUP /end SUB_GROUP /begin FUNCTION_LIST /end FUNCTION_LIST /begin REF_CHARACTERISTIC /end REF_CHARACTERISTIC /begin REF_MEASUREMENT ActivePull.VehicleYawRate.DegpS_f32 /end REF_MEASUREMENT /end GROUP
/begin GROUP ApXcp "MICROSAR RTE" /begin SUB_GROUP ApXcp.ReceiverPorts ApXcp.SenderPorts /end SUB_GROUP /begin FUNCTION_LIST /end FUNCTION_LIST /begin REF_CHARACTERISTIC /end REF_CHARACTERISTIC /begin REF_MEASUREMENT /end REF_MEASUREMENT /end GROUP
/begin GROUP ApXcp.ActiveTunOvrPtrAddr.Cnt_u32 "MICROSAR RTE" /begin SUB_GROUP /end SUB_GROUP /begin FUNCTION_LIST /end FUNCTION_LIST /begin REF_CHARACTERISTIC /end REF_CHARACTERISTIC /begin REF_MEASUREMENT ApXcp.ActiveTunOvrPtrAddr.Cnt_u32 /end REF_MEASUREMENT /end GROUP
/begin GROUP ApXcp.ActiveTunPers.Cnt_u16 "MICROSAR RTE" /begin SUB_GROUP /end SUB_GROUP /begin FUNCTION_LIST /end FUNCTION_LIST /begin REF_CHARACTERISTIC /end REF_CHARACTERISTIC /begin REF_MEASUREMENT ApXcp.ActiveTunPers.Cnt_u16 /end REF_MEASUREMENT /end GROUP
/begin GROUP ApXcp.ActiveTunSet.Cnt_u16 "MICROSAR RTE" /begin SUB_GROUP /end SUB_GROUP /begin FUNCTION_LIST /end FUNCTION_LIST /begin REF_CHARACTERISTIC /end REF_CHARACTERISTIC /begin REF_MEASUREMENT ApXcp.ActiveTunSet.Cnt_u16 /end REF_MEASUREMENT /end GROUP
/begin GROUP ApXcp.DesiredTunPers.Cnt_u16 "MICROSAR RTE" /begin SUB_GROUP /end SUB_GROUP /begin FUNCTION_LIST /end FUNCTION_LIST /begin REF_CHARACTERISTIC /end REF_CHARACTERISTIC /begin REF_MEASUREMENT ApXcp.DesiredTunPers.Cnt_u16 /end REF_MEASUREMENT /end GROUP
/begin GROUP ApXcp.DesiredTunSet.Cnt_u16 "MICROSAR RTE" /begin SUB_GROUP /end SUB_GROUP /begin FUNCTION_LIST /end FUNCTION_LIST /begin REF_CHARACTERISTIC /end REF_CHARACTERISTIC /begin REF_MEASUREMENT ApXcp.DesiredTunSet.Cnt_u16 /end REF_MEASUREMENT /end GROUP
/begin GROUP ApXcp.ReceiverPorts "MICROSAR RTE"
 /begin SUB_GROUP ApXcp.ActiveTunPers.Cnt_u16 ApXcp.ActiveTunSet.Cnt_u16 ApXcp.DesiredTunPers.Cnt_u16 ApXcp.DesiredTunSet.Cnt_u16 /end SUB_GROUP
 /begin FUNCTION_LIST /end FUNCTION_LIST
 /begin REF_CHARACTERISTIC /end REF_CHARACTERISTIC
 /begin REF_MEASUREMENT /end REF_MEASUREMENT
/end GROUP
/begin GROUP ApXcp.SenderPorts "MICROSAR RTE"
 /begin SUB_GROUP ApXcp.ActiveTunOvrPtrAddr.Cnt_u32 ApXcp.TuningSessionActPtr.Cnt_u8 /end SUB_GROUP
 /begin FUNCTION_LIST /end FUNCTION_LIST
 /begin REF_CHARACTERISTIC /end REF_CHARACTERISTIC
 /begin REF_MEASUREMENT /end REF_MEASUREMENT
/end GROUP
/begin GROUP ApXcp.TuningSessionActPtr.Cnt_u8 "MICROSAR RTE" /begin SUB_GROUP /end SUB_GROUP /begin FUNCTION_LIST /end FUNCTION_LIST /begin REF_CHARACTERISTIC /end REF_CHARACTERISTIC /begin REF_MEASUREMENT ApXcp.TuningSessionActPtr.Cnt_u8 /end REF_MEASUREMENT /end GROUP
/begin GROUP Ap_BmwTqOvrlCdng "MICROSAR RTE"
 /begin SUB_GROUP Ap_BmwTqOvrlCdng.ReceiverPorts Ap_BmwTqOvrlCdng.SenderPorts /end SUB_GROUP
 /begin FUNCTION_LIST /end FUNCTION_LIST
 /begin REF_CHARACTERISTIC /end REF_CHARACTERISTIC
 /begin REF_MEASUREMENT /end REF_MEASUREMENT
/end GROUP
/begin GROUP Ap_BmwTqOvrlCdng.DrvDynActive.Cnt_lgc "MICROSAR RTE" /begin SUB_GROUP /end SUB_GROUP /begin FUNCTION_LIST /end FUNCTION_LIST /begin REF_CHARACTERISTIC /end REF_CHARACTERISTIC /begin REF_MEASUREMENT Ap_BmwTqOvrlCdng.DrvDynActive.Cnt_lgc /end REF_MEASUREMENT /end GROUP
/begin GROUP Ap_BmwTqOvrlCdng.DrvgDynErrIfActv.Cnt_lgc "MICROSAR RTE" /begin SUB_GROUP /end SUB_GROUP /begin FUNCTION_LIST /end FUNCTION_LIST /begin REF_CHARACTERISTIC /end REF_CHARACTERISTIC /begin REF_MEASUREMENT Ap_BmwTqOvrlCdng.DrvgDynErrIfActv.Cnt_lgc /end REF_MEASUREMENT /end GROUP
/begin GROUP Ap_BmwTqOvrlCdng.DrvgDynIfSt.Cnt_u08 "MICROSAR RTE" /begin SUB_GROUP /end SUB_GROUP /begin FUNCTION_LIST /end FUNCTION_LIST /begin REF_CHARACTERISTIC /end REF_CHARACTERISTIC /begin REF_MEASUREMENT Ap_BmwTqOvrlCdng.DrvgDynIfSt.Cnt_u08 /end REF_MEASUREMENT /end GROUP
/begin GROUP Ap_BmwTqOvrlCdng.OpTrqOvRmpInEnable.Cnt_lgc "MICROSAR RTE" /begin SUB_GROUP /end SUB_GROUP /begin FUNCTION_LIST /end FUNCTION_LIST /begin REF_CHARACTERISTIC /end REF_CHARACTERISTIC /begin REF_MEASUREMENT Ap_BmwTqOvrlCdng.OpTrqOvRmpInEnable.Cnt_lgc /end REF_MEASUREMENT /end GROUP
/begin GROUP Ap_BmwTqOvrlCdng.OutpTqOvrl.MtrNm_f32 "MICROSAR RTE" /begin SUB_GROUP /end SUB_GROUP /begin FUNCTION_LIST /end FUNCTION_LIST /begin REF_CHARACTERISTIC /end REF_CHARACTERISTIC /begin REF_MEASUREMENT Ap_BmwTqOvrlCdng.OutpTqOvrl.MtrNm_f32 /end REF_MEASUREMENT /end GROUP
/begin GROUP Ap_BmwTqOvrlCdng.ReceiverPorts "MICROSAR RTE"
 /begin SUB_GROUP Ap_BmwTqOvrlCdng.DrvDynActive.Cnt_lgc Ap_BmwTqOvrlCdng.DrvgDynErrIfActv.Cnt_lgc Ap_BmwTqOvrlCdng.DrvgDynIfSt.Cnt_u08 Ap_BmwTqOvrlCdng.OpTrqOvRmpInEnable.Cnt_lgc Ap_BmwTqOvrlCdng.SerlComTarSteerTqDrvrActr.MtrNm_f32 Ap_BmwTqOvrlCdng.VehicleSpeed.Kph_f32 /end SUB_GROUP
 /begin FUNCTION_LIST /end FUNCTION_LIST
 /begin REF_CHARACTERISTIC /end REF_CHARACTERISTIC
 /begin REF_MEASUREMENT /end REF_MEASUREMENT
/end GROUP
/begin GROUP Ap_BmwTqOvrlCdng.SenderPorts "MICROSAR RTE" /begin SUB_GROUP Ap_BmwTqOvrlCdng.OutpTqOvrl.MtrNm_f32 /end SUB_GROUP /begin FUNCTION_LIST /end FUNCTION_LIST /begin REF_CHARACTERISTIC /end REF_CHARACTERISTIC /begin REF_MEASUREMENT /end REF_MEASUREMENT /end GROUP
/begin GROUP Ap_BmwTqOvrlCdng.SerlComTarSteerTqDrvrActr.MtrNm_f32 "MICROSAR RTE" /begin SUB_GROUP /end SUB_GROUP /begin FUNCTION_LIST /end FUNCTION_LIST /begin REF_CHARACTERISTIC /end REF_CHARACTERISTIC /begin REF_MEASUREMENT Ap_BmwTqOvrlCdng.SerlComTarSteerTqDrvrActr.MtrNm_f32 /end REF_MEASUREMENT /end GROUP
/begin GROUP Ap_BmwTqOvrlCdng.VehicleSpeed.Kph_f32 "MICROSAR RTE" /begin SUB_GROUP /end SUB_GROUP /begin FUNCTION_LIST /end FUNCTION_LIST /begin REF_CHARACTERISTIC /end REF_CHARACTERISTIC /begin REF_MEASUREMENT Ap_BmwTqOvrlCdng.VehicleSpeed.Kph_f32 /end REF_MEASUREMENT /end GROUP
/begin GROUP Ap_TJADamp "MICROSAR RTE" /begin SUB_GROUP Ap_TJADamp.ReceiverPorts Ap_TJADamp.SenderPorts /end SUB_GROUP /begin FUNCTION_LIST /end FUNCTION_LIST /begin REF_CHARACTERISTIC /end REF_CHARACTERISTIC /begin REF_MEASUREMENT /end REF_MEASUREMENT /end GROUP
/begin GROUP Ap_TJADamp.CustomDamp.MtrNm_f32 "MICROSAR RTE" /begin SUB_GROUP /end SUB_GROUP /begin FUNCTION_LIST /end FUNCTION_LIST /begin REF_CHARACTERISTIC /end REF_CHARACTERISTIC /begin REF_MEASUREMENT Ap_TJADamp.CustomDamp.MtrNm_f32 /end REF_MEASUREMENT /end GROUP
/begin GROUP Ap_TJADamp.MtrVelCRF.MtrRadpS_f32 "MICROSAR RTE" /begin SUB_GROUP /end SUB_GROUP /begin FUNCTION_LIST /end FUNCTION_LIST /begin REF_CHARACTERISTIC /end REF_CHARACTERISTIC /begin REF_MEASUREMENT Ap_TJADamp.MtrVelCRF.MtrRadpS_f32 /end REF_MEASUREMENT /end GROUP
/begin GROUP Ap_TJADamp.ReceiverPorts "MICROSAR RTE"
 /begin SUB_GROUP Ap_TJADamp.MtrVelCRF.MtrRadpS_f32 Ap_TJADamp.TJADampSclRqst.Uls_f32 Ap_TJADamp.VehicleSpeed.Kph_f32 /end SUB_GROUP
 /begin FUNCTION_LIST /end FUNCTION_LIST
 /begin REF_CHARACTERISTIC /end REF_CHARACTERISTIC
 /begin REF_MEASUREMENT /end REF_MEASUREMENT
/end GROUP
/begin GROUP Ap_TJADamp.SenderPorts "MICROSAR RTE" /begin SUB_GROUP Ap_TJADamp.CustomDamp.MtrNm_f32 /end SUB_GROUP /begin FUNCTION_LIST /end FUNCTION_LIST /begin REF_CHARACTERISTIC /end REF_CHARACTERISTIC /begin REF_MEASUREMENT /end REF_MEASUREMENT /end GROUP
/begin GROUP Ap_TJADamp.TJADampSclRqst.Uls_f32 "MICROSAR RTE" /begin SUB_GROUP /end SUB_GROUP /begin FUNCTION_LIST /end FUNCTION_LIST /begin REF_CHARACTERISTIC /end REF_CHARACTERISTIC /begin REF_MEASUREMENT Ap_TJADamp.TJADampSclRqst.Uls_f32 /end REF_MEASUREMENT /end GROUP
/begin GROUP Ap_TJADamp.VehicleSpeed.Kph_f32 "MICROSAR RTE" /begin SUB_GROUP /end SUB_GROUP /begin FUNCTION_LIST /end FUNCTION_LIST /begin REF_CHARACTERISTIC /end REF_CHARACTERISTIC /begin REF_MEASUREMENT Ap_TJADamp.VehicleSpeed.Kph_f32 /end REF_MEASUREMENT /end GROUP
/begin GROUP Assist "MICROSAR RTE" /begin SUB_GROUP Assist.ReceiverPorts Assist.SenderPorts /end SUB_GROUP /begin FUNCTION_LIST /end FUNCTION_LIST /begin REF_CHARACTERISTIC /end REF_CHARACTERISTIC /begin REF_MEASUREMENT /end REF_MEASUREMENT /end GROUP
/begin GROUP Assist.AssistDDFactor.Uls_f32 "MICROSAR RTE" /begin SUB_GROUP /end SUB_GROUP /begin FUNCTION_LIST /end FUNCTION_LIST /begin REF_CHARACTERISTIC /end REF_CHARACTERISTIC /begin REF_MEASUREMENT Assist.AssistDDFactor.Uls_f32 /end REF_MEASUREMENT /end GROUP
/begin GROUP Assist.BaseAssistCmd.MtrNm_f32 "MICROSAR RTE" /begin SUB_GROUP /end SUB_GROUP /begin FUNCTION_LIST /end FUNCTION_LIST /begin REF_CHARACTERISTIC /end REF_CHARACTERISTIC /begin REF_MEASUREMENT Assist.BaseAssistCmd.MtrNm_f32 /end REF_MEASUREMENT /end GROUP
/begin GROUP Assist.DftAsstTbl.Cnt_lgc "MICROSAR RTE" /begin SUB_GROUP /end SUB_GROUP /begin FUNCTION_LIST /end FUNCTION_LIST /begin REF_CHARACTERISTIC /end REF_CHARACTERISTIC /begin REF_MEASUREMENT Assist.DftAsstTbl.Cnt_lgc /end REF_MEASUREMENT /end GROUP
/begin GROUP Assist.DutyCycleLevel.Uls_f32 "MICROSAR RTE" /begin SUB_GROUP /end SUB_GROUP /begin FUNCTION_LIST /end FUNCTION_LIST /begin REF_CHARACTERISTIC /end REF_CHARACTERISTIC /begin REF_MEASUREMENT Assist.DutyCycleLevel.Uls_f32 /end REF_MEASUREMENT /end GROUP
/begin GROUP Assist.DwnldAsstGain.Uls_f32 "MICROSAR RTE" /begin SUB_GROUP /end SUB_GROUP /begin FUNCTION_LIST /end FUNCTION_LIST /begin REF_CHARACTERISTIC /end REF_CHARACTERISTIC /begin REF_MEASUREMENT Assist.DwnldAsstGain.Uls_f32 /end REF_MEASUREMENT /end GROUP
/begin GROUP Assist.HwTrq.HwNm_f32 "MICROSAR RTE" /begin SUB_GROUP /end SUB_GROUP /begin FUNCTION_LIST /end FUNCTION_LIST /begin REF_CHARACTERISTIC /end REF_CHARACTERISTIC /begin REF_MEASUREMENT Assist.HwTrq.HwNm_f32 /end REF_MEASUREMENT /end GROUP
/begin GROUP Assist.HwTrqHysAdd.HwNm_f32 "MICROSAR RTE" /begin SUB_GROUP /end SUB_GROUP /begin FUNCTION_LIST /end FUNCTION_LIST /begin REF_CHARACTERISTIC /end REF_CHARACTERISTIC /begin REF_MEASUREMENT Assist.HwTrqHysAdd.HwNm_f32 /end REF_MEASUREMENT /end GROUP
/begin GROUP Assist.IpTrqOvr.HwNm_f32 "MICROSAR RTE" /begin SUB_GROUP /end SUB_GROUP /begin FUNCTION_LIST /end FUNCTION_LIST /begin REF_CHARACTERISTIC /end REF_CHARACTERISTIC /begin REF_MEASUREMENT Assist.IpTrqOvr.HwNm_f32 /end REF_MEASUREMENT /end GROUP
/begin GROUP Assist.ReceiverPorts "MICROSAR RTE"
 /begin SUB_GROUP Assist.AssistDDFactor.Uls_f32 Assist.DftAsstTbl.Cnt_lgc Assist.DutyCycleLevel.Uls_f32 Assist.DwnldAsstGain.Uls_f32 Assist.HwTrq.HwNm_f32 Assist.HwTrqHysAdd.HwNm_f32 Assist.IpTrqOvr.HwNm_f32 Assist.VehSpd.Kph_f32 Assist.WIRCmdAmpBlnd.MtrNm_f32 /end SUB_GROUP
 /begin FUNCTION_LIST /end FUNCTION_LIST
 /begin REF_CHARACTERISTIC /end REF_CHARACTERISTIC
 /begin REF_MEASUREMENT /end REF_MEASUREMENT
/end GROUP
/begin GROUP Assist.SenderPorts "MICROSAR RTE" /begin SUB_GROUP Assist.BaseAssistCmd.MtrNm_f32 /end SUB_GROUP /begin FUNCTION_LIST /end FUNCTION_LIST /begin REF_CHARACTERISTIC /end REF_CHARACTERISTIC /begin REF_MEASUREMENT /end REF_MEASUREMENT /end GROUP
/begin GROUP Assist.VehSpd.Kph_f32 "MICROSAR RTE" /begin SUB_GROUP /end SUB_GROUP /begin FUNCTION_LIST /end FUNCTION_LIST /begin REF_CHARACTERISTIC /end REF_CHARACTERISTIC /begin REF_MEASUREMENT Assist.VehSpd.Kph_f32 /end REF_MEASUREMENT /end GROUP
/begin GROUP Assist.WIRCmdAmpBlnd.MtrNm_f32 "MICROSAR RTE" /begin SUB_GROUP /end SUB_GROUP /begin FUNCTION_LIST /end FUNCTION_LIST /begin REF_CHARACTERISTIC /end REF_CHARACTERISTIC /begin REF_MEASUREMENT Assist.WIRCmdAmpBlnd.MtrNm_f32 /end REF_MEASUREMENT /end GROUP
/begin GROUP AssistFirewall "MICROSAR RTE"
 /begin SUB_GROUP AssistFirewall.ModeRequirePorts AssistFirewall.ReceiverPorts AssistFirewall.SenderPorts /end SUB_GROUP
 /begin FUNCTION_LIST /end FUNCTION_LIST
 /begin REF_CHARACTERISTIC /end REF_CHARACTERISTIC
 /begin REF_MEASUREMENT /end REF_MEASUREMENT
/end GROUP
/begin GROUP AssistFirewall.AsstFirewallActive.Uls_f32 "MICROSAR RTE" /begin SUB_GROUP /end SUB_GROUP /begin FUNCTION_LIST /end FUNCTION_LIST /begin REF_CHARACTERISTIC /end REF_CHARACTERISTIC /begin REF_MEASUREMENT AssistFirewall.AsstFirewallActive.Uls_f32 /end REF_MEASUREMENT /end GROUP
/begin GROUP AssistFirewall.BaseAssistCmd.MtrNm_f32 "MICROSAR RTE" /begin SUB_GROUP /end SUB_GROUP /begin FUNCTION_LIST /end FUNCTION_LIST /begin REF_CHARACTERISTIC /end REF_CHARACTERISTIC /begin REF_MEASUREMENT AssistFirewall.BaseAssistCmd.MtrNm_f32 /end REF_MEASUREMENT /end GROUP
/begin GROUP AssistFirewall.CombinedAssist.MtrNm_f32 "MICROSAR RTE" /begin SUB_GROUP /end SUB_GROUP /begin FUNCTION_LIST /end FUNCTION_LIST /begin REF_CHARACTERISTIC /end REF_CHARACTERISTIC /begin REF_MEASUREMENT AssistFirewall.CombinedAssist.MtrNm_f32 /end REF_MEASUREMENT /end GROUP
/begin GROUP AssistFirewall.Defeat_AsstTbl_Service.Cnt_lgc "MICROSAR RTE" /begin SUB_GROUP /end SUB_GROUP /begin FUNCTION_LIST /end FUNCTION_LIST /begin REF_CHARACTERISTIC /end REF_CHARACTERISTIC /begin REF_MEASUREMENT AssistFirewall.Defeat_AsstTbl_Service.Cnt_lgc /end REF_MEASUREMENT /end GROUP
/begin GROUP AssistFirewall.HighFreqAssist.MtrNm_f32 "MICROSAR RTE" /begin SUB_GROUP /end SUB_GROUP /begin FUNCTION_LIST /end FUNCTION_LIST /begin REF_CHARACTERISTIC /end REF_CHARACTERISTIC /begin REF_MEASUREMENT AssistFirewall.HighFreqAssist.MtrNm_f32 /end REF_MEASUREMENT /end GROUP
/begin GROUP AssistFirewall.HwTorque.HwNm_f32 "MICROSAR RTE" /begin SUB_GROUP /end SUB_GROUP /begin FUNCTION_LIST /end FUNCTION_LIST /begin REF_CHARACTERISTIC /end REF_CHARACTERISTIC /begin REF_MEASUREMENT AssistFirewall.HwTorque.HwNm_f32 /end REF_MEASUREMENT /end GROUP
/begin GROUP AssistFirewall.HysteresisComp.MtrNm_f32 "MICROSAR RTE" /begin SUB_GROUP /end SUB_GROUP /begin FUNCTION_LIST /end FUNCTION_LIST /begin REF_CHARACTERISTIC /end REF_CHARACTERISTIC /begin REF_MEASUREMENT AssistFirewall.HysteresisComp.MtrNm_f32 /end REF_MEASUREMENT /end GROUP
/begin GROUP AssistFirewall.MEC_Counter.Cnt_enum "MICROSAR RTE" /begin SUB_GROUP /end SUB_GROUP /begin FUNCTION_LIST /end FUNCTION_LIST /begin REF_CHARACTERISTIC /end REF_CHARACTERISTIC /begin REF_MEASUREMENT AssistFirewall.MEC_Counter.Cnt_enum /end REF_MEASUREMENT /end GROUP
/begin GROUP AssistFirewall.ModeRequirePorts "MICROSAR RTE" /begin SUB_GROUP AssistFirewall.SystemState.Mode /end SUB_GROUP /begin FUNCTION_LIST /end FUNCTION_LIST /begin REF_CHARACTERISTIC /end REF_CHARACTERISTIC /begin REF_MEASUREMENT /end REF_MEASUREMENT /end GROUP
/begin GROUP AssistFirewall.ReceiverPorts "MICROSAR RTE"
 /begin SUB_GROUP AssistFirewall.BaseAssistCmd.MtrNm_f32 AssistFirewall.Defeat_AsstTbl_Service.Cnt_lgc AssistFirewall.HighFreqAssist.MtrNm_f32 AssistFirewall.HwTorque.HwNm_f32 AssistFirewall.HysteresisComp.MtrNm_f32 AssistFirewall.MEC_Counter.Cnt_enum AssistFirewall.VehicleSpeed.Kph_f32 /end SUB_GROUP
 /begin FUNCTION_LIST /end FUNCTION_LIST
 /begin REF_CHARACTERISTIC /end REF_CHARACTERISTIC
 /begin REF_MEASUREMENT /end REF_MEASUREMENT
/end GROUP
/begin GROUP AssistFirewall.SenderPorts "MICROSAR RTE"
 /begin SUB_GROUP AssistFirewall.AsstFirewallActive.Uls_f32 AssistFirewall.CombinedAssist.MtrNm_f32 /end SUB_GROUP
 /begin FUNCTION_LIST /end FUNCTION_LIST
 /begin REF_CHARACTERISTIC /end REF_CHARACTERISTIC
 /begin REF_MEASUREMENT /end REF_MEASUREMENT
/end GROUP
/begin GROUP AssistFirewall.SystemState.Mode "MICROSAR RTE" /begin SUB_GROUP /end SUB_GROUP /begin FUNCTION_LIST /end FUNCTION_LIST /begin REF_CHARACTERISTIC /end REF_CHARACTERISTIC /begin REF_MEASUREMENT AssistFirewall.SystemState.Mode /end REF_MEASUREMENT /end GROUP
/begin GROUP AssistFirewall.VehicleSpeed.Kph_f32 "MICROSAR RTE" /begin SUB_GROUP /end SUB_GROUP /begin FUNCTION_LIST /end FUNCTION_LIST /begin REF_CHARACTERISTIC /end REF_CHARACTERISTIC /begin REF_MEASUREMENT AssistFirewall.VehicleSpeed.Kph_f32 /end REF_MEASUREMENT /end GROUP
/begin GROUP AssistSumnLmt "MICROSAR RTE"
 /begin SUB_GROUP AssistSumnLmt.ModeRequirePorts AssistSumnLmt.ReceiverPorts AssistSumnLmt.SenderPorts /end SUB_GROUP
 /begin FUNCTION_LIST /end FUNCTION_LIST
 /begin REF_CHARACTERISTIC /end REF_CHARACTERISTIC
 /begin REF_MEASUREMENT /end REF_MEASUREMENT
/end GROUP
/begin GROUP AssistSumnLmt.AssistCmd.MtrNm_f32 "MICROSAR RTE" /begin SUB_GROUP /end SUB_GROUP /begin FUNCTION_LIST /end FUNCTION_LIST /begin REF_CHARACTERISTIC /end REF_CHARACTERISTIC /begin REF_MEASUREMENT AssistSumnLmt.AssistCmd.MtrNm_f32 /end REF_MEASUREMENT /end GROUP
/begin GROUP AssistSumnLmt.AssistPowerLimit.MtrNm_f32 "MICROSAR RTE" /begin SUB_GROUP /end SUB_GROUP /begin FUNCTION_LIST /end FUNCTION_LIST /begin REF_CHARACTERISTIC /end REF_CHARACTERISTIC /begin REF_MEASUREMENT AssistSumnLmt.AssistPowerLimit.MtrNm_f32 /end REF_MEASUREMENT /end GROUP
/begin GROUP AssistSumnLmt.CombinedDamping.MtrNm_f32 "MICROSAR RTE" /begin SUB_GROUP /end SUB_GROUP /begin FUNCTION_LIST /end FUNCTION_LIST /begin REF_CHARACTERISTIC /end REF_CHARACTERISTIC /begin REF_MEASUREMENT AssistSumnLmt.CombinedDamping.MtrNm_f32 /end REF_MEASUREMENT /end GROUP
/begin GROUP AssistSumnLmt.DefeatLimitService.Cnt_lgc "MICROSAR RTE" /begin SUB_GROUP /end SUB_GROUP /begin FUNCTION_LIST /end FUNCTION_LIST /begin REF_CHARACTERISTIC /end REF_CHARACTERISTIC /begin REF_MEASUREMENT AssistSumnLmt.DefeatLimitService.Cnt_lgc /end REF_MEASUREMENT /end GROUP
/begin GROUP AssistSumnLmt.EOTDampingLtd.MtrNm_f32 "MICROSAR RTE" /begin SUB_GROUP /end SUB_GROUP /begin FUNCTION_LIST /end FUNCTION_LIST /begin REF_CHARACTERISTIC /end REF_CHARACTERISTIC /begin REF_MEASUREMENT AssistSumnLmt.EOTDampingLtd.MtrNm_f32 /end REF_MEASUREMENT /end GROUP
/begin GROUP AssistSumnLmt.EOTGainLtd.Uls_f32 "MICROSAR RTE" /begin SUB_GROUP /end SUB_GROUP /begin FUNCTION_LIST /end FUNCTION_LIST /begin REF_CHARACTERISTIC /end REF_CHARACTERISTIC /begin REF_MEASUREMENT AssistSumnLmt.EOTGainLtd.Uls_f32 /end REF_MEASUREMENT /end GROUP
/begin GROUP AssistSumnLmt.EOTLimitLtd.MtrNm_f32 "MICROSAR RTE" /begin SUB_GROUP /end SUB_GROUP /begin FUNCTION_LIST /end FUNCTION_LIST /begin REF_CHARACTERISTIC /end REF_CHARACTERISTIC /begin REF_MEASUREMENT AssistSumnLmt.EOTLimitLtd.MtrNm_f32 /end REF_MEASUREMENT /end GROUP
/begin GROUP AssistSumnLmt.LimitPercentFiltered.Uls_f32 "MICROSAR RTE" /begin SUB_GROUP /end SUB_GROUP /begin FUNCTION_LIST /end FUNCTION_LIST /begin REF_CHARACTERISTIC /end REF_CHARACTERISTIC /begin REF_MEASUREMENT AssistSumnLmt.LimitPercentFiltered.Uls_f32 /end REF_MEASUREMENT /end GROUP
/begin GROUP AssistSumnLmt.LimitedReturn.MtrNm_f32 "MICROSAR RTE" /begin SUB_GROUP /end SUB_GROUP /begin FUNCTION_LIST /end FUNCTION_LIST /begin REF_CHARACTERISTIC /end REF_CHARACTERISTIC /begin REF_MEASUREMENT AssistSumnLmt.LimitedReturn.MtrNm_f32 /end REF_MEASUREMENT /end GROUP
/begin GROUP AssistSumnLmt.LrnPnCtrDisable.Cnt_lgc "MICROSAR RTE" /begin SUB_GROUP /end SUB_GROUP /begin FUNCTION_LIST /end FUNCTION_LIST /begin REF_CHARACTERISTIC /end REF_CHARACTERISTIC /begin REF_MEASUREMENT AssistSumnLmt.LrnPnCtrDisable.Cnt_lgc /end REF_MEASUREMENT /end GROUP
/begin GROUP AssistSumnLmt.LrnPnCtrEnable.Cnt_lgc "MICROSAR RTE" /begin SUB_GROUP /end SUB_GROUP /begin FUNCTION_LIST /end FUNCTION_LIST /begin REF_CHARACTERISTIC /end REF_CHARACTERISTIC /begin REF_MEASUREMENT AssistSumnLmt.LrnPnCtrEnable.Cnt_lgc /end REF_MEASUREMENT /end GROUP
/begin GROUP AssistSumnLmt.LrnPnCtrTCmd.MtrNm_f32 "MICROSAR RTE" /begin SUB_GROUP /end SUB_GROUP /begin FUNCTION_LIST /end FUNCTION_LIST /begin REF_CHARACTERISTIC /end REF_CHARACTERISTIC /begin REF_MEASUREMENT AssistSumnLmt.LrnPnCtrTCmd.MtrNm_f32 /end REF_MEASUREMENT /end GROUP
/begin GROUP AssistSumnLmt.ModeRequirePorts "MICROSAR RTE" /begin SUB_GROUP AssistSumnLmt.SystemState.Mode /end SUB_GROUP /begin FUNCTION_LIST /end FUNCTION_LIST /begin REF_CHARACTERISTIC /end REF_CHARACTERISTIC /begin REF_MEASUREMENT /end REF_MEASUREMENT /end GROUP
/begin GROUP AssistSumnLmt.OutpTqOvrl.MtrNm_f32 "MICROSAR RTE" /begin SUB_GROUP /end SUB_GROUP /begin FUNCTION_LIST /end FUNCTION_LIST /begin REF_CHARACTERISTIC /end REF_CHARACTERISTIC /begin REF_MEASUREMENT AssistSumnLmt.OutpTqOvrl.MtrNm_f32 /end REF_MEASUREMENT /end GROUP
/begin GROUP AssistSumnLmt.OutputRampMultLtd.Uls_f32 "MICROSAR RTE" /begin SUB_GROUP /end SUB_GROUP /begin FUNCTION_LIST /end FUNCTION_LIST /begin REF_CHARACTERISTIC /end REF_CHARACTERISTIC /begin REF_MEASUREMENT AssistSumnLmt.OutputRampMultLtd.Uls_f32 /end REF_MEASUREMENT /end GROUP
/begin GROUP AssistSumnLmt.PostLimitTorque.MtrNm_f32 "MICROSAR RTE" /begin SUB_GROUP /end SUB_GROUP /begin FUNCTION_LIST /end FUNCTION_LIST /begin REF_CHARACTERISTIC /end REF_CHARACTERISTIC /begin REF_MEASUREMENT AssistSumnLmt.PostLimitTorque.MtrNm_f32 /end REF_MEASUREMENT /end GROUP
/begin GROUP AssistSumnLmt.PowerLimitPerc.Uls_f32 "MICROSAR RTE" /begin SUB_GROUP /end SUB_GROUP /begin FUNCTION_LIST /end FUNCTION_LIST /begin REF_CHARACTERISTIC /end REF_CHARACTERISTIC /begin REF_MEASUREMENT AssistSumnLmt.PowerLimitPerc.Uls_f32 /end REF_MEASUREMENT /end GROUP
/begin GROUP AssistSumnLmt.PreLimitForPower.MtrNm_f32 "MICROSAR RTE" /begin SUB_GROUP /end SUB_GROUP /begin FUNCTION_LIST /end FUNCTION_LIST /begin REF_CHARACTERISTIC /end REF_CHARACTERISTIC /begin REF_MEASUREMENT AssistSumnLmt.PreLimitForPower.MtrNm_f32 /end REF_MEASUREMENT /end GROUP
/begin GROUP AssistSumnLmt.PreLimitForStall.MtrNm_f32 "MICROSAR RTE" /begin SUB_GROUP /end SUB_GROUP /begin FUNCTION_LIST /end FUNCTION_LIST /begin REF_CHARACTERISTIC /end REF_CHARACTERISTIC /begin REF_MEASUREMENT AssistSumnLmt.PreLimitForStall.MtrNm_f32 /end REF_MEASUREMENT /end GROUP
/begin GROUP AssistSumnLmt.PreLimitTorque.MtrNm_f32 "MICROSAR RTE" /begin SUB_GROUP /end SUB_GROUP /begin FUNCTION_LIST /end FUNCTION_LIST /begin REF_CHARACTERISTIC /end REF_CHARACTERISTIC /begin REF_MEASUREMENT AssistSumnLmt.PreLimitTorque.MtrNm_f32 /end REF_MEASUREMENT /end GROUP
/begin GROUP AssistSumnLmt.PrkAssistCmd.MtrNm_f32 "MICROSAR RTE" /begin SUB_GROUP /end SUB_GROUP /begin FUNCTION_LIST /end FUNCTION_LIST /begin REF_CHARACTERISTIC /end REF_CHARACTERISTIC /begin REF_MEASUREMENT AssistSumnLmt.PrkAssistCmd.MtrNm_f32 /end REF_MEASUREMENT /end GROUP
/begin GROUP AssistSumnLmt.PrkAssistDisable.Cnt_lgc "MICROSAR RTE" /begin SUB_GROUP /end SUB_GROUP /begin FUNCTION_LIST /end FUNCTION_LIST /begin REF_CHARACTERISTIC /end REF_CHARACTERISTIC /begin REF_MEASUREMENT AssistSumnLmt.PrkAssistDisable.Cnt_lgc /end REF_MEASUREMENT /end GROUP
/begin GROUP AssistSumnLmt.PullCompCmd.MtrNm_f32 "MICROSAR RTE" /begin SUB_GROUP /end SUB_GROUP /begin FUNCTION_LIST /end FUNCTION_LIST /begin REF_CHARACTERISTIC /end REF_CHARACTERISTIC /begin REF_MEASUREMENT AssistSumnLmt.PullCompCmd.MtrNm_f32 /end REF_MEASUREMENT /end GROUP
/begin GROUP AssistSumnLmt.ReceiverPorts "MICROSAR RTE"
 /begin SUB_GROUP AssistSumnLmt.AssistCmd.MtrNm_f32 AssistSumnLmt.AssistPowerLimit.MtrNm_f32 AssistSumnLmt.CombinedDamping.MtrNm_f32 AssistSumnLmt.DefeatLimitService.Cnt_lgc AssistSumnLmt.EOTDampingLtd.MtrNm_f32 AssistSumnLmt.EOTGainLtd.Uls_f32 AssistSumnLmt.EOTLimitLtd.MtrNm_f32 AssistSumnLmt.LimitedReturn.MtrNm_f32 AssistSumnLmt.LrnPnCtrDisable.Cnt_lgc AssistSumnLmt.LrnPnCtrEnable.Cnt_lgc AssistSumnLmt.LrnPnCtrTCmd.MtrNm_f32 AssistSumnLmt.OutpTqOvrl.MtrNm_f32 AssistSumnLmt.OutputRampMultLtd.Uls_f32 AssistSumnLmt.PowerLimitPerc.Uls_f32 AssistSumnLmt.PrkAssistCmd.MtrNm_f32 AssistSumnLmt.PrkAssistDisable.Cnt_lgc AssistSumnLmt.PullCompCmd.MtrNm_f32 AssistSumnLmt.StallLimitLtd.MtrNm_f32 AssistSumnLmt.ThermLimitPerc.Uls_f32 AssistSumnLmt.ThermalLimitLtd.MtrNm_f32 AssistSumnLmt.TrqOscCmd.MtrNm_f32 AssistSumnLmt.VehSpdLimitLtd.MtrNm_f32 AssistSumnLmt.VehicleSpeed.Kph_f32 AssistSumnLmt.WhlImbRejCmd.MtrNm_f32 /end SUB_GROUP
 /begin FUNCTION_LIST /end FUNCTION_LIST
 /begin REF_CHARACTERISTIC /end REF_CHARACTERISTIC
 /begin REF_MEASUREMENT /end REF_MEASUREMENT
/end GROUP
/begin GROUP AssistSumnLmt.SenderPorts "MICROSAR RTE"
 /begin SUB_GROUP AssistSumnLmt.LimitPercentFiltered.Uls_f32 AssistSumnLmt.PostLimitTorque.MtrNm_f32 AssistSumnLmt.PreLimitForPower.MtrNm_f32 AssistSumnLmt.PreLimitForStall.MtrNm_f32 AssistSumnLmt.PreLimitTorque.MtrNm_f32 /end SUB_GROUP
 /begin FUNCTION_LIST /end FUNCTION_LIST
 /begin REF_CHARACTERISTIC /end REF_CHARACTERISTIC
 /begin REF_MEASUREMENT /end REF_MEASUREMENT
/end GROUP
/begin GROUP AssistSumnLmt.StallLimitLtd.MtrNm_f32 "MICROSAR RTE" /begin SUB_GROUP /end SUB_GROUP /begin FUNCTION_LIST /end FUNCTION_LIST /begin REF_CHARACTERISTIC /end REF_CHARACTERISTIC /begin REF_MEASUREMENT AssistSumnLmt.StallLimitLtd.MtrNm_f32 /end REF_MEASUREMENT /end GROUP
/begin GROUP AssistSumnLmt.SystemState.Mode "MICROSAR RTE" /begin SUB_GROUP /end SUB_GROUP /begin FUNCTION_LIST /end FUNCTION_LIST /begin REF_CHARACTERISTIC /end REF_CHARACTERISTIC /begin REF_MEASUREMENT AssistSumnLmt.SystemState.Mode /end REF_MEASUREMENT /end GROUP
/begin GROUP AssistSumnLmt.ThermLimitPerc.Uls_f32 "MICROSAR RTE" /begin SUB_GROUP /end SUB_GROUP /begin FUNCTION_LIST /end FUNCTION_LIST /begin REF_CHARACTERISTIC /end REF_CHARACTERISTIC /begin REF_MEASUREMENT AssistSumnLmt.ThermLimitPerc.Uls_f32 /end REF_MEASUREMENT /end GROUP
/begin GROUP AssistSumnLmt.ThermalLimitLtd.MtrNm_f32 "MICROSAR RTE" /begin SUB_GROUP /end SUB_GROUP /begin FUNCTION_LIST /end FUNCTION_LIST /begin REF_CHARACTERISTIC /end REF_CHARACTERISTIC /begin REF_MEASUREMENT AssistSumnLmt.ThermalLimitLtd.MtrNm_f32 /end REF_MEASUREMENT /end GROUP
/begin GROUP AssistSumnLmt.TrqOscCmd.MtrNm_f32 "MICROSAR RTE" /begin SUB_GROUP /end SUB_GROUP /begin FUNCTION_LIST /end FUNCTION_LIST /begin REF_CHARACTERISTIC /end REF_CHARACTERISTIC /begin REF_MEASUREMENT AssistSumnLmt.TrqOscCmd.MtrNm_f32 /end REF_MEASUREMENT /end GROUP
/begin GROUP AssistSumnLmt.VehSpdLimitLtd.MtrNm_f32 "MICROSAR RTE" /begin SUB_GROUP /end SUB_GROUP /begin FUNCTION_LIST /end FUNCTION_LIST /begin REF_CHARACTERISTIC /end REF_CHARACTERISTIC /begin REF_MEASUREMENT AssistSumnLmt.VehSpdLimitLtd.MtrNm_f32 /end REF_MEASUREMENT /end GROUP
/begin GROUP AssistSumnLmt.VehicleSpeed.Kph_f32 "MICROSAR RTE" /begin SUB_GROUP /end SUB_GROUP /begin FUNCTION_LIST /end FUNCTION_LIST /begin REF_CHARACTERISTIC /end REF_CHARACTERISTIC /begin REF_MEASUREMENT AssistSumnLmt.VehicleSpeed.Kph_f32 /end REF_MEASUREMENT /end GROUP
/begin GROUP AssistSumnLmt.WhlImbRejCmd.MtrNm_f32 "MICROSAR RTE" /begin SUB_GROUP /end SUB_GROUP /begin FUNCTION_LIST /end FUNCTION_LIST /begin REF_CHARACTERISTIC /end REF_CHARACTERISTIC /begin REF_MEASUREMENT AssistSumnLmt.WhlImbRejCmd.MtrNm_f32 /end REF_MEASUREMENT /end GROUP
/begin GROUP AvgFricLrn "MICROSAR RTE"
 /begin SUB_GROUP AvgFricLrn.ModeRequirePorts AvgFricLrn.PerInstanceMemories AvgFricLrn.ReceiverPorts AvgFricLrn.SenderPorts /end SUB_GROUP
 /begin FUNCTION_LIST /end FUNCTION_LIST
 /begin REF_CHARACTERISTIC /end REF_CHARACTERISTIC
 /begin REF_MEASUREMENT /end REF_MEASUREMENT
/end GROUP
/begin GROUP AvgFricLrn.AvgFricLrnData "MICROSAR RTE" /begin SUB_GROUP /end SUB_GROUP /begin FUNCTION_LIST /end FUNCTION_LIST /begin REF_CHARACTERISTIC /end REF_CHARACTERISTIC
 /begin REF_MEASUREMENT AvgFricLrn.AvgFricLrnData.EOLFric_HwNm_f32 AvgFricLrn.AvgFricLrnData.EnableFricLearning_Cnt_lgc AvgFricLrn.AvgFricLrnData.EnableFricOffsetOutput_Cnt_lgc AvgFricLrn.AvgFricLrnData.FricOffset_HwNm_f32 AvgFricLrn.AvgFricLrnData.OpMode_Cnt_enum AvgFricLrn.AvgFricLrnData.RangeCounter_Cnt_u16 AvgFricLrn.AvgFricLrnData.Theta_HwNm_f32 AvgFricLrn.AvgFricLrnData.VehLearnedFric_HwNm_f32 /end REF_MEASUREMENT
/end GROUP
/begin GROUP AvgFricLrn.CRFMtrTrq.MtrNm_f32 "MICROSAR RTE" /begin SUB_GROUP /end SUB_GROUP /begin FUNCTION_LIST /end FUNCTION_LIST /begin REF_CHARACTERISTIC /end REF_CHARACTERISTIC /begin REF_MEASUREMENT AvgFricLrn.CRFMtrTrq.MtrNm_f32 /end REF_MEASUREMENT /end GROUP
/begin GROUP AvgFricLrn.DefeatFricLearning.Cnt_lgc "MICROSAR RTE" /begin SUB_GROUP /end SUB_GROUP /begin FUNCTION_LIST /end FUNCTION_LIST /begin REF_CHARACTERISTIC /end REF_CHARACTERISTIC /begin REF_MEASUREMENT AvgFricLrn.DefeatFricLearning.Cnt_lgc /end REF_MEASUREMENT /end GROUP
/begin GROUP AvgFricLrn.EstFric.HwNm_f32 "MICROSAR RTE" /begin SUB_GROUP /end SUB_GROUP /begin FUNCTION_LIST /end FUNCTION_LIST /begin REF_CHARACTERISTIC /end REF_CHARACTERISTIC /begin REF_MEASUREMENT AvgFricLrn.EstFric.HwNm_f32 /end REF_MEASUREMENT /end GROUP
/begin GROUP AvgFricLrn.FricLrnCustEna.Cnt_lgc "MICROSAR RTE" /begin SUB_GROUP /end SUB_GROUP /begin FUNCTION_LIST /end FUNCTION_LIST /begin REF_CHARACTERISTIC /end REF_CHARACTERISTIC /begin REF_MEASUREMENT AvgFricLrn.FricLrnCustEna.Cnt_lgc /end REF_MEASUREMENT /end GROUP
/begin GROUP AvgFricLrn.FricOffset.HwNm_f32 "MICROSAR RTE" /begin SUB_GROUP /end SUB_GROUP /begin FUNCTION_LIST /end FUNCTION_LIST /begin REF_CHARACTERISTIC /end REF_CHARACTERISTIC /begin REF_MEASUREMENT AvgFricLrn.FricOffset.HwNm_f32 /end REF_MEASUREMENT /end GROUP
/begin GROUP AvgFricLrn.HwAng.HwDeg_f32 "MICROSAR RTE" /begin SUB_GROUP /end SUB_GROUP /begin FUNCTION_LIST /end FUNCTION_LIST /begin REF_CHARACTERISTIC /end REF_CHARACTERISTIC /begin REF_MEASUREMENT AvgFricLrn.HwAng.HwDeg_f32 /end REF_MEASUREMENT /end GROUP
/begin GROUP AvgFricLrn.HwPosAuthority.Uls_f32 "MICROSAR RTE" /begin SUB_GROUP /end SUB_GROUP /begin FUNCTION_LIST /end FUNCTION_LIST /begin REF_CHARACTERISTIC /end REF_CHARACTERISTIC /begin REF_MEASUREMENT AvgFricLrn.HwPosAuthority.Uls_f32 /end REF_MEASUREMENT /end GROUP
/begin GROUP AvgFricLrn.HwTrq.HwNm_f32 "MICROSAR RTE" /begin SUB_GROUP /end SUB_GROUP /begin FUNCTION_LIST /end FUNCTION_LIST /begin REF_CHARACTERISTIC /end REF_CHARACTERISTIC /begin REF_MEASUREMENT AvgFricLrn.HwTrq.HwNm_f32 /end REF_MEASUREMENT /end GROUP
/begin GROUP AvgFricLrn.HwVel.HwRadpS_f32 "MICROSAR RTE" /begin SUB_GROUP /end SUB_GROUP /begin FUNCTION_LIST /end FUNCTION_LIST /begin REF_CHARACTERISTIC /end REF_CHARACTERISTIC /begin REF_MEASUREMENT AvgFricLrn.HwVel.HwRadpS_f32 /end REF_MEASUREMENT /end GROUP
/begin GROUP AvgFricLrn.LatAcc.MpSecSq_f32 "MICROSAR RTE" /begin SUB_GROUP /end SUB_GROUP /begin FUNCTION_LIST /end FUNCTION_LIST /begin REF_CHARACTERISTIC /end REF_CHARACTERISTIC /begin REF_MEASUREMENT AvgFricLrn.LatAcc.MpSecSq_f32 /end REF_MEASUREMENT /end GROUP
/begin GROUP AvgFricLrn.ModeRequirePorts "MICROSAR RTE" /begin SUB_GROUP AvgFricLrn.SystemState.Mode /end SUB_GROUP /begin FUNCTION_LIST /end FUNCTION_LIST /begin REF_CHARACTERISTIC /end REF_CHARACTERISTIC /begin REF_MEASUREMENT /end REF_MEASUREMENT /end GROUP
/begin GROUP AvgFricLrn.PerInstanceMemories "MICROSAR RTE" /begin SUB_GROUP AvgFricLrn.AvgFricLrnData /end SUB_GROUP /begin FUNCTION_LIST /end FUNCTION_LIST /begin REF_CHARACTERISTIC /end REF_CHARACTERISTIC /begin REF_MEASUREMENT /end REF_MEASUREMENT /end GROUP
/begin GROUP AvgFricLrn.ReceiverPorts "MICROSAR RTE"
 /begin SUB_GROUP AvgFricLrn.CRFMtrTrq.MtrNm_f32 AvgFricLrn.DefeatFricLearning.Cnt_lgc AvgFricLrn.FricLrnCustEna.Cnt_lgc AvgFricLrn.HwAng.HwDeg_f32 AvgFricLrn.HwPosAuthority.Uls_f32 AvgFricLrn.HwTrq.HwNm_f32 AvgFricLrn.HwVel.HwRadpS_f32 AvgFricLrn.LatAcc.MpSecSq_f32 AvgFricLrn.Temperature.DegC_f32 AvgFricLrn.VehSpd.Kph_f32 AvgFricLrn.VehicleSpeedValid.Cnt_lgc /end SUB_GROUP
 /begin FUNCTION_LIST /end FUNCTION_LIST
 /begin REF_CHARACTERISTIC /end REF_CHARACTERISTIC
 /begin REF_MEASUREMENT /end REF_MEASUREMENT
/end GROUP
/begin GROUP AvgFricLrn.SatEstFric.HwNm_f32 "MICROSAR RTE" /begin SUB_GROUP /end SUB_GROUP /begin FUNCTION_LIST /end FUNCTION_LIST /begin REF_CHARACTERISTIC /end REF_CHARACTERISTIC /begin REF_MEASUREMENT AvgFricLrn.SatEstFric.HwNm_f32 /end REF_MEASUREMENT /end GROUP
/begin GROUP AvgFricLrn.SenderPorts "MICROSAR RTE"
 /begin SUB_GROUP AvgFricLrn.EstFric.HwNm_f32 AvgFricLrn.FricOffset.HwNm_f32 AvgFricLrn.SatEstFric.HwNm_f32 /end SUB_GROUP
 /begin FUNCTION_LIST /end FUNCTION_LIST
 /begin REF_CHARACTERISTIC /end REF_CHARACTERISTIC
 /begin REF_MEASUREMENT /end REF_MEASUREMENT
/end GROUP
/begin GROUP AvgFricLrn.SystemState.Mode "MICROSAR RTE" /begin SUB_GROUP /end SUB_GROUP /begin FUNCTION_LIST /end FUNCTION_LIST /begin REF_CHARACTERISTIC /end REF_CHARACTERISTIC /begin REF_MEASUREMENT AvgFricLrn.SystemState.Mode /end REF_MEASUREMENT /end GROUP
/begin GROUP AvgFricLrn.Temperature.DegC_f32 "MICROSAR RTE" /begin SUB_GROUP /end SUB_GROUP /begin FUNCTION_LIST /end FUNCTION_LIST /begin REF_CHARACTERISTIC /end REF_CHARACTERISTIC /begin REF_MEASUREMENT AvgFricLrn.Temperature.DegC_f32 /end REF_MEASUREMENT /end GROUP
/begin GROUP AvgFricLrn.VehSpd.Kph_f32 "MICROSAR RTE" /begin SUB_GROUP /end SUB_GROUP /begin FUNCTION_LIST /end FUNCTION_LIST /begin REF_CHARACTERISTIC /end REF_CHARACTERISTIC /begin REF_MEASUREMENT AvgFricLrn.VehSpd.Kph_f32 /end REF_MEASUREMENT /end GROUP
/begin GROUP AvgFricLrn.VehicleSpeedValid.Cnt_lgc "MICROSAR RTE" /begin SUB_GROUP /end SUB_GROUP /begin FUNCTION_LIST /end FUNCTION_LIST /begin REF_CHARACTERISTIC /end REF_CHARACTERISTIC /begin REF_MEASUREMENT AvgFricLrn.VehicleSpeedValid.Cnt_lgc /end REF_MEASUREMENT /end GROUP
/begin GROUP BVDiag "MICROSAR RTE" /begin SUB_GROUP BVDiag.ReceiverPorts /end SUB_GROUP /begin FUNCTION_LIST /end FUNCTION_LIST /begin REF_CHARACTERISTIC /end REF_CHARACTERISTIC /begin REF_MEASUREMENT /end REF_MEASUREMENT /end GROUP
/begin GROUP BVDiag.Batt.Volt_f32 "MICROSAR RTE" /begin SUB_GROUP /end SUB_GROUP /begin FUNCTION_LIST /end FUNCTION_LIST /begin REF_CHARACTERISTIC /end REF_CHARACTERISTIC /begin REF_MEASUREMENT BVDiag.Batt.Volt_f32 /end REF_MEASUREMENT /end GROUP
/begin GROUP BVDiag.CCLMSAActive.Cnt_lgc "MICROSAR RTE" /begin SUB_GROUP /end SUB_GROUP /begin FUNCTION_LIST /end FUNCTION_LIST /begin REF_CHARACTERISTIC /end REF_CHARACTERISTIC /begin REF_MEASUREMENT BVDiag.CCLMSAActive.Cnt_lgc /end REF_MEASUREMENT /end GROUP
/begin GROUP BVDiag.ReceiverPorts "MICROSAR RTE" /begin SUB_GROUP BVDiag.Batt.Volt_f32 BVDiag.CCLMSAActive.Cnt_lgc /end SUB_GROUP /begin FUNCTION_LIST /end FUNCTION_LIST /begin REF_CHARACTERISTIC /end REF_CHARACTERISTIC /begin REF_MEASUREMENT /end REF_MEASUREMENT /end GROUP
/begin GROUP BatteryVoltage "MICROSAR RTE"
 /begin SUB_GROUP BatteryVoltage.ModeRequirePorts BatteryVoltage.ReceiverPorts BatteryVoltage.SenderPorts /end SUB_GROUP
 /begin FUNCTION_LIST /end FUNCTION_LIST
 /begin REF_CHARACTERISTIC /end REF_CHARACTERISTIC
 /begin REF_MEASUREMENT /end REF_MEASUREMENT
/end GROUP
/begin GROUP BatteryVoltage.Batt.Volt_f32 "MICROSAR RTE" /begin SUB_GROUP /end SUB_GROUP /begin FUNCTION_LIST /end FUNCTION_LIST /begin REF_CHARACTERISTIC /end REF_CHARACTERISTIC /begin REF_MEASUREMENT BatteryVoltage.Batt.Volt_f32 /end REF_MEASUREMENT /end GROUP
/begin GROUP BatteryVoltage.BattSwitched.Volt_f32 "MICROSAR RTE" /begin SUB_GROUP /end SUB_GROUP /begin FUNCTION_LIST /end FUNCTION_LIST /begin REF_CHARACTERISTIC /end REF_CHARACTERISTIC /begin REF_MEASUREMENT BatteryVoltage.BattSwitched.Volt_f32 /end REF_MEASUREMENT /end GROUP
/begin GROUP BatteryVoltage.ModeRequirePorts "MICROSAR RTE" /begin SUB_GROUP BatteryVoltage.SystemState.Mode /end SUB_GROUP /begin FUNCTION_LIST /end FUNCTION_LIST /begin REF_CHARACTERISTIC /end REF_CHARACTERISTIC /begin REF_MEASUREMENT /end REF_MEASUREMENT /end GROUP
/begin GROUP BatteryVoltage.ReceiverPorts "MICROSAR RTE"
 /begin SUB_GROUP BatteryVoltage.Batt.Volt_f32 BatteryVoltage.BattSwitched.Volt_f32 BatteryVoltage.SysCVSwitch.Volt_f32 /end SUB_GROUP
 /begin FUNCTION_LIST /end FUNCTION_LIST
 /begin REF_CHARACTERISTIC /end REF_CHARACTERISTIC
 /begin REF_MEASUREMENT /end REF_MEASUREMENT
/end GROUP
/begin GROUP BatteryVoltage.SenderPorts "MICROSAR RTE"
 /begin SUB_GROUP BatteryVoltage.SysC_Vecu.Volt_f32 BatteryVoltage.Vecu.Volt_f32 BatteryVoltage.VswitchClosed.Cnt_lgc /end SUB_GROUP
 /begin FUNCTION_LIST /end FUNCTION_LIST
 /begin REF_CHARACTERISTIC /end REF_CHARACTERISTIC
 /begin REF_MEASUREMENT /end REF_MEASUREMENT
/end GROUP
/begin GROUP BatteryVoltage.SysCVSwitch.Volt_f32 "MICROSAR RTE" /begin SUB_GROUP /end SUB_GROUP /begin FUNCTION_LIST /end FUNCTION_LIST /begin REF_CHARACTERISTIC /end REF_CHARACTERISTIC /begin REF_MEASUREMENT BatteryVoltage.SysCVSwitch.Volt_f32 /end REF_MEASUREMENT /end GROUP
/begin GROUP BatteryVoltage.SysC_Vecu.Volt_f32 "MICROSAR RTE" /begin SUB_GROUP /end SUB_GROUP /begin FUNCTION_LIST /end FUNCTION_LIST /begin REF_CHARACTERISTIC /end REF_CHARACTERISTIC /begin REF_MEASUREMENT BatteryVoltage.SysC_Vecu.Volt_f32 /end REF_MEASUREMENT /end GROUP
/begin GROUP BatteryVoltage.SystemState.Mode "MICROSAR RTE" /begin SUB_GROUP /end SUB_GROUP /begin FUNCTION_LIST /end FUNCTION_LIST /begin REF_CHARACTERISTIC /end REF_CHARACTERISTIC /begin REF_MEASUREMENT BatteryVoltage.SystemState.Mode /end REF_MEASUREMENT /end GROUP
/begin GROUP BatteryVoltage.Vecu.Volt_f32 "MICROSAR RTE" /begin SUB_GROUP /end SUB_GROUP /begin FUNCTION_LIST /end FUNCTION_LIST /begin REF_CHARACTERISTIC /end REF_CHARACTERISTIC /begin REF_MEASUREMENT BatteryVoltage.Vecu.Volt_f32 /end REF_MEASUREMENT /end GROUP
/begin GROUP BatteryVoltage.VswitchClosed.Cnt_lgc "MICROSAR RTE" /begin SUB_GROUP /end SUB_GROUP /begin FUNCTION_LIST /end FUNCTION_LIST /begin REF_CHARACTERISTIC /end REF_CHARACTERISTIC /begin REF_MEASUREMENT BatteryVoltage.VswitchClosed.Cnt_lgc /end REF_MEASUREMENT /end GROUP
/begin GROUP BmwHaptcFb "MICROSAR RTE"
 /begin SUB_GROUP BmwHaptcFb.ModeRequirePorts BmwHaptcFb.ReceiverPorts BmwHaptcFb.SenderPorts /end SUB_GROUP
 /begin FUNCTION_LIST /end FUNCTION_LIST
 /begin REF_CHARACTERISTIC /end REF_CHARACTERISTIC
 /begin REF_MEASUREMENT /end REF_MEASUREMENT
/end GROUP
/begin GROUP BmwHaptcFb.HaptcFbEnable.Cnt_lgc "MICROSAR RTE" /begin SUB_GROUP /end SUB_GROUP /begin FUNCTION_LIST /end FUNCTION_LIST /begin REF_CHARACTERISTIC /end REF_CHARACTERISTIC /begin REF_MEASUREMENT BmwHaptcFb.HaptcFbEnable.Cnt_lgc /end REF_MEASUREMENT /end GROUP
/begin GROUP BmwHaptcFb.HaptcFbIntenNr.Cnt_u16 "MICROSAR RTE" /begin SUB_GROUP /end SUB_GROUP /begin FUNCTION_LIST /end FUNCTION_LIST /begin REF_CHARACTERISTIC /end REF_CHARACTERISTIC /begin REF_MEASUREMENT BmwHaptcFb.HaptcFbIntenNr.Cnt_u16 /end REF_MEASUREMENT /end GROUP
/begin GROUP BmwHaptcFb.HaptcFbIntenSigVld.Cnt_lgc "MICROSAR RTE" /begin SUB_GROUP /end SUB_GROUP /begin FUNCTION_LIST /end FUNCTION_LIST /begin REF_CHARACTERISTIC /end REF_CHARACTERISTIC /begin REF_MEASUREMENT BmwHaptcFb.HaptcFbIntenSigVld.Cnt_lgc /end REF_MEASUREMENT /end GROUP
/begin GROUP BmwHaptcFb.HaptcFbPatNr.Cnt_u16 "MICROSAR RTE" /begin SUB_GROUP /end SUB_GROUP /begin FUNCTION_LIST /end FUNCTION_LIST /begin REF_CHARACTERISTIC /end REF_CHARACTERISTIC /begin REF_MEASUREMENT BmwHaptcFb.HaptcFbPatNr.Cnt_u16 /end REF_MEASUREMENT /end GROUP
/begin GROUP BmwHaptcFb.HaptcFbPatSigVld.Cnt_lgc "MICROSAR RTE" /begin SUB_GROUP /end SUB_GROUP /begin FUNCTION_LIST /end FUNCTION_LIST /begin REF_CHARACTERISTIC /end REF_CHARACTERISTIC /begin REF_MEASUREMENT BmwHaptcFb.HaptcFbPatSigVld.Cnt_lgc /end REF_MEASUREMENT /end GROUP
/begin GROUP BmwHaptcFb.HaptcFbSt.Cnt_u08 "MICROSAR RTE" /begin SUB_GROUP /end SUB_GROUP /begin FUNCTION_LIST /end FUNCTION_LIST /begin REF_CHARACTERISTIC /end REF_CHARACTERISTIC /begin REF_MEASUREMENT BmwHaptcFb.HaptcFbSt.Cnt_u08 /end REF_MEASUREMENT /end GROUP
/begin GROUP BmwHaptcFb.ModeRequirePorts "MICROSAR RTE" /begin SUB_GROUP BmwHaptcFb.SystemState.Mode /end SUB_GROUP /begin FUNCTION_LIST /end FUNCTION_LIST /begin REF_CHARACTERISTIC /end REF_CHARACTERISTIC /begin REF_MEASUREMENT /end REF_MEASUREMENT /end GROUP
/begin GROUP BmwHaptcFb.PostLimitTrq.MtrNm_f32 "MICROSAR RTE" /begin SUB_GROUP /end SUB_GROUP /begin FUNCTION_LIST /end FUNCTION_LIST /begin REF_CHARACTERISTIC /end REF_CHARACTERISTIC /begin REF_MEASUREMENT BmwHaptcFb.PostLimitTrq.MtrNm_f32 /end REF_MEASUREMENT /end GROUP
/begin GROUP BmwHaptcFb.PreLimitTrq.MtrNm_f32 "MICROSAR RTE" /begin SUB_GROUP /end SUB_GROUP /begin FUNCTION_LIST /end FUNCTION_LIST /begin REF_CHARACTERISTIC /end REF_CHARACTERISTIC /begin REF_MEASUREMENT BmwHaptcFb.PreLimitTrq.MtrNm_f32 /end REF_MEASUREMENT /end GROUP
/begin GROUP BmwHaptcFb.ReceiverPorts "MICROSAR RTE"
 /begin SUB_GROUP BmwHaptcFb.HaptcFbEnable.Cnt_lgc BmwHaptcFb.HaptcFbIntenNr.Cnt_u16 BmwHaptcFb.HaptcFbIntenSigVld.Cnt_lgc BmwHaptcFb.HaptcFbPatNr.Cnt_u16 BmwHaptcFb.HaptcFbPatSigVld.Cnt_lgc BmwHaptcFb.PostLimitTrq.MtrNm_f32 BmwHaptcFb.PreLimitTrq.MtrNm_f32 BmwHaptcFb.TrqOscActv.Cnt_lgc BmwHaptcFb.TrqOscDCExceeded.Cnt_lgc BmwHaptcFb.VehicleSpeed.Kph_f32 BmwHaptcFb.VehicleSpeedValid.Cnt_lgc /end SUB_GROUP
 /begin FUNCTION_LIST /end FUNCTION_LIST
 /begin REF_CHARACTERISTIC /end REF_CHARACTERISTIC
 /begin REF_MEASUREMENT /end REF_MEASUREMENT
/end GROUP
/begin GROUP BmwHaptcFb.SenderPorts "MICROSAR RTE"
 /begin SUB_GROUP BmwHaptcFb.HaptcFbSt.Cnt_u08 BmwHaptcFb.TrqOscAmp.MtrNm_f32 BmwHaptcFb.TrqOscEnable.Cnt_lgc BmwHaptcFb.TrqOscFallingRampRate.MtrNmpS_f32 BmwHaptcFb.TrqOscFreq.Hz_f32 BmwHaptcFb.TrqOscRisngRampRate.MtrNmpS_f32 /end SUB_GROUP
 /begin FUNCTION_LIST /end FUNCTION_LIST
 /begin REF_CHARACTERISTIC /end REF_CHARACTERISTIC
 /begin REF_MEASUREMENT /end REF_MEASUREMENT
/end GROUP
/begin GROUP BmwHaptcFb.SystemState.Mode "MICROSAR RTE" /begin SUB_GROUP /end SUB_GROUP /begin FUNCTION_LIST /end FUNCTION_LIST /begin REF_CHARACTERISTIC /end REF_CHARACTERISTIC /begin REF_MEASUREMENT BmwHaptcFb.SystemState.Mode /end REF_MEASUREMENT /end GROUP
/begin GROUP BmwHaptcFb.TrqOscActv.Cnt_lgc "MICROSAR RTE" /begin SUB_GROUP /end SUB_GROUP /begin FUNCTION_LIST /end FUNCTION_LIST /begin REF_CHARACTERISTIC /end REF_CHARACTERISTIC /begin REF_MEASUREMENT BmwHaptcFb.TrqOscActv.Cnt_lgc /end REF_MEASUREMENT /end GROUP
/begin GROUP BmwHaptcFb.TrqOscAmp.MtrNm_f32 "MICROSAR RTE" /begin SUB_GROUP /end SUB_GROUP /begin FUNCTION_LIST /end FUNCTION_LIST /begin REF_CHARACTERISTIC /end REF_CHARACTERISTIC /begin REF_MEASUREMENT BmwHaptcFb.TrqOscAmp.MtrNm_f32 /end REF_MEASUREMENT /end GROUP
/begin GROUP BmwHaptcFb.TrqOscDCExceeded.Cnt_lgc "MICROSAR RTE" /begin SUB_GROUP /end SUB_GROUP /begin FUNCTION_LIST /end FUNCTION_LIST /begin REF_CHARACTERISTIC /end REF_CHARACTERISTIC /begin REF_MEASUREMENT BmwHaptcFb.TrqOscDCExceeded.Cnt_lgc /end REF_MEASUREMENT /end GROUP
/begin GROUP BmwHaptcFb.TrqOscEnable.Cnt_lgc "MICROSAR RTE" /begin SUB_GROUP /end SUB_GROUP /begin FUNCTION_LIST /end FUNCTION_LIST /begin REF_CHARACTERISTIC /end REF_CHARACTERISTIC /begin REF_MEASUREMENT BmwHaptcFb.TrqOscEnable.Cnt_lgc /end REF_MEASUREMENT /end GROUP
/begin GROUP BmwHaptcFb.TrqOscFallingRampRate.MtrNmpS_f32 "MICROSAR RTE" /begin SUB_GROUP /end SUB_GROUP /begin FUNCTION_LIST /end FUNCTION_LIST /begin REF_CHARACTERISTIC /end REF_CHARACTERISTIC /begin REF_MEASUREMENT BmwHaptcFb.TrqOscFallingRampRate.MtrNmpS_f32 /end REF_MEASUREMENT /end GROUP
/begin GROUP BmwHaptcFb.TrqOscFreq.Hz_f32 "MICROSAR RTE" /begin SUB_GROUP /end SUB_GROUP /begin FUNCTION_LIST /end FUNCTION_LIST /begin REF_CHARACTERISTIC /end REF_CHARACTERISTIC /begin REF_MEASUREMENT BmwHaptcFb.TrqOscFreq.Hz_f32 /end REF_MEASUREMENT /end GROUP
/begin GROUP BmwHaptcFb.TrqOscRisngRampRate.MtrNmpS_f32 "MICROSAR RTE" /begin SUB_GROUP /end SUB_GROUP /begin FUNCTION_LIST /end FUNCTION_LIST /begin REF_CHARACTERISTIC /end REF_CHARACTERISTIC /begin REF_MEASUREMENT BmwHaptcFb.TrqOscRisngRampRate.MtrNmpS_f32 /end REF_MEASUREMENT /end GROUP
/begin GROUP BmwHaptcFb.VehicleSpeed.Kph_f32 "MICROSAR RTE" /begin SUB_GROUP /end SUB_GROUP /begin FUNCTION_LIST /end FUNCTION_LIST /begin REF_CHARACTERISTIC /end REF_CHARACTERISTIC /begin REF_MEASUREMENT BmwHaptcFb.VehicleSpeed.Kph_f32 /end REF_MEASUREMENT /end GROUP
/begin GROUP BmwHaptcFb.VehicleSpeedValid.Cnt_lgc "MICROSAR RTE" /begin SUB_GROUP /end SUB_GROUP /begin FUNCTION_LIST /end FUNCTION_LIST /begin REF_CHARACTERISTIC /end REF_CHARACTERISTIC /begin REF_MEASUREMENT BmwHaptcFb.VehicleSpeedValid.Cnt_lgc /end REF_MEASUREMENT /end GROUP
/begin GROUP BmwRtnArbn "MICROSAR RTE" /begin SUB_GROUP BmwRtnArbn.ReceiverPorts BmwRtnArbn.SenderPorts /end SUB_GROUP /begin FUNCTION_LIST /end FUNCTION_LIST /begin REF_CHARACTERISTIC /end REF_CHARACTERISTIC /begin REF_MEASUREMENT /end REF_MEASUREMENT /end GROUP
/begin GROUP BmwRtnArbn.BasicRtnCmd.MtrNm_f32 "MICROSAR RTE" /begin SUB_GROUP /end SUB_GROUP /begin FUNCTION_LIST /end FUNCTION_LIST /begin REF_CHARACTERISTIC /end REF_CHARACTERISTIC /begin REF_MEASUREMENT BmwRtnArbn.BasicRtnCmd.MtrNm_f32 /end REF_MEASUREMENT /end GROUP
/begin GROUP BmwRtnArbn.DefeatReturnSvc.Cnt_lgc "MICROSAR RTE" /begin SUB_GROUP /end SUB_GROUP /begin FUNCTION_LIST /end FUNCTION_LIST /begin REF_CHARACTERISTIC /end REF_CHARACTERISTIC /begin REF_MEASUREMENT BmwRtnArbn.DefeatReturnSvc.Cnt_lgc /end REF_MEASUREMENT /end GROUP
/begin GROUP BmwRtnArbn.DiagStsHwPosDis.Cnt_lgc "MICROSAR RTE" /begin SUB_GROUP /end SUB_GROUP /begin FUNCTION_LIST /end FUNCTION_LIST /begin REF_CHARACTERISTIC /end REF_CHARACTERISTIC /begin REF_MEASUREMENT BmwRtnArbn.DiagStsHwPosDis.Cnt_lgc /end REF_MEASUREMENT /end GROUP
/begin GROUP BmwRtnArbn.EnableCVR.Cnt_lgc "MICROSAR RTE" /begin SUB_GROUP /end SUB_GROUP /begin FUNCTION_LIST /end FUNCTION_LIST /begin REF_CHARACTERISTIC /end REF_CHARACTERISTIC /begin REF_MEASUREMENT BmwRtnArbn.EnableCVR.Cnt_lgc /end REF_MEASUREMENT /end GROUP
/begin GROUP BmwRtnArbn.HandwheelAuthority.Uls_f32 "MICROSAR RTE" /begin SUB_GROUP /end SUB_GROUP /begin FUNCTION_LIST /end FUNCTION_LIST /begin REF_CHARACTERISTIC /end REF_CHARACTERISTIC /begin REF_MEASUREMENT BmwRtnArbn.HandwheelAuthority.Uls_f32 /end REF_MEASUREMENT /end GROUP
/begin GROUP BmwRtnArbn.HandwheelPosition.HwDeg_f32 "MICROSAR RTE" /begin SUB_GROUP /end SUB_GROUP /begin FUNCTION_LIST /end FUNCTION_LIST /begin REF_CHARACTERISTIC /end REF_CHARACTERISTIC /begin REF_MEASUREMENT BmwRtnArbn.HandwheelPosition.HwDeg_f32 /end REF_MEASUREMENT /end GROUP
/begin GROUP BmwRtnArbn.HandwheelVelocity.HwRadpS_f32 "MICROSAR RTE" /begin SUB_GROUP /end SUB_GROUP /begin FUNCTION_LIST /end FUNCTION_LIST /begin REF_CHARACTERISTIC /end REF_CHARACTERISTIC /begin REF_MEASUREMENT BmwRtnArbn.HandwheelVelocity.HwRadpS_f32 /end REF_MEASUREMENT /end GROUP
/begin GROUP BmwRtnArbn.HwTorque.HwNm_f32 "MICROSAR RTE" /begin SUB_GROUP /end SUB_GROUP /begin FUNCTION_LIST /end FUNCTION_LIST /begin REF_CHARACTERISTIC /end REF_CHARACTERISTIC /begin REF_MEASUREMENT BmwRtnArbn.HwTorque.HwNm_f32 /end REF_MEASUREMENT /end GROUP
/begin GROUP BmwRtnArbn.MRFMtrTrqCmdScl.MtrNm_f32 "MICROSAR RTE" /begin SUB_GROUP /end SUB_GROUP /begin FUNCTION_LIST /end FUNCTION_LIST /begin REF_CHARACTERISTIC /end REF_CHARACTERISTIC /begin REF_MEASUREMENT BmwRtnArbn.MRFMtrTrqCmdScl.MtrNm_f32 /end REF_MEASUREMENT /end GROUP
/begin GROUP BmwRtnArbn.PAReturnSclFct.Uls_f32 "MICROSAR RTE" /begin SUB_GROUP /end SUB_GROUP /begin FUNCTION_LIST /end FUNCTION_LIST /begin REF_CHARACTERISTIC /end REF_CHARACTERISTIC /begin REF_MEASUREMENT BmwRtnArbn.PAReturnSclFct.Uls_f32 /end REF_MEASUREMENT /end GROUP
/begin GROUP BmwRtnArbn.ReceiverPorts "MICROSAR RTE"
 /begin SUB_GROUP BmwRtnArbn.BasicRtnCmd.MtrNm_f32 BmwRtnArbn.DefeatReturnSvc.Cnt_lgc BmwRtnArbn.DiagStsHwPosDis.Cnt_lgc BmwRtnArbn.EnableCVR.Cnt_lgc BmwRtnArbn.HandwheelAuthority.Uls_f32 BmwRtnArbn.HandwheelPosition.HwDeg_f32 BmwRtnArbn.HandwheelVelocity.HwRadpS_f32 BmwRtnArbn.HwTorque.HwNm_f32 BmwRtnArbn.MRFMtrTrqCmdScl.MtrNm_f32 BmwRtnArbn.PAReturnSclFct.Uls_f32 BmwRtnArbn.ReturnDDFactor.Uls_f32 BmwRtnArbn.ReturnOffset.HwDeg_f32 BmwRtnArbn.VehicleSpeed.Kph_f32 /end SUB_GROUP
 /begin FUNCTION_LIST /end FUNCTION_LIST
 /begin REF_CHARACTERISTIC /end REF_CHARACTERISTIC
 /begin REF_MEASUREMENT /end REF_MEASUREMENT
/end GROUP
/begin GROUP BmwRtnArbn.ReturnCmd.MtrNm_f32 "MICROSAR RTE" /begin SUB_GROUP /end SUB_GROUP /begin FUNCTION_LIST /end FUNCTION_LIST /begin REF_CHARACTERISTIC /end REF_CHARACTERISTIC /begin REF_MEASUREMENT BmwRtnArbn.ReturnCmd.MtrNm_f32 /end REF_MEASUREMENT /end GROUP
/begin GROUP BmwRtnArbn.ReturnDDFactor.Uls_f32 "MICROSAR RTE" /begin SUB_GROUP /end SUB_GROUP /begin FUNCTION_LIST /end FUNCTION_LIST /begin REF_CHARACTERISTIC /end REF_CHARACTERISTIC /begin REF_MEASUREMENT BmwRtnArbn.ReturnDDFactor.Uls_f32 /end REF_MEASUREMENT /end GROUP
/begin GROUP BmwRtnArbn.ReturnOffset.HwDeg_f32 "MICROSAR RTE" /begin SUB_GROUP /end SUB_GROUP /begin FUNCTION_LIST /end FUNCTION_LIST /begin REF_CHARACTERISTIC /end REF_CHARACTERISTIC /begin REF_MEASUREMENT BmwRtnArbn.ReturnOffset.HwDeg_f32 /end REF_MEASUREMENT /end GROUP
/begin GROUP BmwRtnArbn.SenderPorts "MICROSAR RTE" /begin SUB_GROUP BmwRtnArbn.ReturnCmd.MtrNm_f32 /end SUB_GROUP /begin FUNCTION_LIST /end FUNCTION_LIST /begin REF_CHARACTERISTIC /end REF_CHARACTERISTIC /begin REF_MEASUREMENT /end REF_MEASUREMENT /end GROUP
/begin GROUP BmwRtnArbn.VehicleSpeed.Kph_f32 "MICROSAR RTE" /begin SUB_GROUP /end SUB_GROUP /begin FUNCTION_LIST /end FUNCTION_LIST /begin REF_CHARACTERISTIC /end REF_CHARACTERISTIC /begin REF_MEASUREMENT BmwRtnArbn.VehicleSpeed.Kph_f32 /end REF_MEASUREMENT /end GROUP
/begin GROUP CDDInterface10 "MICROSAR RTE" /begin SUB_GROUP CDDInterface10.ReceiverPorts CDDInterface10.SenderPorts /end SUB_GROUP /begin FUNCTION_LIST /end FUNCTION_LIST /begin REF_CHARACTERISTIC /end REF_CHARACTERISTIC /begin REF_MEASUREMENT /end REF_MEASUREMENT /end GROUP
/begin GROUP CDDInterface10.CommOffset.Cnt_u16 "MICROSAR RTE" /begin SUB_GROUP /end SUB_GROUP /begin FUNCTION_LIST /end FUNCTION_LIST /begin REF_CHARACTERISTIC /end REF_CHARACTERISTIC /begin REF_MEASUREMENT CDDInterface10.CommOffset.Cnt_u16 /end REF_MEASUREMENT /end GROUP
/begin GROUP CDDInterface10.DeadTimeComp.Uls_f32 "MICROSAR RTE" /begin SUB_GROUP /end SUB_GROUP /begin FUNCTION_LIST /end FUNCTION_LIST /begin REF_CHARACTERISTIC /end REF_CHARACTERISTIC /begin REF_MEASUREMENT CDDInterface10.DeadTimeComp.Uls_f32 /end REF_MEASUREMENT /end GROUP
/begin GROUP CDDInterface10.DutyCycleSmall.Cnt_u16 "MICROSAR RTE" /begin SUB_GROUP /end SUB_GROUP /begin FUNCTION_LIST /end FUNCTION_LIST /begin REF_CHARACTERISTIC /end REF_CHARACTERISTIC /begin REF_MEASUREMENT CDDInterface10.DutyCycleSmall.Cnt_u16 /end REF_MEASUREMENT /end GROUP
/begin GROUP CDDInterface10.ExpectedOnTimeA.Cnt_u32 "MICROSAR RTE" /begin SUB_GROUP /end SUB_GROUP /begin FUNCTION_LIST /end FUNCTION_LIST /begin REF_CHARACTERISTIC /end REF_CHARACTERISTIC /begin REF_MEASUREMENT CDDInterface10.ExpectedOnTimeA.Cnt_u32 /end REF_MEASUREMENT /end GROUP
/begin GROUP CDDInterface10.ExpectedOnTimeB.Cnt_u32 "MICROSAR RTE" /begin SUB_GROUP /end SUB_GROUP /begin FUNCTION_LIST /end FUNCTION_LIST /begin REF_CHARACTERISTIC /end REF_CHARACTERISTIC /begin REF_MEASUREMENT CDDInterface10.ExpectedOnTimeB.Cnt_u32 /end REF_MEASUREMENT /end GROUP
/begin GROUP CDDInterface10.ExpectedOnTimeC.Cnt_u32 "MICROSAR RTE" /begin SUB_GROUP /end SUB_GROUP /begin FUNCTION_LIST /end FUNCTION_LIST /begin REF_CHARACTERISTIC /end REF_CHARACTERISTIC /begin REF_MEASUREMENT CDDInterface10.ExpectedOnTimeC.Cnt_u32 /end REF_MEASUREMENT /end GROUP
/begin GROUP CDDInterface10.FETFaultPhase.Cnt_enum "MICROSAR RTE" /begin SUB_GROUP /end SUB_GROUP /begin FUNCTION_LIST /end FUNCTION_LIST /begin REF_CHARACTERISTIC /end REF_CHARACTERISTIC /begin REF_MEASUREMENT CDDInterface10.FETFaultPhase.Cnt_enum /end REF_MEASUREMENT /end GROUP
/begin GROUP CDDInterface10.FETFaultType.Cnt_enum "MICROSAR RTE" /begin SUB_GROUP /end SUB_GROUP /begin FUNCTION_LIST /end FUNCTION_LIST /begin REF_CHARACTERISTIC /end REF_CHARACTERISTIC /begin REF_MEASUREMENT CDDInterface10.FETFaultType.Cnt_enum /end REF_MEASUREMENT /end GROUP
/begin GROUP CDDInterface10.MeasuredOnTimeA.Cnt_u32 "MICROSAR RTE" /begin SUB_GROUP /end SUB_GROUP /begin FUNCTION_LIST /end FUNCTION_LIST /begin REF_CHARACTERISTIC /end REF_CHARACTERISTIC /begin REF_MEASUREMENT CDDInterface10.MeasuredOnTimeA.Cnt_u32 /end REF_MEASUREMENT /end GROUP
/begin GROUP CDDInterface10.MeasuredOnTimeB.Cnt_u32 "MICROSAR RTE" /begin SUB_GROUP /end SUB_GROUP /begin FUNCTION_LIST /end FUNCTION_LIST /begin REF_CHARACTERISTIC /end REF_CHARACTERISTIC /begin REF_MEASUREMENT CDDInterface10.MeasuredOnTimeB.Cnt_u32 /end REF_MEASUREMENT /end GROUP
/begin GROUP CDDInterface10.MeasuredOnTimeC.Cnt_u32 "MICROSAR RTE" /begin SUB_GROUP /end SUB_GROUP /begin FUNCTION_LIST /end FUNCTION_LIST /begin REF_CHARACTERISTIC /end REF_CHARACTERISTIC /begin REF_MEASUREMENT CDDInterface10.MeasuredOnTimeC.Cnt_u32 /end REF_MEASUREMENT /end GROUP
/begin GROUP CDDInterface10.ModIdxFinal.Uls_f32 "MICROSAR RTE" /begin SUB_GROUP /end SUB_GROUP /begin FUNCTION_LIST /end FUNCTION_LIST /begin REF_CHARACTERISTIC /end REF_CHARACTERISTIC /begin REF_MEASUREMENT CDDInterface10.ModIdxFinal.Uls_f32 /end REF_MEASUREMENT /end GROUP
/begin GROUP CDDInterface10.MtrElecMechPolarity.Cnt_s08 "MICROSAR RTE" /begin SUB_GROUP /end SUB_GROUP /begin FUNCTION_LIST /end FUNCTION_LIST /begin REF_CHARACTERISTIC /end REF_CHARACTERISTIC /begin REF_MEASUREMENT CDDInterface10.MtrElecMechPolarity.Cnt_s08 /end REF_MEASUREMENT /end GROUP
/begin GROUP CDDInterface10.MtrTrqCmdSign.Cnt_s16 "MICROSAR RTE" /begin SUB_GROUP /end SUB_GROUP /begin FUNCTION_LIST /end FUNCTION_LIST /begin REF_CHARACTERISTIC /end REF_CHARACTERISTIC /begin REF_MEASUREMENT CDDInterface10.MtrTrqCmdSign.Cnt_s16 /end REF_MEASUREMENT /end GROUP
/begin GROUP CDDInterface10.PhaseAdvFinal.Cnt_u16 "MICROSAR RTE" /begin SUB_GROUP /end SUB_GROUP /begin FUNCTION_LIST /end FUNCTION_LIST /begin REF_CHARACTERISTIC /end REF_CHARACTERISTIC /begin REF_MEASUREMENT CDDInterface10.PhaseAdvFinal.Cnt_u16 /end REF_MEASUREMENT /end GROUP
/begin GROUP CDDInterface10.ReceiverPorts "MICROSAR RTE"
 /begin SUB_GROUP CDDInterface10.CommOffset.Cnt_u16 CDDInterface10.DeadTimeComp.Uls_f32 CDDInterface10.FETFaultPhase.Cnt_enum CDDInterface10.FETFaultType.Cnt_enum CDDInterface10.ModIdxFinal.Uls_f32 CDDInterface10.MtrElecMechPolarity.Cnt_s08 CDDInterface10.MtrTrqCmdSign.Cnt_s16 CDDInterface10.PhaseAdvFinal.Cnt_u16 /end SUB_GROUP
 /begin FUNCTION_LIST /end FUNCTION_LIST
 /begin REF_CHARACTERISTIC /end REF_CHARACTERISTIC
 /begin REF_MEASUREMENT /end REF_MEASUREMENT
/end GROUP
/begin GROUP CDDInterface10.SenderPorts "MICROSAR RTE"
 /begin SUB_GROUP CDDInterface10.DutyCycleSmall.Cnt_u16 CDDInterface10.ExpectedOnTimeA.Cnt_u32 CDDInterface10.ExpectedOnTimeB.Cnt_u32 CDDInterface10.ExpectedOnTimeC.Cnt_u32 CDDInterface10.MeasuredOnTimeA.Cnt_u32 CDDInterface10.MeasuredOnTimeB.Cnt_u32 CDDInterface10.MeasuredOnTimeC.Cnt_u32 /end SUB_GROUP
 /begin FUNCTION_LIST /end FUNCTION_LIST
 /begin REF_CHARACTERISTIC /end REF_CHARACTERISTIC
 /begin REF_MEASUREMENT /end REF_MEASUREMENT
/end GROUP
/begin GROUP CDDInterface9 "MICROSAR RTE" /begin SUB_GROUP CDDInterface9.ReceiverPorts CDDInterface9.SenderPorts /end SUB_GROUP /begin FUNCTION_LIST /end FUNCTION_LIST /begin REF_CHARACTERISTIC /end REF_CHARACTERISTIC /begin REF_MEASUREMENT /end REF_MEASUREMENT /end GROUP
/begin GROUP CDDInterface9.ActPullCompLrnSrlComSvcDft.Cnt_lgc "MICROSAR RTE" /begin SUB_GROUP /end SUB_GROUP /begin FUNCTION_LIST /end FUNCTION_LIST /begin REF_CHARACTERISTIC /end REF_CHARACTERISTIC /begin REF_MEASUREMENT CDDInterface9.ActPullCompLrnSrlComSvcDft.Cnt_lgc /end REF_MEASUREMENT /end GROUP
/begin GROUP CDDInterface9.AvgFrcLrnSrlComSvcDft.Cnt_lgc "MICROSAR RTE" /begin SUB_GROUP /end SUB_GROUP /begin FUNCTION_LIST /end FUNCTION_LIST /begin REF_CHARACTERISTIC /end REF_CHARACTERISTIC /begin REF_MEASUREMENT CDDInterface9.AvgFrcLrnSrlComSvcDft.Cnt_lgc /end REF_MEASUREMENT /end GROUP
/begin GROUP CDDInterface9.DampingSrlComSvcDft.Cnt_lgc "MICROSAR RTE" /begin SUB_GROUP /end SUB_GROUP /begin FUNCTION_LIST /end FUNCTION_LIST /begin REF_CHARACTERISTIC /end REF_CHARACTERISTIC /begin REF_MEASUREMENT CDDInterface9.DampingSrlComSvcDft.Cnt_lgc /end REF_MEASUREMENT /end GROUP
/begin GROUP CDDInterface9.DftAsstTbl.Cnt_lgc "MICROSAR RTE" /begin SUB_GROUP /end SUB_GROUP /begin FUNCTION_LIST /end FUNCTION_LIST /begin REF_CHARACTERISTIC /end REF_CHARACTERISTIC /begin REF_MEASUREMENT CDDInterface9.DftAsstTbl.Cnt_lgc /end REF_MEASUREMENT /end GROUP
/begin GROUP CDDInterface9.DrivingDynSrlComSvcDft.Cnt_lgc "MICROSAR RTE" /begin SUB_GROUP /end SUB_GROUP /begin FUNCTION_LIST /end FUNCTION_LIST /begin REF_CHARACTERISTIC /end REF_CHARACTERISTIC /begin REF_MEASUREMENT CDDInterface9.DrivingDynSrlComSvcDft.Cnt_lgc /end REF_MEASUREMENT /end GROUP
/begin GROUP CDDInterface9.DwnldAsstGain.Uls_f32 "MICROSAR RTE" /begin SUB_GROUP /end SUB_GROUP /begin FUNCTION_LIST /end FUNCTION_LIST /begin REF_CHARACTERISTIC /end REF_CHARACTERISTIC /begin REF_MEASUREMENT CDDInterface9.DwnldAsstGain.Uls_f32 /end REF_MEASUREMENT /end GROUP
/begin GROUP CDDInterface9.EOTImpactSrlComSvcDft.Cnt_lgc "MICROSAR RTE" /begin SUB_GROUP /end SUB_GROUP /begin FUNCTION_LIST /end FUNCTION_LIST /begin REF_CHARACTERISTIC /end REF_CHARACTERISTIC /begin REF_MEASUREMENT CDDInterface9.EOTImpactSrlComSvcDft.Cnt_lgc /end REF_MEASUREMENT /end GROUP
/begin GROUP CDDInterface9.EOTThermalSrlComSvcDft.Cnt_lgc "MICROSAR RTE" /begin SUB_GROUP /end SUB_GROUP /begin FUNCTION_LIST /end FUNCTION_LIST /begin REF_CHARACTERISTIC /end REF_CHARACTERISTIC /begin REF_MEASUREMENT CDDInterface9.EOTThermalSrlComSvcDft.Cnt_lgc /end REF_MEASUREMENT /end GROUP
/begin GROUP CDDInterface9.EngONSrlComSvcDft.Cnt_lgc "MICROSAR RTE" /begin SUB_GROUP /end SUB_GROUP /begin FUNCTION_LIST /end FUNCTION_LIST /begin REF_CHARACTERISTIC /end REF_CHARACTERISTIC /begin REF_MEASUREMENT CDDInterface9.EngONSrlComSvcDft.Cnt_lgc /end REF_MEASUREMENT /end GROUP
/begin GROUP CDDInterface9.FirewallSrlComSrvDft.Cnt_lgc "MICROSAR RTE" /begin SUB_GROUP /end SUB_GROUP /begin FUNCTION_LIST /end FUNCTION_LIST /begin REF_CHARACTERISTIC /end REF_CHARACTERISTIC /begin REF_MEASUREMENT CDDInterface9.FirewallSrlComSrvDft.Cnt_lgc /end REF_MEASUREMENT /end GROUP
/begin GROUP CDDInterface9.FreqDepDmpSrlComSvcDft.Cnt_lgc "MICROSAR RTE" /begin SUB_GROUP /end SUB_GROUP /begin FUNCTION_LIST /end FUNCTION_LIST /begin REF_CHARACTERISTIC /end REF_CHARACTERISTIC /begin REF_MEASUREMENT CDDInterface9.FreqDepDmpSrlComSvcDft.Cnt_lgc /end REF_MEASUREMENT /end GROUP
/begin GROUP CDDInterface9.HysAddSrlComSvcDft.Cnt_lgc "MICROSAR RTE" /begin SUB_GROUP /end SUB_GROUP /begin FUNCTION_LIST /end FUNCTION_LIST /begin REF_CHARACTERISTIC /end REF_CHARACTERISTIC /begin REF_MEASUREMENT CDDInterface9.HysAddSrlComSvcDft.Cnt_lgc /end REF_MEASUREMENT /end GROUP
/begin GROUP CDDInterface9.HystCompSrlComSvcDft.Cnt_lgc "MICROSAR RTE" /begin SUB_GROUP /end SUB_GROUP /begin FUNCTION_LIST /end FUNCTION_LIST /begin REF_CHARACTERISTIC /end REF_CHARACTERISTIC /begin REF_MEASUREMENT CDDInterface9.HystCompSrlComSvcDft.Cnt_lgc /end REF_MEASUREMENT /end GROUP
/begin GROUP CDDInterface9.IgnCnt.Cnt_u16 "MICROSAR RTE" /begin SUB_GROUP /end SUB_GROUP /begin FUNCTION_LIST /end FUNCTION_LIST /begin REF_CHARACTERISTIC /end REF_CHARACTERISTIC /begin REF_MEASUREMENT CDDInterface9.IgnCnt.Cnt_u16 /end REF_MEASUREMENT /end GROUP
/begin GROUP CDDInterface9.KinIntDiagSrlComSvcDft.Cnt_lgc "MICROSAR RTE" /begin SUB_GROUP /end SUB_GROUP /begin FUNCTION_LIST /end FUNCTION_LIST /begin REF_CHARACTERISTIC /end REF_CHARACTERISTIC /begin REF_MEASUREMENT CDDInterface9.KinIntDiagSrlComSvcDft.Cnt_lgc /end REF_MEASUREMENT /end GROUP
/begin GROUP CDDInterface9.LimitSrlComSvcDft.Cnt_lgc "MICROSAR RTE" /begin SUB_GROUP /end SUB_GROUP /begin FUNCTION_LIST /end FUNCTION_LIST /begin REF_CHARACTERISTIC /end REF_CHARACTERISTIC /begin REF_MEASUREMENT CDDInterface9.LimitSrlComSvcDft.Cnt_lgc /end REF_MEASUREMENT /end GROUP
/begin GROUP CDDInterface9.LrnPnCenterEnable.Cnt_lgc "MICROSAR RTE" /begin SUB_GROUP /end SUB_GROUP /begin FUNCTION_LIST /end FUNCTION_LIST /begin REF_CHARACTERISTIC /end REF_CHARACTERISTIC /begin REF_MEASUREMENT CDDInterface9.LrnPnCenterEnable.Cnt_lgc /end REF_MEASUREMENT /end GROUP
/begin GROUP CDDInterface9.MfgDiagInhibit.Cnt_lgc "MICROSAR RTE" /begin SUB_GROUP /end SUB_GROUP /begin FUNCTION_LIST /end FUNCTION_LIST /begin REF_CHARACTERISTIC /end REF_CHARACTERISTIC /begin REF_MEASUREMENT CDDInterface9.MfgDiagInhibit.Cnt_lgc /end REF_MEASUREMENT /end GROUP
/begin GROUP CDDInterface9.ModIdxSrlComSvcDft.Cnt_lgc "MICROSAR RTE" /begin SUB_GROUP /end SUB_GROUP /begin FUNCTION_LIST /end FUNCTION_LIST /begin REF_CHARACTERISTIC /end REF_CHARACTERISTIC /begin REF_MEASUREMENT CDDInterface9.ModIdxSrlComSvcDft.Cnt_lgc /end REF_MEASUREMENT /end GROUP
/begin GROUP CDDInterface9.MtrParmNrmLrnSrlComSvcDft.Cnt_lgc "MICROSAR RTE" /begin SUB_GROUP /end SUB_GROUP /begin FUNCTION_LIST /end FUNCTION_LIST /begin REF_CHARACTERISTIC /end REF_CHARACTERISTIC /begin REF_MEASUREMENT CDDInterface9.MtrParmNrmLrnSrlComSvcDft.Cnt_lgc /end REF_MEASUREMENT /end GROUP
/begin GROUP CDDInterface9.MtrVelNrmLrnSrlComSvcDft.Cnt_lgc "MICROSAR RTE" /begin SUB_GROUP /end SUB_GROUP /begin FUNCTION_LIST /end FUNCTION_LIST /begin REF_CHARACTERISTIC /end REF_CHARACTERISTIC /begin REF_MEASUREMENT CDDInterface9.MtrVelNrmLrnSrlComSvcDft.Cnt_lgc /end REF_MEASUREMENT /end GROUP
/begin GROUP CDDInterface9.MultIgnSrlComSvcDft.Cnt_lgc "MICROSAR RTE" /begin SUB_GROUP /end SUB_GROUP /begin FUNCTION_LIST /end FUNCTION_LIST /begin REF_CHARACTERISTIC /end REF_CHARACTERISTIC /begin REF_MEASUREMENT CDDInterface9.MultIgnSrlComSvcDft.Cnt_lgc /end REF_MEASUREMENT /end GROUP
/begin GROUP CDDInterface9.NxtrMEC.Cnt_enum "MICROSAR RTE" /begin SUB_GROUP /end SUB_GROUP /begin FUNCTION_LIST /end FUNCTION_LIST /begin REF_CHARACTERISTIC /end REF_CHARACTERISTIC /begin REF_MEASUREMENT CDDInterface9.NxtrMEC.Cnt_enum /end REF_MEASUREMENT /end GROUP
/begin GROUP CDDInterface9.OscTrajEnable.Cnt_lgc "MICROSAR RTE" /begin SUB_GROUP /end SUB_GROUP /begin FUNCTION_LIST /end FUNCTION_LIST /begin REF_CHARACTERISTIC /end REF_CHARACTERISTIC /begin REF_MEASUREMENT CDDInterface9.OscTrajEnable.Cnt_lgc /end REF_MEASUREMENT /end GROUP
/begin GROUP CDDInterface9.ParkAstSrlComSvcDft.Cnt_lgc "MICROSAR RTE" /begin SUB_GROUP /end SUB_GROUP /begin FUNCTION_LIST /end FUNCTION_LIST /begin REF_CHARACTERISTIC /end REF_CHARACTERISTIC /begin REF_MEASUREMENT CDDInterface9.ParkAstSrlComSvcDft.Cnt_lgc /end REF_MEASUREMENT /end GROUP
/begin GROUP CDDInterface9.PosTrajEnable.Cnt_lgc "MICROSAR RTE" /begin SUB_GROUP /end SUB_GROUP /begin FUNCTION_LIST /end FUNCTION_LIST /begin REF_CHARACTERISTIC /end REF_CHARACTERISTIC /begin REF_MEASUREMENT CDDInterface9.PosTrajEnable.Cnt_lgc /end REF_MEASUREMENT /end GROUP
/begin GROUP CDDInterface9.PullCompSrlComSvcDft.Cnt_lgc "MICROSAR RTE" /begin SUB_GROUP /end SUB_GROUP /begin FUNCTION_LIST /end FUNCTION_LIST /begin REF_CHARACTERISTIC /end REF_CHARACTERISTIC /begin REF_MEASUREMENT CDDInterface9.PullCompSrlComSvcDft.Cnt_lgc /end REF_MEASUREMENT /end GROUP
/begin GROUP CDDInterface9.ReceiverPorts "MICROSAR RTE"
 /begin SUB_GROUP CDDInterface9.TcActivePN.Cnt_u32 CDDInterface9.TcActivePNVldCnt.Cnt_u32 /end SUB_GROUP
 /begin FUNCTION_LIST /end FUNCTION_LIST
 /begin REF_CHARACTERISTIC /end REF_CHARACTERISTIC
 /begin REF_MEASUREMENT /end REF_MEASUREMENT
/end GROUP
/begin GROUP CDDInterface9.ReturnSrlComSvcDft.Cnt_lgc "MICROSAR RTE" /begin SUB_GROUP /end SUB_GROUP /begin FUNCTION_LIST /end FUNCTION_LIST /begin REF_CHARACTERISTIC /end REF_CHARACTERISTIC /begin REF_MEASUREMENT CDDInterface9.ReturnSrlComSvcDft.Cnt_lgc /end REF_MEASUREMENT /end GROUP
/begin GROUP CDDInterface9.RxMsgsSrlComSvcDft.Cnt_lgc "MICROSAR RTE" /begin SUB_GROUP /end SUB_GROUP /begin FUNCTION_LIST /end FUNCTION_LIST /begin REF_CHARACTERISTIC /end REF_CHARACTERISTIC /begin REF_MEASUREMENT CDDInterface9.RxMsgsSrlComSvcDft.Cnt_lgc /end REF_MEASUREMENT /end GROUP
/begin GROUP CDDInterface9.SenderPorts "MICROSAR RTE"
 /begin SUB_GROUP CDDInterface9.ActPullCompLrnSrlComSvcDft.Cnt_lgc CDDInterface9.AvgFrcLrnSrlComSvcDft.Cnt_lgc CDDInterface9.DampingSrlComSvcDft.Cnt_lgc CDDInterface9.DftAsstTbl.Cnt_lgc CDDInterface9.DrivingDynSrlComSvcDft.Cnt_lgc CDDInterface9.DwnldAsstGain.Uls_f32 CDDInterface9.EOTImpactSrlComSvcDft.Cnt_lgc CDDInterface9.EOTThermalSrlComSvcDft.Cnt_lgc CDDInterface9.EngONSrlComSvcDft.Cnt_lgc CDDInterface9.FirewallSrlComSrvDft.Cnt_lgc CDDInterface9.FreqDepDmpSrlComSvcDft.Cnt_lgc CDDInterface9.HysAddSrlComSvcDft.Cnt_lgc CDDInterface9.HystCompSrlComSvcDft.Cnt_lgc CDDInterface9.IgnCnt.Cnt_u16 CDDInterface9.KinIntDiagSrlComSvcDft.Cnt_lgc CDDInterface9.LimitSrlComSvcDft.Cnt_lgc CDDInterface9.LrnPnCenterEnable.Cnt_lgc CDDInterface9.MfgDiagInhibit.Cnt_lgc CDDInterface9.ModIdxSrlComSvcDft.Cnt_lgc CDDInterface9.MtrParmNrmLrnSrlComSvcDft.Cnt_lgc CDDInterface9.MtrVelNrmLrnSrlComSvcDft.Cnt_lgc CDDInterface9.MultIgnSrlComSvcDft.Cnt_lgc CDDInterface9.NxtrMEC.Cnt_enum CDDInterface9.OscTrajEnable.Cnt_lgc CDDInterface9.ParkAstSrlComSvcDft.Cnt_lgc CDDInterface9.PosTrajEnable.Cnt_lgc CDDInterface9.PullCompSrlComSvcDft.Cnt_lgc CDDInterface9.ReturnSrlComSvcDft.Cnt_lgc CDDInterface9.RxMsgsSrlComSvcDft.Cnt_lgc CDDInterface9.SrlComSvcDft.Cnt_b32 CDDInterface9.TcFlashErrors.Cnt_u08 CDDInterface9.TcFlashVerify.Cnt_lgc CDDInterface9.ThermalDCSrlComSvcDft.Cnt_lgc CDDInterface9.TrqRmpSrlComSvcDft.Cnt_lgc CDDInterface9.WhlImbRejSrlComSvcDft.Cnt_lgc /end SUB_GROUP
 /begin FUNCTION_LIST /end FUNCTION_LIST
 /begin REF_CHARACTERISTIC /end REF_CHARACTERISTIC
 /begin REF_MEASUREMENT /end REF_MEASUREMENT
/end GROUP
/begin GROUP CDDInterface9.SrlComSvcDft.Cnt_b32 "MICROSAR RTE" /begin SUB_GROUP /end SUB_GROUP /begin FUNCTION_LIST /end FUNCTION_LIST /begin REF_CHARACTERISTIC /end REF_CHARACTERISTIC /begin REF_MEASUREMENT CDDInterface9.SrlComSvcDft.Cnt_b32 /end REF_MEASUREMENT /end GROUP
/begin GROUP CDDInterface9.TcActivePN.Cnt_u32 "MICROSAR RTE" /begin SUB_GROUP /end SUB_GROUP /begin FUNCTION_LIST /end FUNCTION_LIST /begin REF_CHARACTERISTIC /end REF_CHARACTERISTIC /begin REF_MEASUREMENT CDDInterface9.TcActivePN.Cnt_u32 /end REF_MEASUREMENT /end GROUP
/begin GROUP CDDInterface9.TcActivePNVldCnt.Cnt_u32 "MICROSAR RTE" /begin SUB_GROUP /end SUB_GROUP /begin FUNCTION_LIST /end FUNCTION_LIST /begin REF_CHARACTERISTIC /end REF_CHARACTERISTIC /begin REF_MEASUREMENT CDDInterface9.TcActivePNVldCnt.Cnt_u32 /end REF_MEASUREMENT /end GROUP
/begin GROUP CDDInterface9.TcFlashErrors.Cnt_u08 "MICROSAR RTE" /begin SUB_GROUP /end SUB_GROUP /begin FUNCTION_LIST /end FUNCTION_LIST /begin REF_CHARACTERISTIC /end REF_CHARACTERISTIC /begin REF_MEASUREMENT CDDInterface9.TcFlashErrors.Cnt_u08 /end REF_MEASUREMENT /end GROUP
/begin GROUP CDDInterface9.TcFlashVerify.Cnt_lgc "MICROSAR RTE" /begin SUB_GROUP /end SUB_GROUP /begin FUNCTION_LIST /end FUNCTION_LIST /begin REF_CHARACTERISTIC /end REF_CHARACTERISTIC /begin REF_MEASUREMENT CDDInterface9.TcFlashVerify.Cnt_lgc /end REF_MEASUREMENT /end GROUP
/begin GROUP CDDInterface9.ThermalDCSrlComSvcDft.Cnt_lgc "MICROSAR RTE" /begin SUB_GROUP /end SUB_GROUP /begin FUNCTION_LIST /end FUNCTION_LIST /begin REF_CHARACTERISTIC /end REF_CHARACTERISTIC /begin REF_MEASUREMENT CDDInterface9.ThermalDCSrlComSvcDft.Cnt_lgc /end REF_MEASUREMENT /end GROUP
/begin GROUP CDDInterface9.TrqRmpSrlComSvcDft.Cnt_lgc "MICROSAR RTE" /begin SUB_GROUP /end SUB_GROUP /begin FUNCTION_LIST /end FUNCTION_LIST /begin REF_CHARACTERISTIC /end REF_CHARACTERISTIC /begin REF_MEASUREMENT CDDInterface9.TrqRmpSrlComSvcDft.Cnt_lgc /end REF_MEASUREMENT /end GROUP
/begin GROUP CDDInterface9.WhlImbRejSrlComSvcDft.Cnt_lgc "MICROSAR RTE" /begin SUB_GROUP /end SUB_GROUP /begin FUNCTION_LIST /end FUNCTION_LIST /begin REF_CHARACTERISTIC /end REF_CHARACTERISTIC /begin REF_MEASUREMENT CDDInterface9.WhlImbRejSrlComSvcDft.Cnt_lgc /end REF_MEASUREMENT /end GROUP
/begin GROUP CtrlTemp "MICROSAR RTE" /begin SUB_GROUP CtrlTemp.ReceiverPorts CtrlTemp.SenderPorts /end SUB_GROUP /begin FUNCTION_LIST /end FUNCTION_LIST /begin REF_CHARACTERISTIC /end REF_CHARACTERISTIC /begin REF_MEASUREMENT /end REF_MEASUREMENT /end GROUP
/begin GROUP CtrlTemp.AmbTemp.DegC_f32 "MICROSAR RTE" /begin SUB_GROUP /end SUB_GROUP /begin FUNCTION_LIST /end FUNCTION_LIST /begin REF_CHARACTERISTIC /end REF_CHARACTERISTIC /begin REF_MEASUREMENT CtrlTemp.AmbTemp.DegC_f32 /end REF_MEASUREMENT /end GROUP
/begin GROUP CtrlTemp.DiagStsTempRdPrf.Cnt_lgc "MICROSAR RTE" /begin SUB_GROUP /end SUB_GROUP /begin FUNCTION_LIST /end FUNCTION_LIST /begin REF_CHARACTERISTIC /end REF_CHARACTERISTIC /begin REF_MEASUREMENT CtrlTemp.DiagStsTempRdPrf.Cnt_lgc /end REF_MEASUREMENT /end GROUP
/begin GROUP CtrlTemp.FiltMeasTemp.DegC_f32 "MICROSAR RTE" /begin SUB_GROUP /end SUB_GROUP /begin FUNCTION_LIST /end FUNCTION_LIST /begin REF_CHARACTERISTIC /end REF_CHARACTERISTIC /begin REF_MEASUREMENT CtrlTemp.FiltMeasTemp.DegC_f32 /end REF_MEASUREMENT /end GROUP
/begin GROUP CtrlTemp.ReceiverPorts "MICROSAR RTE"
 /begin SUB_GROUP CtrlTemp.AmbTemp.DegC_f32 CtrlTemp.DiagStsTempRdPrf.Cnt_lgc CtrlTemp.TemperatureADC.Volt_f32 /end SUB_GROUP
 /begin FUNCTION_LIST /end FUNCTION_LIST
 /begin REF_CHARACTERISTIC /end REF_CHARACTERISTIC
 /begin REF_MEASUREMENT /end REF_MEASUREMENT
/end GROUP
/begin GROUP CtrlTemp.SenderPorts "MICROSAR RTE" /begin SUB_GROUP CtrlTemp.FiltMeasTemp.DegC_f32 /end SUB_GROUP /begin FUNCTION_LIST /end FUNCTION_LIST /begin REF_CHARACTERISTIC /end REF_CHARACTERISTIC /begin REF_MEASUREMENT /end REF_MEASUREMENT /end GROUP
/begin GROUP CtrlTemp.TemperatureADC.Volt_f32 "MICROSAR RTE" /begin SUB_GROUP /end SUB_GROUP /begin FUNCTION_LIST /end FUNCTION_LIST /begin REF_CHARACTERISTIC /end REF_CHARACTERISTIC /begin REF_MEASUREMENT CtrlTemp.TemperatureADC.Volt_f32 /end REF_MEASUREMENT /end GROUP
/begin GROUP CtrldDisShtdn "MICROSAR RTE"
 /begin SUB_GROUP CtrldDisShtdn.ModeRequirePorts CtrldDisShtdn.ReceiverPorts CtrldDisShtdn.SenderPorts /end SUB_GROUP
 /begin FUNCTION_LIST /end FUNCTION_LIST
 /begin REF_CHARACTERISTIC /end REF_CHARACTERISTIC
 /begin REF_MEASUREMENT /end REF_MEASUREMENT
/end GROUP
/begin GROUP CtrldDisShtdn.AssistAssyPolarity.Cnt_s08 "MICROSAR RTE" /begin SUB_GROUP /end SUB_GROUP /begin FUNCTION_LIST /end FUNCTION_LIST /begin REF_CHARACTERISTIC /end REF_CHARACTERISTIC /begin REF_MEASUREMENT CtrldDisShtdn.AssistAssyPolarity.Cnt_s08 /end REF_MEASUREMENT /end GROUP
/begin GROUP CtrldDisShtdn.CRFMtrVel.MtrRadpS_f32 "MICROSAR RTE" /begin SUB_GROUP /end SUB_GROUP /begin FUNCTION_LIST /end FUNCTION_LIST /begin REF_CHARACTERISTIC /end REF_CHARACTERISTIC /begin REF_MEASUREMENT CtrldDisShtdn.CRFMtrVel.MtrRadpS_f32 /end REF_MEASUREMENT /end GROUP
/begin GROUP CtrldDisShtdn.CntDisMtrTrqCmdCRF.MtrNm_f32 "MICROSAR RTE" /begin SUB_GROUP /end SUB_GROUP /begin FUNCTION_LIST /end FUNCTION_LIST /begin REF_CHARACTERISTIC /end REF_CHARACTERISTIC /begin REF_MEASUREMENT CtrldDisShtdn.CntDisMtrTrqCmdCRF.MtrNm_f32 /end REF_MEASUREMENT /end GROUP
/begin GROUP CtrldDisShtdn.CntDisMtrTrqCmdMRF.MtrNm_f32 "MICROSAR RTE" /begin SUB_GROUP /end SUB_GROUP /begin FUNCTION_LIST /end FUNCTION_LIST /begin REF_CHARACTERISTIC /end REF_CHARACTERISTIC /begin REF_MEASUREMENT CtrldDisShtdn.CntDisMtrTrqCmdMRF.MtrNm_f32 /end REF_MEASUREMENT /end GROUP
/begin GROUP CtrldDisShtdn.CtrldDmpStsCmp.Cnt_lgc "MICROSAR RTE" /begin SUB_GROUP /end SUB_GROUP /begin FUNCTION_LIST /end FUNCTION_LIST /begin REF_CHARACTERISTIC /end REF_CHARACTERISTIC /begin REF_MEASUREMENT CtrldDisShtdn.CtrldDmpStsCmp.Cnt_lgc /end REF_MEASUREMENT /end GROUP
/begin GROUP CtrldDisShtdn.DiagStsF2Active.Cnt_lgc "MICROSAR RTE" /begin SUB_GROUP /end SUB_GROUP /begin FUNCTION_LIST /end FUNCTION_LIST /begin REF_CHARACTERISTIC /end REF_CHARACTERISTIC /begin REF_MEASUREMENT CtrldDisShtdn.DiagStsF2Active.Cnt_lgc /end REF_MEASUREMENT /end GROUP
/begin GROUP CtrldDisShtdn.ModeRequirePorts "MICROSAR RTE" /begin SUB_GROUP CtrldDisShtdn.SystemState.Mode /end SUB_GROUP /begin FUNCTION_LIST /end FUNCTION_LIST /begin REF_CHARACTERISTIC /end REF_CHARACTERISTIC /begin REF_MEASUREMENT /end REF_MEASUREMENT /end GROUP
/begin GROUP CtrldDisShtdn.ReceiverPorts "MICROSAR RTE"
 /begin SUB_GROUP CtrldDisShtdn.AssistAssyPolarity.Cnt_s08 CtrldDisShtdn.CRFMtrVel.MtrRadpS_f32 CtrldDisShtdn.DiagStsF2Active.Cnt_lgc CtrldDisShtdn.SumLimTrqCmd.MtrNm_f32 /end SUB_GROUP
 /begin FUNCTION_LIST /end FUNCTION_LIST
 /begin REF_CHARACTERISTIC /end REF_CHARACTERISTIC
 /begin REF_MEASUREMENT /end REF_MEASUREMENT
/end GROUP
/begin GROUP CtrldDisShtdn.SenderPorts "MICROSAR RTE"
 /begin SUB_GROUP CtrldDisShtdn.CntDisMtrTrqCmdCRF.MtrNm_f32 CtrldDisShtdn.CntDisMtrTrqCmdMRF.MtrNm_f32 CtrldDisShtdn.CtrldDmpStsCmp.Cnt_lgc CtrldDisShtdn.SysC_CRFMtrTrqCmd.MtrNm_f32 CtrldDisShtdn.SysC_MRFMtrTrqCmd.MtrNm_f32 /end SUB_GROUP
 /begin FUNCTION_LIST /end FUNCTION_LIST
 /begin REF_CHARACTERISTIC /end REF_CHARACTERISTIC
 /begin REF_MEASUREMENT /end REF_MEASUREMENT
/end GROUP
/begin GROUP CtrldDisShtdn.SumLimTrqCmd.MtrNm_f32 "MICROSAR RTE" /begin SUB_GROUP /end SUB_GROUP /begin FUNCTION_LIST /end FUNCTION_LIST /begin REF_CHARACTERISTIC /end REF_CHARACTERISTIC /begin REF_MEASUREMENT CtrldDisShtdn.SumLimTrqCmd.MtrNm_f32 /end REF_MEASUREMENT /end GROUP
/begin GROUP CtrldDisShtdn.SysC_CRFMtrTrqCmd.MtrNm_f32 "MICROSAR RTE" /begin SUB_GROUP /end SUB_GROUP /begin FUNCTION_LIST /end FUNCTION_LIST /begin REF_CHARACTERISTIC /end REF_CHARACTERISTIC /begin REF_MEASUREMENT CtrldDisShtdn.SysC_CRFMtrTrqCmd.MtrNm_f32 /end REF_MEASUREMENT /end GROUP
/begin GROUP CtrldDisShtdn.SysC_MRFMtrTrqCmd.MtrNm_f32 "MICROSAR RTE" /begin SUB_GROUP /end SUB_GROUP /begin FUNCTION_LIST /end FUNCTION_LIST /begin REF_CHARACTERISTIC /end REF_CHARACTERISTIC /begin REF_MEASUREMENT CtrldDisShtdn.SysC_MRFMtrTrqCmd.MtrNm_f32 /end REF_MEASUREMENT /end GROUP
/**********************************************************************************************************************
* RECORD_LAYOUT
*********************************************************************************************************************/
/begin RECORD_LAYOUT RTE_RL_UBYTE FNC_VALUES 1 UBYTE ROW_DIR DIRECT /end RECORD_LAYOUT
/begin RECORD_LAYOUT RTE_RL_UWORD FNC_VALUES 1 UWORD ROW_DIR DIRECT /end RECORD_LAYOUT
/**********************************************************************************************************************
* COMPU_METHOD / COMPU_VTAB_RANGE
*********************************************************************************************************************/
/begin COMPU_METHOD RTE_CM_BOOLEAN "" TAB_VERB "%3.1" "" COMPU_TAB_REF RTE_CM_BOOLEAN /end COMPU_METHOD
/begin COMPU_VTAB_RANGE RTE_CM_BOOLEAN "" 2 0 0 "false" 1 255 "true" /end COMPU_VTAB_RANGE
/begin COMPU_METHOD RTE_CM_ENUM_ST_OFFS_QUAD_EPS "" TAB_VERB "%.1" "" COMPU_TAB_REF RTE_CM_ENUM_ST_OFFS_QUAD_EPS /end COMPU_METHOD
/begin COMPU_VTAB_RANGE RTE_CM_ENUM_ST_OFFS_QUAD_EPS "" 12 0 0 "STOFFSQUADEPS_SLEEP" 1 1 "STOFFSQUADEPS_CALCULATED" 2 2 "STOFFSQUADEPS_INDEX" 3 3 "STOFFSQUADEPS_MODELCOMP" 4 4 "STOFFSQUADEPS_LOCKTOLOCK" 5 5 "STOFFSQUADEPS_SUMSTEERINGANGLE" 6 6 "STOFFSQUADEPS_CHECK" 7 7 "STOFFSQUADEPS_CORRECTION" 8 8 "STOFFSQUADEPS_INITIALIZATION" 9 9 "STOFFSQUADEPS_DETERMINED" 11 11 "STOFFSQUADEPS_APPROXIMATED" 15 15 "STOFFSQUADEPS_INVALID" /end COMPU_VTAB_RANGE
/begin COMPU_METHOD RTE_CM_ENUM_TurnsCntrValStateType "" TAB_VERB "%.1" "" COMPU_TAB_REF RTE_CM_ENUM_TurnsCntrValStateType /end COMPU_METHOD
/begin COMPU_VTAB_RANGE RTE_CM_ENUM_TurnsCntrValStateType "" 3 0 0 "TCV_COMPUTING" 100 100 "TCV_VALID" 255 255 "TCV_INVALID" /end COMPU_VTAB_RANGE
/begin COMPU_METHOD RTE_CM_ENUM_StaMd_Mode "" TAB_VERB "%.1" "" COMPU_TAB_REF RTE_CM_ENUM_StaMd_Mode /end COMPU_METHOD
/begin COMPU_VTAB_RANGE RTE_CM_ENUM_StaMd_Mode "" 5 0 0 "RTE_MODE_StaMd_Mode_DISABLE" 1 1 "RTE_MODE_StaMd_Mode_OFF" 2 2 "RTE_MODE_StaMd_Mode_OPERATE" 3 3 "RTE_MODE_StaMd_Mode_WARMINIT" 4 4 "RTE_TRANSITION_StaMd_Mode" /end COMPU_VTAB_RANGE
/begin COMPU_METHOD RTE_CM_ENUM_TuningSessionAddrPtrEnum "" TAB_VERB "%.1" "" COMPU_TAB_REF RTE_CM_ENUM_TuningSessionAddrPtrEnum /end COMPU_METHOD
/begin COMPU_VTAB_RANGE RTE_CM_ENUM_TuningSessionAddrPtrEnum "" 7 0 0 "TUN_SESSION_PTR_PERS" 1 1 "TUN_SESSION_PTR_SETS" 2 2 "TUN_SESSION_PTR_COMMON" 3 3 "TUN_SESSION_PTR_SETANDPER" 4 4 "TUN_SESSION_PTR_SETANDPERANDCOMMON" 16 16 "TUN_SESSION_PTR_CUSTSEG" 255 255 "TUN_SESSION_PTR_DISABLED" /end COMPU_VTAB_RANGE
/begin COMPU_METHOD RTE_CM_ENUM_QU_SER_STMOM_STMOM_DV_ACT "" TAB_VERB "%.1" "" COMPU_TAB_REF RTE_CM_ENUM_QU_SER_STMOM_STMOM_DV_ACT /end COMPU_METHOD
/begin COMPU_VTAB_RANGE RTE_CM_ENUM_QU_SER_STMOM_STMOM_DV_ACT "" 7 32 32 "Cx20_Schnittstelle_verfuegbar___funktionsbereit" 33 33 "Cx21_Schnittstelle_aktiv" 96 96 "Cx60_Service_nicht_verfuegbar___Fehler" 128 128 "Cx80_Schnittstelle_wird_initialisiert" 224 224 "CxE0_Service_nicht_verfuegbar___Standby___PMA" 225 225 "CxE1_Service_nicht_verfuegbar___Standby___EPS_Status" 255 255 "CxFF_Signal_ungueltig" /end COMPU_VTAB_RANGE
/begin COMPU_METHOD RTE_CM_ENUM_ManufModeType "" TAB_VERB "%.1" "" COMPU_TAB_REF RTE_CM_ENUM_ManufModeType /end COMPU_METHOD
/begin COMPU_VTAB_RANGE RTE_CM_ENUM_ManufModeType "" 3 0 0 "ProductionMode" 1 1 "ManufacturingMode" 2 2 "EngineeringMode" /end COMPU_VTAB_RANGE
/begin COMPU_METHOD RTE_CM_ENUM_FETPHASETYPE_ENUM "" TAB_VERB "%.1" "" COMPU_TAB_REF RTE_CM_ENUM_FETPHASETYPE_ENUM /end COMPU_METHOD
/begin COMPU_VTAB_RANGE RTE_CM_ENUM_FETPHASETYPE_ENUM "" 4 0 0 "NOPHASE" 1 1 "PHASEA" 2 2 "PHASEB" 3 3 "PHASEC" /end COMPU_VTAB_RANGE
/begin COMPU_METHOD RTE_CM_ENUM_FETFAULTTYPE_ENUM "" TAB_VERB "%.1" "" COMPU_TAB_REF RTE_CM_ENUM_FETFAULTTYPE_ENUM /end COMPU_METHOD
/begin COMPU_VTAB_RANGE RTE_CM_ENUM_FETFAULTTYPE_ENUM "" 3 0 0 "NOFAULT" 1 1 "LOWER" 2 2 "UPPER" /end COMPU_VTAB_RANGE
