/begin MEASUREMENT PwrLmtFunc.AssistPowerLimit.MtrNm_f32 "MICROSAR RTE" FLOAT32_IEEE NO_COMPU_METHOD 0 0 1.175494351e-38 3.402823466e+38 ECU_ADDRESS 0 SYMBOL_LINK "Rte_PwrLmtFunc_AssistPowerLimit_MtrNm_f32" 0 DISPLAY_IDENTIFIER PwrLmtFunc.SenderPorts.AssistPowerLimit.MtrNm_f32 /end MEASUREMENT
/begin MEASUREMENT PwrLmtFunc.CCLMSAActive.Cnt_lgc "MICROSAR RTE" UBYTE RTE_CM_BOOLEAN 0 0 0 255 ECU_ADDRESS 0 SYMBOL_LINK "Rte_CustPL_CCLMSAActive_Cnt_lgc" 0 DISPLAY_IDENTIFIER PwrLmtFunc.ReceiverPorts.CCLMSAActive.Cnt_lgc /end MEASUREMENT
/begin MEASUREMENT PwrLmtFunc.CustCurrLmt.Amp_f32 "MICROSAR RTE" FLOAT32_IEEE NO_COMPU_METHOD 0 0 1.175494351e-38 3.402823466e+38 ECU_ADDRESS 0 SYMBOL_LINK "Rte_CustPL_CustCurrLmt_Amp_f32" 0 DISPLAY_IDENTIFIER PwrLmtFunc.ReceiverPorts.CustCurrLmt.Amp_f32 /end MEASUREMENT
/begin MEASUREMENT PwrLmtFunc.KeEstimate.VpRadpS_f32 "MICROSAR RTE" FLOAT32_IEEE NO_COMPU_METHOD 0 0 1.175494351e-38 3.402823466e+38 ECU_ADDRESS 0 SYMBOL_LINK "Rte_ParamComp_EstKe_VpRadpS_f32" 0 DISPLAY_IDENTIFIER PwrLmtFunc.ReceiverPorts.KeEstimate.VpRadpS_f32 /end MEASUREMENT
/begin MEASUREMENT PwrLmtFunc.MotorVelocityMRF.MtrRadpS_f32 "MICROSAR RTE" FLOAT32_IEEE NO_COMPU_METHOD 0 0 1.175494351e-38 3.402823466e+38 ECU_ADDRESS 0 SYMBOL_LINK "Rte_MtrVel_MRFMotorVel_MtrRadpS_f32" 0 DISPLAY_IDENTIFIER PwrLmtFunc.ReceiverPorts.MotorVelocityMRF.MtrRadpS_f32 /end MEASUREMENT
/begin MEASUREMENT PwrLmtFunc.MtrEnvSpd.MtrRadpS_f32 "MICROSAR RTE" FLOAT32_IEEE NO_COMPU_METHOD 0 0 1.175494351e-38 3.402823466e+38 ECU_ADDRESS 0 SYMBOL_LINK "Rte_PwrLmtFunc_MtrEnvSpd_MtrRadpS_f32" 0 DISPLAY_IDENTIFIER PwrLmtFunc.SenderPorts.MtrEnvSpd.MtrRadpS_f32 /end MEASUREMENT
/begin MEASUREMENT PwrLmtFunc.PosServEnable.Cnt_lgc "MICROSAR RTE" UBYTE RTE_CM_BOOLEAN 0 0 0 255 ECU_ADDRESS 0 SYMBOL_LINK "Rte_ParkAssistEnable_PosServEnable_Cnt_lgc" 0 DISPLAY_IDENTIFIER PwrLmtFunc.ReceiverPorts.PosServEnable.Cnt_lgc /end MEASUREMENT
/begin MEASUREMENT PwrLmtFunc.PowerLimitPerc.Uls_f32 "MICROSAR RTE" FLOAT32_IEEE NO_COMPU_METHOD 0 0 1.175494351e-38 3.402823466e+38 ECU_ADDRESS 0 SYMBOL_LINK "Rte_PwrLmtFunc_PowerLimitPerc_Uls_f32" 0 DISPLAY_IDENTIFIER PwrLmtFunc.SenderPorts.PowerLimitPerc.Uls_f32 /end MEASUREMENT
/begin MEASUREMENT PwrLmtFunc.PreLimitForPwr.MtrNm_f32 "MICROSAR RTE" FLOAT32_IEEE NO_COMPU_METHOD 0 0 1.175494351e-38 3.402823466e+38 ECU_ADDRESS 0 SYMBOL_LINK "Rte_AssistSumnLmt_PreLimitForPower_MtrNm_f32" 0 DISPLAY_IDENTIFIER PwrLmtFunc.ReceiverPorts.PreLimitForPwr.MtrNm_f32 /end MEASUREMENT
/begin MEASUREMENT PwrLmtFunc.SystemState.Mode "MICROSAR RTE" UBYTE RTE_CM_ENUM_StaMd_Mode 0 0 0 255 ECU_ADDRESS 0 SYMBOL_LINK "Rte_ModeMachine_StaMd7_SystemState7_Mode" 0 DISPLAY_IDENTIFIER PwrLmtFunc.ModeRequirePorts.SystemState.Mode /end MEASUREMENT
/begin MEASUREMENT PwrLmtFunc.Vecu.Volt_f32 "This port prototype is inteded to communicate voltage signals that represent the ecu supplied voltage.  This signal has a lower limit, which is non-zero, to allow users of the signal to use it as a denominator in an expression without requiring a divide b" FLOAT32_IEEE NO_COMPU_METHOD 0 0 1.175494351e-38 3.402823466e+38 ECU_ADDRESS 0 SYMBOL_LINK "Rte_BatteryVoltage_Vecu_Volt_f32" 0 DISPLAY_IDENTIFIER PwrLmtFunc.ReceiverPorts.Vecu.Volt_f32 /end MEASUREMENT
/begin MEASUREMENT QuadDet.InstMtrDir.Cnt_s08 "MICROSAR RTE" SBYTE NO_COMPU_METHOD 0 0 -128 127 ECU_ADDRESS 0 SYMBOL_LINK "Rte_QuadDet_InstMtrDir_Cnt_s08" 0 DISPLAY_IDENTIFIER QuadDet.SenderPorts.InstMtrDir.Cnt_s08 /end MEASUREMENT
/begin MEASUREMENT QuadDet.MRFCumMtrPos.Deg_f32 "MICROSAR RTE" FLOAT32_IEEE NO_COMPU_METHOD 0 0 1.175494351e-38 3.402823466e+38 ECU_ADDRESS 0 SYMBOL_LINK "Rte_MtrPos_CumMtrPosMRF_Deg_f32" 0 DISPLAY_IDENTIFIER QuadDet.ReceiverPorts.MRFCumMtrPos.Deg_f32 /end MEASUREMENT
/begin MEASUREMENT QuadDet.MRFMtrTrqCmdScl.MtrNm_f32 "MICROSAR RTE" FLOAT32_IEEE NO_COMPU_METHOD 0 0 1.175494351e-38 3.402823466e+38 ECU_ADDRESS 0 SYMBOL_LINK "Rte_TrqCmdScl_MRFMtrTrqCmdScl_MtrNm_f32" 0 DISPLAY_IDENTIFIER QuadDet.ReceiverPorts.MRFMtrTrqCmdScl.MtrNm_f32 /end MEASUREMENT
/begin MEASUREMENT QuadDet.MRFMtrVel.MtrRadpS_f32 "MICROSAR RTE" FLOAT32_IEEE NO_COMPU_METHOD 0 0 1.175494351e-38 3.402823466e+38 ECU_ADDRESS 0 SYMBOL_LINK "Rte_MtrVel_MRFMotorVel_MtrRadpS_f32" 0 DISPLAY_IDENTIFIER QuadDet.ReceiverPorts.MRFMtrVel.MtrRadpS_f32 /end MEASUREMENT
/begin MEASUREMENT QuadDet.MtrQuad.Cnt_u08 "MICROSAR RTE" UBYTE NO_COMPU_METHOD 0 0 0 255 ECU_ADDRESS 0 SYMBOL_LINK "Rte_QuadDet_MtrQuad_Cnt_u08" 0 DISPLAY_IDENTIFIER QuadDet.SenderPorts.MtrQuad.Cnt_u08 /end MEASUREMENT
/begin MEASUREMENT RackLoad.CRFMtrTrqCmd.MtrNm_f32 "MICROSAR RTE" FLOAT32_IEEE NO_COMPU_METHOD 0 0 1.175494351e-38 3.402823466e+38 ECU_ADDRESS 0 SYMBOL_LINK "Rte_CtrldDisShtdn_CntDisMtrTrqCmdCRF_MtrNm_f32" 0 DISPLAY_IDENTIFIER RackLoad.ReceiverPorts.CRFMtrTrqCmd.MtrNm_f32 /end MEASUREMENT
/begin MEASUREMENT RackLoad.CRFMtrVel.MtrRadpS_f32 "MICROSAR RTE" FLOAT32_IEEE NO_COMPU_METHOD 0 0 1.175494351e-38 3.402823466e+38 ECU_ADDRESS 0 SYMBOL_LINK "Rte_MtrVel_CRFMotorVel_MtrRadpS_f32" 0 DISPLAY_IDENTIFIER RackLoad.ReceiverPorts.CRFMtrVel.MtrRadpS_f32 /end MEASUREMENT
/begin MEASUREMENT RackLoad.HwPos.HwDeg_f32 "MICROSAR RTE" FLOAT32_IEEE NO_COMPU_METHOD 0 0 1.175494351e-38 3.402823466e+38 ECU_ADDRESS 0 SYMBOL_LINK "Rte_AbsHwPos_HandwheelPosition_HwDeg_f32" 0 DISPLAY_IDENTIFIER RackLoad.ReceiverPorts.HwPos.HwDeg_f32 /end MEASUREMENT
/begin MEASUREMENT RackLoad.HwPosAuth.Uls_f32 "MICROSAR RTE" FLOAT32_IEEE NO_COMPU_METHOD 0 0 1.175494351e-38 3.402823466e+38 ECU_ADDRESS 0 SYMBOL_LINK "Rte_AbsHwPos_HandwheelAuthority_Uls_f32" 0 DISPLAY_IDENTIFIER RackLoad.ReceiverPorts.HwPosAuth.Uls_f32 /end MEASUREMENT
/begin MEASUREMENT RackLoad.HwTrq.HwNm_f32 "MICROSAR RTE" FLOAT32_IEEE NO_COMPU_METHOD 0 0 1.175494351e-38 3.402823466e+38 ECU_ADDRESS 0 SYMBOL_LINK "Rte_Sweep_OutputHwTrq_HwNm_f32" 0 DISPLAY_IDENTIFIER RackLoad.ReceiverPorts.HwTrq.HwNm_f32 /end MEASUREMENT
/begin MEASUREMENT Return.AssistMechTempEst.DegC_f32 "MICROSAR RTE" FLOAT32_IEEE NO_COMPU_METHOD 0 0 1.175494351e-38 3.402823466e+38 ECU_ADDRESS 0 SYMBOL_LINK "Rte_MtrTempEst_AssistMechTempEst_DegC_f32" 0 DISPLAY_IDENTIFIER Return.ReceiverPorts.AssistMechTempEst.DegC_f32 /end MEASUREMENT
/begin MEASUREMENT Return.DiagStsHwPosDis.Cnt_lgc "MICROSAR RTE" UBYTE RTE_CM_BOOLEAN 0 0 0 255 ECU_ADDRESS 0 SYMBOL_LINK "Rte_DiagMgr10_DiagStsHWASbSystmFltPres_Cnt_lgc" 0 DISPLAY_IDENTIFIER Return.ReceiverPorts.DiagStsHwPosDis.Cnt_lgc /end MEASUREMENT
/begin MEASUREMENT Return.HandwheelAuthority.Uls_f32 "MICROSAR RTE" FLOAT32_IEEE NO_COMPU_METHOD 0 0 1.175494351e-38 3.402823466e+38 ECU_ADDRESS 0 SYMBOL_LINK "Rte_AbsHwPos_HandwheelAuthority_Uls_f32" 0 DISPLAY_IDENTIFIER Return.ReceiverPorts.HandwheelAuthority.Uls_f32 /end MEASUREMENT
/begin MEASUREMENT Return.HandwheelPosition.HwDeg_f32 "MICROSAR RTE" FLOAT32_IEEE NO_COMPU_METHOD 0 0 1.175494351e-38 3.402823466e+38 ECU_ADDRESS 0 SYMBOL_LINK "Rte_AbsHwPos_HandwheelPosition_HwDeg_f32" 0 DISPLAY_IDENTIFIER Return.ReceiverPorts.HandwheelPosition.HwDeg_f32 /end MEASUREMENT
/begin MEASUREMENT Return.HandwheelVel.HwRadpS_f32 "MICROSAR RTE" FLOAT32_IEEE NO_COMPU_METHOD 0 0 1.175494351e-38 3.402823466e+38 ECU_ADDRESS 0 SYMBOL_LINK "Rte_MtrVel_HandwheelVel_HwRadpS_f32" 0 DISPLAY_IDENTIFIER Return.ReceiverPorts.HandwheelVel.HwRadpS_f32 /end MEASUREMENT
/begin MEASUREMENT Return.HwTorque.HwNm_f32 "MICROSAR RTE" FLOAT32_IEEE NO_COMPU_METHOD 0 0 1.175494351e-38 3.402823466e+38 ECU_ADDRESS 0 SYMBOL_LINK "Rte_Sweep_OutputHwTrq_HwNm_f32" 0 DISPLAY_IDENTIFIER Return.ReceiverPorts.HwTorque.HwNm_f32 /end MEASUREMENT
/begin MEASUREMENT Return.PAReturnSclFct.Uls_f32 "MICROSAR RTE" FLOAT32_IEEE NO_COMPU_METHOD 0 0 1.175494351e-38 3.402823466e+38 ECU_ADDRESS 0 SYMBOL_LINK "Rte_PosServo_PosSrvoReturnSclFct_Uls_f32" 0 DISPLAY_IDENTIFIER Return.ReceiverPorts.PAReturnSclFct.Uls_f32 /end MEASUREMENT
/begin MEASUREMENT Return.ReturnCmd.MtrNm_f32 "MICROSAR RTE" FLOAT32_IEEE NO_COMPU_METHOD 0 0 1.175494351e-38 3.402823466e+38 ECU_ADDRESS 0 SYMBOL_LINK "Rte_Return_ReturnCmd_MtrNm_f32" 0 DISPLAY_IDENTIFIER Return.SenderPorts.ReturnCmd.MtrNm_f32 /end MEASUREMENT
/begin MEASUREMENT Return.ReturnDDFactor.Uls_f32 "MICROSAR RTE" FLOAT32_IEEE NO_COMPU_METHOD 0 0 1.175494351e-38 3.402823466e+38 ECU_ADDRESS 0 SYMBOL_LINK "Rte_DrvDynCtrl_ReturnDDFactor_Uls_f32" 0 DISPLAY_IDENTIFIER Return.ReceiverPorts.ReturnDDFactor.Uls_f32 /end MEASUREMENT
/begin MEASUREMENT Return.ReturnOffset.HwDeg_f32 "MICROSAR RTE" FLOAT32_IEEE NO_COMPU_METHOD 0 0 1.175494351e-38 3.402823466e+38 ECU_ADDRESS 0 SYMBOL_LINK "Rte_SrlComInput_ReturnOffset_HwDeg_f32" 0 DISPLAY_IDENTIFIER Return.ReceiverPorts.ReturnOffset.HwDeg_f32 /end MEASUREMENT
/begin MEASUREMENT Return.VehicleSpeed.Kph_f32 "MICROSAR RTE" FLOAT32_IEEE NO_COMPU_METHOD 0 0 1.175494351e-38 3.402823466e+38 ECU_ADDRESS 0 SYMBOL_LINK "Rte_SignlCondn_VehicleSpeed_Kph_f32" 0 DISPLAY_IDENTIFIER Return.ReceiverPorts.VehicleSpeed.Kph_f32 /end MEASUREMENT
/begin MEASUREMENT ReturnFirewall.Defeat_Return_Svc.Cnt_lgc "MICROSAR RTE" UBYTE RTE_CM_BOOLEAN 0 0 0 255 ECU_ADDRESS 0 SYMBOL_LINK "Rte_CDDInterface9_FirewallSrlComSrvDft_Cnt_lgc" 0 DISPLAY_IDENTIFIER ReturnFirewall.ReceiverPorts.Defeat_Return_Svc.Cnt_lgc /end MEASUREMENT
/begin MEASUREMENT ReturnFirewall.HandwheelPosition.HwDeg_f32 "MICROSAR RTE" FLOAT32_IEEE NO_COMPU_METHOD 0 0 1.175494351e-38 3.402823466e+38 ECU_ADDRESS 0 SYMBOL_LINK "Rte_AbsHwPos_HandwheelPosition_HwDeg_f32" 0 DISPLAY_IDENTIFIER ReturnFirewall.ReceiverPorts.HandwheelPosition.HwDeg_f32 /end MEASUREMENT
/begin MEASUREMENT ReturnFirewall.LimitedReturn.MtrNm_f32 "MICROSAR RTE" FLOAT32_IEEE NO_COMPU_METHOD 0 0 1.175494351e-38 3.402823466e+38 ECU_ADDRESS 0 SYMBOL_LINK "Rte_ReturnFirewall_LimitedReturn_MtrNm_f32" 0 DISPLAY_IDENTIFIER ReturnFirewall.SenderPorts.LimitedReturn.MtrNm_f32 /end MEASUREMENT
/begin MEASUREMENT ReturnFirewall.MEC_Counter.Cnt_enum "MICROSAR RTE" UBYTE RTE_CM_ENUM_ManufModeType 0 0 0 2 ECU_ADDRESS 0 SYMBOL_LINK "Rte_CDDInterface9_NxtrMEC_Cnt_enum" 0 DISPLAY_IDENTIFIER ReturnFirewall.ReceiverPorts.MEC_Counter.Cnt_enum /end MEASUREMENT
/begin MEASUREMENT ReturnFirewall.ReturnCmd.MtrNm_f32 "MICROSAR RTE" FLOAT32_IEEE NO_COMPU_METHOD 0 0 1.175494351e-38 3.402823466e+38 ECU_ADDRESS 0 SYMBOL_LINK "Rte_BmwRtnArbn_ReturnCmd_MtrNm_f32" 0 DISPLAY_IDENTIFIER ReturnFirewall.ReceiverPorts.ReturnCmd.MtrNm_f32 /end MEASUREMENT
/begin MEASUREMENT ReturnFirewall.SystemState.Mode "MICROSAR RTE" UBYTE RTE_CM_ENUM_StaMd_Mode 0 0 0 255 ECU_ADDRESS 0 SYMBOL_LINK "Rte_ModeMachine_StaMd_SystemState_Mode" 0 DISPLAY_IDENTIFIER ReturnFirewall.ModeRequirePorts.SystemState.Mode /end MEASUREMENT
/begin MEASUREMENT ReturnFirewall.VehicleSpeed.Kph_f32 "MICROSAR RTE" FLOAT32_IEEE NO_COMPU_METHOD 0 0 1.175494351e-38 3.402823466e+38 ECU_ADDRESS 0 SYMBOL_LINK "Rte_SignlCondn_VehicleSpeed_Kph_f32" 0 DISPLAY_IDENTIFIER ReturnFirewall.ReceiverPorts.VehicleSpeed.Kph_f32 /end MEASUREMENT
/begin MEASUREMENT RteErrata10.SystemState.Mode "MICROSAR RTE" UBYTE RTE_CM_ENUM_StaMd_Mode 0 0 0 255 ECU_ADDRESS 0 SYMBOL_LINK "Rte_ModeMachine_StaMd_SystemState_Mode" 0 DISPLAY_IDENTIFIER RteErrata10.ModeRequirePorts.SystemState.Mode /end MEASUREMENT
/begin MEASUREMENT RteErrata11.SystemState.Mode "MICROSAR RTE" UBYTE RTE_CM_ENUM_StaMd_Mode 0 0 0 255 ECU_ADDRESS 0 SYMBOL_LINK "Rte_ModeMachine_StaMd11_SystemState11_Mode" 0 DISPLAY_IDENTIFIER RteErrata11.ModeRequirePorts.SystemState.Mode /end MEASUREMENT
/begin MEASUREMENT RteErrata7.SystemState.Mode "MICROSAR RTE" UBYTE RTE_CM_ENUM_StaMd_Mode 0 0 0 255 ECU_ADDRESS 0 SYMBOL_LINK "Rte_ModeMachine_StaMd7_SystemState7_Mode" 0 DISPLAY_IDENTIFIER RteErrata7.ModeRequirePorts.SystemState.Mode /end MEASUREMENT
/begin MEASUREMENT RteErrata8.SystemState.Mode "MICROSAR RTE" UBYTE RTE_CM_ENUM_StaMd_Mode 0 0 0 255 ECU_ADDRESS 0 SYMBOL_LINK "Rte_ModeMachine_StaMd8_SystemState8_Mode" 0 DISPLAY_IDENTIFIER RteErrata8.ModeRequirePorts.SystemState.Mode /end MEASUREMENT
/begin MEASUREMENT RteErrata9.SystemState.Mode "MICROSAR RTE" UBYTE RTE_CM_ENUM_StaMd_Mode 0 0 0 255 ECU_ADDRESS 0 SYMBOL_LINK "Rte_ModeMachine_StaMd9_SystemState9_Mode" 0 DISPLAY_IDENTIFIER RteErrata9.ModeRequirePorts.SystemState.Mode /end MEASUREMENT
/begin MEASUREMENT Sa_BkCpPc.Batt.Volt_f32 "This signal is intended to communicate any type voltage signal measured by the ecu.  This signal has a lower limit of 0 which reequires users of the signal to provide divide by 0 protection if it is used as a denominator in a calculation.  See Vecu port p" FLOAT32_IEEE NO_COMPU_METHOD 0 0 1.175494351e-38 3.402823466e+38 ECU_ADDRESS 0 SYMBOL_LINK "Rte_IoHwAb7_Batt_Volt_f32" 0 DISPLAY_IDENTIFIER Sa_BkCpPc.ReceiverPorts.Batt.Volt_f32 /end MEASUREMENT
/begin MEASUREMENT Sa_BkCpPc.BattSwitched.Volt_f32 "This signal is intended to communicate any type voltage signal measured by the ecu.  This signal has a lower limit of 0 which reequires users of the signal to provide divide by 0 protection if it is used as a denominator in a calculation.  See Vecu port p" FLOAT32_IEEE NO_COMPU_METHOD 0 0 1.175494351e-38 3.402823466e+38 ECU_ADDRESS 0 SYMBOL_LINK "Rte_IoHwAb7_BattSwitched_Volt_f32" 0 DISPLAY_IDENTIFIER Sa_BkCpPc.ReceiverPorts.BattSwitched.Volt_f32 /end MEASUREMENT
/begin MEASUREMENT Sa_BkCpPc.MotorVelocityMRFUnfiltered.MtrRadpS_f32 "MICROSAR RTE" FLOAT32_IEEE NO_COMPU_METHOD 0 0 1.175494351e-38 3.402823466e+38 ECU_ADDRESS 0 SYMBOL_LINK "Rte_MtrVel_MRFMotorVelUnfiltered_MtrRadpS_f32" 0 DISPLAY_IDENTIFIER Sa_BkCpPc.ReceiverPorts.MotorVelocityMRFUnfiltered.MtrRadpS_f32 /end MEASUREMENT
/begin MEASUREMENT Sa_BkCpPc.OVERRIDESIGDIAGADC.Volt_f32 "This signal is intended to communicate any type voltage signal measured by the ecu.  This signal has a lower limit of 0 which reequires users of the signal to provide divide by 0 protection if it is used as a denominator in a calculation.  See Vecu port p" FLOAT32_IEEE NO_COMPU_METHOD 0 0 1.175494351e-38 3.402823466e+38 ECU_ADDRESS 0 SYMBOL_LINK "Rte_Sa_BkCpPc_OVERRIDESIGDIAGADC_Volt_f32" 0 DISPLAY_IDENTIFIER Sa_BkCpPc.ReceiverPorts.OVERRIDESIGDIAGADC.Volt_f32 /end MEASUREMENT
/begin MEASUREMENT Sa_BkCpPc.PMOSDIAGADC.Volt_f32 "This signal is intended to communicate any type voltage signal measured by the ecu.  This signal has a lower limit of 0 which reequires users of the signal to provide divide by 0 protection if it is used as a denominator in a calculation.  See Vecu port p" FLOAT32_IEEE NO_COMPU_METHOD 0 0 1.175494351e-38 3.402823466e+38 ECU_ADDRESS 0 SYMBOL_LINK "Rte_Sa_BkCpPc_PMOSDIAGADC_Volt_f32" 0 DISPLAY_IDENTIFIER Sa_BkCpPc.ReceiverPorts.PMOSDIAGADC.Volt_f32 /end MEASUREMENT
/begin MEASUREMENT Sa_BkCpPc.PwrDiscATestComplete.Cnt_lgc "MICROSAR RTE" UBYTE RTE_CM_BOOLEAN 0 0 0 255 ECU_ADDRESS 0 SYMBOL_LINK "Rte_Sa_BkCpPc_PwrDiscATestComplete_Cnt_lgc" 0 DISPLAY_IDENTIFIER Sa_BkCpPc.SenderPorts.PwrDiscATestComplete.Cnt_lgc /end MEASUREMENT
/begin MEASUREMENT Sa_BkCpPc.PwrDiscATestStart.Cnt_lgc "MICROSAR RTE" UBYTE RTE_CM_BOOLEAN 0 0 0 255 ECU_ADDRESS 0 SYMBOL_LINK "Rte_HwPwUp_PwrDiscATestStart_Cnt_lgc" 0 DISPLAY_IDENTIFIER Sa_BkCpPc.ReceiverPorts.PwrDiscATestStart.Cnt_lgc /end MEASUREMENT
/begin MEASUREMENT Sa_BkCpPc.PwrDiscBTestComplete.Cnt_lgc "MICROSAR RTE" UBYTE RTE_CM_BOOLEAN 0 0 0 255 ECU_ADDRESS 0 SYMBOL_LINK "Rte_Sa_BkCpPc_PwrDiscBTestComplete_Cnt_lgc" 0 DISPLAY_IDENTIFIER Sa_BkCpPc.SenderPorts.PwrDiscBTestComplete.Cnt_lgc /end MEASUREMENT
/begin MEASUREMENT Sa_BkCpPc.PwrDiscBTestStart.Cnt_lgc "MICROSAR RTE" UBYTE RTE_CM_BOOLEAN 0 0 0 255 ECU_ADDRESS 0 SYMBOL_LINK "Rte_HwPwUp_PwrDiscBTestStart_Cnt_lgc" 0 DISPLAY_IDENTIFIER Sa_BkCpPc.ReceiverPorts.PwrDiscBTestStart.Cnt_lgc /end MEASUREMENT
/begin MEASUREMENT Sa_BkCpPc.PwrDiscClosed.Cnt_lgc "MICROSAR RTE" UBYTE RTE_CM_BOOLEAN 0 0 0 255 ECU_ADDRESS 0 SYMBOL_LINK "Rte_Sa_BkCpPc_PwrDiscClosed_Cnt_lgc" 0 DISPLAY_IDENTIFIER Sa_BkCpPc.SenderPorts.PwrDiscClosed.Cnt_lgc /end MEASUREMENT
/begin MEASUREMENT Sa_BkCpPc.SystemState.Mode "MICROSAR RTE" UBYTE RTE_CM_ENUM_StaMd_Mode 0 0 0 255 ECU_ADDRESS 0 SYMBOL_LINK "Rte_ModeMachine_StaMd7_SystemState7_Mode" 0 DISPLAY_IDENTIFIER Sa_BkCpPc.ModeRequirePorts.SystemState.Mode /end MEASUREMENT
/begin MEASUREMENT SignlCondn.EstimdLatAcce.MpSecSq_f32 "MICROSAR RTE" FLOAT32_IEEE NO_COMPU_METHOD 0 0 1.175494351e-38 3.402823466e+38 ECU_ADDRESS 0 SYMBOL_LINK "Rte_SignlCondn_EstimdLatAcce_MpSecSq_f32" 0 DISPLAY_IDENTIFIER SignlCondn.SenderPorts.EstimdLatAcce.MpSecSq_f32 /end MEASUREMENT
/begin MEASUREMENT SignlCondn.EstimdLatAcceValid.Cnt_lgc "MICROSAR RTE" UBYTE RTE_CM_BOOLEAN 0 0 0 255 ECU_ADDRESS 0 SYMBOL_LINK "Rte_SignlCondn_EstimdLatAcceValid_Cnt_lgc" 0 DISPLAY_IDENTIFIER SignlCondn.SenderPorts.EstimdLatAcceValid.Cnt_lgc /end MEASUREMENT
/begin MEASUREMENT SignlCondn.SrlComVehLatAccel.MpSecSq_f32 "MICROSAR RTE" FLOAT32_IEEE NO_COMPU_METHOD 0 0 1.175494351e-38 3.402823466e+38 ECU_ADDRESS 0 SYMBOL_LINK "Rte_SignlCondn_SrlComVehLatAccel_MpSecSq_f32" 0 DISPLAY_IDENTIFIER SignlCondn.ReceiverPorts.SrlComVehLatAccel.MpSecSq_f32 /end MEASUREMENT
/begin MEASUREMENT SignlCondn.SrlComVehLatAccelValid.Cnt_lgc "MICROSAR RTE" UBYTE RTE_CM_BOOLEAN 0 0 0 255 ECU_ADDRESS 0 SYMBOL_LINK "Rte_SrlComInput2_SrlComVehLatAccelValid_Cnt_lgc" 0 DISPLAY_IDENTIFIER SignlCondn.ReceiverPorts.SrlComVehLatAccelValid.Cnt_lgc /end MEASUREMENT
/begin MEASUREMENT SignlCondn.SrlComVehLonAccel.MpSecSq_f32 "MICROSAR RTE" FLOAT32_IEEE NO_COMPU_METHOD 0 0 1.175494351e-38 3.402823466e+38 ECU_ADDRESS 0 SYMBOL_LINK "Rte_SignlCondn_SrlComVehLonAccel_MpSecSq_f32" 0 DISPLAY_IDENTIFIER SignlCondn.ReceiverPorts.SrlComVehLonAccel.MpSecSq_f32 /end MEASUREMENT
/begin MEASUREMENT SignlCondn.SrlComVehLonAccelValid.Cnt_lgc "MICROSAR RTE" UBYTE RTE_CM_BOOLEAN 0 0 0 255 ECU_ADDRESS 0 SYMBOL_LINK "Rte_SignlCondn_SrlComVehLonAccelValid_Cnt_lgc" 0 DISPLAY_IDENTIFIER SignlCondn.ReceiverPorts.SrlComVehLonAccelValid.Cnt_lgc /end MEASUREMENT
/begin MEASUREMENT SignlCondn.SrlComVehSpeed.Kph_f32 "MICROSAR RTE" FLOAT32_IEEE NO_COMPU_METHOD 0 0 1.175494351e-38 3.402823466e+38 ECU_ADDRESS 0 SYMBOL_LINK "Rte_SrlComInput2_SrlComVehSpd_Kph_f32" 0 DISPLAY_IDENTIFIER SignlCondn.ReceiverPorts.SrlComVehSpeed.Kph_f32 /end MEASUREMENT
/begin MEASUREMENT SignlCondn.SrlComVehSpeedValid.Cnt_lgc "MICROSAR RTE" UBYTE RTE_CM_BOOLEAN 0 0 0 255 ECU_ADDRESS 0 SYMBOL_LINK "Rte_SrlComInput2_VehSpdValid_Cnt_lgc" 0 DISPLAY_IDENTIFIER SignlCondn.ReceiverPorts.SrlComVehSpeedValid.Cnt_lgc /end MEASUREMENT
/begin MEASUREMENT SignlCondn.SrlComVehYawRate.DegpS_f32 "MICROSAR RTE" FLOAT32_IEEE NO_COMPU_METHOD 0 0 1.175494351e-38 3.402823466e+38 ECU_ADDRESS 0 SYMBOL_LINK "Rte_SignlCondn_SrlComVehYawRate_DegpS_f32" 0 DISPLAY_IDENTIFIER SignlCondn.ReceiverPorts.SrlComVehYawRate.DegpS_f32 /end MEASUREMENT
/begin MEASUREMENT SignlCondn.SrlComVehYawRateValid.Cnt_lgc "MICROSAR RTE" UBYTE RTE_CM_BOOLEAN 0 0 0 255 ECU_ADDRESS 0 SYMBOL_LINK "Rte_SrlComInput2_SrlComVehYawRateValid_Cnt_lgc" 0 DISPLAY_IDENTIFIER SignlCondn.ReceiverPorts.SrlComVehYawRateValid.Cnt_lgc /end MEASUREMENT
/begin MEASUREMENT SignlCondn.VehicleLatAcceValid.Cnt_lgc "MICROSAR RTE" UBYTE RTE_CM_BOOLEAN 0 0 0 255 ECU_ADDRESS 0 SYMBOL_LINK "Rte_SignlCondn_VehicleLatAcceValid_Cnt_lgc" 0 DISPLAY_IDENTIFIER SignlCondn.SenderPorts.VehicleLatAcceValid.Cnt_lgc /end MEASUREMENT
/begin MEASUREMENT SignlCondn.VehicleLatAccel.MpSecSq_f32 "MICROSAR RTE" FLOAT32_IEEE NO_COMPU_METHOD 0 0 1.175494351e-38 3.402823466e+38 ECU_ADDRESS 0 SYMBOL_LINK "Rte_SignlCondn_VehicleLatAccel_MpSecSq_f32" 0 DISPLAY_IDENTIFIER SignlCondn.SenderPorts.VehicleLatAccel.MpSecSq_f32 /end MEASUREMENT
/begin MEASUREMENT SignlCondn.VehicleLonAccel.KphpS_f32 "MICROSAR RTE" FLOAT32_IEEE NO_COMPU_METHOD 0 0 1.175494351e-38 3.402823466e+38 ECU_ADDRESS 0 SYMBOL_LINK "Rte_SignlCondn_VehicleLonAccel_KphpS_f32" 0 DISPLAY_IDENTIFIER SignlCondn.SenderPorts.VehicleLonAccel.KphpS_f32 /end MEASUREMENT
/begin MEASUREMENT SignlCondn.VehicleLonAccelValid.Cnt_lgc "MICROSAR RTE" UBYTE RTE_CM_BOOLEAN 0 0 0 255 ECU_ADDRESS 0 SYMBOL_LINK "Rte_SignlCondn_VehicleLonAccelValid_Cnt_lgc" 0 DISPLAY_IDENTIFIER SignlCondn.SenderPorts.VehicleLonAccelValid.Cnt_lgc /end MEASUREMENT
/begin MEASUREMENT SignlCondn.VehicleSpeed.Kph_f32 "MICROSAR RTE" FLOAT32_IEEE NO_COMPU_METHOD 0 0 1.175494351e-38 3.402823466e+38 ECU_ADDRESS 0 SYMBOL_LINK "Rte_SignlCondn_VehicleSpeed_Kph_f32" 0 DISPLAY_IDENTIFIER SignlCondn.SenderPorts.VehicleSpeed.Kph_f32 /end MEASUREMENT
/begin MEASUREMENT SignlCondn.VehicleSpeedValid.Cnt_lgc "MICROSAR RTE" UBYTE RTE_CM_BOOLEAN 0 0 0 255 ECU_ADDRESS 0 SYMBOL_LINK "Rte_SignlCondn_VehicleSpeedValid_Cnt_lgc" 0 DISPLAY_IDENTIFIER SignlCondn.SenderPorts.VehicleSpeedValid.Cnt_lgc /end MEASUREMENT
/begin MEASUREMENT SignlCondn.VehicleYawRate.DegpS_f32 "MICROSAR RTE" FLOAT32_IEEE NO_COMPU_METHOD 0 0 1.175494351e-38 3.402823466e+38 ECU_ADDRESS 0 SYMBOL_LINK "Rte_SignlCondn_VehicleYawRate_DegpS_f32" 0 DISPLAY_IDENTIFIER SignlCondn.SenderPorts.VehicleYawRate.DegpS_f32 /end MEASUREMENT
/begin MEASUREMENT SignlCondn.VehicleYawRateValid.Cnt_lgc "MICROSAR RTE" UBYTE RTE_CM_BOOLEAN 0 0 0 255 ECU_ADDRESS 0 SYMBOL_LINK "Rte_SignlCondn_VehicleYawRateValid_Cnt_lgc" 0 DISPLAY_IDENTIFIER SignlCondn.SenderPorts.VehicleYawRateValid.Cnt_lgc /end MEASUREMENT
/begin MEASUREMENT SrlComInput.CDRVDYNMSG.Cnt_lgc "MICROSAR RTE" UBYTE RTE_CM_BOOLEAN 0 0 0 255 ECU_ADDRESS 0 SYMBOL_LINK "Rte_VehCfg_CDRVDYNMSG_Cnt_lgc" 0 DISPLAY_IDENTIFIER SrlComInput.ReceiverPorts.CDRVDYNMSG.Cnt_lgc /end MEASUREMENT
/begin MEASUREMENT SrlComInput.CERRMVOLTFALLBACK.Cnt_lgc "MICROSAR RTE" UBYTE RTE_CM_BOOLEAN 0 0 0 255 ECU_ADDRESS 0 SYMBOL_LINK "Rte_VehCfg_CERRMVOLTFALLBACK_Cnt_lgc" 0 DISPLAY_IDENTIFIER SrlComInput.ReceiverPorts.CERRMVOLTFALLBACK.Cnt_lgc /end MEASUREMENT
/begin MEASUREMENT SrlComInput.CFACTORIF.Cnt_lgc "MICROSAR RTE" UBYTE RTE_CM_BOOLEAN 0 0 0 255 ECU_ADDRESS 0 SYMBOL_LINK "Rte_VehCfg_CFACTORIF_Cnt_lgc" 0 DISPLAY_IDENTIFIER SrlComInput.ReceiverPorts.CFACTORIF.Cnt_lgc /end MEASUREMENT
/begin MEASUREMENT SrlComInput.CHWACORRECTION.Cnt_lgc "MICROSAR RTE" UBYTE RTE_CM_BOOLEAN 0 0 0 255 ECU_ADDRESS 0 SYMBOL_LINK "Rte_VehCfg_CHWACORRECTION_Cnt_lgc" 0 DISPLAY_IDENTIFIER SrlComInput.ReceiverPorts.CHWACORRECTION.Cnt_lgc /end MEASUREMENT
/begin MEASUREMENT SrlComInput.CHWANGLEIF.Cnt_lgc "MICROSAR RTE" UBYTE RTE_CM_BOOLEAN 0 0 0 255 ECU_ADDRESS 0 SYMBOL_LINK "Rte_VehCfg_CHWANGLEIF_Cnt_lgc" 0 DISPLAY_IDENTIFIER SrlComInput.ReceiverPorts.CHWANGLEIF.Cnt_lgc /end MEASUREMENT
/begin MEASUREMENT SrlComInput.CHWTORQUEIF.Cnt_lgc "MICROSAR RTE" UBYTE RTE_CM_BOOLEAN 0 0 0 255 ECU_ADDRESS 0 SYMBOL_LINK "Rte_VehCfg_CHWTORQUEIF_Cnt_lgc" 0 DISPLAY_IDENTIFIER SrlComInput.ReceiverPorts.CHWTORQUEIF.Cnt_lgc /end MEASUREMENT
/begin MEASUREMENT SrlComInput.CMTTORQUEIF.Cnt_lgc "MICROSAR RTE" UBYTE RTE_CM_BOOLEAN 0 0 0 255 ECU_ADDRESS 0 SYMBOL_LINK "Rte_VehCfg_CMTTORQUEIF_Cnt_lgc" 0 DISPLAY_IDENTIFIER SrlComInput.ReceiverPorts.CMTTORQUEIF.Cnt_lgc /end MEASUREMENT
/begin MEASUREMENT SrlComInput.DiagStsDefVehSpd.Cnt_lgc "MICROSAR RTE" UBYTE RTE_CM_BOOLEAN 0 0 0 255 ECU_ADDRESS 0 SYMBOL_LINK "Rte_DiagMgr10_DiagStsDefVehSpd_Cnt_lgc" 0 DISPLAY_IDENTIFIER SrlComInput.ReceiverPorts.DiagStsDefVehSpd.Cnt_lgc /end MEASUREMENT
/begin MEASUREMENT SrlComInput.ErrmBnU.Cnt_u8 "MICROSAR RTE" UBYTE RTE_CM_ENUM_CTR_ERRM_BN_U 0 0 0 63 ECU_ADDRESS 0 SYMBOL_LINK "Rte_SrlComInput_ErrmBnU_Cnt_u8" 0 DISPLAY_IDENTIFIER SrlComInput.SenderPorts.ErrmBnU.Cnt_u8 /end MEASUREMENT
/begin MEASUREMENT SrlComInput.HaptcFbIntenNr.Cnt_u16 "MICROSAR RTE" UWORD NO_COMPU_METHOD 0 0 0 65535 ECU_ADDRESS 0 SYMBOL_LINK "Rte_SrlComInput_HaptcFbIntenNr_Cnt_u16" 0 DISPLAY_IDENTIFIER SrlComInput.SenderPorts.HaptcFbIntenNr.Cnt_u16 /end MEASUREMENT
/begin MEASUREMENT SrlComInput.HaptcFbIntenSigVld.Cnt_lgc "MICROSAR RTE" UBYTE RTE_CM_BOOLEAN 0 0 0 255 ECU_ADDRESS 0 SYMBOL_LINK "Rte_SrlComInput_HaptcFbIntenSigVld_Cnt_lgc" 0 DISPLAY_IDENTIFIER SrlComInput.SenderPorts.HaptcFbIntenSigVld.Cnt_lgc /end MEASUREMENT
/begin MEASUREMENT SrlComInput.HaptcFbPatNr.Cnt_u16 "MICROSAR RTE" UWORD NO_COMPU_METHOD 0 0 0 65535 ECU_ADDRESS 0 SYMBOL_LINK "Rte_SrlComInput_HaptcFbPatNr_Cnt_u16" 0 DISPLAY_IDENTIFIER SrlComInput.SenderPorts.HaptcFbPatNr.Cnt_u16 /end MEASUREMENT
/begin MEASUREMENT SrlComInput.HaptcFbPatSigVld.Cnt_lgc "MICROSAR RTE" UBYTE RTE_CM_BOOLEAN 0 0 0 255 ECU_ADDRESS 0 SYMBOL_LINK "Rte_SrlComInput_HaptcFbPatSigVld_Cnt_lgc" 0 DISPLAY_IDENTIFIER SrlComInput.SenderPorts.HaptcFbPatSigVld.Cnt_lgc /end MEASUREMENT
/begin MEASUREMENT SrlComInput.IgnTimeOff.Cnt_u32 "MICROSAR RTE" ULONG NO_COMPU_METHOD 0 0 0 4294967295 ECU_ADDRESS 0 SYMBOL_LINK "Rte_SrlComInput_IgnTimeOff_Cnt_u32" 0 DISPLAY_IDENTIFIER SrlComInput.SenderPorts.IgnTimeOff.Cnt_u32 /end MEASUREMENT
/begin MEASUREMENT SrlComInput.IlkErrmFzm.Cnt_u8 "MICROSAR RTE" UBYTE RTE_CM_ENUM_ST_ILK_ERRM_FZM 0 0 0 3 ECU_ADDRESS 0 SYMBOL_LINK "Rte_SrlComInput_IlkErrmFzm_Cnt_u8" 0 DISPLAY_IDENTIFIER SrlComInput.SenderPorts.IlkErrmFzm.Cnt_u8 /end MEASUREMENT
/begin MEASUREMENT SrlComInput.ReturnOffset.HwDeg_f32 "MICROSAR RTE" FLOAT32_IEEE NO_COMPU_METHOD 0 0 1.175494351e-38 3.402823466e+38 ECU_ADDRESS 0 SYMBOL_LINK "Rte_SrlComInput_ReturnOffset_HwDeg_f32" 0 DISPLAY_IDENTIFIER SrlComInput.SenderPorts.ReturnOffset.HwDeg_f32 /end MEASUREMENT
/begin MEASUREMENT SrlComInput.SrlComSGOFFSQUADEPS.SG_OFFS_QUAD_EPS.ALIV_OFFS_QUAD_EPS "MICROSAR RTE" UBYTE RTE_CM_ENUM_ALIV_COU_4 0 0 0 15 ECU_ADDRESS 0 SYMBOL_LINK "Rte_SrlComInput_SrlComSGOFFSQUADEPS_SG_OFFS_QUAD_EPS.ALIV_OFFS_QUAD_EPS" 0 DISPLAY_IDENTIFIER SrlComInput.SenderPorts.SrlComSGOFFSQUADEPS.SG_OFFS_QUAD_EPS.ALIV_OFFS_QUAD_EPS /end MEASUREMENT
/begin MEASUREMENT SrlComInput.SrlComSGOFFSQUADEPS.SG_OFFS_QUAD_EPS.AVL_PO_IDX_ICM "MICROSAR RTE" UWORD RTE_CM_AVL_PINA_IDX_ICM 0 0 -1439.9560546875 1439.9560546875 ECU_ADDRESS 0 SYMBOL_LINK "Rte_SrlComInput_SrlComSGOFFSQUADEPS_SG_OFFS_QUAD_EPS.AVL_PO_IDX_ICM" 0 DISPLAY_IDENTIFIER SrlComInput.SenderPorts.SrlComSGOFFSQUADEPS.SG_OFFS_QUAD_EPS.AVL_PO_IDX_ICM /end MEASUREMENT
/begin MEASUREMENT SrlComInput.SrlComSGOFFSQUADEPS.SG_OFFS_QUAD_EPS.CRC_OFFS_QUAD_EPS "MICROSAR RTE" UBYTE RTE_CM_CRC8 0 0 0 255 ECU_ADDRESS 0 SYMBOL_LINK "Rte_SrlComInput_SrlComSGOFFSQUADEPS_SG_OFFS_QUAD_EPS.CRC_OFFS_QUAD_EPS" 0 DISPLAY_IDENTIFIER SrlComInput.SenderPorts.SrlComSGOFFSQUADEPS.SG_OFFS_QUAD_EPS.CRC_OFFS_QUAD_EPS /end MEASUREMENT
/begin MEASUREMENT SrlComInput.SrlComSGOFFSQUADEPS.SG_OFFS_QUAD_EPS.OFFS_QUAD_RTR_EPS "MICROSAR RTE" UBYTE RTE_CM_OFFS_QUAD_PINA_EPS 0 0 -127 127 ECU_ADDRESS 0 SYMBOL_LINK "Rte_SrlComInput_SrlComSGOFFSQUADEPS_SG_OFFS_QUAD_EPS.OFFS_QUAD_RTR_EPS" 0 DISPLAY_IDENTIFIER SrlComInput.SenderPorts.SrlComSGOFFSQUADEPS.SG_OFFS_QUAD_EPS.OFFS_QUAD_RTR_EPS /end MEASUREMENT
/begin MEASUREMENT SrlComInput.SrlComSGOFFSQUADEPS.SG_OFFS_QUAD_EPS.ST_OFFS_QUAD_EPS "MICROSAR RTE" UBYTE RTE_CM_ENUM_ST_OFFS_QUAD_PINA_EPS 0 0 0 15 ECU_ADDRESS 0 SYMBOL_LINK "Rte_SrlComInput_SrlComSGOFFSQUADEPS_SG_OFFS_QUAD_EPS.ST_OFFS_QUAD_EPS" 0 DISPLAY_IDENTIFIER SrlComInput.SenderPorts.SrlComSGOFFSQUADEPS.SG_OFFS_QUAD_EPS.ST_OFFS_QUAD_EPS /end MEASUREMENT
/begin MEASUREMENT SrlComInput.SrlComSGTARQTASTRMOMDV.SG_TAR_QTA_STRMOM_DV.ALIV_TAR_QTA_STMOM_DV "MICROSAR RTE" UBYTE RTE_CM_ENUM_ALIV_COU_4 0 0 0 15 ECU_ADDRESS 0 SYMBOL_LINK "Rte_SrlComInput_SrlComSGTARQTASTRMOMDV_SG_TAR_QTA_STRMOM_DV.ALIV_TAR_QTA_STMOM_DV" 0 DISPLAY_IDENTIFIER SrlComInput.SenderPorts.SrlComSGTARQTASTRMOMDV.SG_TAR_QTA_STRMOM_DV.ALIV_TAR_QTA_STMOM_DV /end MEASUREMENT
/begin MEASUREMENT SrlComInput.SrlComSGTARQTASTRMOMDV.SG_TAR_QTA_STRMOM_DV.CRC_TAR_QTA_STMOM_DV "MICROSAR RTE" UBYTE RTE_CM_CRC8 0 0 0 255 ECU_ADDRESS 0 SYMBOL_LINK "Rte_SrlComInput_SrlComSGTARQTASTRMOMDV_SG_TAR_QTA_STRMOM_DV.CRC_TAR_QTA_STMOM_DV" 0 DISPLAY_IDENTIFIER SrlComInput.SenderPorts.SrlComSGTARQTASTRMOMDV.SG_TAR_QTA_STRMOM_DV.CRC_TAR_QTA_STMOM_DV /end MEASUREMENT
/begin MEASUREMENT SrlComInput.SrlComSGTARQTASTRMOMDV.SG_TAR_QTA_STRMOM_DV.CTR_DEAC_EPS_FNS "MICROSAR RTE" UBYTE RTE_CM_ENUM_New_Coding_83 0 0 0 15 ECU_ADDRESS 0 SYMBOL_LINK "Rte_SrlComInput_SrlComSGTARQTASTRMOMDV_SG_TAR_QTA_STRMOM_DV.CTR_DEAC_EPS_FNS" 0 DISPLAY_IDENTIFIER SrlComInput.SenderPorts.SrlComSGTARQTASTRMOMDV.SG_TAR_QTA_STRMOM_DV.CTR_DEAC_EPS_FNS /end MEASUREMENT
/begin MEASUREMENT SrlComInput.SrlComSGTARQTASTRMOMDV.SG_TAR_QTA_STRMOM_DV.FACT_ASS_STMOM_FTAX "MICROSAR RTE" UBYTE RTE_CM_FACT_ASS_STMOM_FTAX 0 0 1 1.9921875 ECU_ADDRESS 0 SYMBOL_LINK "Rte_SrlComInput_SrlComSGTARQTASTRMOMDV_SG_TAR_QTA_STRMOM_DV.FACT_ASS_STMOM_FTAX" 0 DISPLAY_IDENTIFIER SrlComInput.SenderPorts.SrlComSGTARQTASTRMOMDV.SG_TAR_QTA_STRMOM_DV.FACT_ASS_STMOM_FTAX /end MEASUREMENT
/begin MEASUREMENT SrlComInput.SrlComSGTARQTASTRMOMDV.SG_TAR_QTA_STRMOM_DV.FACT_CTRR_STMOM_FTAX "MICROSAR RTE" UBYTE RTE_CM_FACT_CTRR_STMOM_FTAX 0 0 0.0078125 1 ECU_ADDRESS 0 SYMBOL_LINK "Rte_SrlComInput_SrlComSGTARQTASTRMOMDV_SG_TAR_QTA_STRMOM_DV.FACT_CTRR_STMOM_FTAX" 0 DISPLAY_IDENTIFIER SrlComInput.SenderPorts.SrlComSGTARQTASTRMOMDV.SG_TAR_QTA_STRMOM_DV.FACT_CTRR_STMOM_FTAX /end MEASUREMENT
/begin MEASUREMENT SrlComInput.SrlComSGTARQTASTRMOMDV.SG_TAR_QTA_STRMOM_DV.FACT_DMPNG_STMOM_FTAX "MICROSAR RTE" UBYTE RTE_CM_FACT_CTRR_STMOM_FTAX 0 0 0.0078125 1 ECU_ADDRESS 0 SYMBOL_LINK "Rte_SrlComInput_SrlComSGTARQTASTRMOMDV_SG_TAR_QTA_STRMOM_DV.FACT_DMPNG_STMOM_FTAX" 0 DISPLAY_IDENTIFIER SrlComInput.SenderPorts.SrlComSGTARQTASTRMOMDV.SG_TAR_QTA_STRMOM_DV.FACT_DMPNG_STMOM_FTAX /end MEASUREMENT
/begin MEASUREMENT SrlComInput.SrlComSGTARQTASTRMOMDV.SG_TAR_QTA_STRMOM_DV.QU_TAR_FACT_STMOM_FTAX "MICROSAR RTE" UBYTE RTE_CM_ENUM_QU_TAR_FACT_STMOM_FTAX 0 0 0 15 ECU_ADDRESS 0 SYMBOL_LINK "Rte_SrlComInput_SrlComSGTARQTASTRMOMDV_SG_TAR_QTA_STRMOM_DV.QU_TAR_FACT_STMOM_FTAX" 0 DISPLAY_IDENTIFIER SrlComInput.SenderPorts.SrlComSGTARQTASTRMOMDV.SG_TAR_QTA_STRMOM_DV.QU_TAR_FACT_STMOM_FTAX /end MEASUREMENT
/begin MEASUREMENT SrlComInput.SrlComSGTARQTASTRMOMDV.SG_TAR_QTA_STRMOM_DV.QU_TAR_QTA_STMOM_DV "MICROSAR RTE" UBYTE RTE_CM_ENUM_QU_TAR_QTA_STMOM_DV 0 0 0 15 ECU_ADDRESS 0 SYMBOL_LINK "Rte_SrlComInput_SrlComSGTARQTASTRMOMDV_SG_TAR_QTA_STRMOM_DV.QU_TAR_QTA_STMOM_DV" 0 DISPLAY_IDENTIFIER SrlComInput.SenderPorts.SrlComSGTARQTASTRMOMDV.SG_TAR_QTA_STRMOM_DV.QU_TAR_QTA_STMOM_DV /end MEASUREMENT
/begin MEASUREMENT SrlComInput.SrlComSGTARQTASTRMOMDV.SG_TAR_QTA_STRMOM_DV.TAR_QTA_STMOM_DV "MICROSAR RTE" UWORD RTE_CM_STMOM_QTA_DV 0 0 -10 10 ECU_ADDRESS 0 SYMBOL_LINK "Rte_SrlComInput_SrlComSGTARQTASTRMOMDV_SG_TAR_QTA_STRMOM_DV.TAR_QTA_STMOM_DV" 0 DISPLAY_IDENTIFIER SrlComInput.SenderPorts.SrlComSGTARQTASTRMOMDV.SG_TAR_QTA_STRMOM_DV.TAR_QTA_STMOM_DV /end MEASUREMENT
/begin MEASUREMENT SrlComInput.SrlComSGTARSTMOMDVACT.SG_TAR_STMOM_DV_ACT.ALIV_TAR_STMOM_DV_ACT "MICROSAR RTE" UBYTE RTE_CM_ENUM_ALIV_COU_4 0 0 0 15 ECU_ADDRESS 0 SYMBOL_LINK "Rte_SrlComInput_SrlComSGTARSTMOMDVACT_SG_TAR_STMOM_DV_ACT.ALIV_TAR_STMOM_DV_ACT" 0 DISPLAY_IDENTIFIER SrlComInput.SenderPorts.SrlComSGTARSTMOMDVACT.SG_TAR_STMOM_DV_ACT.ALIV_TAR_STMOM_DV_ACT /end MEASUREMENT
/begin MEASUREMENT SrlComInput.SrlComSGTARSTMOMDVACT.SG_TAR_STMOM_DV_ACT.CRC_TAR_STMOM_DV_ACT "MICROSAR RTE" UBYTE RTE_CM_CRC8 0 0 0 255 ECU_ADDRESS 0 SYMBOL_LINK "Rte_SrlComInput_SrlComSGTARSTMOMDVACT_SG_TAR_STMOM_DV_ACT.CRC_TAR_STMOM_DV_ACT" 0 DISPLAY_IDENTIFIER SrlComInput.SenderPorts.SrlComSGTARSTMOMDVACT.SG_TAR_STMOM_DV_ACT.CRC_TAR_STMOM_DV_ACT /end MEASUREMENT
/begin MEASUREMENT SrlComInput.SrlComSGTARSTMOMDVACT.SG_TAR_STMOM_DV_ACT.FACT_DMPNG_ADDON_STMOM_FTAX "MICROSAR RTE" UBYTE RTE_CM_FACT_DMPNG_ADDON_STMOM_FTAX 0 0 0 3.984375 ECU_ADDRESS 0 SYMBOL_LINK "Rte_SrlComInput_SrlComSGTARSTMOMDVACT_SG_TAR_STMOM_DV_ACT.FACT_DMPNG_ADDON_STMOM_FTAX" 0 DISPLAY_IDENTIFIER SrlComInput.SenderPorts.SrlComSGTARSTMOMDVACT.SG_TAR_STMOM_DV_ACT.FACT_DMPNG_ADDON_STMOM_FTAX /end MEASUREMENT
/begin MEASUREMENT SrlComInput.SrlComSGTARSTMOMDVACT.SG_TAR_STMOM_DV_ACT.QU_TAR_DMPNG_ADDON_STMOM_FTAX "MICROSAR RTE" UBYTE RTE_CM_ENUM_QU_TAR_DMPNG_ADDON_STMOM_FTAX 0 0 0 15 ECU_ADDRESS 0 SYMBOL_LINK "Rte_SrlComInput_SrlComSGTARSTMOMDVACT_SG_TAR_STMOM_DV_ACT.QU_TAR_DMPNG_ADDON_STMOM_FTAX" 0 DISPLAY_IDENTIFIER SrlComInput.SenderPorts.SrlComSGTARSTMOMDVACT.SG_TAR_STMOM_DV_ACT.QU_TAR_DMPNG_ADDON_STMOM_FTAX /end MEASUREMENT
/begin MEASUREMENT SrlComInput.SrlComSGTARSTMOMDVACT.SG_TAR_STMOM_DV_ACT.QU_TAR_STMOM_DV_ACT "MICROSAR RTE" UBYTE RTE_CM_ENUM_QU_TAR_STMOM_DV_ACT 0 0 0 15 ECU_ADDRESS 0 SYMBOL_LINK "Rte_SrlComInput_SrlComSGTARSTMOMDVACT_SG_TAR_STMOM_DV_ACT.QU_TAR_STMOM_DV_ACT" 0 DISPLAY_IDENTIFIER SrlComInput.SenderPorts.SrlComSGTARSTMOMDVACT.SG_TAR_STMOM_DV_ACT.QU_TAR_STMOM_DV_ACT /end MEASUREMENT
/begin MEASUREMENT SrlComInput.SrlComSGTARSTMOMDVACT.SG_TAR_STMOM_DV_ACT.TAR_STMOM_DV_ACT "MICROSAR RTE" UWORD RTE_CM_TAR_STMOM_DV_ACT 0 0 -12 12 ECU_ADDRESS 0 SYMBOL_LINK "Rte_SrlComInput_SrlComSGTARSTMOMDVACT_SG_TAR_STMOM_DV_ACT.TAR_STMOM_DV_ACT" 0 DISPLAY_IDENTIFIER SrlComInput.SenderPorts.SrlComSGTARSTMOMDVACT.SG_TAR_STMOM_DV_ACT.TAR_STMOM_DV_ACT /end MEASUREMENT
/begin MEASUREMENT SrlComInput.SrlComSGVVEH.SG_V_VEH.ALIV_V_VEH "MICROSAR RTE" UBYTE RTE_CM_ENUM_ALIV_COU_V 0 0 0 15 ECU_ADDRESS 0 SYMBOL_LINK "Rte_SrlComInput_SrlComSGVVEH_SG_V_VEH.ALIV_V_VEH" 0 DISPLAY_IDENTIFIER SrlComInput.SenderPorts.SrlComSGVVEH.SG_V_VEH.ALIV_V_VEH /end MEASUREMENT
/begin MEASUREMENT SrlComInput.SrlComSGVVEH.SG_V_VEH.CRC_V_VEH "MICROSAR RTE" UBYTE RTE_CM_CRC_V_VEH 0 0 0 255 ECU_ADDRESS 0 SYMBOL_LINK "Rte_SrlComInput_SrlComSGVVEH_SG_V_VEH.CRC_V_VEH" 0 DISPLAY_IDENTIFIER SrlComInput.SenderPorts.SrlComSGVVEH.SG_V_VEH.CRC_V_VEH /end MEASUREMENT
/begin MEASUREMENT SrlComInput.SrlComSGVVEH.SG_V_VEH.DVCO_VEH "MICROSAR RTE" UBYTE RTE_CM_ENUM_DVCO_VEH 0 0 0 7 ECU_ADDRESS 0 SYMBOL_LINK "Rte_SrlComInput_SrlComSGVVEH_SG_V_VEH.DVCO_VEH" 0 DISPLAY_IDENTIFIER SrlComInput.SenderPorts.SrlComSGVVEH.SG_V_VEH.DVCO_VEH /end MEASUREMENT
/begin MEASUREMENT SrlComInput.SrlComSGVVEH.SG_V_VEH.QU_V_VEH_COG "MICROSAR RTE" UBYTE RTE_CM_ENUM_QU_V_VEH_COG 0 0 0 15 ECU_ADDRESS 0 SYMBOL_LINK "Rte_SrlComInput_SrlComSGVVEH_SG_V_VEH.QU_V_VEH_COG" 0 DISPLAY_IDENTIFIER SrlComInput.SenderPorts.SrlComSGVVEH.SG_V_VEH.QU_V_VEH_COG /end MEASUREMENT
/begin MEASUREMENT SrlComInput.SrlComSGVVEH.SG_V_VEH.ST_V_VEH_NSS "MICROSAR RTE" UBYTE RTE_CM_ENUM_ST_V_VEH_NSS 0 0 0 15 ECU_ADDRESS 0 SYMBOL_LINK "Rte_SrlComInput_SrlComSGVVEH_SG_V_VEH.ST_V_VEH_NSS" 0 DISPLAY_IDENTIFIER SrlComInput.SenderPorts.SrlComSGVVEH.SG_V_VEH.ST_V_VEH_NSS /end MEASUREMENT
/begin MEASUREMENT SrlComInput.SrlComSGVVEH.SG_V_VEH.V_VEH_0x27_0x01 "MICROSAR RTE" UBYTE RTE_CM_BOOLEAN 0 0 0 255 ECU_ADDRESS 0 SYMBOL_LINK "Rte_SrlComInput_SrlComSGVVEH_SG_V_VEH.V_VEH_0x27_0x01" 0 DISPLAY_IDENTIFIER SrlComInput.SenderPorts.SrlComSGVVEH.SG_V_VEH.V_VEH_0x27_0x01 /end MEASUREMENT
/begin MEASUREMENT SrlComInput.SrlComSGVVEH.SG_V_VEH.V_VEH_COG "MICROSAR RTE" UWORD RTE_CM_V_VEH_COG 0 0 0 350 ECU_ADDRESS 0 SYMBOL_LINK "Rte_SrlComInput_SrlComSGVVEH_SG_V_VEH.V_VEH_COG" 0 DISPLAY_IDENTIFIER SrlComInput.SenderPorts.SrlComSGVVEH.SG_V_VEH.V_VEH_COG /end MEASUREMENT
/begin MEASUREMENT SrlComInput.SrlComSvcDft.Cnt_b32 "MICROSAR RTE" ULONG NO_COMPU_METHOD 0 0 0 4294967295 ECU_ADDRESS 0 SYMBOL_LINK "Rte_CDDInterface9_SrlComSvcDft_Cnt_b32" 0 DISPLAY_IDENTIFIER SrlComInput.ReceiverPorts.SrlComSvcDft.Cnt_b32 /end MEASUREMENT
/begin MEASUREMENT SrlComInput.SupplyCurrLmt.Amp_f32 "MICROSAR RTE" FLOAT32_IEEE NO_COMPU_METHOD 0 0 1.175494351e-38 3.402823466e+38 ECU_ADDRESS 0 SYMBOL_LINK "Rte_SrlComInput_SupplyCurrLmt_Amp_f32" 0 DISPLAY_IDENTIFIER SrlComInput.SenderPorts.SupplyCurrLmt.Amp_f32 /end MEASUREMENT
/begin MEASUREMENT SrlComInput.SystemState.Mode "MICROSAR RTE" UBYTE RTE_CM_ENUM_StaMd_Mode 0 0 0 255 ECU_ADDRESS 0 SYMBOL_LINK "Rte_ModeMachine_StaMd9_SystemState9_Mode" 0 DISPLAY_IDENTIFIER SrlComInput.ModeRequirePorts.SystemState.Mode /end MEASUREMENT
/begin MEASUREMENT SrlComInput.VINValid.Cnt_lgc "MICROSAR RTE" UBYTE RTE_CM_BOOLEAN 0 0 0 255 ECU_ADDRESS 0 SYMBOL_LINK "Rte_SrlComInput_VINValid_Cnt_lgc" 0 DISPLAY_IDENTIFIER SrlComInput.SenderPorts.VINValid.Cnt_lgc /end MEASUREMENT
/begin MEASUREMENT SrlComInput.VehTimeValid.Cnt_lgc "MICROSAR RTE" UBYTE RTE_CM_BOOLEAN 0 0 0 255 ECU_ADDRESS 0 SYMBOL_LINK "Rte_SrlComInput_VehTimeValid_Cnt_lgc" 0 DISPLAY_IDENTIFIER SrlComInput.SenderPorts.VehTimeValid.Cnt_lgc /end MEASUREMENT
/begin MEASUREMENT SrlComInput2.CADASIF.Cnt_lgc "MICROSAR RTE" UBYTE RTE_CM_BOOLEAN 0 0 0 255 ECU_ADDRESS 0 SYMBOL_LINK "Rte_VehCfg_CADASIF_Cnt_lgc" 0 DISPLAY_IDENTIFIER SrlComInput2.ReceiverPorts.CADASIF.Cnt_lgc /end MEASUREMENT
/begin MEASUREMENT SrlComInput2.CFACTORIF.Cnt_lgc "MICROSAR RTE" UBYTE RTE_CM_BOOLEAN 0 0 0 255 ECU_ADDRESS 0 SYMBOL_LINK "Rte_VehCfg_CFACTORIF_Cnt_lgc" 0 DISPLAY_IDENTIFIER SrlComInput2.ReceiverPorts.CFACTORIF.Cnt_lgc /end MEASUREMENT
/begin MEASUREMENT SrlComInput2.CHWANGLEIF.Cnt_lgc "MICROSAR RTE" UBYTE RTE_CM_BOOLEAN 0 0 0 255 ECU_ADDRESS 0 SYMBOL_LINK "Rte_VehCfg_CHWANGLEIF_Cnt_lgc" 0 DISPLAY_IDENTIFIER SrlComInput2.ReceiverPorts.CHWANGLEIF.Cnt_lgc /end MEASUREMENT
/begin MEASUREMENT SrlComInput2.CHWTORQUEIF.Cnt_lgc "MICROSAR RTE" UBYTE RTE_CM_BOOLEAN 0 0 0 255 ECU_ADDRESS 0 SYMBOL_LINK "Rte_VehCfg_CHWTORQUEIF_Cnt_lgc" 0 DISPLAY_IDENTIFIER SrlComInput2.ReceiverPorts.CHWTORQUEIF.Cnt_lgc /end MEASUREMENT
/begin MEASUREMENT SrlComInput2.CMTTORQUEIF.Cnt_lgc "MICROSAR RTE" UBYTE RTE_CM_BOOLEAN 0 0 0 255 ECU_ADDRESS 0 SYMBOL_LINK "Rte_VehCfg_CMTTORQUEIF_Cnt_lgc" 0 DISPLAY_IDENTIFIER SrlComInput2.ReceiverPorts.CMTTORQUEIF.Cnt_lgc /end MEASUREMENT
/begin MEASUREMENT SrlComInput2.DiagStsDefVehSpd.Cnt_lgc "MICROSAR RTE" UBYTE RTE_CM_BOOLEAN 0 0 0 255 ECU_ADDRESS 0 SYMBOL_LINK "Rte_DiagMgr10_DiagStsDefVehSpd_Cnt_lgc" 0 DISPLAY_IDENTIFIER SrlComInput2.ReceiverPorts.DiagStsDefVehSpd.Cnt_lgc /end MEASUREMENT
/begin MEASUREMENT SrlComInput2.FRVldVehSpd.Kph_f32 "MICROSAR RTE" FLOAT32_IEEE NO_COMPU_METHOD 0 0 1.175494351e-38 3.402823466e+38 ECU_ADDRESS 0 SYMBOL_LINK "Rte_SrlComInput2_FRVldVehSpd_Kph_f32" 0 DISPLAY_IDENTIFIER SrlComInput2.SenderPorts.FRVldVehSpd.Kph_f32 /end MEASUREMENT
/begin MEASUREMENT SrlComInput2.SerlComTarSteerTqDrvrActr.MtrNm_f32 "MICROSAR RTE" FLOAT32_IEEE NO_COMPU_METHOD 0 0 1.175494351e-38 3.402823466e+38 ECU_ADDRESS 0 SYMBOL_LINK "Rte_SrlComInput2_SerlComTarSteerTqDrvrActr_MtrNm_f32" 0 DISPLAY_IDENTIFIER SrlComInput2.SenderPorts.SerlComTarSteerTqDrvrActr.MtrNm_f32 /end MEASUREMENT
/begin MEASUREMENT SrlComInput2.SrlComAssistScaleFactor.Uls_f32 "MICROSAR RTE" FLOAT32_IEEE NO_COMPU_METHOD 0 0 1.175494351e-38 3.402823466e+38 ECU_ADDRESS 0 SYMBOL_LINK "Rte_SrlComInput2_SrlComAssistScaleFactor_Uls_f32" 0 DISPLAY_IDENTIFIER SrlComInput2.SenderPorts.SrlComAssistScaleFactor.Uls_f32 /end MEASUREMENT
/begin MEASUREMENT SrlComInput2.SrlComCRFRevOffset.Rev_s16 "MICROSAR RTE" SWORD NO_COMPU_METHOD 0 0 -32768 32767 ECU_ADDRESS 0 SYMBOL_LINK "Rte_SrlComInput2_SrlComCRFRevOffset_Rev_s16" 0 DISPLAY_IDENTIFIER SrlComInput2.SenderPorts.SrlComCRFRevOffset.Rev_s16 /end MEASUREMENT
/begin MEASUREMENT SrlComInput2.SrlComDampingScaleFactor.Uls_f32 "MICROSAR RTE" FLOAT32_IEEE NO_COMPU_METHOD 0 0 1.175494351e-38 3.402823466e+38 ECU_ADDRESS 0 SYMBOL_LINK "Rte_SrlComInput2_SrlComDampingScaleFactor_Uls_f32" 0 DISPLAY_IDENTIFIER SrlComInput2.SenderPorts.SrlComDampingScaleFactor.Uls_f32 /end MEASUREMENT
/begin MEASUREMENT SrlComInput2.SrlComDrvDynEnable.Cnt_lgc "MICROSAR RTE" UBYTE RTE_CM_BOOLEAN 0 0 0 255 ECU_ADDRESS 0 SYMBOL_LINK "Rte_SrlComInput2_SrlComDrvDynEnable_Cnt_lgc" 0 DISPLAY_IDENTIFIER SrlComInput2.SenderPorts.SrlComDrvDynEnable.Cnt_lgc /end MEASUREMENT
/begin MEASUREMENT SrlComInput2.SrlComDrvDynInvalid.Cnt_lgc "MICROSAR RTE" UBYTE RTE_CM_BOOLEAN 0 0 0 255 ECU_ADDRESS 0 SYMBOL_LINK "Rte_SrlComInput2_SrlComDrvDynInvalid_Cnt_lgc" 0 DISPLAY_IDENTIFIER SrlComInput2.SenderPorts.SrlComDrvDynInvalid.Cnt_lgc /end MEASUREMENT
/begin MEASUREMENT SrlComInput2.SrlComEngCrank.Cnt_lgc "MICROSAR RTE" UBYTE RTE_CM_BOOLEAN 0 0 0 255 ECU_ADDRESS 0 SYMBOL_LINK "Rte_SrlComInput2_SrlComEngCrank_Cnt_lgc" 0 DISPLAY_IDENTIFIER SrlComInput2.SenderPorts.SrlComEngCrank.Cnt_lgc /end MEASUREMENT
/begin MEASUREMENT SrlComInput2.SrlComInputTorqueOverlay.HwNm_f32 "MICROSAR RTE" FLOAT32_IEEE NO_COMPU_METHOD 0 0 1.175494351e-38 3.402823466e+38 ECU_ADDRESS 0 SYMBOL_LINK "Rte_SrlComInput2_SrlComInputTorqueOverlay_HwNm_f32" 0 DISPLAY_IDENTIFIER SrlComInput2.SenderPorts.SrlComInputTorqueOverlay.HwNm_f32 /end MEASUREMENT
/begin MEASUREMENT SrlComInput2.SrlComPrkAstHwAngle.HwDeg_f32 "MICROSAR RTE" FLOAT32_IEEE NO_COMPU_METHOD 0 0 1.175494351e-38 3.402823466e+38 ECU_ADDRESS 0 SYMBOL_LINK "Rte_SrlComInput2_SrlComPrkAstHwAngle_HwDeg_f32" 0 DISPLAY_IDENTIFIER SrlComInput2.SenderPorts.SrlComPrkAstHwAngle.HwDeg_f32 /end MEASUREMENT
/begin MEASUREMENT SrlComInput2.SrlComPrkAstInvalid.Cnt_lgc "MICROSAR RTE" UBYTE RTE_CM_BOOLEAN 0 0 0 255 ECU_ADDRESS 0 SYMBOL_LINK "Rte_SrlComInput2_SrlComPrkAstInvalid_Cnt_lgc" 0 DISPLAY_IDENTIFIER SrlComInput2.SenderPorts.SrlComPrkAstInvalid.Cnt_lgc /end MEASUREMENT
/begin MEASUREMENT SrlComInput2.SrlComReturnScaleFactor.Uls_f32 "MICROSAR RTE" FLOAT32_IEEE NO_COMPU_METHOD 0 0 1.175494351e-38 3.402823466e+38 ECU_ADDRESS 0 SYMBOL_LINK "Rte_SrlComInput2_SrlComReturnScaleFactor_Uls_f32" 0 DISPLAY_IDENTIFIER SrlComInput2.SenderPorts.SrlComReturnScaleFactor.Uls_f32 /end MEASUREMENT
/begin MEASUREMENT SrlComInput2.SrlComRevOffsetSts.Cnt_u08 "MICROSAR RTE" UBYTE RTE_CM_ENUM_ST_OFFS_QUAD_EPS 0 0 0 15 ECU_ADDRESS 0 SYMBOL_LINK "Rte_SrlComInput2_SrlComRevOffsetSts_Cnt_u08" 0 DISPLAY_IDENTIFIER SrlComInput2.SenderPorts.SrlComRevOffsetSts.Cnt_u08 /end MEASUREMENT
/begin MEASUREMENT SrlComInput2.SrlComSGOFFSQUADEPS.SG_OFFS_QUAD_EPS.ALIV_OFFS_QUAD_EPS "MICROSAR RTE" UBYTE RTE_CM_ENUM_ALIV_COU_4 0 0 0 15 ECU_ADDRESS 0 SYMBOL_LINK "Rte_SrlComInput_SrlComSGOFFSQUADEPS_SG_OFFS_QUAD_EPS.ALIV_OFFS_QUAD_EPS" 0 DISPLAY_IDENTIFIER SrlComInput2.ReceiverPorts.SrlComSGOFFSQUADEPS.SG_OFFS_QUAD_EPS.ALIV_OFFS_QUAD_EPS /end MEASUREMENT
/begin MEASUREMENT SrlComInput2.SrlComSGOFFSQUADEPS.SG_OFFS_QUAD_EPS.AVL_PO_IDX_ICM "MICROSAR RTE" UWORD RTE_CM_AVL_PINA_IDX_ICM 0 0 -1439.9560546875 1439.9560546875 ECU_ADDRESS 0 SYMBOL_LINK "Rte_SrlComInput_SrlComSGOFFSQUADEPS_SG_OFFS_QUAD_EPS.AVL_PO_IDX_ICM" 0 DISPLAY_IDENTIFIER SrlComInput2.ReceiverPorts.SrlComSGOFFSQUADEPS.SG_OFFS_QUAD_EPS.AVL_PO_IDX_ICM /end MEASUREMENT
/begin MEASUREMENT SrlComInput2.SrlComSGOFFSQUADEPS.SG_OFFS_QUAD_EPS.CRC_OFFS_QUAD_EPS "MICROSAR RTE" UBYTE RTE_CM_CRC8 0 0 0 255 ECU_ADDRESS 0 SYMBOL_LINK "Rte_SrlComInput_SrlComSGOFFSQUADEPS_SG_OFFS_QUAD_EPS.CRC_OFFS_QUAD_EPS" 0 DISPLAY_IDENTIFIER SrlComInput2.ReceiverPorts.SrlComSGOFFSQUADEPS.SG_OFFS_QUAD_EPS.CRC_OFFS_QUAD_EPS /end MEASUREMENT
/begin MEASUREMENT SrlComInput2.SrlComSGOFFSQUADEPS.SG_OFFS_QUAD_EPS.OFFS_QUAD_RTR_EPS "MICROSAR RTE" UBYTE RTE_CM_OFFS_QUAD_PINA_EPS 0 0 -127 127 ECU_ADDRESS 0 SYMBOL_LINK "Rte_SrlComInput_SrlComSGOFFSQUADEPS_SG_OFFS_QUAD_EPS.OFFS_QUAD_RTR_EPS" 0 DISPLAY_IDENTIFIER SrlComInput2.ReceiverPorts.SrlComSGOFFSQUADEPS.SG_OFFS_QUAD_EPS.OFFS_QUAD_RTR_EPS /end MEASUREMENT
/begin MEASUREMENT SrlComInput2.SrlComSGOFFSQUADEPS.SG_OFFS_QUAD_EPS.ST_OFFS_QUAD_EPS "MICROSAR RTE" UBYTE RTE_CM_ENUM_ST_OFFS_QUAD_PINA_EPS 0 0 0 15 ECU_ADDRESS 0 SYMBOL_LINK "Rte_SrlComInput_SrlComSGOFFSQUADEPS_SG_OFFS_QUAD_EPS.ST_OFFS_QUAD_EPS" 0 DISPLAY_IDENTIFIER SrlComInput2.ReceiverPorts.SrlComSGOFFSQUADEPS.SG_OFFS_QUAD_EPS.ST_OFFS_QUAD_EPS /end MEASUREMENT
/begin MEASUREMENT SrlComInput2.SrlComSGTARQTASTRMOMDV.SG_TAR_QTA_STRMOM_DV.ALIV_TAR_QTA_STMOM_DV "MICROSAR RTE" UBYTE RTE_CM_ENUM_ALIV_COU_4 0 0 0 15 ECU_ADDRESS 0 SYMBOL_LINK "Rte_SrlComInput_SrlComSGTARQTASTRMOMDV_SG_TAR_QTA_STRMOM_DV.ALIV_TAR_QTA_STMOM_DV" 0 DISPLAY_IDENTIFIER SrlComInput2.ReceiverPorts.SrlComSGTARQTASTRMOMDV.SG_TAR_QTA_STRMOM_DV.ALIV_TAR_QTA_STMOM_DV /end MEASUREMENT
/begin MEASUREMENT SrlComInput2.SrlComSGTARQTASTRMOMDV.SG_TAR_QTA_STRMOM_DV.CRC_TAR_QTA_STMOM_DV "MICROSAR RTE" UBYTE RTE_CM_CRC8 0 0 0 255 ECU_ADDRESS 0 SYMBOL_LINK "Rte_SrlComInput_SrlComSGTARQTASTRMOMDV_SG_TAR_QTA_STRMOM_DV.CRC_TAR_QTA_STMOM_DV" 0 DISPLAY_IDENTIFIER SrlComInput2.ReceiverPorts.SrlComSGTARQTASTRMOMDV.SG_TAR_QTA_STRMOM_DV.CRC_TAR_QTA_STMOM_DV /end MEASUREMENT
/begin MEASUREMENT SrlComInput2.SrlComSGTARQTASTRMOMDV.SG_TAR_QTA_STRMOM_DV.CTR_DEAC_EPS_FNS "MICROSAR RTE" UBYTE RTE_CM_ENUM_New_Coding_83 0 0 0 15 ECU_ADDRESS 0 SYMBOL_LINK "Rte_SrlComInput_SrlComSGTARQTASTRMOMDV_SG_TAR_QTA_STRMOM_DV.CTR_DEAC_EPS_FNS" 0 DISPLAY_IDENTIFIER SrlComInput2.ReceiverPorts.SrlComSGTARQTASTRMOMDV.SG_TAR_QTA_STRMOM_DV.CTR_DEAC_EPS_FNS /end MEASUREMENT
/begin MEASUREMENT SrlComInput2.SrlComSGTARQTASTRMOMDV.SG_TAR_QTA_STRMOM_DV.FACT_ASS_STMOM_FTAX "MICROSAR RTE" UBYTE RTE_CM_FACT_ASS_STMOM_FTAX 0 0 1 1.9921875 ECU_ADDRESS 0 SYMBOL_LINK "Rte_SrlComInput_SrlComSGTARQTASTRMOMDV_SG_TAR_QTA_STRMOM_DV.FACT_ASS_STMOM_FTAX" 0 DISPLAY_IDENTIFIER SrlComInput2.ReceiverPorts.SrlComSGTARQTASTRMOMDV.SG_TAR_QTA_STRMOM_DV.FACT_ASS_STMOM_FTAX /end MEASUREMENT
/begin MEASUREMENT SrlComInput2.SrlComSGTARQTASTRMOMDV.SG_TAR_QTA_STRMOM_DV.FACT_CTRR_STMOM_FTAX "MICROSAR RTE" UBYTE RTE_CM_FACT_CTRR_STMOM_FTAX 0 0 0.0078125 1 ECU_ADDRESS 0 SYMBOL_LINK "Rte_SrlComInput_SrlComSGTARQTASTRMOMDV_SG_TAR_QTA_STRMOM_DV.FACT_CTRR_STMOM_FTAX" 0 DISPLAY_IDENTIFIER SrlComInput2.ReceiverPorts.SrlComSGTARQTASTRMOMDV.SG_TAR_QTA_STRMOM_DV.FACT_CTRR_STMOM_FTAX /end MEASUREMENT
/begin MEASUREMENT SrlComInput2.SrlComSGTARQTASTRMOMDV.SG_TAR_QTA_STRMOM_DV.FACT_DMPNG_STMOM_FTAX "MICROSAR RTE" UBYTE RTE_CM_FACT_CTRR_STMOM_FTAX 0 0 0.0078125 1 ECU_ADDRESS 0 SYMBOL_LINK "Rte_SrlComInput_SrlComSGTARQTASTRMOMDV_SG_TAR_QTA_STRMOM_DV.FACT_DMPNG_STMOM_FTAX" 0 DISPLAY_IDENTIFIER SrlComInput2.ReceiverPorts.SrlComSGTARQTASTRMOMDV.SG_TAR_QTA_STRMOM_DV.FACT_DMPNG_STMOM_FTAX /end MEASUREMENT
/begin MEASUREMENT SrlComInput2.SrlComSGTARQTASTRMOMDV.SG_TAR_QTA_STRMOM_DV.QU_TAR_FACT_STMOM_FTAX "MICROSAR RTE" UBYTE RTE_CM_ENUM_QU_TAR_FACT_STMOM_FTAX 0 0 0 15 ECU_ADDRESS 0 SYMBOL_LINK "Rte_SrlComInput_SrlComSGTARQTASTRMOMDV_SG_TAR_QTA_STRMOM_DV.QU_TAR_FACT_STMOM_FTAX" 0 DISPLAY_IDENTIFIER SrlComInput2.ReceiverPorts.SrlComSGTARQTASTRMOMDV.SG_TAR_QTA_STRMOM_DV.QU_TAR_FACT_STMOM_FTAX /end MEASUREMENT
/begin MEASUREMENT SrlComInput2.SrlComSGTARQTASTRMOMDV.SG_TAR_QTA_STRMOM_DV.QU_TAR_QTA_STMOM_DV "MICROSAR RTE" UBYTE RTE_CM_ENUM_QU_TAR_QTA_STMOM_DV 0 0 0 15 ECU_ADDRESS 0 SYMBOL_LINK "Rte_SrlComInput_SrlComSGTARQTASTRMOMDV_SG_TAR_QTA_STRMOM_DV.QU_TAR_QTA_STMOM_DV" 0 DISPLAY_IDENTIFIER SrlComInput2.ReceiverPorts.SrlComSGTARQTASTRMOMDV.SG_TAR_QTA_STRMOM_DV.QU_TAR_QTA_STMOM_DV /end MEASUREMENT
/begin MEASUREMENT SrlComInput2.SrlComSGTARQTASTRMOMDV.SG_TAR_QTA_STRMOM_DV.TAR_QTA_STMOM_DV "MICROSAR RTE" UWORD RTE_CM_STMOM_QTA_DV 0 0 -10 10 ECU_ADDRESS 0 SYMBOL_LINK "Rte_SrlComInput_SrlComSGTARQTASTRMOMDV_SG_TAR_QTA_STRMOM_DV.TAR_QTA_STMOM_DV" 0 DISPLAY_IDENTIFIER SrlComInput2.ReceiverPorts.SrlComSGTARQTASTRMOMDV.SG_TAR_QTA_STRMOM_DV.TAR_QTA_STMOM_DV /end MEASUREMENT
/begin MEASUREMENT SrlComInput2.SrlComSGTARSTMOMDVACT.SG_TAR_STMOM_DV_ACT.ALIV_TAR_STMOM_DV_ACT "MICROSAR RTE" UBYTE RTE_CM_ENUM_ALIV_COU_4 0 0 0 15 ECU_ADDRESS 0 SYMBOL_LINK "Rte_SrlComInput_SrlComSGTARSTMOMDVACT_SG_TAR_STMOM_DV_ACT.ALIV_TAR_STMOM_DV_ACT" 0 DISPLAY_IDENTIFIER SrlComInput2.ReceiverPorts.SrlComSGTARSTMOMDVACT.SG_TAR_STMOM_DV_ACT.ALIV_TAR_STMOM_DV_ACT /end MEASUREMENT
/begin MEASUREMENT SrlComInput2.SrlComSGTARSTMOMDVACT.SG_TAR_STMOM_DV_ACT.CRC_TAR_STMOM_DV_ACT "MICROSAR RTE" UBYTE RTE_CM_CRC8 0 0 0 255 ECU_ADDRESS 0 SYMBOL_LINK "Rte_SrlComInput_SrlComSGTARSTMOMDVACT_SG_TAR_STMOM_DV_ACT.CRC_TAR_STMOM_DV_ACT" 0 DISPLAY_IDENTIFIER SrlComInput2.ReceiverPorts.SrlComSGTARSTMOMDVACT.SG_TAR_STMOM_DV_ACT.CRC_TAR_STMOM_DV_ACT /end MEASUREMENT
/begin MEASUREMENT SrlComInput2.SrlComSGTARSTMOMDVACT.SG_TAR_STMOM_DV_ACT.FACT_DMPNG_ADDON_STMOM_FTAX "MICROSAR RTE" UBYTE RTE_CM_FACT_DMPNG_ADDON_STMOM_FTAX 0 0 0 3.984375 ECU_ADDRESS 0 SYMBOL_LINK "Rte_SrlComInput_SrlComSGTARSTMOMDVACT_SG_TAR_STMOM_DV_ACT.FACT_DMPNG_ADDON_STMOM_FTAX" 0 DISPLAY_IDENTIFIER SrlComInput2.ReceiverPorts.SrlComSGTARSTMOMDVACT.SG_TAR_STMOM_DV_ACT.FACT_DMPNG_ADDON_STMOM_FTAX /end MEASUREMENT
/begin MEASUREMENT SrlComInput2.SrlComSGTARSTMOMDVACT.SG_TAR_STMOM_DV_ACT.QU_TAR_DMPNG_ADDON_STMOM_FTAX "MICROSAR RTE" UBYTE RTE_CM_ENUM_QU_TAR_DMPNG_ADDON_STMOM_FTAX 0 0 0 15 ECU_ADDRESS 0 SYMBOL_LINK "Rte_SrlComInput_SrlComSGTARSTMOMDVACT_SG_TAR_STMOM_DV_ACT.QU_TAR_DMPNG_ADDON_STMOM_FTAX" 0 DISPLAY_IDENTIFIER SrlComInput2.ReceiverPorts.SrlComSGTARSTMOMDVACT.SG_TAR_STMOM_DV_ACT.QU_TAR_DMPNG_ADDON_STMOM_FTAX /end MEASUREMENT
/begin MEASUREMENT SrlComInput2.SrlComSGTARSTMOMDVACT.SG_TAR_STMOM_DV_ACT.QU_TAR_STMOM_DV_ACT "MICROSAR RTE" UBYTE RTE_CM_ENUM_QU_TAR_STMOM_DV_ACT 0 0 0 15 ECU_ADDRESS 0 SYMBOL_LINK "Rte_SrlComInput_SrlComSGTARSTMOMDVACT_SG_TAR_STMOM_DV_ACT.QU_TAR_STMOM_DV_ACT" 0 DISPLAY_IDENTIFIER SrlComInput2.ReceiverPorts.SrlComSGTARSTMOMDVACT.SG_TAR_STMOM_DV_ACT.QU_TAR_STMOM_DV_ACT /end MEASUREMENT
/begin MEASUREMENT SrlComInput2.SrlComSGTARSTMOMDVACT.SG_TAR_STMOM_DV_ACT.TAR_STMOM_DV_ACT "MICROSAR RTE" UWORD RTE_CM_TAR_STMOM_DV_ACT 0 0 -12 12 ECU_ADDRESS 0 SYMBOL_LINK "Rte_SrlComInput_SrlComSGTARSTMOMDVACT_SG_TAR_STMOM_DV_ACT.TAR_STMOM_DV_ACT" 0 DISPLAY_IDENTIFIER SrlComInput2.ReceiverPorts.SrlComSGTARSTMOMDVACT.SG_TAR_STMOM_DV_ACT.TAR_STMOM_DV_ACT /end MEASUREMENT
/begin MEASUREMENT SrlComInput2.SrlComSGVVEH.SG_V_VEH.ALIV_V_VEH "MICROSAR RTE" UBYTE RTE_CM_ENUM_ALIV_COU_V 0 0 0 15 ECU_ADDRESS 0 SYMBOL_LINK "Rte_SrlComInput_SrlComSGVVEH_SG_V_VEH.ALIV_V_VEH" 0 DISPLAY_IDENTIFIER SrlComInput2.ReceiverPorts.SrlComSGVVEH.SG_V_VEH.ALIV_V_VEH /end MEASUREMENT
/begin MEASUREMENT SrlComInput2.SrlComSGVVEH.SG_V_VEH.CRC_V_VEH "MICROSAR RTE" UBYTE RTE_CM_CRC_V_VEH 0 0 0 255 ECU_ADDRESS 0 SYMBOL_LINK "Rte_SrlComInput_SrlComSGVVEH_SG_V_VEH.CRC_V_VEH" 0 DISPLAY_IDENTIFIER SrlComInput2.ReceiverPorts.SrlComSGVVEH.SG_V_VEH.CRC_V_VEH /end MEASUREMENT
/begin MEASUREMENT SrlComInput2.SrlComSGVVEH.SG_V_VEH.DVCO_VEH "MICROSAR RTE" UBYTE RTE_CM_ENUM_DVCO_VEH 0 0 0 7 ECU_ADDRESS 0 SYMBOL_LINK "Rte_SrlComInput_SrlComSGVVEH_SG_V_VEH.DVCO_VEH" 0 DISPLAY_IDENTIFIER SrlComInput2.ReceiverPorts.SrlComSGVVEH.SG_V_VEH.DVCO_VEH /end MEASUREMENT
/begin MEASUREMENT SrlComInput2.SrlComSGVVEH.SG_V_VEH.QU_V_VEH_COG "MICROSAR RTE" UBYTE RTE_CM_ENUM_QU_V_VEH_COG 0 0 0 15 ECU_ADDRESS 0 SYMBOL_LINK "Rte_SrlComInput_SrlComSGVVEH_SG_V_VEH.QU_V_VEH_COG" 0 DISPLAY_IDENTIFIER SrlComInput2.ReceiverPorts.SrlComSGVVEH.SG_V_VEH.QU_V_VEH_COG /end MEASUREMENT
/begin MEASUREMENT SrlComInput2.SrlComSGVVEH.SG_V_VEH.ST_V_VEH_NSS "MICROSAR RTE" UBYTE RTE_CM_ENUM_ST_V_VEH_NSS 0 0 0 15 ECU_ADDRESS 0 SYMBOL_LINK "Rte_SrlComInput_SrlComSGVVEH_SG_V_VEH.ST_V_VEH_NSS" 0 DISPLAY_IDENTIFIER SrlComInput2.ReceiverPorts.SrlComSGVVEH.SG_V_VEH.ST_V_VEH_NSS /end MEASUREMENT
/begin MEASUREMENT SrlComInput2.SrlComSGVVEH.SG_V_VEH.V_VEH_0x27_0x01 "MICROSAR RTE" UBYTE RTE_CM_BOOLEAN 0 0 0 255 ECU_ADDRESS 0 SYMBOL_LINK "Rte_SrlComInput_SrlComSGVVEH_SG_V_VEH.V_VEH_0x27_0x01" 0 DISPLAY_IDENTIFIER SrlComInput2.ReceiverPorts.SrlComSGVVEH.SG_V_VEH.V_VEH_0x27_0x01 /end MEASUREMENT
/begin MEASUREMENT SrlComInput2.SrlComSGVVEH.SG_V_VEH.V_VEH_COG "MICROSAR RTE" UWORD RTE_CM_V_VEH_COG 0 0 0 350 ECU_ADDRESS 0 SYMBOL_LINK "Rte_SrlComInput_SrlComSGVVEH_SG_V_VEH.V_VEH_COG" 0 DISPLAY_IDENTIFIER SrlComInput2.ReceiverPorts.SrlComSGVVEH.SG_V_VEH.V_VEH_COG /end MEASUREMENT
/begin MEASUREMENT SrlComInput2.SrlComSvcDft.Cnt_b32 "MICROSAR RTE" ULONG NO_COMPU_METHOD 0 0 0 4294967295 ECU_ADDRESS 0 SYMBOL_LINK "Rte_CDDInterface9_SrlComSvcDft_Cnt_b32" 0 DISPLAY_IDENTIFIER SrlComInput2.ReceiverPorts.SrlComSvcDft.Cnt_b32 /end MEASUREMENT
/begin MEASUREMENT SrlComInput2.SrlComVehDrvCondition.Cnt_u08 "MICROSAR RTE" UBYTE RTE_CM_ENUM_DVCO_VEH 0 0 0 7 ECU_ADDRESS 0 SYMBOL_LINK "Rte_SrlComInput2_SrlComVehDrvCondition_Cnt_u08" 0 DISPLAY_IDENTIFIER SrlComInput2.SenderPorts.SrlComVehDrvCondition.Cnt_u08 /end MEASUREMENT
/begin MEASUREMENT SrlComInput2.SrlComVehLatAccel.MpSecSq_f32 "MICROSAR RTE" FLOAT32_IEEE NO_COMPU_METHOD 0 0 1.175494351e-38 3.402823466e+38 ECU_ADDRESS 0 SYMBOL_LINK "Rte_SrlComInput2_SrlComVehLatAccel_MpSecSq_f32" 0 DISPLAY_IDENTIFIER SrlComInput2.SenderPorts.SrlComVehLatAccel.MpSecSq_f32 /end MEASUREMENT
/begin MEASUREMENT SrlComInput2.SrlComVehLatAccelValid.Cnt_lgc "MICROSAR RTE" UBYTE RTE_CM_BOOLEAN 0 0 0 255 ECU_ADDRESS 0 SYMBOL_LINK "Rte_SrlComInput2_SrlComVehLatAccelValid_Cnt_lgc" 0 DISPLAY_IDENTIFIER SrlComInput2.SenderPorts.SrlComVehLatAccelValid.Cnt_lgc /end MEASUREMENT
/begin MEASUREMENT SrlComInput2.SrlComVehNearStandstill.Cnt_u08 "MICROSAR RTE" UBYTE RTE_CM_ENUM_ST_V_VEH_NSS 0 0 0 15 ECU_ADDRESS 0 SYMBOL_LINK "Rte_SrlComInput2_SrlComVehNearStandstill_Cnt_u08" 0 DISPLAY_IDENTIFIER SrlComInput2.SenderPorts.SrlComVehNearStandstill.Cnt_u08 /end MEASUREMENT
/begin MEASUREMENT SrlComInput2.SrlComVehSpd.Kph_f32 "MICROSAR RTE" FLOAT32_IEEE NO_COMPU_METHOD 0 0 1.175494351e-38 3.402823466e+38 ECU_ADDRESS 0 SYMBOL_LINK "Rte_SrlComInput2_SrlComVehSpd_Kph_f32" 0 DISPLAY_IDENTIFIER SrlComInput2.SenderPorts.SrlComVehSpd.Kph_f32 /end MEASUREMENT
/begin MEASUREMENT SrlComInput2.SrlComVehYawRate.DegpS_f32 "MICROSAR RTE" FLOAT32_IEEE NO_COMPU_METHOD 0 0 1.175494351e-38 3.402823466e+38 ECU_ADDRESS 0 SYMBOL_LINK "Rte_SrlComInput2_SrlComVehYawRate_DegpS_f32" 0 DISPLAY_IDENTIFIER SrlComInput2.SenderPorts.SrlComVehYawRate.DegpS_f32 /end MEASUREMENT
/begin MEASUREMENT SrlComInput2.SrlComVehYawRateValid.Cnt_lgc "MICROSAR RTE" UBYTE RTE_CM_BOOLEAN 0 0 0 255 ECU_ADDRESS 0 SYMBOL_LINK "Rte_SrlComInput2_SrlComVehYawRateValid_Cnt_lgc" 0 DISPLAY_IDENTIFIER SrlComInput2.SenderPorts.SrlComVehYawRateValid.Cnt_lgc /end MEASUREMENT
/begin MEASUREMENT SrlComInput2.SrlCom_QU_V_VEH_COG.Cnt_u08 "MICROSAR RTE" UBYTE RTE_CM_ENUM_QU_V_VEH_COG 0 0 0 15 ECU_ADDRESS 0 SYMBOL_LINK "Rte_SrlComInput2_SrlCom_QU_V_VEH_COG_Cnt_u08" 0 DISPLAY_IDENTIFIER SrlComInput2.SenderPorts.SrlCom_QU_V_VEH_COG.Cnt_u08 /end MEASUREMENT
/begin MEASUREMENT SrlComInput2.TJADampSclRqst.Uls_f32 "MICROSAR RTE" FLOAT32_IEEE NO_COMPU_METHOD 0 0 1.175494351e-38 3.402823466e+38 ECU_ADDRESS 0 SYMBOL_LINK "Rte_SrlComInput2_TJADampSclRqst_Uls_f32" 0 DISPLAY_IDENTIFIER SrlComInput2.SenderPorts.TJADampSclRqst.Uls_f32 /end MEASUREMENT
/begin MEASUREMENT SrlComInput2.VehSpdValid.Cnt_lgc "MICROSAR RTE" UBYTE RTE_CM_BOOLEAN 0 0 0 255 ECU_ADDRESS 0 SYMBOL_LINK "Rte_SrlComInput2_VehSpdValid_Cnt_lgc" 0 DISPLAY_IDENTIFIER SrlComInput2.SenderPorts.VehSpdValid.Cnt_lgc /end MEASUREMENT
/begin MEASUREMENT SrlComInput2.VehicleSpeed.Kph_f32 "MICROSAR RTE" FLOAT32_IEEE NO_COMPU_METHOD 0 0 1.175494351e-38 3.402823466e+38 ECU_ADDRESS 0 SYMBOL_LINK "Rte_SignlCondn_VehicleSpeed_Kph_f32" 0 DISPLAY_IDENTIFIER SrlComInput2.ReceiverPorts.VehicleSpeed.Kph_f32 /end MEASUREMENT
/begin MEASUREMENT SrlComOutput.AVLFORCGRDTxConf.Cnt_lgc "MICROSAR RTE" UBYTE RTE_CM_BOOLEAN 0 0 0 255 ECU_ADDRESS 0 SYMBOL_LINK "Rte_SrlComOutput_AVLFORCGRDTxConf_Cnt_lgc" 0 DISPLAY_IDENTIFIER SrlComOutput.SenderPorts.AVLFORCGRDTxConf.Cnt_lgc /end MEASUREMENT
/begin MEASUREMENT SrlComOutput.AVLSTMOMTxConf.Cnt_lgc "MICROSAR RTE" UBYTE RTE_CM_BOOLEAN 0 0 0 255 ECU_ADDRESS 0 SYMBOL_LINK "Rte_SrlComOutput_AVLSTMOMTxConf_Cnt_lgc" 0 DISPLAY_IDENTIFIER SrlComOutput.SenderPorts.AVLSTMOMTxConf.Cnt_lgc /end MEASUREMENT
/begin MEASUREMENT SrlComOutput.CtrlTempFinal.DegC_f32 "MICROSAR RTE" FLOAT32_IEEE NO_COMPU_METHOD 0 0 1.175494351e-38 3.402823466e+38 ECU_ADDRESS 0 SYMBOL_LINK "Rte_CtrlTemp_FiltMeasTemp_DegC_f32" 0 DISPLAY_IDENTIFIER SrlComOutput.ReceiverPorts.CtrlTempFinal.DegC_f32 /end MEASUREMENT
/begin MEASUREMENT SrlComOutput.CuTempEst.DegC_f32 "MICROSAR RTE" FLOAT32_IEEE NO_COMPU_METHOD 0 0 1.175494351e-38 3.402823466e+38 ECU_ADDRESS 0 SYMBOL_LINK "Rte_MtrTempEst_CuTempEst_DegC_f32" 0 DISPLAY_IDENTIFIER SrlComOutput.ReceiverPorts.CuTempEst.DegC_f32 /end MEASUREMENT
/begin MEASUREMENT SrlComOutput.EcuM_CurrentMode.currentMode "MICROSAR RTE" UBYTE RTE_CM_ENUM_EcuM_Mode 0 0 0 255 ECU_ADDRESS 0 SYMBOL_LINK "Rte_ModeMachine_EcuM_currentMode_currentMode" 0 DISPLAY_IDENTIFIER SrlComOutput.ModeRequirePorts.EcuM_CurrentMode.currentMode /end MEASUREMENT
/begin MEASUREMENT SrlComOutput.EpsOpTrq.MtrNm_f32 "MICROSAR RTE" FLOAT32_IEEE NO_COMPU_METHOD 0 0 1.175494351e-38 3.402823466e+38 ECU_ADDRESS 0 SYMBOL_LINK "Rte_CtrldDisShtdn_CntDisMtrTrqCmdMRF_MtrNm_f32" 0 DISPLAY_IDENTIFIER SrlComOutput.ReceiverPorts.EpsOpTrq.MtrNm_f32 /end MEASUREMENT
/begin MEASUREMENT SrlComOutput.EstBattCurr.Amp_f32 "MICROSAR RTE" FLOAT32_IEEE NO_COMPU_METHOD 0 0 1.175494351e-38 3.402823466e+38 ECU_ADDRESS 0 SYMBOL_LINK "Rte_ElecPwr_SupplyCur_Amp_f32" 0 DISPLAY_IDENTIFIER SrlComOutput.ReceiverPorts.EstBattCurr.Amp_f32 /end MEASUREMENT
/begin MEASUREMENT SrlComOutput.FinHwPos.HwDeg_f32 "MICROSAR RTE" FLOAT32_IEEE NO_COMPU_METHOD 0 0 1.175494351e-38 3.402823466e+38 ECU_ADDRESS 0 SYMBOL_LINK "Rte_AbsHwPos_SrlComHwPos_HwDeg_f32" 0 DISPLAY_IDENTIFIER SrlComOutput.ReceiverPorts.FinHwPos.HwDeg_f32 /end MEASUREMENT
/begin MEASUREMENT SrlComOutput.HwTrq.HwNm_f32 "MICROSAR RTE" FLOAT32_IEEE NO_COMPU_METHOD 0 0 1.175494351e-38 3.402823466e+38 ECU_ADDRESS 0 SYMBOL_LINK "Rte_Sweep_OutputHwTrq_HwNm_f32" 0 DISPLAY_IDENTIFIER SrlComOutput.ReceiverPorts.HwTrq.HwNm_f32 /end MEASUREMENT
/begin MEASUREMENT SrlComOutput.MagTempEst.DegC_f32 "MICROSAR RTE" FLOAT32_IEEE NO_COMPU_METHOD 0 0 1.175494351e-38 3.402823466e+38 ECU_ADDRESS 0 SYMBOL_LINK "Rte_MtrTempEst_MagTempEst_DegC_f32" 0 DISPLAY_IDENTIFIER SrlComOutput.ReceiverPorts.MagTempEst.DegC_f32 /end MEASUREMENT
/begin MEASUREMENT SrlComOutput.MtrCurrQax.Amp_f32 "MICROSAR RTE" FLOAT32_IEEE NO_COMPU_METHOD 0 0 1.175494351e-38 3.402823466e+38 ECU_ADDRESS 0 SYMBOL_LINK "Rte_MtrCurr_MtrCurrQax_Amp_f32" 0 DISPLAY_IDENTIFIER SrlComOutput.ReceiverPorts.MtrCurrQax.Amp_f32 /end MEASUREMENT
/begin MEASUREMENT SrlComOutput.MtrTrqCmd.MtrNm_f32 "MICROSAR RTE" FLOAT32_IEEE NO_COMPU_METHOD 0 0 1.175494351e-38 3.402823466e+38 ECU_ADDRESS 0 SYMBOL_LINK "Rte_AssistSumnLmt_PostLimitTorque_MtrNm_f32" 0 DISPLAY_IDENTIFIER SrlComOutput.ReceiverPorts.MtrTrqCmd.MtrNm_f32 /end MEASUREMENT
/begin MEASUREMENT SrlComOutput.MtrVel.MtrRadpS_f32 "MICROSAR RTE" FLOAT32_IEEE NO_COMPU_METHOD 0 0 1.175494351e-38 3.402823466e+38 ECU_ADDRESS 0 SYMBOL_LINK "Rte_MtrVel_MRFMotorVel_MtrRadpS_f32" 0 DISPLAY_IDENTIFIER SrlComOutput.ReceiverPorts.MtrVel.MtrRadpS_f32 /end MEASUREMENT
/begin MEASUREMENT SrlComOutput.SrlComAVLPOEPS.AVL_PO_EPS.ALIV_AVL_PO_EPS "MICROSAR RTE" UBYTE RTE_CM_ENUM_ALIV_COU_4 0 0 0 15 ECU_ADDRESS 0 SYMBOL_LINK "Rte_SrlComOutput2_SrlComAVLPOEPS_AVL_PO_EPS.ALIV_AVL_PO_EPS" 0 DISPLAY_IDENTIFIER SrlComOutput.ReceiverPorts.SrlComAVLPOEPS.AVL_PO_EPS.ALIV_AVL_PO_EPS /end MEASUREMENT
/begin MEASUREMENT SrlComOutput.SrlComAVLPOEPS.AVL_PO_EPS.AVL_PO_EPS "MICROSAR RTE" UWORD RTE_CM_AVL_PINA_EPS 0 0 -1439.9560546875 1439.9560546875 ECU_ADDRESS 0 SYMBOL_LINK "Rte_SrlComOutput2_SrlComAVLPOEPS_AVL_PO_EPS.AVL_PO_EPS" 0 DISPLAY_IDENTIFIER SrlComOutput.ReceiverPorts.SrlComAVLPOEPS.AVL_PO_EPS.AVL_PO_EPS /end MEASUREMENT
/begin MEASUREMENT SrlComOutput.SrlComAVLPOEPS.AVL_PO_EPS.AVL_PO_IDX_EPS "MICROSAR RTE" UWORD RTE_CM_AVL_PINA_IDX_ICM 0 0 -1439.9560546875 1439.9560546875 ECU_ADDRESS 0 SYMBOL_LINK "Rte_SrlComOutput2_SrlComAVLPOEPS_AVL_PO_EPS.AVL_PO_IDX_EPS" 0 DISPLAY_IDENTIFIER SrlComOutput.ReceiverPorts.SrlComAVLPOEPS.AVL_PO_EPS.AVL_PO_IDX_EPS /end MEASUREMENT
/begin MEASUREMENT SrlComOutput.SrlComAVLPOEPS.AVL_PO_EPS.CRC_AVL_PO_EPS "MICROSAR RTE" UBYTE RTE_CM_CRC8 0 0 0 255 ECU_ADDRESS 0 SYMBOL_LINK "Rte_SrlComOutput2_SrlComAVLPOEPS_AVL_PO_EPS.CRC_AVL_PO_EPS" 0 DISPLAY_IDENTIFIER SrlComOutput.ReceiverPorts.SrlComAVLPOEPS.AVL_PO_EPS.CRC_AVL_PO_EPS /end MEASUREMENT
/begin MEASUREMENT SrlComOutput.SrlComAVLPOEPS.AVL_PO_EPS.IDX_TORQ_SEN "MICROSAR RTE" UBYTE RTE_CM_ENUM_IDX_TORQ_SEN 0 0 0 3 ECU_ADDRESS 0 SYMBOL_LINK "Rte_SrlComOutput2_SrlComAVLPOEPS_AVL_PO_EPS.IDX_TORQ_SEN" 0 DISPLAY_IDENTIFIER SrlComOutput.ReceiverPorts.SrlComAVLPOEPS.AVL_PO_EPS.IDX_TORQ_SEN /end MEASUREMENT
/begin MEASUREMENT SrlComOutput.SrlComAVLPOEPS.AVL_PO_EPS.OFFS_GRD_MID_EPS "MICROSAR RTE" UWORD RTE_CM_OFFS_GRD_MID_EPS 0 0 -89.9560546875 89.9560546875 ECU_ADDRESS 0 SYMBOL_LINK "Rte_SrlComOutput2_SrlComAVLPOEPS_AVL_PO_EPS.OFFS_GRD_MID_EPS" 0 DISPLAY_IDENTIFIER SrlComOutput.ReceiverPorts.SrlComAVLPOEPS.AVL_PO_EPS.OFFS_GRD_MID_EPS /end MEASUREMENT
/begin MEASUREMENT SrlComOutput.SrlComAVLPOEPS.AVL_PO_EPS.QU_AVL_PO_EPS "MICROSAR RTE" UBYTE RTE_CM_ENUM_QU_AVL_PINA_EPS 0 0 0 15 ECU_ADDRESS 0 SYMBOL_LINK "Rte_SrlComOutput2_SrlComAVLPOEPS_AVL_PO_EPS.QU_AVL_PO_EPS" 0 DISPLAY_IDENTIFIER SrlComOutput.ReceiverPorts.SrlComAVLPOEPS.AVL_PO_EPS.QU_AVL_PO_EPS /end MEASUREMENT
/begin MEASUREMENT SrlComOutput.SrlComAVLPOEPS.AVL_PO_EPS.UN_PO_EPS "MICROSAR RTE" UBYTE RTE_CM_ENUM_UN_PO_EPS 0 0 0 3 ECU_ADDRESS 0 SYMBOL_LINK "Rte_SrlComOutput2_SrlComAVLPOEPS_AVL_PO_EPS.UN_PO_EPS" 0 DISPLAY_IDENTIFIER SrlComOutput.ReceiverPorts.SrlComAVLPOEPS.AVL_PO_EPS.UN_PO_EPS /end MEASUREMENT
/begin MEASUREMENT SrlComOutput.SrlComAVLSTMOM.AVL_FORC_GRD.ALIV_AVL_FORC_GRD "MICROSAR RTE" UBYTE RTE_CM_ENUM_ALIV_COU_4 0 0 0 15 ECU_ADDRESS 0 SYMBOL_LINK "Rte_SrlComOutput2_SrlComAVLSTMOM_AVL_FORC_GRD.ALIV_AVL_FORC_GRD" 0 DISPLAY_IDENTIFIER SrlComOutput.ReceiverPorts.SrlComAVLSTMOM.AVL_FORC_GRD.ALIV_AVL_FORC_GRD /end MEASUREMENT
/begin MEASUREMENT SrlComOutput.SrlComAVLSTMOM.AVL_FORC_GRD.AVL_FORC_GRD "MICROSAR RTE" UWORD RTE_CM_AVL_FORC_GRD 0 0 -17 17.0032 ECU_ADDRESS 0 SYMBOL_LINK "Rte_SrlComOutput2_SrlComAVLSTMOM_AVL_FORC_GRD.AVL_FORC_GRD" 0 DISPLAY_IDENTIFIER SrlComOutput.ReceiverPorts.SrlComAVLSTMOM.AVL_FORC_GRD.AVL_FORC_GRD /end MEASUREMENT
/begin MEASUREMENT SrlComOutput.SrlComAVLSTMOM.AVL_FORC_GRD.AVL_FORC_GRD_0x0C_0x04 "MICROSAR RTE" UBYTE NO_COMPU_METHOD 0 0 0 15 ECU_ADDRESS 0 SYMBOL_LINK "Rte_SrlComOutput2_SrlComAVLSTMOM_AVL_FORC_GRD.AVL_FORC_GRD_0x0C_0x04" 0 DISPLAY_IDENTIFIER SrlComOutput.ReceiverPorts.SrlComAVLSTMOM.AVL_FORC_GRD.AVL_FORC_GRD_0x0C_0x04 /end MEASUREMENT
/begin MEASUREMENT SrlComOutput.SrlComAVLSTMOM.AVL_FORC_GRD.AVL_PWR_EL_EPS_COOD "MICROSAR RTE" UBYTE RTE_CM_AVL_PWR_EL 0 0 -12 12 ECU_ADDRESS 0 SYMBOL_LINK "Rte_SrlComOutput2_SrlComAVLSTMOM_AVL_FORC_GRD.AVL_PWR_EL_EPS_COOD" 0 DISPLAY_IDENTIFIER SrlComOutput.ReceiverPorts.SrlComAVLSTMOM.AVL_FORC_GRD.AVL_PWR_EL_EPS_COOD /end MEASUREMENT
/begin MEASUREMENT SrlComOutput.SrlComAVLSTMOM.AVL_FORC_GRD.CRC_AVL_FORC_GRD "MICROSAR RTE" UBYTE RTE_CM_CRC8 0 0 0 255 ECU_ADDRESS 0 SYMBOL_LINK "Rte_SrlComOutput2_SrlComAVLSTMOM_AVL_FORC_GRD.CRC_AVL_FORC_GRD" 0 DISPLAY_IDENTIFIER SrlComOutput.ReceiverPorts.SrlComAVLSTMOM.AVL_FORC_GRD.CRC_AVL_FORC_GRD /end MEASUREMENT
/begin MEASUREMENT SrlComOutput.SrlComAVLSTMOM.AVL_FORC_GRD.QU_AVL_FORC_GRD "MICROSAR RTE" UBYTE RTE_CM_ENUM_QU_AVL_FORC_GRD 0 0 0 15 ECU_ADDRESS 0 SYMBOL_LINK "Rte_SrlComOutput2_SrlComAVLSTMOM_AVL_FORC_GRD.QU_AVL_FORC_GRD" 0 DISPLAY_IDENTIFIER SrlComOutput.ReceiverPorts.SrlComAVLSTMOM.AVL_FORC_GRD.QU_AVL_FORC_GRD /end MEASUREMENT
/begin MEASUREMENT SrlComOutput.SrlComAVLSTMOM.AVL_STMOM_DV_ACT.ALIV_AVL_STMOM_DV_ACT "MICROSAR RTE" UBYTE RTE_CM_ENUM_ALIV_COU_4 0 0 0 15 ECU_ADDRESS 0 SYMBOL_LINK "Rte_SrlComOutput2_SrlComAVLSTMOM_AVL_STMOM_DV_ACT.ALIV_AVL_STMOM_DV_ACT" 0 DISPLAY_IDENTIFIER SrlComOutput.ReceiverPorts.SrlComAVLSTMOM.AVL_STMOM_DV_ACT.ALIV_AVL_STMOM_DV_ACT /end MEASUREMENT
/begin MEASUREMENT SrlComOutput.SrlComAVLSTMOM.AVL_STMOM_DV_ACT.AVL_STMOM_DV_ACT "MICROSAR RTE" UWORD RTE_CM_STMOM_QTA_DV 0 0 -10 10 ECU_ADDRESS 0 SYMBOL_LINK "Rte_SrlComOutput2_SrlComAVLSTMOM_AVL_STMOM_DV_ACT.AVL_STMOM_DV_ACT" 0 DISPLAY_IDENTIFIER SrlComOutput.ReceiverPorts.SrlComAVLSTMOM.AVL_STMOM_DV_ACT.AVL_STMOM_DV_ACT /end MEASUREMENT
/begin MEASUREMENT SrlComOutput.SrlComAVLSTMOM.AVL_STMOM_DV_ACT.AVL_STMOM_DV_ACT_0x0C_0x04 "MICROSAR RTE" UBYTE NO_COMPU_METHOD 0 0 0 15 ECU_ADDRESS 0 SYMBOL_LINK "Rte_SrlComOutput2_SrlComAVLSTMOM_AVL_STMOM_DV_ACT.AVL_STMOM_DV_ACT_0x0C_0x04" 0 DISPLAY_IDENTIFIER SrlComOutput.ReceiverPorts.SrlComAVLSTMOM.AVL_STMOM_DV_ACT.AVL_STMOM_DV_ACT_0x0C_0x04 /end MEASUREMENT
/begin MEASUREMENT SrlComOutput.SrlComAVLSTMOM.AVL_STMOM_DV_ACT.CRC_AVL_STMOM_DV_ACT "MICROSAR RTE" UBYTE RTE_CM_CRC8 0 0 0 255 ECU_ADDRESS 0 SYMBOL_LINK "Rte_SrlComOutput2_SrlComAVLSTMOM_AVL_STMOM_DV_ACT.CRC_AVL_STMOM_DV_ACT" 0 DISPLAY_IDENTIFIER SrlComOutput.ReceiverPorts.SrlComAVLSTMOM.AVL_STMOM_DV_ACT.CRC_AVL_STMOM_DV_ACT /end MEASUREMENT
/begin MEASUREMENT SrlComOutput.SrlComAVLSTMOM.AVL_STMOM_DV_ACT.QU_AVL_STMOM_DV_ACT "MICROSAR RTE" UBYTE RTE_CM_ENUM_QU_AVL_STMOM_DV_ACT 0 0 0 15 ECU_ADDRESS 0 SYMBOL_LINK "Rte_SrlComOutput2_SrlComAVLSTMOM_AVL_STMOM_DV_ACT.QU_AVL_STMOM_DV_ACT" 0 DISPLAY_IDENTIFIER SrlComOutput.ReceiverPorts.SrlComAVLSTMOM.AVL_STMOM_DV_ACT.QU_AVL_STMOM_DV_ACT /end MEASUREMENT
/begin MEASUREMENT SrlComOutput.SrlComSTEST.ST_EST.ALIV_ST_EST_FTAX "MICROSAR RTE" UBYTE RTE_CM_ENUM_ALIV_COU_4 0 0 0 15 ECU_ADDRESS 0 SYMBOL_LINK "Rte_SrlComOutput2_SrlComSTEST_ST_EST.ALIV_ST_EST_FTAX" 0 DISPLAY_IDENTIFIER SrlComOutput.ReceiverPorts.SrlComSTEST.ST_EST.ALIV_ST_EST_FTAX /end MEASUREMENT
/begin MEASUREMENT SrlComOutput.SrlComSTEST.ST_EST.CRC_ST_EST_FTAX "MICROSAR RTE" UBYTE RTE_CM_CRC8 0 0 0 255 ECU_ADDRESS 0 SYMBOL_LINK "Rte_SrlComOutput2_SrlComSTEST_ST_EST.CRC_ST_EST_FTAX" 0 DISPLAY_IDENTIFIER SrlComOutput.ReceiverPorts.SrlComSTEST.ST_EST.CRC_ST_EST_FTAX /end MEASUREMENT
/begin MEASUREMENT SrlComOutput.SrlComSTEST.ST_EST.QU_FN_EST "MICROSAR RTE" UBYTE RTE_CM_ENUM_QU_FN_EST 0 0 0 255 ECU_ADDRESS 0 SYMBOL_LINK "Rte_SrlComOutput2_SrlComSTEST_ST_EST.QU_FN_EST" 0 DISPLAY_IDENTIFIER SrlComOutput.ReceiverPorts.SrlComSTEST.ST_EST.QU_FN_EST /end MEASUREMENT
/begin MEASUREMENT SrlComOutput.SrlComSTEST.ST_EST.QU_FN_VIB_EPS "MICROSAR RTE" UBYTE RTE_CM_ENUM_New_Coding_50 0 0 0 15 ECU_ADDRESS 0 SYMBOL_LINK "Rte_SrlComOutput2_SrlComSTEST_ST_EST.QU_FN_VIB_EPS" 0 DISPLAY_IDENTIFIER SrlComOutput.ReceiverPorts.SrlComSTEST.ST_EST.QU_FN_VIB_EPS /end MEASUREMENT
/begin MEASUREMENT SrlComOutput.SrlComSTEST.ST_EST.QU_SER_STMOM_DV_ACT "MICROSAR RTE" UBYTE RTE_CM_ENUM_QU_SER_STMOM_STMOM_DV_ACT 0 0 0 255 ECU_ADDRESS 0 SYMBOL_LINK "Rte_SrlComOutput2_SrlComSTEST_ST_EST.QU_SER_STMOM_DV_ACT" 0 DISPLAY_IDENTIFIER SrlComOutput.ReceiverPorts.SrlComSTEST.ST_EST.QU_SER_STMOM_DV_ACT /end MEASUREMENT
/begin MEASUREMENT SrlComOutput.SrlComSTEST.ST_EST.ST_EST_0x10_0x08 "MICROSAR RTE" UBYTE NO_COMPU_METHOD 0 0 0 255 ECU_ADDRESS 0 SYMBOL_LINK "Rte_SrlComOutput2_SrlComSTEST_ST_EST.ST_EST_0x10_0x08" 0 DISPLAY_IDENTIFIER SrlComOutput.ReceiverPorts.SrlComSTEST.ST_EST.ST_EST_0x10_0x08 /end MEASUREMENT
/begin MEASUREMENT SrlComOutput.SrlComSUEPS.SU_EPS.ALIV_SU_EPS "MICROSAR RTE" UBYTE RTE_CM_New_Coding_51 0 0 0 14 ECU_ADDRESS 0 SYMBOL_LINK "Rte_SrlComOutput2_SrlComSUEPS_SU_EPS.ALIV_SU_EPS" 0 DISPLAY_IDENTIFIER SrlComOutput.ReceiverPorts.SrlComSUEPS.SU_EPS.ALIV_SU_EPS /end MEASUREMENT
/begin MEASUREMENT SrlComOutput.SrlComSUEPS.SU_EPS.CRC_SU_EPS "MICROSAR RTE" UBYTE RTE_CM_New_Coding_52 0 0 0 255 ECU_ADDRESS 0 SYMBOL_LINK "Rte_SrlComOutput2_SrlComSUEPS_SU_EPS.CRC_SU_EPS" 0 DISPLAY_IDENTIFIER SrlComOutput.ReceiverPorts.SrlComSUEPS.SU_EPS.CRC_SU_EPS /end MEASUREMENT
/begin MEASUREMENT SrlComOutput.SrlComSUEPS.SU_EPS.SU_EPS_0x0E_0x20 "MICROSAR RTE" ULONG NO_COMPU_METHOD 0 0 0 4294967295 ECU_ADDRESS 0 SYMBOL_LINK "Rte_SrlComOutput2_SrlComSUEPS_SU_EPS.SU_EPS_0x0E_0x20" 0 DISPLAY_IDENTIFIER SrlComOutput.ReceiverPorts.SrlComSUEPS.SU_EPS.SU_EPS_0x0E_0x20 /end MEASUREMENT
/begin MEASUREMENT SrlComOutput.SrlComSUEPS.SU_EPS.SU_EPS_0x2E_0x06 "MICROSAR RTE" UBYTE NO_COMPU_METHOD 0 0 0 63 ECU_ADDRESS 0 SYMBOL_LINK "Rte_SrlComOutput2_SrlComSUEPS_SU_EPS.SU_EPS_0x2E_0x06" 0 DISPLAY_IDENTIFIER SrlComOutput.ReceiverPorts.SrlComSUEPS.SU_EPS.SU_EPS_0x2E_0x06 /end MEASUREMENT
/begin MEASUREMENT SrlComOutput.SrlComSUEPS.SU_EPS.TOT_STR_EPS "MICROSAR RTE" UWORD RTE_CM_TOT_STR_EPS 0 0 0 50.000022 ECU_ADDRESS 0 SYMBOL_LINK "Rte_SrlComOutput2_SrlComSUEPS_SU_EPS.TOT_STR_EPS" 0 DISPLAY_IDENTIFIER SrlComOutput.ReceiverPorts.SrlComSUEPS.SU_EPS.TOT_STR_EPS /end MEASUREMENT
/begin MEASUREMENT SrlComOutput.SrlComSUEPS.SU_EPS.UN_TOT_STR_EPS "MICROSAR RTE" UBYTE RTE_CM_ENUM_UN_TOT_STR_EPS 0 0 0 3 ECU_ADDRESS 0 SYMBOL_LINK "Rte_SrlComOutput2_SrlComSUEPS_SU_EPS.UN_TOT_STR_EPS" 0 DISPLAY_IDENTIFIER SrlComOutput.ReceiverPorts.SrlComSUEPS.SU_EPS.UN_TOT_STR_EPS /end MEASUREMENT
/begin MEASUREMENT SrlComOutput.SystemState.Mode "MICROSAR RTE" UBYTE RTE_CM_ENUM_StaMd_Mode 0 0 0 255 ECU_ADDRESS 0 SYMBOL_LINK "Rte_ModeMachine_StaMd9_SystemState9_Mode" 0 DISPLAY_IDENTIFIER SrlComOutput.ModeRequirePorts.SystemState.Mode /end MEASUREMENT
/begin MEASUREMENT SrlComOutput.T1ADC.Volt_f32 "This signal is intended to communicate any type voltage signal measured by the ecu.  This signal has a lower limit of 0 which reequires users of the signal to provide divide by 0 protection if it is used as a denominator in a calculation.  See Vecu port p" FLOAT32_IEEE NO_COMPU_METHOD 0 0 1.175494351e-38 3.402823466e+38 ECU_ADDRESS 0 SYMBOL_LINK "Rte_IoHwAb7_T1ADC_Volt_f32" 0 DISPLAY_IDENTIFIER SrlComOutput.ReceiverPorts.T1ADC.Volt_f32 /end MEASUREMENT
/begin MEASUREMENT SrlComOutput.T2ADC.Volt_f32 "This signal is intended to communicate any type voltage signal measured by the ecu.  This signal has a lower limit of 0 which reequires users of the signal to provide divide by 0 protection if it is used as a denominator in a calculation.  See Vecu port p" FLOAT32_IEEE NO_COMPU_METHOD 0 0 1.175494351e-38 3.402823466e+38 ECU_ADDRESS 0 SYMBOL_LINK "Rte_IoHwAb7_T2ADC_Volt_f32" 0 DISPLAY_IDENTIFIER SrlComOutput.ReceiverPorts.T2ADC.Volt_f32 /end MEASUREMENT
/begin MEASUREMENT SrlComOutput.ThermLimitPerc.Uls_f32 "MICROSAR RTE" FLOAT32_IEEE NO_COMPU_METHOD 0 0 1.175494351e-38 3.402823466e+38 ECU_ADDRESS 0 SYMBOL_LINK "Rte_ThrmlDutyCycle_ThermLimitPerc_Uls_f32" 0 DISPLAY_IDENTIFIER SrlComOutput.ReceiverPorts.ThermLimitPerc.Uls_f32 /end MEASUREMENT
/begin MEASUREMENT SrlComOutput.TxDebugMsgEn.Cnt_lgc "MICROSAR RTE" UBYTE RTE_CM_BOOLEAN 0 0 0 255 ECU_ADDRESS 0 SYMBOL_LINK "Rte_VehCfg_TxDebugMsgEn_Cnt_lgc" 0 DISPLAY_IDENTIFIER SrlComOutput.ReceiverPorts.TxDebugMsgEn.Cnt_lgc /end MEASUREMENT
/begin MEASUREMENT SrlComOutput.Vecu.Volt_f32 "This port prototype is inteded to communicate voltage signals that represent the ecu supplied voltage.  This signal has a lower limit, which is non-zero, to allow users of the signal to use it as a denominator in an expression without requiring a divide b" FLOAT32_IEEE NO_COMPU_METHOD 0 0 1.175494351e-38 3.402823466e+38 ECU_ADDRESS 0 SYMBOL_LINK "Rte_BatteryVoltage_Vecu_Volt_f32" 0 DISPLAY_IDENTIFIER SrlComOutput.ReceiverPorts.Vecu.Volt_f32 /end MEASUREMENT
/begin MEASUREMENT SrlComOutput2.AVLFORCGRDTxConf.Cnt_lgc "MICROSAR RTE" UBYTE RTE_CM_BOOLEAN 0 0 0 255 ECU_ADDRESS 0 SYMBOL_LINK "Rte_SrlComOutput_AVLFORCGRDTxConf_Cnt_lgc" 0 DISPLAY_IDENTIFIER SrlComOutput2.ReceiverPorts.AVLFORCGRDTxConf.Cnt_lgc /end MEASUREMENT
/begin MEASUREMENT SrlComOutput2.AVLSTMOMTxConf.Cnt_lgc "MICROSAR RTE" UBYTE RTE_CM_BOOLEAN 0 0 0 255 ECU_ADDRESS 0 SYMBOL_LINK "Rte_SrlComOutput_AVLSTMOMTxConf_Cnt_lgc" 0 DISPLAY_IDENTIFIER SrlComOutput2.ReceiverPorts.AVLSTMOMTxConf.Cnt_lgc /end MEASUREMENT
/begin MEASUREMENT SrlComOutput2.CADASMSG.Cnt_lgc "MICROSAR RTE" UBYTE RTE_CM_BOOLEAN 0 0 0 255 ECU_ADDRESS 0 SYMBOL_LINK "Rte_VehCfg_CADASIF_Cnt_lgc" 0 DISPLAY_IDENTIFIER SrlComOutput2.ReceiverPorts.CADASMSG.Cnt_lgc /end MEASUREMENT
/begin MEASUREMENT SrlComOutput2.CDISPCCEPS.Cnt_u08 "MICROSAR RTE" UBYTE NO_COMPU_METHOD 0 0 0 255 ECU_ADDRESS 0 SYMBOL_LINK "Rte_VehCfg_CDISPCCDRDY02_Cnt_u08" 0 DISPLAY_IDENTIFIER SrlComOutput2.ReceiverPorts.CDISPCCEPS.Cnt_u08 /end MEASUREMENT
/begin GROUP PwrLmtFunc.AssistPowerLimit.MtrNm_f32 "MICROSAR RTE" /begin SUB_GROUP /end SUB_GROUP /begin FUNCTION_LIST /end FUNCTION_LIST /begin REF_CHARACTERISTIC /end REF_CHARACTERISTIC /begin REF_MEASUREMENT PwrLmtFunc.AssistPowerLimit.MtrNm_f32 /end REF_MEASUREMENT /end GROUP
/begin GROUP PwrLmtFunc.CCLMSAActive.Cnt_lgc "MICROSAR RTE" /begin SUB_GROUP /end SUB_GROUP /begin FUNCTION_LIST /end FUNCTION_LIST /begin REF_CHARACTERISTIC /end REF_CHARACTERISTIC /begin REF_MEASUREMENT PwrLmtFunc.CCLMSAActive.Cnt_lgc /end REF_MEASUREMENT /end GROUP
/begin GROUP PwrLmtFunc.CustCurrLmt.Amp_f32 "MICROSAR RTE" /begin SUB_GROUP /end SUB_GROUP /begin FUNCTION_LIST /end FUNCTION_LIST /begin REF_CHARACTERISTIC /end REF_CHARACTERISTIC /begin REF_MEASUREMENT PwrLmtFunc.CustCurrLmt.Amp_f32 /end REF_MEASUREMENT /end GROUP
/begin GROUP PwrLmtFunc.KeEstimate.VpRadpS_f32 "MICROSAR RTE" /begin SUB_GROUP /end SUB_GROUP /begin FUNCTION_LIST /end FUNCTION_LIST /begin REF_CHARACTERISTIC /end REF_CHARACTERISTIC /begin REF_MEASUREMENT PwrLmtFunc.KeEstimate.VpRadpS_f32 /end REF_MEASUREMENT /end GROUP
/begin GROUP PwrLmtFunc.ModeRequirePorts "MICROSAR RTE" /begin SUB_GROUP PwrLmtFunc.SystemState.Mode /end SUB_GROUP /begin FUNCTION_LIST /end FUNCTION_LIST /begin REF_CHARACTERISTIC /end REF_CHARACTERISTIC /begin REF_MEASUREMENT /end REF_MEASUREMENT /end GROUP
/begin GROUP PwrLmtFunc.MotorVelocityMRF.MtrRadpS_f32 "MICROSAR RTE" /begin SUB_GROUP /end SUB_GROUP /begin FUNCTION_LIST /end FUNCTION_LIST /begin REF_CHARACTERISTIC /end REF_CHARACTERISTIC /begin REF_MEASUREMENT PwrLmtFunc.MotorVelocityMRF.MtrRadpS_f32 /end REF_MEASUREMENT /end GROUP
/begin GROUP PwrLmtFunc.MtrEnvSpd.MtrRadpS_f32 "MICROSAR RTE" /begin SUB_GROUP /end SUB_GROUP /begin FUNCTION_LIST /end FUNCTION_LIST /begin REF_CHARACTERISTIC /end REF_CHARACTERISTIC /begin REF_MEASUREMENT PwrLmtFunc.MtrEnvSpd.MtrRadpS_f32 /end REF_MEASUREMENT /end GROUP
/begin GROUP PwrLmtFunc.PosServEnable.Cnt_lgc "MICROSAR RTE" /begin SUB_GROUP /end SUB_GROUP /begin FUNCTION_LIST /end FUNCTION_LIST /begin REF_CHARACTERISTIC /end REF_CHARACTERISTIC /begin REF_MEASUREMENT PwrLmtFunc.PosServEnable.Cnt_lgc /end REF_MEASUREMENT /end GROUP
/begin GROUP PwrLmtFunc.PowerLimitPerc.Uls_f32 "MICROSAR RTE" /begin SUB_GROUP /end SUB_GROUP /begin FUNCTION_LIST /end FUNCTION_LIST /begin REF_CHARACTERISTIC /end REF_CHARACTERISTIC /begin REF_MEASUREMENT PwrLmtFunc.PowerLimitPerc.Uls_f32 /end REF_MEASUREMENT /end GROUP
/begin GROUP PwrLmtFunc.PreLimitForPwr.MtrNm_f32 "MICROSAR RTE" /begin SUB_GROUP /end SUB_GROUP /begin FUNCTION_LIST /end FUNCTION_LIST /begin REF_CHARACTERISTIC /end REF_CHARACTERISTIC /begin REF_MEASUREMENT PwrLmtFunc.PreLimitForPwr.MtrNm_f32 /end REF_MEASUREMENT /end GROUP
/begin GROUP PwrLmtFunc.ReceiverPorts "MICROSAR RTE"
 /begin SUB_GROUP PwrLmtFunc.CCLMSAActive.Cnt_lgc PwrLmtFunc.CustCurrLmt.Amp_f32 PwrLmtFunc.KeEstimate.VpRadpS_f32 PwrLmtFunc.MotorVelocityMRF.MtrRadpS_f32 PwrLmtFunc.PosServEnable.Cnt_lgc PwrLmtFunc.PreLimitForPwr.MtrNm_f32 PwrLmtFunc.Vecu.Volt_f32 /end SUB_GROUP
 /begin FUNCTION_LIST /end FUNCTION_LIST
 /begin REF_CHARACTERISTIC /end REF_CHARACTERISTIC
 /begin REF_MEASUREMENT /end REF_MEASUREMENT
/end GROUP
/begin GROUP PwrLmtFunc.SenderPorts "MICROSAR RTE"
 /begin SUB_GROUP PwrLmtFunc.AssistPowerLimit.MtrNm_f32 PwrLmtFunc.MtrEnvSpd.MtrRadpS_f32 PwrLmtFunc.PowerLimitPerc.Uls_f32 /end SUB_GROUP
 /begin FUNCTION_LIST /end FUNCTION_LIST
 /begin REF_CHARACTERISTIC /end REF_CHARACTERISTIC
 /begin REF_MEASUREMENT /end REF_MEASUREMENT
/end GROUP
/begin GROUP PwrLmtFunc.SystemState.Mode "MICROSAR RTE" /begin SUB_GROUP /end SUB_GROUP /begin FUNCTION_LIST /end FUNCTION_LIST /begin REF_CHARACTERISTIC /end REF_CHARACTERISTIC /begin REF_MEASUREMENT PwrLmtFunc.SystemState.Mode /end REF_MEASUREMENT /end GROUP
/begin GROUP PwrLmtFunc.Vecu.Volt_f32 "MICROSAR RTE" /begin SUB_GROUP /end SUB_GROUP /begin FUNCTION_LIST /end FUNCTION_LIST /begin REF_CHARACTERISTIC /end REF_CHARACTERISTIC /begin REF_MEASUREMENT PwrLmtFunc.Vecu.Volt_f32 /end REF_MEASUREMENT /end GROUP
/begin GROUP QuadDet "MICROSAR RTE" /begin SUB_GROUP QuadDet.ReceiverPorts QuadDet.SenderPorts /end SUB_GROUP /begin FUNCTION_LIST /end FUNCTION_LIST /begin REF_CHARACTERISTIC /end REF_CHARACTERISTIC /begin REF_MEASUREMENT /end REF_MEASUREMENT /end GROUP
/begin GROUP QuadDet.InstMtrDir.Cnt_s08 "MICROSAR RTE" /begin SUB_GROUP /end SUB_GROUP /begin FUNCTION_LIST /end FUNCTION_LIST /begin REF_CHARACTERISTIC /end REF_CHARACTERISTIC /begin REF_MEASUREMENT QuadDet.InstMtrDir.Cnt_s08 /end REF_MEASUREMENT /end GROUP
/begin GROUP QuadDet.MRFCumMtrPos.Deg_f32 "MICROSAR RTE" /begin SUB_GROUP /end SUB_GROUP /begin FUNCTION_LIST /end FUNCTION_LIST /begin REF_CHARACTERISTIC /end REF_CHARACTERISTIC /begin REF_MEASUREMENT QuadDet.MRFCumMtrPos.Deg_f32 /end REF_MEASUREMENT /end GROUP
/begin GROUP QuadDet.MRFMtrTrqCmdScl.MtrNm_f32 "MICROSAR RTE" /begin SUB_GROUP /end SUB_GROUP /begin FUNCTION_LIST /end FUNCTION_LIST /begin REF_CHARACTERISTIC /end REF_CHARACTERISTIC /begin REF_MEASUREMENT QuadDet.MRFMtrTrqCmdScl.MtrNm_f32 /end REF_MEASUREMENT /end GROUP
/begin GROUP QuadDet.MRFMtrVel.MtrRadpS_f32 "MICROSAR RTE" /begin SUB_GROUP /end SUB_GROUP /begin FUNCTION_LIST /end FUNCTION_LIST /begin REF_CHARACTERISTIC /end REF_CHARACTERISTIC /begin REF_MEASUREMENT QuadDet.MRFMtrVel.MtrRadpS_f32 /end REF_MEASUREMENT /end GROUP
/begin GROUP QuadDet.MtrQuad.Cnt_u08 "MICROSAR RTE" /begin SUB_GROUP /end SUB_GROUP /begin FUNCTION_LIST /end FUNCTION_LIST /begin REF_CHARACTERISTIC /end REF_CHARACTERISTIC /begin REF_MEASUREMENT QuadDet.MtrQuad.Cnt_u08 /end REF_MEASUREMENT /end GROUP
/begin GROUP QuadDet.ReceiverPorts "MICROSAR RTE"
 /begin SUB_GROUP QuadDet.MRFCumMtrPos.Deg_f32 QuadDet.MRFMtrTrqCmdScl.MtrNm_f32 QuadDet.MRFMtrVel.MtrRadpS_f32 /end SUB_GROUP
 /begin FUNCTION_LIST /end FUNCTION_LIST
 /begin REF_CHARACTERISTIC /end REF_CHARACTERISTIC
 /begin REF_MEASUREMENT /end REF_MEASUREMENT
/end GROUP
/begin GROUP QuadDet.SenderPorts "MICROSAR RTE" /begin SUB_GROUP QuadDet.InstMtrDir.Cnt_s08 QuadDet.MtrQuad.Cnt_u08 /end SUB_GROUP /begin FUNCTION_LIST /end FUNCTION_LIST /begin REF_CHARACTERISTIC /end REF_CHARACTERISTIC /begin REF_MEASUREMENT /end REF_MEASUREMENT /end GROUP
/begin GROUP RTE "MICROSAR RTE" /begin SUB_GROUP SWCs /end SUB_GROUP /begin FUNCTION_LIST /end FUNCTION_LIST /begin REF_CHARACTERISTIC /end REF_CHARACTERISTIC /begin REF_MEASUREMENT /end REF_MEASUREMENT /end GROUP
/begin GROUP RackLoad "MICROSAR RTE" /begin SUB_GROUP RackLoad.ReceiverPorts /end SUB_GROUP /begin FUNCTION_LIST /end FUNCTION_LIST /begin REF_CHARACTERISTIC /end REF_CHARACTERISTIC /begin REF_MEASUREMENT /end REF_MEASUREMENT /end GROUP
/begin GROUP RackLoad.CRFMtrTrqCmd.MtrNm_f32 "MICROSAR RTE" /begin SUB_GROUP /end SUB_GROUP /begin FUNCTION_LIST /end FUNCTION_LIST /begin REF_CHARACTERISTIC /end REF_CHARACTERISTIC /begin REF_MEASUREMENT RackLoad.CRFMtrTrqCmd.MtrNm_f32 /end REF_MEASUREMENT /end GROUP
/begin GROUP RackLoad.CRFMtrVel.MtrRadpS_f32 "MICROSAR RTE" /begin SUB_GROUP /end SUB_GROUP /begin FUNCTION_LIST /end FUNCTION_LIST /begin REF_CHARACTERISTIC /end REF_CHARACTERISTIC /begin REF_MEASUREMENT RackLoad.CRFMtrVel.MtrRadpS_f32 /end REF_MEASUREMENT /end GROUP
/begin GROUP RackLoad.HwPos.HwDeg_f32 "MICROSAR RTE" /begin SUB_GROUP /end SUB_GROUP /begin FUNCTION_LIST /end FUNCTION_LIST /begin REF_CHARACTERISTIC /end REF_CHARACTERISTIC /begin REF_MEASUREMENT RackLoad.HwPos.HwDeg_f32 /end REF_MEASUREMENT /end GROUP
/begin GROUP RackLoad.HwPosAuth.Uls_f32 "MICROSAR RTE" /begin SUB_GROUP /end SUB_GROUP /begin FUNCTION_LIST /end FUNCTION_LIST /begin REF_CHARACTERISTIC /end REF_CHARACTERISTIC /begin REF_MEASUREMENT RackLoad.HwPosAuth.Uls_f32 /end REF_MEASUREMENT /end GROUP
/begin GROUP RackLoad.HwTrq.HwNm_f32 "MICROSAR RTE" /begin SUB_GROUP /end SUB_GROUP /begin FUNCTION_LIST /end FUNCTION_LIST /begin REF_CHARACTERISTIC /end REF_CHARACTERISTIC /begin REF_MEASUREMENT RackLoad.HwTrq.HwNm_f32 /end REF_MEASUREMENT /end GROUP
/begin GROUP RackLoad.ReceiverPorts "MICROSAR RTE"
 /begin SUB_GROUP RackLoad.CRFMtrTrqCmd.MtrNm_f32 RackLoad.CRFMtrVel.MtrRadpS_f32 RackLoad.HwPos.HwDeg_f32 RackLoad.HwPosAuth.Uls_f32 RackLoad.HwTrq.HwNm_f32 /end SUB_GROUP
 /begin FUNCTION_LIST /end FUNCTION_LIST
 /begin REF_CHARACTERISTIC /end REF_CHARACTERISTIC
 /begin REF_MEASUREMENT /end REF_MEASUREMENT
/end GROUP
/begin GROUP Return "MICROSAR RTE" /begin SUB_GROUP Return.ReceiverPorts Return.SenderPorts /end SUB_GROUP /begin FUNCTION_LIST /end FUNCTION_LIST /begin REF_CHARACTERISTIC /end REF_CHARACTERISTIC /begin REF_MEASUREMENT /end REF_MEASUREMENT /end GROUP
/begin GROUP Return.AssistMechTempEst.DegC_f32 "MICROSAR RTE" /begin SUB_GROUP /end SUB_GROUP /begin FUNCTION_LIST /end FUNCTION_LIST /begin REF_CHARACTERISTIC /end REF_CHARACTERISTIC /begin REF_MEASUREMENT Return.AssistMechTempEst.DegC_f32 /end REF_MEASUREMENT /end GROUP
/begin GROUP Return.DiagStsHwPosDis.Cnt_lgc "MICROSAR RTE" /begin SUB_GROUP /end SUB_GROUP /begin FUNCTION_LIST /end FUNCTION_LIST /begin REF_CHARACTERISTIC /end REF_CHARACTERISTIC /begin REF_MEASUREMENT Return.DiagStsHwPosDis.Cnt_lgc /end REF_MEASUREMENT /end GROUP
/begin GROUP Return.HandwheelAuthority.Uls_f32 "MICROSAR RTE" /begin SUB_GROUP /end SUB_GROUP /begin FUNCTION_LIST /end FUNCTION_LIST /begin REF_CHARACTERISTIC /end REF_CHARACTERISTIC /begin REF_MEASUREMENT Return.HandwheelAuthority.Uls_f32 /end REF_MEASUREMENT /end GROUP
/begin GROUP Return.HandwheelPosition.HwDeg_f32 "MICROSAR RTE" /begin SUB_GROUP /end SUB_GROUP /begin FUNCTION_LIST /end FUNCTION_LIST /begin REF_CHARACTERISTIC /end REF_CHARACTERISTIC /begin REF_MEASUREMENT Return.HandwheelPosition.HwDeg_f32 /end REF_MEASUREMENT /end GROUP
/begin GROUP Return.HandwheelVel.HwRadpS_f32 "MICROSAR RTE" /begin SUB_GROUP /end SUB_GROUP /begin FUNCTION_LIST /end FUNCTION_LIST /begin REF_CHARACTERISTIC /end REF_CHARACTERISTIC /begin REF_MEASUREMENT Return.HandwheelVel.HwRadpS_f32 /end REF_MEASUREMENT /end GROUP
/begin GROUP Return.HwTorque.HwNm_f32 "MICROSAR RTE" /begin SUB_GROUP /end SUB_GROUP /begin FUNCTION_LIST /end FUNCTION_LIST /begin REF_CHARACTERISTIC /end REF_CHARACTERISTIC /begin REF_MEASUREMENT Return.HwTorque.HwNm_f32 /end REF_MEASUREMENT /end GROUP
/begin GROUP Return.PAReturnSclFct.Uls_f32 "MICROSAR RTE" /begin SUB_GROUP /end SUB_GROUP /begin FUNCTION_LIST /end FUNCTION_LIST /begin REF_CHARACTERISTIC /end REF_CHARACTERISTIC /begin REF_MEASUREMENT Return.PAReturnSclFct.Uls_f32 /end REF_MEASUREMENT /end GROUP
/begin GROUP Return.ReceiverPorts "MICROSAR RTE"
 /begin SUB_GROUP Return.AssistMechTempEst.DegC_f32 Return.DiagStsHwPosDis.Cnt_lgc Return.HandwheelAuthority.Uls_f32 Return.HandwheelPosition.HwDeg_f32 Return.HandwheelVel.HwRadpS_f32 Return.HwTorque.HwNm_f32 Return.PAReturnSclFct.Uls_f32 Return.ReturnDDFactor.Uls_f32 Return.ReturnOffset.HwDeg_f32 Return.VehicleSpeed.Kph_f32 /end SUB_GROUP
 /begin FUNCTION_LIST /end FUNCTION_LIST
 /begin REF_CHARACTERISTIC /end REF_CHARACTERISTIC
 /begin REF_MEASUREMENT /end REF_MEASUREMENT
/end GROUP
/begin GROUP Return.ReturnCmd.MtrNm_f32 "MICROSAR RTE" /begin SUB_GROUP /end SUB_GROUP /begin FUNCTION_LIST /end FUNCTION_LIST /begin REF_CHARACTERISTIC /end REF_CHARACTERISTIC /begin REF_MEASUREMENT Return.ReturnCmd.MtrNm_f32 /end REF_MEASUREMENT /end GROUP
/begin GROUP Return.ReturnDDFactor.Uls_f32 "MICROSAR RTE" /begin SUB_GROUP /end SUB_GROUP /begin FUNCTION_LIST /end FUNCTION_LIST /begin REF_CHARACTERISTIC /end REF_CHARACTERISTIC /begin REF_MEASUREMENT Return.ReturnDDFactor.Uls_f32 /end REF_MEASUREMENT /end GROUP
/begin GROUP Return.ReturnOffset.HwDeg_f32 "MICROSAR RTE" /begin SUB_GROUP /end SUB_GROUP /begin FUNCTION_LIST /end FUNCTION_LIST /begin REF_CHARACTERISTIC /end REF_CHARACTERISTIC /begin REF_MEASUREMENT Return.ReturnOffset.HwDeg_f32 /end REF_MEASUREMENT /end GROUP
/begin GROUP Return.SenderPorts "MICROSAR RTE" /begin SUB_GROUP Return.ReturnCmd.MtrNm_f32 /end SUB_GROUP /begin FUNCTION_LIST /end FUNCTION_LIST /begin REF_CHARACTERISTIC /end REF_CHARACTERISTIC /begin REF_MEASUREMENT /end REF_MEASUREMENT /end GROUP
/begin GROUP Return.VehicleSpeed.Kph_f32 "MICROSAR RTE" /begin SUB_GROUP /end SUB_GROUP /begin FUNCTION_LIST /end FUNCTION_LIST /begin REF_CHARACTERISTIC /end REF_CHARACTERISTIC /begin REF_MEASUREMENT Return.VehicleSpeed.Kph_f32 /end REF_MEASUREMENT /end GROUP
/begin GROUP ReturnFirewall "MICROSAR RTE"
 /begin SUB_GROUP ReturnFirewall.ModeRequirePorts ReturnFirewall.ReceiverPorts ReturnFirewall.SenderPorts /end SUB_GROUP
 /begin FUNCTION_LIST /end FUNCTION_LIST
 /begin REF_CHARACTERISTIC /end REF_CHARACTERISTIC
 /begin REF_MEASUREMENT /end REF_MEASUREMENT
/end GROUP
/begin GROUP ReturnFirewall.Defeat_Return_Svc.Cnt_lgc "MICROSAR RTE" /begin SUB_GROUP /end SUB_GROUP /begin FUNCTION_LIST /end FUNCTION_LIST /begin REF_CHARACTERISTIC /end REF_CHARACTERISTIC /begin REF_MEASUREMENT ReturnFirewall.Defeat_Return_Svc.Cnt_lgc /end REF_MEASUREMENT /end GROUP
/begin GROUP ReturnFirewall.HandwheelPosition.HwDeg_f32 "MICROSAR RTE" /begin SUB_GROUP /end SUB_GROUP /begin FUNCTION_LIST /end FUNCTION_LIST /begin REF_CHARACTERISTIC /end REF_CHARACTERISTIC /begin REF_MEASUREMENT ReturnFirewall.HandwheelPosition.HwDeg_f32 /end REF_MEASUREMENT /end GROUP
/begin GROUP ReturnFirewall.LimitedReturn.MtrNm_f32 "MICROSAR RTE" /begin SUB_GROUP /end SUB_GROUP /begin FUNCTION_LIST /end FUNCTION_LIST /begin REF_CHARACTERISTIC /end REF_CHARACTERISTIC /begin REF_MEASUREMENT ReturnFirewall.LimitedReturn.MtrNm_f32 /end REF_MEASUREMENT /end GROUP
/begin GROUP ReturnFirewall.MEC_Counter.Cnt_enum "MICROSAR RTE" /begin SUB_GROUP /end SUB_GROUP /begin FUNCTION_LIST /end FUNCTION_LIST /begin REF_CHARACTERISTIC /end REF_CHARACTERISTIC /begin REF_MEASUREMENT ReturnFirewall.MEC_Counter.Cnt_enum /end REF_MEASUREMENT /end GROUP
/begin GROUP ReturnFirewall.ModeRequirePorts "MICROSAR RTE" /begin SUB_GROUP ReturnFirewall.SystemState.Mode /end SUB_GROUP /begin FUNCTION_LIST /end FUNCTION_LIST /begin REF_CHARACTERISTIC /end REF_CHARACTERISTIC /begin REF_MEASUREMENT /end REF_MEASUREMENT /end GROUP
/begin GROUP ReturnFirewall.ReceiverPorts "MICROSAR RTE"
 /begin SUB_GROUP ReturnFirewall.Defeat_Return_Svc.Cnt_lgc ReturnFirewall.HandwheelPosition.HwDeg_f32 ReturnFirewall.MEC_Counter.Cnt_enum ReturnFirewall.ReturnCmd.MtrNm_f32 ReturnFirewall.VehicleSpeed.Kph_f32 /end SUB_GROUP
 /begin FUNCTION_LIST /end FUNCTION_LIST
 /begin REF_CHARACTERISTIC /end REF_CHARACTERISTIC
 /begin REF_MEASUREMENT /end REF_MEASUREMENT
/end GROUP
/begin GROUP ReturnFirewall.ReturnCmd.MtrNm_f32 "MICROSAR RTE" /begin SUB_GROUP /end SUB_GROUP /begin FUNCTION_LIST /end FUNCTION_LIST /begin REF_CHARACTERISTIC /end REF_CHARACTERISTIC /begin REF_MEASUREMENT ReturnFirewall.ReturnCmd.MtrNm_f32 /end REF_MEASUREMENT /end GROUP
/begin GROUP ReturnFirewall.SenderPorts "MICROSAR RTE" /begin SUB_GROUP ReturnFirewall.LimitedReturn.MtrNm_f32 /end SUB_GROUP /begin FUNCTION_LIST /end FUNCTION_LIST /begin REF_CHARACTERISTIC /end REF_CHARACTERISTIC /begin REF_MEASUREMENT /end REF_MEASUREMENT /end GROUP
/begin GROUP ReturnFirewall.SystemState.Mode "MICROSAR RTE" /begin SUB_GROUP /end SUB_GROUP /begin FUNCTION_LIST /end FUNCTION_LIST /begin REF_CHARACTERISTIC /end REF_CHARACTERISTIC /begin REF_MEASUREMENT ReturnFirewall.SystemState.Mode /end REF_MEASUREMENT /end GROUP
/begin GROUP ReturnFirewall.VehicleSpeed.Kph_f32 "MICROSAR RTE" /begin SUB_GROUP /end SUB_GROUP /begin FUNCTION_LIST /end FUNCTION_LIST /begin REF_CHARACTERISTIC /end REF_CHARACTERISTIC /begin REF_MEASUREMENT ReturnFirewall.VehicleSpeed.Kph_f32 /end REF_MEASUREMENT /end GROUP
/begin GROUP RteErrata10 "MICROSAR RTE" /begin SUB_GROUP RteErrata10.ModeRequirePorts /end SUB_GROUP /begin FUNCTION_LIST /end FUNCTION_LIST /begin REF_CHARACTERISTIC /end REF_CHARACTERISTIC /begin REF_MEASUREMENT /end REF_MEASUREMENT /end GROUP
/begin GROUP RteErrata10.ModeRequirePorts "MICROSAR RTE" /begin SUB_GROUP RteErrata10.SystemState.Mode /end SUB_GROUP /begin FUNCTION_LIST /end FUNCTION_LIST /begin REF_CHARACTERISTIC /end REF_CHARACTERISTIC /begin REF_MEASUREMENT /end REF_MEASUREMENT /end GROUP
/begin GROUP RteErrata10.SystemState.Mode "MICROSAR RTE" /begin SUB_GROUP /end SUB_GROUP /begin FUNCTION_LIST /end FUNCTION_LIST /begin REF_CHARACTERISTIC /end REF_CHARACTERISTIC /begin REF_MEASUREMENT RteErrata10.SystemState.Mode /end REF_MEASUREMENT /end GROUP
/begin GROUP RteErrata11 "MICROSAR RTE" /begin SUB_GROUP RteErrata11.ModeRequirePorts /end SUB_GROUP /begin FUNCTION_LIST /end FUNCTION_LIST /begin REF_CHARACTERISTIC /end REF_CHARACTERISTIC /begin REF_MEASUREMENT /end REF_MEASUREMENT /end GROUP
/begin GROUP RteErrata11.ModeRequirePorts "MICROSAR RTE" /begin SUB_GROUP RteErrata11.SystemState.Mode /end SUB_GROUP /begin FUNCTION_LIST /end FUNCTION_LIST /begin REF_CHARACTERISTIC /end REF_CHARACTERISTIC /begin REF_MEASUREMENT /end REF_MEASUREMENT /end GROUP
/begin GROUP RteErrata11.SystemState.Mode "MICROSAR RTE" /begin SUB_GROUP /end SUB_GROUP /begin FUNCTION_LIST /end FUNCTION_LIST /begin REF_CHARACTERISTIC /end REF_CHARACTERISTIC /begin REF_MEASUREMENT RteErrata11.SystemState.Mode /end REF_MEASUREMENT /end GROUP
/begin GROUP RteErrata7 "MICROSAR RTE" /begin SUB_GROUP RteErrata7.ModeRequirePorts /end SUB_GROUP /begin FUNCTION_LIST /end FUNCTION_LIST /begin REF_CHARACTERISTIC /end REF_CHARACTERISTIC /begin REF_MEASUREMENT /end REF_MEASUREMENT /end GROUP
/begin GROUP RteErrata7.ModeRequirePorts "MICROSAR RTE" /begin SUB_GROUP RteErrata7.SystemState.Mode /end SUB_GROUP /begin FUNCTION_LIST /end FUNCTION_LIST /begin REF_CHARACTERISTIC /end REF_CHARACTERISTIC /begin REF_MEASUREMENT /end REF_MEASUREMENT /end GROUP
/begin GROUP RteErrata7.SystemState.Mode "MICROSAR RTE" /begin SUB_GROUP /end SUB_GROUP /begin FUNCTION_LIST /end FUNCTION_LIST /begin REF_CHARACTERISTIC /end REF_CHARACTERISTIC /begin REF_MEASUREMENT RteErrata7.SystemState.Mode /end REF_MEASUREMENT /end GROUP
/begin GROUP RteErrata8 "MICROSAR RTE" /begin SUB_GROUP RteErrata8.ModeRequirePorts /end SUB_GROUP /begin FUNCTION_LIST /end FUNCTION_LIST /begin REF_CHARACTERISTIC /end REF_CHARACTERISTIC /begin REF_MEASUREMENT /end REF_MEASUREMENT /end GROUP
/begin GROUP RteErrata8.ModeRequirePorts "MICROSAR RTE" /begin SUB_GROUP RteErrata8.SystemState.Mode /end SUB_GROUP /begin FUNCTION_LIST /end FUNCTION_LIST /begin REF_CHARACTERISTIC /end REF_CHARACTERISTIC /begin REF_MEASUREMENT /end REF_MEASUREMENT /end GROUP
/begin GROUP RteErrata8.SystemState.Mode "MICROSAR RTE" /begin SUB_GROUP /end SUB_GROUP /begin FUNCTION_LIST /end FUNCTION_LIST /begin REF_CHARACTERISTIC /end REF_CHARACTERISTIC /begin REF_MEASUREMENT RteErrata8.SystemState.Mode /end REF_MEASUREMENT /end GROUP
/begin GROUP RteErrata9 "MICROSAR RTE" /begin SUB_GROUP RteErrata9.ModeRequirePorts /end SUB_GROUP /begin FUNCTION_LIST /end FUNCTION_LIST /begin REF_CHARACTERISTIC /end REF_CHARACTERISTIC /begin REF_MEASUREMENT /end REF_MEASUREMENT /end GROUP
/begin GROUP RteErrata9.ModeRequirePorts "MICROSAR RTE" /begin SUB_GROUP RteErrata9.SystemState.Mode /end SUB_GROUP /begin FUNCTION_LIST /end FUNCTION_LIST /begin REF_CHARACTERISTIC /end REF_CHARACTERISTIC /begin REF_MEASUREMENT /end REF_MEASUREMENT /end GROUP
/begin GROUP RteErrata9.SystemState.Mode "MICROSAR RTE" /begin SUB_GROUP /end SUB_GROUP /begin FUNCTION_LIST /end FUNCTION_LIST /begin REF_CHARACTERISTIC /end REF_CHARACTERISTIC /begin REF_MEASUREMENT RteErrata9.SystemState.Mode /end REF_MEASUREMENT /end GROUP
/begin GROUP SWCs "MICROSAR RTE"
 /begin SUB_GROUP AbsHwPos ActivePull ApXcp Ap_BmwTqOvrlCdng Ap_TJADamp Assist AssistFirewall AssistSumnLmt AvgFricLrn BVDiag BatteryVoltage BmwHaptcFb BmwRtnArbn CDDInterface10 CDDInterface9 CtrlTemp CtrldDisShtdn CurrentEst CustPL Damping DampingFirewall DemIf DiagMgr10 DiagMgr11 DiagMgr7 DiagMgr8 DiagMgr9 DigPhsReasDiag DrvDynCtrl DrvDynamicsEnable EOTActuatorMng EcuM ElecPwr EtDmpFw FltInjection FrqDepDmpnInrtCmp GenPosTraj Gsod HiLoadStall HwPwUp HwTrq HwTrq2 HystAdd HystComp IoHwAb7 LktoLkStr LmtCod LnRkCr LrnEOT MtrCtrlOpConv MtrCurr MtrDrvDiag MtrPos MtrPos2 MtrPos3 MtrTempEst MtrVel MtrVel2 Nhet2 OscTraj ParamComp ParkAssistEnable PhaseCtrl PhaseDscnt Polarity PosServo PrimaryShutdown PrkAstMfgServCh2 PwrLmtFunc QuadDet RackLoad Return ReturnFirewall RteErrata10 RteErrata11 RteErrata7 RteErrata8 RteErrata9 Sa_BkCpPc SignlCondn SrlComInput SrlComInput2 SrlComOutput SrlComOutput2 StOpCtrl StaMd StaMd11 StaMd7 StaMd8 StaMd9 StabilityComp StabilityComp2 Sweep Sweep2 ThrmlDutyCycle TmprlMon TrqBasedInrtCmp TrqCmdScl TrqOsc TuningSelAuth TurnsCounter VehCfg VehPwrMd VehSpdLmt VltgCtrl /end SUB_GROUP
 /begin FUNCTION_LIST /end FUNCTION_LIST
 /begin REF_CHARACTERISTIC /end REF_CHARACTERISTIC
 /begin REF_MEASUREMENT /end REF_MEASUREMENT
/end GROUP
/begin GROUP Sa_BkCpPc "MICROSAR RTE"
 /begin SUB_GROUP Sa_BkCpPc.ModeRequirePorts Sa_BkCpPc.ReceiverPorts Sa_BkCpPc.SenderPorts /end SUB_GROUP
 /begin FUNCTION_LIST /end FUNCTION_LIST
 /begin REF_CHARACTERISTIC /end REF_CHARACTERISTIC
 /begin REF_MEASUREMENT /end REF_MEASUREMENT
/end GROUP
/begin GROUP Sa_BkCpPc.Batt.Volt_f32 "MICROSAR RTE" /begin SUB_GROUP /end SUB_GROUP /begin FUNCTION_LIST /end FUNCTION_LIST /begin REF_CHARACTERISTIC /end REF_CHARACTERISTIC /begin REF_MEASUREMENT Sa_BkCpPc.Batt.Volt_f32 /end REF_MEASUREMENT /end GROUP
/begin GROUP Sa_BkCpPc.BattSwitched.Volt_f32 "MICROSAR RTE" /begin SUB_GROUP /end SUB_GROUP /begin FUNCTION_LIST /end FUNCTION_LIST /begin REF_CHARACTERISTIC /end REF_CHARACTERISTIC /begin REF_MEASUREMENT Sa_BkCpPc.BattSwitched.Volt_f32 /end REF_MEASUREMENT /end GROUP
/begin GROUP Sa_BkCpPc.ModeRequirePorts "MICROSAR RTE" /begin SUB_GROUP Sa_BkCpPc.SystemState.Mode /end SUB_GROUP /begin FUNCTION_LIST /end FUNCTION_LIST /begin REF_CHARACTERISTIC /end REF_CHARACTERISTIC /begin REF_MEASUREMENT /end REF_MEASUREMENT /end GROUP
/begin GROUP Sa_BkCpPc.MotorVelocityMRFUnfiltered.MtrRadpS_f32 "MICROSAR RTE" /begin SUB_GROUP /end SUB_GROUP /begin FUNCTION_LIST /end FUNCTION_LIST /begin REF_CHARACTERISTIC /end REF_CHARACTERISTIC /begin REF_MEASUREMENT Sa_BkCpPc.MotorVelocityMRFUnfiltered.MtrRadpS_f32 /end REF_MEASUREMENT /end GROUP
/begin GROUP Sa_BkCpPc.OVERRIDESIGDIAGADC.Volt_f32 "MICROSAR RTE" /begin SUB_GROUP /end SUB_GROUP /begin FUNCTION_LIST /end FUNCTION_LIST /begin REF_CHARACTERISTIC /end REF_CHARACTERISTIC /begin REF_MEASUREMENT Sa_BkCpPc.OVERRIDESIGDIAGADC.Volt_f32 /end REF_MEASUREMENT /end GROUP
/begin GROUP Sa_BkCpPc.PMOSDIAGADC.Volt_f32 "MICROSAR RTE" /begin SUB_GROUP /end SUB_GROUP /begin FUNCTION_LIST /end FUNCTION_LIST /begin REF_CHARACTERISTIC /end REF_CHARACTERISTIC /begin REF_MEASUREMENT Sa_BkCpPc.PMOSDIAGADC.Volt_f32 /end REF_MEASUREMENT /end GROUP
/begin GROUP Sa_BkCpPc.PwrDiscATestComplete.Cnt_lgc "MICROSAR RTE" /begin SUB_GROUP /end SUB_GROUP /begin FUNCTION_LIST /end FUNCTION_LIST /begin REF_CHARACTERISTIC /end REF_CHARACTERISTIC /begin REF_MEASUREMENT Sa_BkCpPc.PwrDiscATestComplete.Cnt_lgc /end REF_MEASUREMENT /end GROUP
/begin GROUP Sa_BkCpPc.PwrDiscATestStart.Cnt_lgc "MICROSAR RTE" /begin SUB_GROUP /end SUB_GROUP /begin FUNCTION_LIST /end FUNCTION_LIST /begin REF_CHARACTERISTIC /end REF_CHARACTERISTIC /begin REF_MEASUREMENT Sa_BkCpPc.PwrDiscATestStart.Cnt_lgc /end REF_MEASUREMENT /end GROUP
/begin GROUP Sa_BkCpPc.PwrDiscBTestComplete.Cnt_lgc "MICROSAR RTE" /begin SUB_GROUP /end SUB_GROUP /begin FUNCTION_LIST /end FUNCTION_LIST /begin REF_CHARACTERISTIC /end REF_CHARACTERISTIC /begin REF_MEASUREMENT Sa_BkCpPc.PwrDiscBTestComplete.Cnt_lgc /end REF_MEASUREMENT /end GROUP
/begin GROUP Sa_BkCpPc.PwrDiscBTestStart.Cnt_lgc "MICROSAR RTE" /begin SUB_GROUP /end SUB_GROUP /begin FUNCTION_LIST /end FUNCTION_LIST /begin REF_CHARACTERISTIC /end REF_CHARACTERISTIC /begin REF_MEASUREMENT Sa_BkCpPc.PwrDiscBTestStart.Cnt_lgc /end REF_MEASUREMENT /end GROUP
/begin GROUP Sa_BkCpPc.PwrDiscClosed.Cnt_lgc "MICROSAR RTE" /begin SUB_GROUP /end SUB_GROUP /begin FUNCTION_LIST /end FUNCTION_LIST /begin REF_CHARACTERISTIC /end REF_CHARACTERISTIC /begin REF_MEASUREMENT Sa_BkCpPc.PwrDiscClosed.Cnt_lgc /end REF_MEASUREMENT /end GROUP
/begin GROUP Sa_BkCpPc.ReceiverPorts "MICROSAR RTE"
 /begin SUB_GROUP Sa_BkCpPc.Batt.Volt_f32 Sa_BkCpPc.BattSwitched.Volt_f32 Sa_BkCpPc.MotorVelocityMRFUnfiltered.MtrRadpS_f32 Sa_BkCpPc.OVERRIDESIGDIAGADC.Volt_f32 Sa_BkCpPc.PMOSDIAGADC.Volt_f32 Sa_BkCpPc.PwrDiscATestStart.Cnt_lgc Sa_BkCpPc.PwrDiscBTestStart.Cnt_lgc /end SUB_GROUP
 /begin FUNCTION_LIST /end FUNCTION_LIST
 /begin REF_CHARACTERISTIC /end REF_CHARACTERISTIC
 /begin REF_MEASUREMENT /end REF_MEASUREMENT
/end GROUP
/begin GROUP Sa_BkCpPc.SenderPorts "MICROSAR RTE"
 /begin SUB_GROUP Sa_BkCpPc.PwrDiscATestComplete.Cnt_lgc Sa_BkCpPc.PwrDiscBTestComplete.Cnt_lgc Sa_BkCpPc.PwrDiscClosed.Cnt_lgc /end SUB_GROUP
 /begin FUNCTION_LIST /end FUNCTION_LIST
 /begin REF_CHARACTERISTIC /end REF_CHARACTERISTIC
 /begin REF_MEASUREMENT /end REF_MEASUREMENT
/end GROUP
/begin GROUP Sa_BkCpPc.SystemState.Mode "MICROSAR RTE" /begin SUB_GROUP /end SUB_GROUP /begin FUNCTION_LIST /end FUNCTION_LIST /begin REF_CHARACTERISTIC /end REF_CHARACTERISTIC /begin REF_MEASUREMENT Sa_BkCpPc.SystemState.Mode /end REF_MEASUREMENT /end GROUP
/begin GROUP SignlCondn "MICROSAR RTE" /begin SUB_GROUP SignlCondn.ReceiverPorts SignlCondn.SenderPorts /end SUB_GROUP /begin FUNCTION_LIST /end FUNCTION_LIST /begin REF_CHARACTERISTIC /end REF_CHARACTERISTIC /begin REF_MEASUREMENT /end REF_MEASUREMENT /end GROUP
/begin GROUP SignlCondn.EstimdLatAcce.MpSecSq_f32 "MICROSAR RTE" /begin SUB_GROUP /end SUB_GROUP /begin FUNCTION_LIST /end FUNCTION_LIST /begin REF_CHARACTERISTIC /end REF_CHARACTERISTIC /begin REF_MEASUREMENT SignlCondn.EstimdLatAcce.MpSecSq_f32 /end REF_MEASUREMENT /end GROUP
/begin GROUP SignlCondn.EstimdLatAcceValid.Cnt_lgc "MICROSAR RTE" /begin SUB_GROUP /end SUB_GROUP /begin FUNCTION_LIST /end FUNCTION_LIST /begin REF_CHARACTERISTIC /end REF_CHARACTERISTIC /begin REF_MEASUREMENT SignlCondn.EstimdLatAcceValid.Cnt_lgc /end REF_MEASUREMENT /end GROUP
/begin GROUP SignlCondn.ReceiverPorts "MICROSAR RTE"
 /begin SUB_GROUP SignlCondn.SrlComVehLatAccel.MpSecSq_f32 SignlCondn.SrlComVehLatAccelValid.Cnt_lgc SignlCondn.SrlComVehLonAccel.MpSecSq_f32 SignlCondn.SrlComVehLonAccelValid.Cnt_lgc SignlCondn.SrlComVehSpeed.Kph_f32 SignlCondn.SrlComVehSpeedValid.Cnt_lgc SignlCondn.SrlComVehYawRate.DegpS_f32 SignlCondn.SrlComVehYawRateValid.Cnt_lgc /end SUB_GROUP
 /begin FUNCTION_LIST /end FUNCTION_LIST
 /begin REF_CHARACTERISTIC /end REF_CHARACTERISTIC
 /begin REF_MEASUREMENT /end REF_MEASUREMENT
/end GROUP
/begin GROUP SignlCondn.SenderPorts "MICROSAR RTE"
 /begin SUB_GROUP SignlCondn.EstimdLatAcce.MpSecSq_f32 SignlCondn.EstimdLatAcceValid.Cnt_lgc SignlCondn.VehicleLatAcceValid.Cnt_lgc SignlCondn.VehicleLatAccel.MpSecSq_f32 SignlCondn.VehicleLonAccel.KphpS_f32 SignlCondn.VehicleLonAccelValid.Cnt_lgc SignlCondn.VehicleSpeed.Kph_f32 SignlCondn.VehicleSpeedValid.Cnt_lgc SignlCondn.VehicleYawRate.DegpS_f32 SignlCondn.VehicleYawRateValid.Cnt_lgc /end SUB_GROUP
 /begin FUNCTION_LIST /end FUNCTION_LIST
 /begin REF_CHARACTERISTIC /end REF_CHARACTERISTIC
 /begin REF_MEASUREMENT /end REF_MEASUREMENT
/end GROUP
/begin GROUP SignlCondn.SrlComVehLatAccel.MpSecSq_f32 "MICROSAR RTE" /begin SUB_GROUP /end SUB_GROUP /begin FUNCTION_LIST /end FUNCTION_LIST /begin REF_CHARACTERISTIC /end REF_CHARACTERISTIC /begin REF_MEASUREMENT SignlCondn.SrlComVehLatAccel.MpSecSq_f32 /end REF_MEASUREMENT /end GROUP
/begin GROUP SignlCondn.SrlComVehLatAccelValid.Cnt_lgc "MICROSAR RTE" /begin SUB_GROUP /end SUB_GROUP /begin FUNCTION_LIST /end FUNCTION_LIST /begin REF_CHARACTERISTIC /end REF_CHARACTERISTIC /begin REF_MEASUREMENT SignlCondn.SrlComVehLatAccelValid.Cnt_lgc /end REF_MEASUREMENT /end GROUP
/begin GROUP SignlCondn.SrlComVehLonAccel.MpSecSq_f32 "MICROSAR RTE" /begin SUB_GROUP /end SUB_GROUP /begin FUNCTION_LIST /end FUNCTION_LIST /begin REF_CHARACTERISTIC /end REF_CHARACTERISTIC /begin REF_MEASUREMENT SignlCondn.SrlComVehLonAccel.MpSecSq_f32 /end REF_MEASUREMENT /end GROUP
/begin GROUP SignlCondn.SrlComVehLonAccelValid.Cnt_lgc "MICROSAR RTE" /begin SUB_GROUP /end SUB_GROUP /begin FUNCTION_LIST /end FUNCTION_LIST /begin REF_CHARACTERISTIC /end REF_CHARACTERISTIC /begin REF_MEASUREMENT SignlCondn.SrlComVehLonAccelValid.Cnt_lgc /end REF_MEASUREMENT /end GROUP
/begin GROUP SignlCondn.SrlComVehSpeed.Kph_f32 "MICROSAR RTE" /begin SUB_GROUP /end SUB_GROUP /begin FUNCTION_LIST /end FUNCTION_LIST /begin REF_CHARACTERISTIC /end REF_CHARACTERISTIC /begin REF_MEASUREMENT SignlCondn.SrlComVehSpeed.Kph_f32 /end REF_MEASUREMENT /end GROUP
/begin GROUP SignlCondn.SrlComVehSpeedValid.Cnt_lgc "MICROSAR RTE" /begin SUB_GROUP /end SUB_GROUP /begin FUNCTION_LIST /end FUNCTION_LIST /begin REF_CHARACTERISTIC /end REF_CHARACTERISTIC /begin REF_MEASUREMENT SignlCondn.SrlComVehSpeedValid.Cnt_lgc /end REF_MEASUREMENT /end GROUP
/begin GROUP SignlCondn.SrlComVehYawRate.DegpS_f32 "MICROSAR RTE" /begin SUB_GROUP /end SUB_GROUP /begin FUNCTION_LIST /end FUNCTION_LIST /begin REF_CHARACTERISTIC /end REF_CHARACTERISTIC /begin REF_MEASUREMENT SignlCondn.SrlComVehYawRate.DegpS_f32 /end REF_MEASUREMENT /end GROUP
/begin GROUP SignlCondn.SrlComVehYawRateValid.Cnt_lgc "MICROSAR RTE" /begin SUB_GROUP /end SUB_GROUP /begin FUNCTION_LIST /end FUNCTION_LIST /begin REF_CHARACTERISTIC /end REF_CHARACTERISTIC /begin REF_MEASUREMENT SignlCondn.SrlComVehYawRateValid.Cnt_lgc /end REF_MEASUREMENT /end GROUP
/begin GROUP SignlCondn.VehicleLatAcceValid.Cnt_lgc "MICROSAR RTE" /begin SUB_GROUP /end SUB_GROUP /begin FUNCTION_LIST /end FUNCTION_LIST /begin REF_CHARACTERISTIC /end REF_CHARACTERISTIC /begin REF_MEASUREMENT SignlCondn.VehicleLatAcceValid.Cnt_lgc /end REF_MEASUREMENT /end GROUP
/begin GROUP SignlCondn.VehicleLatAccel.MpSecSq_f32 "MICROSAR RTE" /begin SUB_GROUP /end SUB_GROUP /begin FUNCTION_LIST /end FUNCTION_LIST /begin REF_CHARACTERISTIC /end REF_CHARACTERISTIC /begin REF_MEASUREMENT SignlCondn.VehicleLatAccel.MpSecSq_f32 /end REF_MEASUREMENT /end GROUP
/begin GROUP SignlCondn.VehicleLonAccel.KphpS_f32 "MICROSAR RTE" /begin SUB_GROUP /end SUB_GROUP /begin FUNCTION_LIST /end FUNCTION_LIST /begin REF_CHARACTERISTIC /end REF_CHARACTERISTIC /begin REF_MEASUREMENT SignlCondn.VehicleLonAccel.KphpS_f32 /end REF_MEASUREMENT /end GROUP
/begin GROUP SignlCondn.VehicleLonAccelValid.Cnt_lgc "MICROSAR RTE" /begin SUB_GROUP /end SUB_GROUP /begin FUNCTION_LIST /end FUNCTION_LIST /begin REF_CHARACTERISTIC /end REF_CHARACTERISTIC /begin REF_MEASUREMENT SignlCondn.VehicleLonAccelValid.Cnt_lgc /end REF_MEASUREMENT /end GROUP
/begin GROUP SignlCondn.VehicleSpeed.Kph_f32 "MICROSAR RTE" /begin SUB_GROUP /end SUB_GROUP /begin FUNCTION_LIST /end FUNCTION_LIST /begin REF_CHARACTERISTIC /end REF_CHARACTERISTIC /begin REF_MEASUREMENT SignlCondn.VehicleSpeed.Kph_f32 /end REF_MEASUREMENT /end GROUP
/begin GROUP SignlCondn.VehicleSpeedValid.Cnt_lgc "MICROSAR RTE" /begin SUB_GROUP /end SUB_GROUP /begin FUNCTION_LIST /end FUNCTION_LIST /begin REF_CHARACTERISTIC /end REF_CHARACTERISTIC /begin REF_MEASUREMENT SignlCondn.VehicleSpeedValid.Cnt_lgc /end REF_MEASUREMENT /end GROUP
/begin GROUP SignlCondn.VehicleYawRate.DegpS_f32 "MICROSAR RTE" /begin SUB_GROUP /end SUB_GROUP /begin FUNCTION_LIST /end FUNCTION_LIST /begin REF_CHARACTERISTIC /end REF_CHARACTERISTIC /begin REF_MEASUREMENT SignlCondn.VehicleYawRate.DegpS_f32 /end REF_MEASUREMENT /end GROUP
/begin GROUP SignlCondn.VehicleYawRateValid.Cnt_lgc "MICROSAR RTE" /begin SUB_GROUP /end SUB_GROUP /begin FUNCTION_LIST /end FUNCTION_LIST /begin REF_CHARACTERISTIC /end REF_CHARACTERISTIC /begin REF_MEASUREMENT SignlCondn.VehicleYawRateValid.Cnt_lgc /end REF_MEASUREMENT /end GROUP
/begin GROUP SrlComInput "MICROSAR RTE"
 /begin SUB_GROUP SrlComInput.ModeRequirePorts SrlComInput.ReceiverPorts SrlComInput.SenderPorts /end SUB_GROUP
 /begin FUNCTION_LIST /end FUNCTION_LIST
 /begin REF_CHARACTERISTIC /end REF_CHARACTERISTIC
 /begin REF_MEASUREMENT /end REF_MEASUREMENT
/end GROUP
/begin GROUP SrlComInput.CDRVDYNMSG.Cnt_lgc "MICROSAR RTE" /begin SUB_GROUP /end SUB_GROUP /begin FUNCTION_LIST /end FUNCTION_LIST /begin REF_CHARACTERISTIC /end REF_CHARACTERISTIC /begin REF_MEASUREMENT SrlComInput.CDRVDYNMSG.Cnt_lgc /end REF_MEASUREMENT /end GROUP
/begin GROUP SrlComInput.CERRMVOLTFALLBACK.Cnt_lgc "MICROSAR RTE" /begin SUB_GROUP /end SUB_GROUP /begin FUNCTION_LIST /end FUNCTION_LIST /begin REF_CHARACTERISTIC /end REF_CHARACTERISTIC /begin REF_MEASUREMENT SrlComInput.CERRMVOLTFALLBACK.Cnt_lgc /end REF_MEASUREMENT /end GROUP
/begin GROUP SrlComInput.CFACTORIF.Cnt_lgc "MICROSAR RTE" /begin SUB_GROUP /end SUB_GROUP /begin FUNCTION_LIST /end FUNCTION_LIST /begin REF_CHARACTERISTIC /end REF_CHARACTERISTIC /begin REF_MEASUREMENT SrlComInput.CFACTORIF.Cnt_lgc /end REF_MEASUREMENT /end GROUP
/begin GROUP SrlComInput.CHWACORRECTION.Cnt_lgc "MICROSAR RTE" /begin SUB_GROUP /end SUB_GROUP /begin FUNCTION_LIST /end FUNCTION_LIST /begin REF_CHARACTERISTIC /end REF_CHARACTERISTIC /begin REF_MEASUREMENT SrlComInput.CHWACORRECTION.Cnt_lgc /end REF_MEASUREMENT /end GROUP
/begin GROUP SrlComInput.CHWANGLEIF.Cnt_lgc "MICROSAR RTE" /begin SUB_GROUP /end SUB_GROUP /begin FUNCTION_LIST /end FUNCTION_LIST /begin REF_CHARACTERISTIC /end REF_CHARACTERISTIC /begin REF_MEASUREMENT SrlComInput.CHWANGLEIF.Cnt_lgc /end REF_MEASUREMENT /end GROUP
/begin GROUP SrlComInput.CHWTORQUEIF.Cnt_lgc "MICROSAR RTE" /begin SUB_GROUP /end SUB_GROUP /begin FUNCTION_LIST /end FUNCTION_LIST /begin REF_CHARACTERISTIC /end REF_CHARACTERISTIC /begin REF_MEASUREMENT SrlComInput.CHWTORQUEIF.Cnt_lgc /end REF_MEASUREMENT /end GROUP
/begin GROUP SrlComInput.CMTTORQUEIF.Cnt_lgc "MICROSAR RTE" /begin SUB_GROUP /end SUB_GROUP /begin FUNCTION_LIST /end FUNCTION_LIST /begin REF_CHARACTERISTIC /end REF_CHARACTERISTIC /begin REF_MEASUREMENT SrlComInput.CMTTORQUEIF.Cnt_lgc /end REF_MEASUREMENT /end GROUP
/begin GROUP SrlComInput.DiagStsDefVehSpd.Cnt_lgc "MICROSAR RTE" /begin SUB_GROUP /end SUB_GROUP /begin FUNCTION_LIST /end FUNCTION_LIST /begin REF_CHARACTERISTIC /end REF_CHARACTERISTIC /begin REF_MEASUREMENT SrlComInput.DiagStsDefVehSpd.Cnt_lgc /end REF_MEASUREMENT /end GROUP
/begin GROUP SrlComInput.ErrmBnU.Cnt_u8 "MICROSAR RTE" /begin SUB_GROUP /end SUB_GROUP /begin FUNCTION_LIST /end FUNCTION_LIST /begin REF_CHARACTERISTIC /end REF_CHARACTERISTIC /begin REF_MEASUREMENT SrlComInput.ErrmBnU.Cnt_u8 /end REF_MEASUREMENT /end GROUP
/begin GROUP SrlComInput.HaptcFbIntenNr.Cnt_u16 "MICROSAR RTE" /begin SUB_GROUP /end SUB_GROUP /begin FUNCTION_LIST /end FUNCTION_LIST /begin REF_CHARACTERISTIC /end REF_CHARACTERISTIC /begin REF_MEASUREMENT SrlComInput.HaptcFbIntenNr.Cnt_u16 /end REF_MEASUREMENT /end GROUP
/begin GROUP SrlComInput.HaptcFbIntenSigVld.Cnt_lgc "MICROSAR RTE" /begin SUB_GROUP /end SUB_GROUP /begin FUNCTION_LIST /end FUNCTION_LIST /begin REF_CHARACTERISTIC /end REF_CHARACTERISTIC /begin REF_MEASUREMENT SrlComInput.HaptcFbIntenSigVld.Cnt_lgc /end REF_MEASUREMENT /end GROUP
/begin GROUP SrlComInput.HaptcFbPatNr.Cnt_u16 "MICROSAR RTE" /begin SUB_GROUP /end SUB_GROUP /begin FUNCTION_LIST /end FUNCTION_LIST /begin REF_CHARACTERISTIC /end REF_CHARACTERISTIC /begin REF_MEASUREMENT SrlComInput.HaptcFbPatNr.Cnt_u16 /end REF_MEASUREMENT /end GROUP
/begin GROUP SrlComInput.HaptcFbPatSigVld.Cnt_lgc "MICROSAR RTE" /begin SUB_GROUP /end SUB_GROUP /begin FUNCTION_LIST /end FUNCTION_LIST /begin REF_CHARACTERISTIC /end REF_CHARACTERISTIC /begin REF_MEASUREMENT SrlComInput.HaptcFbPatSigVld.Cnt_lgc /end REF_MEASUREMENT /end GROUP
/begin GROUP SrlComInput.IgnTimeOff.Cnt_u32 "MICROSAR RTE" /begin SUB_GROUP /end SUB_GROUP /begin FUNCTION_LIST /end FUNCTION_LIST /begin REF_CHARACTERISTIC /end REF_CHARACTERISTIC /begin REF_MEASUREMENT SrlComInput.IgnTimeOff.Cnt_u32 /end REF_MEASUREMENT /end GROUP
/begin GROUP SrlComInput.IlkErrmFzm.Cnt_u8 "MICROSAR RTE" /begin SUB_GROUP /end SUB_GROUP /begin FUNCTION_LIST /end FUNCTION_LIST /begin REF_CHARACTERISTIC /end REF_CHARACTERISTIC /begin REF_MEASUREMENT SrlComInput.IlkErrmFzm.Cnt_u8 /end REF_MEASUREMENT /end GROUP
/begin GROUP SrlComInput.ModeRequirePorts "MICROSAR RTE" /begin SUB_GROUP SrlComInput.SystemState.Mode /end SUB_GROUP /begin FUNCTION_LIST /end FUNCTION_LIST /begin REF_CHARACTERISTIC /end REF_CHARACTERISTIC /begin REF_MEASUREMENT /end REF_MEASUREMENT /end GROUP
/begin GROUP SrlComInput.ReceiverPorts "MICROSAR RTE"
 /begin SUB_GROUP SrlComInput.CDRVDYNMSG.Cnt_lgc SrlComInput.CERRMVOLTFALLBACK.Cnt_lgc SrlComInput.CFACTORIF.Cnt_lgc SrlComInput.CHWACORRECTION.Cnt_lgc SrlComInput.CHWANGLEIF.Cnt_lgc SrlComInput.CHWTORQUEIF.Cnt_lgc SrlComInput.CMTTORQUEIF.Cnt_lgc SrlComInput.DiagStsDefVehSpd.Cnt_lgc SrlComInput.RxCtrErrmBnU.Cnt_u8 SrlComInput.RxILK_ERRM_FZM.Cnt_u8 SrlComInput.RxMILE_KM.Cnt_u32 SrlComInput.RxVIN.VIN_NO_VECH SrlComInput.SG_OFFS_QUAD_EPS.SG_OFFS_QUAD_EPS SrlComInput.SG_TAR_QTA_STRMOM_DV.SG_TAR_QTA_STRMOM_DV SrlComInput.SG_TAR_STMOM_DV_ACT.SG_TAR_STMOM_DV_ACT SrlComInput.SG_V_VEH.SG_V_VEH SrlComInput.SrlComSvcDft.Cnt_b32 /end SUB_GROUP
 /begin FUNCTION_LIST /end FUNCTION_LIST
 /begin REF_CHARACTERISTIC /end REF_CHARACTERISTIC
 /begin REF_MEASUREMENT /end REF_MEASUREMENT
/end GROUP
/begin GROUP SrlComInput.ReturnOffset.HwDeg_f32 "MICROSAR RTE" /begin SUB_GROUP /end SUB_GROUP /begin FUNCTION_LIST /end FUNCTION_LIST /begin REF_CHARACTERISTIC /end REF_CHARACTERISTIC /begin REF_MEASUREMENT SrlComInput.ReturnOffset.HwDeg_f32 /end REF_MEASUREMENT /end GROUP
/begin GROUP SrlComInput.RxCtrErrmBnU.Cnt_u8 "MICROSAR RTE" /begin SUB_GROUP /end SUB_GROUP /begin FUNCTION_LIST /end FUNCTION_LIST /begin REF_CHARACTERISTIC /end REF_CHARACTERISTIC /begin REF_MEASUREMENT Com_CTR_ERRM_BN_U__ERRM_BN_U /end REF_MEASUREMENT /end GROUP
/begin GROUP SrlComInput.RxILK_ERRM_FZM.Cnt_u8 "MICROSAR RTE" /begin SUB_GROUP /end SUB_GROUP /begin FUNCTION_LIST /end FUNCTION_LIST /begin REF_CHARACTERISTIC /end REF_CHARACTERISTIC /begin REF_MEASUREMENT Com_ST_ILK_ERRM_FZM__FZZSTD /end REF_MEASUREMENT /end GROUP
/begin GROUP SrlComInput.RxMILE_KM.Cnt_u32 "MICROSAR RTE" /begin SUB_GROUP /end SUB_GROUP /begin FUNCTION_LIST /end FUNCTION_LIST /begin REF_CHARACTERISTIC /end REF_CHARACTERISTIC /begin REF_MEASUREMENT Com_MILE_KM__KILOMETERSTAND /end REF_MEASUREMENT /end GROUP
/begin GROUP SrlComInput.RxVIN.VIN_NO_VECH "MICROSAR RTE" /begin SUB_GROUP /end SUB_GROUP /begin FUNCTION_LIST /end FUNCTION_LIST /begin REF_CHARACTERISTIC /end REF_CHARACTERISTIC
 /begin REF_MEASUREMENT Com_NO_VECH_1__FAHRGESTELLNUMMER Com_NO_VECH_2__FAHRGESTELLNUMMER Com_NO_VECH_3__FAHRGESTELLNUMMER Com_NO_VECH_4__FAHRGESTELLNUMMER Com_NO_VECH_5__FAHRGESTELLNUMMER Com_NO_VECH_6__FAHRGESTELLNUMMER Com_NO_VECH_7__FAHRGESTELLNUMMER /end REF_MEASUREMENT
/end GROUP
/begin GROUP SrlComInput.SG_ANFRAGE_EPS.SG_ANFRAGE_EPS "MICROSAR RTE" /begin SUB_GROUP /end SUB_GROUP /begin FUNCTION_LIST /end FUNCTION_LIST /begin REF_CHARACTERISTIC /end REF_CHARACTERISTIC
 /begin REF_MEASUREMENT Com_ID2_0x08_Mx01_EPS__ANFRAGE_EPS Com_ID_FN_INQY_EPS__ANFRAGE_EPS /end REF_MEASUREMENT
/end GROUP
/begin GROUP SrlComInput.SG_OFFS_QUAD_EPS.SG_OFFS_QUAD_EPS "MICROSAR RTE" /begin SUB_GROUP /end SUB_GROUP /begin FUNCTION_LIST /end FUNCTION_LIST /begin REF_CHARACTERISTIC /end REF_CHARACTERISTIC
 /begin REF_MEASUREMENT Com_ALIV_OFFS_QUAD_EPS__OFFS_QUAD_EPS Com_AVL_PO_IDX_ICM__OFFS_QUAD_EPS Com_CRC_OFFS_QUAD_EPS__OFFS_QUAD_EPS Com_OFFS_QUAD_RTR_EPS__OFFS_QUAD_EPS Com_ST_OFFS_QUAD_EPS__OFFS_QUAD_EPS /end REF_MEASUREMENT
/end GROUP
/begin GROUP SrlComInput.SG_TAR_QTA_STRMOM_DV.SG_TAR_QTA_STRMOM_DV "MICROSAR RTE" /begin SUB_GROUP /end SUB_GROUP /begin FUNCTION_LIST /end FUNCTION_LIST /begin REF_CHARACTERISTIC /end REF_CHARACTERISTIC
 /begin REF_MEASUREMENT Com_ALIV_TAR_QTA_STMOM_DV__TAR_QTA_STRMOM_DV Com_CRC_TAR_QTA_STMOM_DV__TAR_QTA_STRMOM_DV Com_CTR_DEAC_EPS_FNS__TAR_QTA_STRMOM_DV Com_FACT_ASS_STMOM_FTAX__TAR_QTA_STRMOM_DV Com_FACT_CTRR_STMOM_FTAX__TAR_QTA_STRMOM_DV Com_FACT_DMPNG_STMOM_FTAX__TAR_QTA_STRMOM_DV Com_QU_TAR_FACT_STMOM_FTAX__TAR_QTA_STRMOM_DV Com_QU_TAR_QTA_STMOM_DV__TAR_QTA_STRMOM_DV Com_TAR_QTA_STMOM_DV__TAR_QTA_STRMOM_DV /end REF_MEASUREMENT
/end GROUP
/begin GROUP SrlComInput.SG_TAR_STMOM_DV_ACT.SG_TAR_STMOM_DV_ACT "MICROSAR RTE" /begin SUB_GROUP /end SUB_GROUP /begin FUNCTION_LIST /end FUNCTION_LIST /begin REF_CHARACTERISTIC /end REF_CHARACTERISTIC
 /begin REF_MEASUREMENT Com_ALIV_TAR_STMOM_DV_ACT__TAR_STMOM_DV_ACT Com_CRC_TAR_STMOM_DV_ACT__TAR_STMOM_DV_ACT Com_FACT_DMPNG_ADDON_STMOM_FTAX__TAR_STMOM_DV_ACT Com_QU_TAR_DMPNG_ADDON_STMOM_FTAX__TAR_STMOM_DV_ACT Com_QU_TAR_STMOM_DV_ACT__TAR_STMOM_DV_ACT Com_TAR_STMOM_DV_ACT__TAR_STMOM_DV_ACT /end REF_MEASUREMENT
/end GROUP
/begin GROUP SrlComInput.SG_V_VEH.SG_V_VEH "MICROSAR RTE" /begin SUB_GROUP /end SUB_GROUP /begin FUNCTION_LIST /end FUNCTION_LIST /begin REF_CHARACTERISTIC /end REF_CHARACTERISTIC
 /begin REF_MEASUREMENT Com_ALIV_V_VEH__V_VEH Com_CRC_V_VEH__V_VEH Com_DVCO_VEH__V_VEH Com_QU_V_VEH_COG__V_VEH Com_ST_V_VEH_NSS__V_VEH Com_V_VEH_0x27_0x01__V_VEH Com_V_VEH_COG__V_VEH /end REF_MEASUREMENT
/end GROUP
/begin GROUP SrlComInput.SenderPorts "MICROSAR RTE"
 /begin SUB_GROUP SrlComInput.ErrmBnU.Cnt_u8 SrlComInput.HaptcFbIntenNr.Cnt_u16 SrlComInput.HaptcFbIntenSigVld.Cnt_lgc SrlComInput.HaptcFbPatNr.Cnt_u16 SrlComInput.HaptcFbPatSigVld.Cnt_lgc SrlComInput.IgnTimeOff.Cnt_u32 SrlComInput.IlkErrmFzm.Cnt_u8 SrlComInput.ReturnOffset.HwDeg_f32 SrlComInput.SG_ANFRAGE_EPS.SG_ANFRAGE_EPS SrlComInput.SrlComSGOFFSQUADEPS.SG_OFFS_QUAD_EPS SrlComInput.SrlComSGTARQTASTRMOMDV.SG_TAR_QTA_STRMOM_DV SrlComInput.SrlComSGTARSTMOMDVACT.SG_TAR_STMOM_DV_ACT SrlComInput.SrlComSGVVEH.SG_V_VEH SrlComInput.SupplyCurrLmt.Amp_f32 SrlComInput.VINValid.Cnt_lgc SrlComInput.VehTimeValid.Cnt_lgc /end SUB_GROUP
 /begin FUNCTION_LIST /end FUNCTION_LIST
 /begin REF_CHARACTERISTIC /end REF_CHARACTERISTIC
 /begin REF_MEASUREMENT /end REF_MEASUREMENT
/end GROUP
/begin GROUP SrlComInput.SrlComSGOFFSQUADEPS.SG_OFFS_QUAD_EPS "MICROSAR RTE" /begin SUB_GROUP /end SUB_GROUP /begin FUNCTION_LIST /end FUNCTION_LIST /begin REF_CHARACTERISTIC /end REF_CHARACTERISTIC
 /begin REF_MEASUREMENT SrlComInput.SrlComSGOFFSQUADEPS.SG_OFFS_QUAD_EPS.ALIV_OFFS_QUAD_EPS SrlComInput.SrlComSGOFFSQUADEPS.SG_OFFS_QUAD_EPS.AVL_PO_IDX_ICM SrlComInput.SrlComSGOFFSQUADEPS.SG_OFFS_QUAD_EPS.CRC_OFFS_QUAD_EPS SrlComInput.SrlComSGOFFSQUADEPS.SG_OFFS_QUAD_EPS.OFFS_QUAD_RTR_EPS SrlComInput.SrlComSGOFFSQUADEPS.SG_OFFS_QUAD_EPS.ST_OFFS_QUAD_EPS /end REF_MEASUREMENT
/end GROUP
/begin GROUP SrlComInput.SrlComSGTARQTASTRMOMDV.SG_TAR_QTA_STRMOM_DV "MICROSAR RTE" /begin SUB_GROUP /end SUB_GROUP /begin FUNCTION_LIST /end FUNCTION_LIST /begin REF_CHARACTERISTIC /end REF_CHARACTERISTIC
 /begin REF_MEASUREMENT SrlComInput.SrlComSGTARQTASTRMOMDV.SG_TAR_QTA_STRMOM_DV.ALIV_TAR_QTA_STMOM_DV SrlComInput.SrlComSGTARQTASTRMOMDV.SG_TAR_QTA_STRMOM_DV.CRC_TAR_QTA_STMOM_DV SrlComInput.SrlComSGTARQTASTRMOMDV.SG_TAR_QTA_STRMOM_DV.CTR_DEAC_EPS_FNS SrlComInput.SrlComSGTARQTASTRMOMDV.SG_TAR_QTA_STRMOM_DV.FACT_ASS_STMOM_FTAX SrlComInput.SrlComSGTARQTASTRMOMDV.SG_TAR_QTA_STRMOM_DV.FACT_CTRR_STMOM_FTAX SrlComInput.SrlComSGTARQTASTRMOMDV.SG_TAR_QTA_STRMOM_DV.FACT_DMPNG_STMOM_FTAX SrlComInput.SrlComSGTARQTASTRMOMDV.SG_TAR_QTA_STRMOM_DV.QU_TAR_FACT_STMOM_FTAX SrlComInput.SrlComSGTARQTASTRMOMDV.SG_TAR_QTA_STRMOM_DV.QU_TAR_QTA_STMOM_DV SrlComInput.SrlComSGTARQTASTRMOMDV.SG_TAR_QTA_STRMOM_DV.TAR_QTA_STMOM_DV /end REF_MEASUREMENT
/end GROUP
/begin GROUP SrlComInput.SrlComSGTARSTMOMDVACT.SG_TAR_STMOM_DV_ACT "MICROSAR RTE" /begin SUB_GROUP /end SUB_GROUP /begin FUNCTION_LIST /end FUNCTION_LIST /begin REF_CHARACTERISTIC /end REF_CHARACTERISTIC
 /begin REF_MEASUREMENT SrlComInput.SrlComSGTARSTMOMDVACT.SG_TAR_STMOM_DV_ACT.ALIV_TAR_STMOM_DV_ACT SrlComInput.SrlComSGTARSTMOMDVACT.SG_TAR_STMOM_DV_ACT.CRC_TAR_STMOM_DV_ACT SrlComInput.SrlComSGTARSTMOMDVACT.SG_TAR_STMOM_DV_ACT.FACT_DMPNG_ADDON_STMOM_FTAX SrlComInput.SrlComSGTARSTMOMDVACT.SG_TAR_STMOM_DV_ACT.QU_TAR_DMPNG_ADDON_STMOM_FTAX SrlComInput.SrlComSGTARSTMOMDVACT.SG_TAR_STMOM_DV_ACT.QU_TAR_STMOM_DV_ACT SrlComInput.SrlComSGTARSTMOMDVACT.SG_TAR_STMOM_DV_ACT.TAR_STMOM_DV_ACT /end REF_MEASUREMENT
/end GROUP
/begin GROUP SrlComInput.SrlComSGVVEH.SG_V_VEH "MICROSAR RTE" /begin SUB_GROUP /end SUB_GROUP /begin FUNCTION_LIST /end FUNCTION_LIST /begin REF_CHARACTERISTIC /end REF_CHARACTERISTIC
 /begin REF_MEASUREMENT SrlComInput.SrlComSGVVEH.SG_V_VEH.ALIV_V_VEH SrlComInput.SrlComSGVVEH.SG_V_VEH.CRC_V_VEH SrlComInput.SrlComSGVVEH.SG_V_VEH.DVCO_VEH SrlComInput.SrlComSGVVEH.SG_V_VEH.QU_V_VEH_COG SrlComInput.SrlComSGVVEH.SG_V_VEH.ST_V_VEH_NSS SrlComInput.SrlComSGVVEH.SG_V_VEH.V_VEH_0x27_0x01 SrlComInput.SrlComSGVVEH.SG_V_VEH.V_VEH_COG /end REF_MEASUREMENT
/end GROUP
/begin GROUP SrlComInput.SrlComSvcDft.Cnt_b32 "MICROSAR RTE" /begin SUB_GROUP /end SUB_GROUP /begin FUNCTION_LIST /end FUNCTION_LIST /begin REF_CHARACTERISTIC /end REF_CHARACTERISTIC /begin REF_MEASUREMENT SrlComInput.SrlComSvcDft.Cnt_b32 /end REF_MEASUREMENT /end GROUP
/begin GROUP SrlComInput.SupplyCurrLmt.Amp_f32 "MICROSAR RTE" /begin SUB_GROUP /end SUB_GROUP /begin FUNCTION_LIST /end FUNCTION_LIST /begin REF_CHARACTERISTIC /end REF_CHARACTERISTIC /begin REF_MEASUREMENT SrlComInput.SupplyCurrLmt.Amp_f32 /end REF_MEASUREMENT /end GROUP
/begin GROUP SrlComInput.SystemState.Mode "MICROSAR RTE" /begin SUB_GROUP /end SUB_GROUP /begin FUNCTION_LIST /end FUNCTION_LIST /begin REF_CHARACTERISTIC /end REF_CHARACTERISTIC /begin REF_MEASUREMENT SrlComInput.SystemState.Mode /end REF_MEASUREMENT /end GROUP
/begin GROUP SrlComInput.VINValid.Cnt_lgc "MICROSAR RTE" /begin SUB_GROUP /end SUB_GROUP /begin FUNCTION_LIST /end FUNCTION_LIST /begin REF_CHARACTERISTIC /end REF_CHARACTERISTIC /begin REF_MEASUREMENT SrlComInput.VINValid.Cnt_lgc /end REF_MEASUREMENT /end GROUP
/begin GROUP SrlComInput.VehTimeValid.Cnt_lgc "MICROSAR RTE" /begin SUB_GROUP /end SUB_GROUP /begin FUNCTION_LIST /end FUNCTION_LIST /begin REF_CHARACTERISTIC /end REF_CHARACTERISTIC /begin REF_MEASUREMENT SrlComInput.VehTimeValid.Cnt_lgc /end REF_MEASUREMENT /end GROUP
/begin GROUP SrlComInput2 "MICROSAR RTE" /begin SUB_GROUP SrlComInput2.ReceiverPorts SrlComInput2.SenderPorts /end SUB_GROUP /begin FUNCTION_LIST /end FUNCTION_LIST /begin REF_CHARACTERISTIC /end REF_CHARACTERISTIC /begin REF_MEASUREMENT /end REF_MEASUREMENT /end GROUP
/begin GROUP SrlComInput2.CADASIF.Cnt_lgc "MICROSAR RTE" /begin SUB_GROUP /end SUB_GROUP /begin FUNCTION_LIST /end FUNCTION_LIST /begin REF_CHARACTERISTIC /end REF_CHARACTERISTIC /begin REF_MEASUREMENT SrlComInput2.CADASIF.Cnt_lgc /end REF_MEASUREMENT /end GROUP
/begin GROUP SrlComInput2.CFACTORIF.Cnt_lgc "MICROSAR RTE" /begin SUB_GROUP /end SUB_GROUP /begin FUNCTION_LIST /end FUNCTION_LIST /begin REF_CHARACTERISTIC /end REF_CHARACTERISTIC /begin REF_MEASUREMENT SrlComInput2.CFACTORIF.Cnt_lgc /end REF_MEASUREMENT /end GROUP
/begin GROUP SrlComInput2.CHWANGLEIF.Cnt_lgc "MICROSAR RTE" /begin SUB_GROUP /end SUB_GROUP /begin FUNCTION_LIST /end FUNCTION_LIST /begin REF_CHARACTERISTIC /end REF_CHARACTERISTIC /begin REF_MEASUREMENT SrlComInput2.CHWANGLEIF.Cnt_lgc /end REF_MEASUREMENT /end GROUP
/begin GROUP SrlComInput2.CHWTORQUEIF.Cnt_lgc "MICROSAR RTE" /begin SUB_GROUP /end SUB_GROUP /begin FUNCTION_LIST /end FUNCTION_LIST /begin REF_CHARACTERISTIC /end REF_CHARACTERISTIC /begin REF_MEASUREMENT SrlComInput2.CHWTORQUEIF.Cnt_lgc /end REF_MEASUREMENT /end GROUP
/begin GROUP SrlComInput2.CMTTORQUEIF.Cnt_lgc "MICROSAR RTE" /begin SUB_GROUP /end SUB_GROUP /begin FUNCTION_LIST /end FUNCTION_LIST /begin REF_CHARACTERISTIC /end REF_CHARACTERISTIC /begin REF_MEASUREMENT SrlComInput2.CMTTORQUEIF.Cnt_lgc /end REF_MEASUREMENT /end GROUP
/begin GROUP SrlComInput2.DiagStsDefVehSpd.Cnt_lgc "MICROSAR RTE" /begin SUB_GROUP /end SUB_GROUP /begin FUNCTION_LIST /end FUNCTION_LIST /begin REF_CHARACTERISTIC /end REF_CHARACTERISTIC /begin REF_MEASUREMENT SrlComInput2.DiagStsDefVehSpd.Cnt_lgc /end REF_MEASUREMENT /end GROUP
/begin GROUP SrlComInput2.FRVldVehSpd.Kph_f32 "MICROSAR RTE" /begin SUB_GROUP /end SUB_GROUP /begin FUNCTION_LIST /end FUNCTION_LIST /begin REF_CHARACTERISTIC /end REF_CHARACTERISTIC /begin REF_MEASUREMENT SrlComInput2.FRVldVehSpd.Kph_f32 /end REF_MEASUREMENT /end GROUP
/begin GROUP SrlComInput2.ReceiverPorts "MICROSAR RTE"
 /begin SUB_GROUP SrlComInput2.CADASIF.Cnt_lgc SrlComInput2.CFACTORIF.Cnt_lgc SrlComInput2.CHWANGLEIF.Cnt_lgc SrlComInput2.CHWTORQUEIF.Cnt_lgc SrlComInput2.CMTTORQUEIF.Cnt_lgc SrlComInput2.DiagStsDefVehSpd.Cnt_lgc SrlComInput2.SrlComSGOFFSQUADEPS.SG_OFFS_QUAD_EPS SrlComInput2.SrlComSGTARQTASTRMOMDV.SG_TAR_QTA_STRMOM_DV SrlComInput2.SrlComSGTARSTMOMDVACT.SG_TAR_STMOM_DV_ACT SrlComInput2.SrlComSGVVEH.SG_V_VEH SrlComInput2.SrlComSvcDft.Cnt_b32 SrlComInput2.VehicleSpeed.Kph_f32 /end SUB_GROUP
 /begin FUNCTION_LIST /end FUNCTION_LIST
 /begin REF_CHARACTERISTIC /end REF_CHARACTERISTIC
 /begin REF_MEASUREMENT /end REF_MEASUREMENT
/end GROUP
/begin GROUP SrlComInput2.SenderPorts "MICROSAR RTE"
 /begin SUB_GROUP SrlComInput2.FRVldVehSpd.Kph_f32 SrlComInput2.SerlComTarSteerTqDrvrActr.MtrNm_f32 SrlComInput2.SrlComAssistScaleFactor.Uls_f32 SrlComInput2.SrlComCRFRevOffset.Rev_s16 SrlComInput2.SrlComDampingScaleFactor.Uls_f32 SrlComInput2.SrlComDrvDynEnable.Cnt_lgc SrlComInput2.SrlComDrvDynInvalid.Cnt_lgc SrlComInput2.SrlComEngCrank.Cnt_lgc SrlComInput2.SrlComInputTorqueOverlay.HwNm_f32 SrlComInput2.SrlComPrkAstHwAngle.HwDeg_f32 SrlComInput2.SrlComPrkAstInvalid.Cnt_lgc SrlComInput2.SrlComReturnScaleFactor.Uls_f32 SrlComInput2.SrlComRevOffsetSts.Cnt_u08 SrlComInput2.SrlComVehDrvCondition.Cnt_u08 SrlComInput2.SrlComVehLatAccel.MpSecSq_f32 SrlComInput2.SrlComVehLatAccelValid.Cnt_lgc SrlComInput2.SrlComVehNearStandstill.Cnt_u08 SrlComInput2.SrlComVehSpd.Kph_f32 SrlComInput2.SrlComVehYawRate.DegpS_f32 SrlComInput2.SrlComVehYawRateValid.Cnt_lgc SrlComInput2.SrlCom_QU_V_VEH_COG.Cnt_u08 SrlComInput2.TJADampSclRqst.Uls_f32 SrlComInput2.VehSpdValid.Cnt_lgc /end SUB_GROUP
 /begin FUNCTION_LIST /end FUNCTION_LIST
 /begin REF_CHARACTERISTIC /end REF_CHARACTERISTIC
 /begin REF_MEASUREMENT /end REF_MEASUREMENT
/end GROUP
/begin GROUP SrlComInput2.SerlComTarSteerTqDrvrActr.MtrNm_f32 "MICROSAR RTE" /begin SUB_GROUP /end SUB_GROUP /begin FUNCTION_LIST /end FUNCTION_LIST /begin REF_CHARACTERISTIC /end REF_CHARACTERISTIC /begin REF_MEASUREMENT SrlComInput2.SerlComTarSteerTqDrvrActr.MtrNm_f32 /end REF_MEASUREMENT /end GROUP
/begin GROUP SrlComInput2.SrlComAssistScaleFactor.Uls_f32 "MICROSAR RTE" /begin SUB_GROUP /end SUB_GROUP /begin FUNCTION_LIST /end FUNCTION_LIST /begin REF_CHARACTERISTIC /end REF_CHARACTERISTIC /begin REF_MEASUREMENT SrlComInput2.SrlComAssistScaleFactor.Uls_f32 /end REF_MEASUREMENT /end GROUP
/begin GROUP SrlComInput2.SrlComCRFRevOffset.Rev_s16 "MICROSAR RTE" /begin SUB_GROUP /end SUB_GROUP /begin FUNCTION_LIST /end FUNCTION_LIST /begin REF_CHARACTERISTIC /end REF_CHARACTERISTIC /begin REF_MEASUREMENT SrlComInput2.SrlComCRFRevOffset.Rev_s16 /end REF_MEASUREMENT /end GROUP
/begin GROUP SrlComInput2.SrlComDampingScaleFactor.Uls_f32 "MICROSAR RTE" /begin SUB_GROUP /end SUB_GROUP /begin FUNCTION_LIST /end FUNCTION_LIST /begin REF_CHARACTERISTIC /end REF_CHARACTERISTIC /begin REF_MEASUREMENT SrlComInput2.SrlComDampingScaleFactor.Uls_f32 /end REF_MEASUREMENT /end GROUP
/begin GROUP SrlComInput2.SrlComDrvDynEnable.Cnt_lgc "MICROSAR RTE" /begin SUB_GROUP /end SUB_GROUP /begin FUNCTION_LIST /end FUNCTION_LIST /begin REF_CHARACTERISTIC /end REF_CHARACTERISTIC /begin REF_MEASUREMENT SrlComInput2.SrlComDrvDynEnable.Cnt_lgc /end REF_MEASUREMENT /end GROUP
/begin GROUP SrlComInput2.SrlComDrvDynInvalid.Cnt_lgc "MICROSAR RTE" /begin SUB_GROUP /end SUB_GROUP /begin FUNCTION_LIST /end FUNCTION_LIST /begin REF_CHARACTERISTIC /end REF_CHARACTERISTIC /begin REF_MEASUREMENT SrlComInput2.SrlComDrvDynInvalid.Cnt_lgc /end REF_MEASUREMENT /end GROUP
/begin GROUP SrlComInput2.SrlComEngCrank.Cnt_lgc "MICROSAR RTE" /begin SUB_GROUP /end SUB_GROUP /begin FUNCTION_LIST /end FUNCTION_LIST /begin REF_CHARACTERISTIC /end REF_CHARACTERISTIC /begin REF_MEASUREMENT SrlComInput2.SrlComEngCrank.Cnt_lgc /end REF_MEASUREMENT /end GROUP
/begin GROUP SrlComInput2.SrlComInputTorqueOverlay.HwNm_f32 "MICROSAR RTE" /begin SUB_GROUP /end SUB_GROUP /begin FUNCTION_LIST /end FUNCTION_LIST /begin REF_CHARACTERISTIC /end REF_CHARACTERISTIC /begin REF_MEASUREMENT SrlComInput2.SrlComInputTorqueOverlay.HwNm_f32 /end REF_MEASUREMENT /end GROUP
/begin GROUP SrlComInput2.SrlComPrkAstHwAngle.HwDeg_f32 "MICROSAR RTE" /begin SUB_GROUP /end SUB_GROUP /begin FUNCTION_LIST /end FUNCTION_LIST /begin REF_CHARACTERISTIC /end REF_CHARACTERISTIC /begin REF_MEASUREMENT SrlComInput2.SrlComPrkAstHwAngle.HwDeg_f32 /end REF_MEASUREMENT /end GROUP
/begin GROUP SrlComInput2.SrlComPrkAstInvalid.Cnt_lgc "MICROSAR RTE" /begin SUB_GROUP /end SUB_GROUP /begin FUNCTION_LIST /end FUNCTION_LIST /begin REF_CHARACTERISTIC /end REF_CHARACTERISTIC /begin REF_MEASUREMENT SrlComInput2.SrlComPrkAstInvalid.Cnt_lgc /end REF_MEASUREMENT /end GROUP
/begin GROUP SrlComInput2.SrlComReturnScaleFactor.Uls_f32 "MICROSAR RTE" /begin SUB_GROUP /end SUB_GROUP /begin FUNCTION_LIST /end FUNCTION_LIST /begin REF_CHARACTERISTIC /end REF_CHARACTERISTIC /begin REF_MEASUREMENT SrlComInput2.SrlComReturnScaleFactor.Uls_f32 /end REF_MEASUREMENT /end GROUP
/begin GROUP SrlComInput2.SrlComRevOffsetSts.Cnt_u08 "MICROSAR RTE" /begin SUB_GROUP /end SUB_GROUP /begin FUNCTION_LIST /end FUNCTION_LIST /begin REF_CHARACTERISTIC /end REF_CHARACTERISTIC /begin REF_MEASUREMENT SrlComInput2.SrlComRevOffsetSts.Cnt_u08 /end REF_MEASUREMENT /end GROUP
/begin GROUP SrlComInput2.SrlComSGOFFSQUADEPS.SG_OFFS_QUAD_EPS "MICROSAR RTE" /begin SUB_GROUP /end SUB_GROUP /begin FUNCTION_LIST /end FUNCTION_LIST /begin REF_CHARACTERISTIC /end REF_CHARACTERISTIC
 /begin REF_MEASUREMENT SrlComInput2.SrlComSGOFFSQUADEPS.SG_OFFS_QUAD_EPS.ALIV_OFFS_QUAD_EPS SrlComInput2.SrlComSGOFFSQUADEPS.SG_OFFS_QUAD_EPS.AVL_PO_IDX_ICM SrlComInput2.SrlComSGOFFSQUADEPS.SG_OFFS_QUAD_EPS.CRC_OFFS_QUAD_EPS SrlComInput2.SrlComSGOFFSQUADEPS.SG_OFFS_QUAD_EPS.OFFS_QUAD_RTR_EPS SrlComInput2.SrlComSGOFFSQUADEPS.SG_OFFS_QUAD_EPS.ST_OFFS_QUAD_EPS /end REF_MEASUREMENT
/end GROUP
/begin GROUP SrlComInput2.SrlComSGTARQTASTRMOMDV.SG_TAR_QTA_STRMOM_DV "MICROSAR RTE" /begin SUB_GROUP /end SUB_GROUP /begin FUNCTION_LIST /end FUNCTION_LIST /begin REF_CHARACTERISTIC /end REF_CHARACTERISTIC
 /begin REF_MEASUREMENT SrlComInput2.SrlComSGTARQTASTRMOMDV.SG_TAR_QTA_STRMOM_DV.ALIV_TAR_QTA_STMOM_DV SrlComInput2.SrlComSGTARQTASTRMOMDV.SG_TAR_QTA_STRMOM_DV.CRC_TAR_QTA_STMOM_DV SrlComInput2.SrlComSGTARQTASTRMOMDV.SG_TAR_QTA_STRMOM_DV.CTR_DEAC_EPS_FNS SrlComInput2.SrlComSGTARQTASTRMOMDV.SG_TAR_QTA_STRMOM_DV.FACT_ASS_STMOM_FTAX SrlComInput2.SrlComSGTARQTASTRMOMDV.SG_TAR_QTA_STRMOM_DV.FACT_CTRR_STMOM_FTAX SrlComInput2.SrlComSGTARQTASTRMOMDV.SG_TAR_QTA_STRMOM_DV.FACT_DMPNG_STMOM_FTAX SrlComInput2.SrlComSGTARQTASTRMOMDV.SG_TAR_QTA_STRMOM_DV.QU_TAR_FACT_STMOM_FTAX SrlComInput2.SrlComSGTARQTASTRMOMDV.SG_TAR_QTA_STRMOM_DV.QU_TAR_QTA_STMOM_DV SrlComInput2.SrlComSGTARQTASTRMOMDV.SG_TAR_QTA_STRMOM_DV.TAR_QTA_STMOM_DV /end REF_MEASUREMENT
/end GROUP
/begin GROUP SrlComInput2.SrlComSGTARSTMOMDVACT.SG_TAR_STMOM_DV_ACT "MICROSAR RTE" /begin SUB_GROUP /end SUB_GROUP /begin FUNCTION_LIST /end FUNCTION_LIST /begin REF_CHARACTERISTIC /end REF_CHARACTERISTIC
 /begin REF_MEASUREMENT SrlComInput2.SrlComSGTARSTMOMDVACT.SG_TAR_STMOM_DV_ACT.ALIV_TAR_STMOM_DV_ACT SrlComInput2.SrlComSGTARSTMOMDVACT.SG_TAR_STMOM_DV_ACT.CRC_TAR_STMOM_DV_ACT SrlComInput2.SrlComSGTARSTMOMDVACT.SG_TAR_STMOM_DV_ACT.FACT_DMPNG_ADDON_STMOM_FTAX SrlComInput2.SrlComSGTARSTMOMDVACT.SG_TAR_STMOM_DV_ACT.QU_TAR_DMPNG_ADDON_STMOM_FTAX SrlComInput2.SrlComSGTARSTMOMDVACT.SG_TAR_STMOM_DV_ACT.QU_TAR_STMOM_DV_ACT SrlComInput2.SrlComSGTARSTMOMDVACT.SG_TAR_STMOM_DV_ACT.TAR_STMOM_DV_ACT /end REF_MEASUREMENT
/end GROUP
/begin GROUP SrlComInput2.SrlComSGVVEH.SG_V_VEH "MICROSAR RTE" /begin SUB_GROUP /end SUB_GROUP /begin FUNCTION_LIST /end FUNCTION_LIST /begin REF_CHARACTERISTIC /end REF_CHARACTERISTIC
 /begin REF_MEASUREMENT SrlComInput2.SrlComSGVVEH.SG_V_VEH.ALIV_V_VEH SrlComInput2.SrlComSGVVEH.SG_V_VEH.CRC_V_VEH SrlComInput2.SrlComSGVVEH.SG_V_VEH.DVCO_VEH SrlComInput2.SrlComSGVVEH.SG_V_VEH.QU_V_VEH_COG SrlComInput2.SrlComSGVVEH.SG_V_VEH.ST_V_VEH_NSS SrlComInput2.SrlComSGVVEH.SG_V_VEH.V_VEH_0x27_0x01 SrlComInput2.SrlComSGVVEH.SG_V_VEH.V_VEH_COG /end REF_MEASUREMENT
/end GROUP
/begin GROUP SrlComInput2.SrlComSvcDft.Cnt_b32 "MICROSAR RTE" /begin SUB_GROUP /end SUB_GROUP /begin FUNCTION_LIST /end FUNCTION_LIST /begin REF_CHARACTERISTIC /end REF_CHARACTERISTIC /begin REF_MEASUREMENT SrlComInput2.SrlComSvcDft.Cnt_b32 /end REF_MEASUREMENT /end GROUP
/begin GROUP SrlComInput2.SrlComVehDrvCondition.Cnt_u08 "MICROSAR RTE" /begin SUB_GROUP /end SUB_GROUP /begin FUNCTION_LIST /end FUNCTION_LIST /begin REF_CHARACTERISTIC /end REF_CHARACTERISTIC /begin REF_MEASUREMENT SrlComInput2.SrlComVehDrvCondition.Cnt_u08 /end REF_MEASUREMENT /end GROUP
/begin GROUP SrlComInput2.SrlComVehLatAccel.MpSecSq_f32 "MICROSAR RTE" /begin SUB_GROUP /end SUB_GROUP /begin FUNCTION_LIST /end FUNCTION_LIST /begin REF_CHARACTERISTIC /end REF_CHARACTERISTIC /begin REF_MEASUREMENT SrlComInput2.SrlComVehLatAccel.MpSecSq_f32 /end REF_MEASUREMENT /end GROUP
/begin GROUP SrlComInput2.SrlComVehLatAccelValid.Cnt_lgc "MICROSAR RTE" /begin SUB_GROUP /end SUB_GROUP /begin FUNCTION_LIST /end FUNCTION_LIST /begin REF_CHARACTERISTIC /end REF_CHARACTERISTIC /begin REF_MEASUREMENT SrlComInput2.SrlComVehLatAccelValid.Cnt_lgc /end REF_MEASUREMENT /end GROUP
/begin GROUP SrlComInput2.SrlComVehNearStandstill.Cnt_u08 "MICROSAR RTE" /begin SUB_GROUP /end SUB_GROUP /begin FUNCTION_LIST /end FUNCTION_LIST /begin REF_CHARACTERISTIC /end REF_CHARACTERISTIC /begin REF_MEASUREMENT SrlComInput2.SrlComVehNearStandstill.Cnt_u08 /end REF_MEASUREMENT /end GROUP
/begin GROUP SrlComInput2.SrlComVehSpd.Kph_f32 "MICROSAR RTE" /begin SUB_GROUP /end SUB_GROUP /begin FUNCTION_LIST /end FUNCTION_LIST /begin REF_CHARACTERISTIC /end REF_CHARACTERISTIC /begin REF_MEASUREMENT SrlComInput2.SrlComVehSpd.Kph_f32 /end REF_MEASUREMENT /end GROUP
/begin GROUP SrlComInput2.SrlComVehYawRate.DegpS_f32 "MICROSAR RTE" /begin SUB_GROUP /end SUB_GROUP /begin FUNCTION_LIST /end FUNCTION_LIST /begin REF_CHARACTERISTIC /end REF_CHARACTERISTIC /begin REF_MEASUREMENT SrlComInput2.SrlComVehYawRate.DegpS_f32 /end REF_MEASUREMENT /end GROUP
/begin GROUP SrlComInput2.SrlComVehYawRateValid.Cnt_lgc "MICROSAR RTE" /begin SUB_GROUP /end SUB_GROUP /begin FUNCTION_LIST /end FUNCTION_LIST /begin REF_CHARACTERISTIC /end REF_CHARACTERISTIC /begin REF_MEASUREMENT SrlComInput2.SrlComVehYawRateValid.Cnt_lgc /end REF_MEASUREMENT /end GROUP
/begin GROUP SrlComInput2.SrlCom_QU_V_VEH_COG.Cnt_u08 "MICROSAR RTE" /begin SUB_GROUP /end SUB_GROUP /begin FUNCTION_LIST /end FUNCTION_LIST /begin REF_CHARACTERISTIC /end REF_CHARACTERISTIC /begin REF_MEASUREMENT SrlComInput2.SrlCom_QU_V_VEH_COG.Cnt_u08 /end REF_MEASUREMENT /end GROUP
/begin GROUP SrlComInput2.TJADampSclRqst.Uls_f32 "MICROSAR RTE" /begin SUB_GROUP /end SUB_GROUP /begin FUNCTION_LIST /end FUNCTION_LIST /begin REF_CHARACTERISTIC /end REF_CHARACTERISTIC /begin REF_MEASUREMENT SrlComInput2.TJADampSclRqst.Uls_f32 /end REF_MEASUREMENT /end GROUP
/begin GROUP SrlComInput2.VehSpdValid.Cnt_lgc "MICROSAR RTE" /begin SUB_GROUP /end SUB_GROUP /begin FUNCTION_LIST /end FUNCTION_LIST /begin REF_CHARACTERISTIC /end REF_CHARACTERISTIC /begin REF_MEASUREMENT SrlComInput2.VehSpdValid.Cnt_lgc /end REF_MEASUREMENT /end GROUP
/begin GROUP SrlComInput2.VehicleSpeed.Kph_f32 "MICROSAR RTE" /begin SUB_GROUP /end SUB_GROUP /begin FUNCTION_LIST /end FUNCTION_LIST /begin REF_CHARACTERISTIC /end REF_CHARACTERISTIC /begin REF_MEASUREMENT SrlComInput2.VehicleSpeed.Kph_f32 /end REF_MEASUREMENT /end GROUP
/begin GROUP SrlComOutput "MICROSAR RTE"
 /begin SUB_GROUP SrlComOutput.ModeRequirePorts SrlComOutput.ReceiverPorts SrlComOutput.SenderPorts /end SUB_GROUP
 /begin FUNCTION_LIST /end FUNCTION_LIST
 /begin REF_CHARACTERISTIC /end REF_CHARACTERISTIC
 /begin REF_MEASUREMENT /end REF_MEASUREMENT
/end GROUP
/begin GROUP SrlComOutput.AVLFORCGRDTxConf.Cnt_lgc "MICROSAR RTE" /begin SUB_GROUP /end SUB_GROUP /begin FUNCTION_LIST /end FUNCTION_LIST /begin REF_CHARACTERISTIC /end REF_CHARACTERISTIC /begin REF_MEASUREMENT SrlComOutput.AVLFORCGRDTxConf.Cnt_lgc /end REF_MEASUREMENT /end GROUP
/begin GROUP SrlComOutput.AVLSTMOMTxConf.Cnt_lgc "MICROSAR RTE" /begin SUB_GROUP /end SUB_GROUP /begin FUNCTION_LIST /end FUNCTION_LIST /begin REF_CHARACTERISTIC /end REF_CHARACTERISTIC /begin REF_MEASUREMENT SrlComOutput.AVLSTMOMTxConf.Cnt_lgc /end REF_MEASUREMENT /end GROUP
/begin GROUP SrlComOutput.AVL_PO_EPS.AVL_PO_EPS "MICROSAR RTE" /begin SUB_GROUP /end SUB_GROUP /begin FUNCTION_LIST /end FUNCTION_LIST /begin REF_CHARACTERISTIC /end REF_CHARACTERISTIC
 /begin REF_MEASUREMENT Com_ALIV_AVL_PO_EPS__AVL_PO_EPS Com_AVL_PO_EPS__AVL_PO_EPS Com_AVL_PO_IDX_EPS__AVL_PO_EPS Com_CRC_AVL_PO_EPS__AVL_PO_EPS Com_IDX_TORQ_SEN__AVL_PO_EPS Com_OFFS_GRD_MID_EPS__AVL_PO_EPS Com_QU_AVL_PO_EPS__AVL_PO_EPS Com_UN_PO_EPS__AVL_PO_EPS /end REF_MEASUREMENT
/end GROUP
/begin GROUP SrlComOutput.AVL_STMOM.AVL_FORC_GRD "MICROSAR RTE" /begin SUB_GROUP /end SUB_GROUP /begin FUNCTION_LIST /end FUNCTION_LIST /begin REF_CHARACTERISTIC /end REF_CHARACTERISTIC
 /begin REF_MEASUREMENT Com_ALIV_AVL_FORC_GRD__AVL_FORC_GRD Com_AVL_FORC_GRD_0x0C_0x04__AVL_FORC_GRD Com_AVL_FORC_GRD__AVL_FORC_GRD Com_AVL_PWR_EL_EPS_COOD__AVL_FORC_GRD Com_CRC_AVL_FORC_GRD__AVL_FORC_GRD Com_QU_AVL_FORC_GRD__AVL_FORC_GRD /end REF_MEASUREMENT
/end GROUP
/begin GROUP SrlComOutput.AVL_STMOM.AVL_STMOM_DV_ACT "MICROSAR RTE" /begin SUB_GROUP /end SUB_GROUP /begin FUNCTION_LIST /end FUNCTION_LIST /begin REF_CHARACTERISTIC /end REF_CHARACTERISTIC
 /begin REF_MEASUREMENT Com_ALIV_AVL_STMOM_DV_ACT__AVL_STMOM_DV_ACT Com_AVL_STMOM_DV_ACT_0x0C_0x04__AVL_STMOM_DV_ACT Com_AVL_STMOM_DV_ACT__AVL_STMOM_DV_ACT Com_CRC_AVL_STMOM_DV_ACT__AVL_STMOM_DV_ACT Com_QU_AVL_STMOM_DV_ACT__AVL_STMOM_DV_ACT /end REF_MEASUREMENT
/end GROUP
/begin GROUP SrlComOutput.CtrlTempFinal.DegC_f32 "MICROSAR RTE" /begin SUB_GROUP /end SUB_GROUP /begin FUNCTION_LIST /end FUNCTION_LIST /begin REF_CHARACTERISTIC /end REF_CHARACTERISTIC /begin REF_MEASUREMENT SrlComOutput.CtrlTempFinal.DegC_f32 /end REF_MEASUREMENT /end GROUP
/begin GROUP SrlComOutput.CuTempEst.DegC_f32 "MICROSAR RTE" /begin SUB_GROUP /end SUB_GROUP /begin FUNCTION_LIST /end FUNCTION_LIST /begin REF_CHARACTERISTIC /end REF_CHARACTERISTIC /begin REF_MEASUREMENT SrlComOutput.CuTempEst.DegC_f32 /end REF_MEASUREMENT /end GROUP
/begin GROUP SrlComOutput.EcuM_CurrentMode.currentMode "MICROSAR RTE" /begin SUB_GROUP /end SUB_GROUP /begin FUNCTION_LIST /end FUNCTION_LIST /begin REF_CHARACTERISTIC /end REF_CHARACTERISTIC /begin REF_MEASUREMENT SrlComOutput.EcuM_CurrentMode.currentMode /end REF_MEASUREMENT /end GROUP
/begin GROUP SrlComOutput.EpsOpTrq.MtrNm_f32 "MICROSAR RTE" /begin SUB_GROUP /end SUB_GROUP /begin FUNCTION_LIST /end FUNCTION_LIST /begin REF_CHARACTERISTIC /end REF_CHARACTERISTIC /begin REF_MEASUREMENT SrlComOutput.EpsOpTrq.MtrNm_f32 /end REF_MEASUREMENT /end GROUP
/begin GROUP SrlComOutput.EstBattCurr.Amp_f32 "MICROSAR RTE" /begin SUB_GROUP /end SUB_GROUP /begin FUNCTION_LIST /end FUNCTION_LIST /begin REF_CHARACTERISTIC /end REF_CHARACTERISTIC /begin REF_MEASUREMENT SrlComOutput.EstBattCurr.Amp_f32 /end REF_MEASUREMENT /end GROUP
/begin GROUP SrlComOutput.FR_DBG_EPS.Batt "MICROSAR RTE" /begin SUB_GROUP /end SUB_GROUP /begin FUNCTION_LIST /end FUNCTION_LIST /begin REF_CHARACTERISTIC /end REF_CHARACTERISTIC /begin REF_MEASUREMENT Com_BATT_VOLTS__DBG_EPS_BS_MOD_58_BYTE /end REF_MEASUREMENT /end GROUP
/begin GROUP SrlComOutput.FR_DBG_EPS.CtrlTemp "MICROSAR RTE" /begin SUB_GROUP /end SUB_GROUP /begin FUNCTION_LIST /end FUNCTION_LIST /begin REF_CHARACTERISTIC /end REF_CHARACTERISTIC /begin REF_MEASUREMENT Com_CONT_TEMP_DEG__DBG_EPS_BS_MOD_58_BYTE /end REF_MEASUREMENT /end GROUP
/begin GROUP SrlComOutput.FR_DBG_EPS.DiffTrq "MICROSAR RTE" /begin SUB_GROUP /end SUB_GROUP /begin FUNCTION_LIST /end FUNCTION_LIST /begin REF_CHARACTERISTIC /end REF_CHARACTERISTIC /begin REF_MEASUREMENT Com_DIFF_TRQ_NM__DBG_EPS_BS_MOD_58_BYTE /end REF_MEASUREMENT /end GROUP
/begin GROUP SrlComOutput.FR_DBG_EPS.EstBattCurr "MICROSAR RTE" /begin SUB_GROUP /end SUB_GROUP /begin FUNCTION_LIST /end FUNCTION_LIST /begin REF_CHARACTERISTIC /end REF_CHARACTERISTIC /begin REF_MEASUREMENT Com_EST_BATT_AMPS__DBG_EPS_BS_MOD_58_BYTE /end REF_MEASUREMENT /end GROUP
/begin GROUP SrlComOutput.FR_DBG_EPS.EstCuTemp "MICROSAR RTE" /begin SUB_GROUP /end SUB_GROUP /begin FUNCTION_LIST /end FUNCTION_LIST /begin REF_CHARACTERISTIC /end REF_CHARACTERISTIC /begin REF_MEASUREMENT Com_EST_CUTEMP_DEG__DBG_EPS_BS_MOD_58_BYTE /end REF_MEASUREMENT /end GROUP
/begin GROUP SrlComOutput.FR_DBG_EPS.EstMtrTemp "MICROSAR RTE" /begin SUB_GROUP /end SUB_GROUP /begin FUNCTION_LIST /end FUNCTION_LIST /begin REF_CHARACTERISTIC /end REF_CHARACTERISTIC /begin REF_MEASUREMENT Com_EST_MOTTEMP_DEG__DBG_EPS_BS_MOD_58_BYTE /end REF_MEASUREMENT /end GROUP
/begin GROUP SrlComOutput.FR_DBG_EPS.MtrCurr "MICROSAR RTE" /begin SUB_GROUP /end SUB_GROUP /begin FUNCTION_LIST /end FUNCTION_LIST /begin REF_CHARACTERISTIC /end REF_CHARACTERISTIC /begin REF_MEASUREMENT Com_MTR_CURR_AMPS__DBG_EPS_BS_MOD_58_BYTE /end REF_MEASUREMENT /end GROUP
/begin GROUP SrlComOutput.FR_DBG_EPS.MtrTrqCmd "MICROSAR RTE" /begin SUB_GROUP /end SUB_GROUP /begin FUNCTION_LIST /end FUNCTION_LIST /begin REF_CHARACTERISTIC /end REF_CHARACTERISTIC /begin REF_MEASUREMENT Com_MTRTRQCMD_NM__DBG_EPS_BS_MOD_58_BYTE /end REF_MEASUREMENT /end GROUP
/begin GROUP SrlComOutput.FR_DBG_EPS.MtrTrqCmdLmtd "MICROSAR RTE" /begin SUB_GROUP /end SUB_GROUP /begin FUNCTION_LIST /end FUNCTION_LIST /begin REF_CHARACTERISTIC /end REF_CHARACTERISTIC /begin REF_MEASUREMENT Com_MTRTRQLMTD_NM__DBG_EPS_BS_MOD_58_BYTE /end REF_MEASUREMENT /end GROUP
/begin GROUP SrlComOutput.FR_DBG_EPS.MtrVel "MICROSAR RTE" /begin SUB_GROUP /end SUB_GROUP /begin FUNCTION_LIST /end FUNCTION_LIST /begin REF_CHARACTERISTIC /end REF_CHARACTERISTIC /begin REF_MEASUREMENT Com_MOT_VEL_RADPSEC__DBG_EPS_BS_MOD_58_BYTE /end REF_MEASUREMENT /end GROUP
/begin GROUP SrlComOutput.FR_DBG_EPS.NTCNumber "MICROSAR RTE" /begin SUB_GROUP /end SUB_GROUP /begin FUNCTION_LIST /end FUNCTION_LIST /begin REF_CHARACTERISTIC /end REF_CHARACTERISTIC /begin REF_MEASUREMENT Com_NTC_Number__DBG_EPS_BS_MOD_58_BYTE /end REF_MEASUREMENT /end GROUP
/begin GROUP SrlComOutput.FR_DBG_EPS.Res_TBD "MICROSAR RTE" /begin SUB_GROUP /end SUB_GROUP /begin FUNCTION_LIST /end FUNCTION_LIST /begin REF_CHARACTERISTIC /end REF_CHARACTERISTIC /begin REF_MEASUREMENT Com_RES_TBD__DBG_EPS_BS_MOD_58_BYTE /end REF_MEASUREMENT /end GROUP
/begin GROUP SrlComOutput.FR_DBG_EPS.SWA "MICROSAR RTE" /begin SUB_GROUP /end SUB_GROUP /begin FUNCTION_LIST /end FUNCTION_LIST /begin REF_CHARACTERISTIC /end REF_CHARACTERISTIC /begin REF_MEASUREMENT Com_SWA_DEG__DBG_EPS_BS_MOD_58_BYTE /end REF_MEASUREMENT /end GROUP
/begin GROUP SrlComOutput.FR_DBG_EPS.SystemState "MICROSAR RTE" /begin SUB_GROUP /end SUB_GROUP /begin FUNCTION_LIST /end FUNCTION_LIST /begin REF_CHARACTERISTIC /end REF_CHARACTERISTIC /begin REF_MEASUREMENT Com_SYS_STATE_ENUM__DBG_EPS_BS_MOD_58_BYTE /end REF_MEASUREMENT /end GROUP
/begin GROUP SrlComOutput.FR_DBG_EPS.Trq1 "MICROSAR RTE" /begin SUB_GROUP /end SUB_GROUP /begin FUNCTION_LIST /end FUNCTION_LIST /begin REF_CHARACTERISTIC /end REF_CHARACTERISTIC /begin REF_MEASUREMENT Com_TORQUE1_VOLTS__DBG_EPS_BS_MOD_58_BYTE /end REF_MEASUREMENT /end GROUP
/begin GROUP SrlComOutput.FR_DBG_EPS.Trq2 "MICROSAR RTE" /begin SUB_GROUP /end SUB_GROUP /begin FUNCTION_LIST /end FUNCTION_LIST /begin REF_CHARACTERISTIC /end REF_CHARACTERISTIC /begin REF_MEASUREMENT Com_TORQUE2_VOLTS__DBG_EPS_BS_MOD_58_BYTE /end REF_MEASUREMENT /end GROUP
/begin GROUP SrlComOutput.FinHwPos.HwDeg_f32 "MICROSAR RTE" /begin SUB_GROUP /end SUB_GROUP /begin FUNCTION_LIST /end FUNCTION_LIST /begin REF_CHARACTERISTIC /end REF_CHARACTERISTIC /begin REF_MEASUREMENT SrlComOutput.FinHwPos.HwDeg_f32 /end REF_MEASUREMENT /end GROUP
/begin GROUP SrlComOutput.HwTrq.HwNm_f32 "MICROSAR RTE" /begin SUB_GROUP /end SUB_GROUP /begin FUNCTION_LIST /end FUNCTION_LIST /begin REF_CHARACTERISTIC /end REF_CHARACTERISTIC /begin REF_MEASUREMENT SrlComOutput.HwTrq.HwNm_f32 /end REF_MEASUREMENT /end GROUP
/begin GROUP SrlComOutput.MagTempEst.DegC_f32 "MICROSAR RTE" /begin SUB_GROUP /end SUB_GROUP /begin FUNCTION_LIST /end FUNCTION_LIST /begin REF_CHARACTERISTIC /end REF_CHARACTERISTIC /begin REF_MEASUREMENT SrlComOutput.MagTempEst.DegC_f32 /end REF_MEASUREMENT /end GROUP
/begin GROUP SrlComOutput.ModeRequirePorts "MICROSAR RTE"
 /begin SUB_GROUP SrlComOutput.EcuM_CurrentMode.currentMode SrlComOutput.SystemState.Mode /end SUB_GROUP
 /begin FUNCTION_LIST /end FUNCTION_LIST
 /begin REF_CHARACTERISTIC /end REF_CHARACTERISTIC
 /begin REF_MEASUREMENT /end REF_MEASUREMENT
/end GROUP
/begin GROUP SrlComOutput.MtrCurrQax.Amp_f32 "MICROSAR RTE" /begin SUB_GROUP /end SUB_GROUP /begin FUNCTION_LIST /end FUNCTION_LIST /begin REF_CHARACTERISTIC /end REF_CHARACTERISTIC /begin REF_MEASUREMENT SrlComOutput.MtrCurrQax.Amp_f32 /end REF_MEASUREMENT /end GROUP
/begin GROUP SrlComOutput.MtrTrqCmd.MtrNm_f32 "MICROSAR RTE" /begin SUB_GROUP /end SUB_GROUP /begin FUNCTION_LIST /end FUNCTION_LIST /begin REF_CHARACTERISTIC /end REF_CHARACTERISTIC /begin REF_MEASUREMENT SrlComOutput.MtrTrqCmd.MtrNm_f32 /end REF_MEASUREMENT /end GROUP
/begin GROUP SrlComOutput.MtrVel.MtrRadpS_f32 "MICROSAR RTE" /begin SUB_GROUP /end SUB_GROUP /begin FUNCTION_LIST /end FUNCTION_LIST /begin REF_CHARACTERISTIC /end REF_CHARACTERISTIC /begin REF_MEASUREMENT SrlComOutput.MtrVel.MtrRadpS_f32 /end REF_MEASUREMENT /end GROUP
/begin GROUP SrlComOutput.ReceiverPorts "MICROSAR RTE"
 /begin SUB_GROUP SrlComOutput.CtrlTempFinal.DegC_f32 SrlComOutput.CuTempEst.DegC_f32 SrlComOutput.EpsOpTrq.MtrNm_f32 SrlComOutput.EstBattCurr.Amp_f32 SrlComOutput.FinHwPos.HwDeg_f32 SrlComOutput.HwTrq.HwNm_f32 SrlComOutput.MagTempEst.DegC_f32 SrlComOutput.MtrCurrQax.Amp_f32 SrlComOutput.MtrTrqCmd.MtrNm_f32 SrlComOutput.MtrVel.MtrRadpS_f32 SrlComOutput.SG_ANFRAGE_DSC_Modul.SG_ANFRAGE_DSC_Modul SrlComOutput.SG_ANFRAGE_SAS.SG_ANFRAGE_SAS SrlComOutput.SG_ANFRAGE_ZGW.SG_ANFRAGE_ZGW SrlComOutput.SrlComAVLPOEPS.AVL_PO_EPS SrlComOutput.SrlComAVLSTMOM.AVL_FORC_GRD SrlComOutput.SrlComAVLSTMOM.AVL_STMOM_DV_ACT SrlComOutput.SrlComSTEST.ST_EST SrlComOutput.SrlComSUEPS.SU_EPS SrlComOutput.T1ADC.Volt_f32 SrlComOutput.T2ADC.Volt_f32 SrlComOutput.ThermLimitPerc.Uls_f32 SrlComOutput.TxDebugMsgEn.Cnt_lgc SrlComOutput.Vecu.Volt_f32 /end SUB_GROUP
 /begin FUNCTION_LIST /end FUNCTION_LIST
 /begin REF_CHARACTERISTIC /end REF_CHARACTERISTIC
 /begin REF_MEASUREMENT /end REF_MEASUREMENT
/end GROUP
/begin GROUP SrlComOutput.SG_ANFRAGE_DSC_Modul.SG_ANFRAGE_DSC_Modul "MICROSAR RTE" /begin SUB_GROUP /end SUB_GROUP /begin FUNCTION_LIST /end FUNCTION_LIST /begin REF_CHARACTERISTIC /end REF_CHARACTERISTIC
 /begin REF_MEASUREMENT Com_ID2_0x08_Mx01_DSC_Modul__ANFRAGE_DSC_Modul Com_ID_FN_INQY_DSC_Modul__ANFRAGE_DSC_Modul /end REF_MEASUREMENT
/end GROUP
/begin GROUP SrlComOutput.SG_ANFRAGE_SAS.SG_ANFRAGE_SAS "MICROSAR RTE" /begin SUB_GROUP /end SUB_GROUP /begin FUNCTION_LIST /end FUNCTION_LIST /begin REF_CHARACTERISTIC /end REF_CHARACTERISTIC
 /begin REF_MEASUREMENT Com_ID2_0x08_Mx01_SAS__ANFRAGE_SAS Com_ID_FN_INQY_SAS__ANFRAGE_SAS /end REF_MEASUREMENT
/end GROUP
/begin GROUP SrlComOutput.SG_ANFRAGE_ZGW.SG_ANFRAGE_ZGW "MICROSAR RTE" /begin SUB_GROUP /end SUB_GROUP /begin FUNCTION_LIST /end FUNCTION_LIST /begin REF_CHARACTERISTIC /end REF_CHARACTERISTIC
 /begin REF_MEASUREMENT Com_ID2_0x08_Mx01_ZGW__ANFRAGE_ZGW Com_ID_FN_INQY_ZGW__ANFRAGE_ZGW /end REF_MEASUREMENT
/end GROUP
/begin GROUP SrlComOutput.ST_EST.ST_EST "MICROSAR RTE" /begin SUB_GROUP /end SUB_GROUP /begin FUNCTION_LIST /end FUNCTION_LIST /begin REF_CHARACTERISTIC /end REF_CHARACTERISTIC
 /begin REF_MEASUREMENT Com_ALIV_ST_EST_FTAX__ST_EST Com_CRC_ST_EST_FTAX__ST_EST Com_QU_FN_EST__ST_EST Com_QU_FN_VIB_EPS__ST_EST Com_QU_SER_STMOM_DV_ACT__ST_EST Com_ST_EST_0x10_0x08__ST_EST /end REF_MEASUREMENT
/end GROUP
/begin GROUP SrlComOutput.SU_EPS.SU_EPS "MICROSAR RTE" /begin SUB_GROUP /end SUB_GROUP /begin FUNCTION_LIST /end FUNCTION_LIST /begin REF_CHARACTERISTIC /end REF_CHARACTERISTIC
 /begin REF_MEASUREMENT Com_ALIV_SU_EPS__SU_EPS Com_CRC_SU_EPS__SU_EPS Com_SU_EPS_0x0E_0x20__SU_EPS Com_SU_EPS_0x2E_0x06__SU_EPS Com_TOT_STR_EPS__SU_EPS Com_UN_TOT_STR_EPS__SU_EPS /end REF_MEASUREMENT
/end GROUP
/begin GROUP SrlComOutput.SenderPorts "MICROSAR RTE"
 /begin SUB_GROUP SrlComOutput.AVLFORCGRDTxConf.Cnt_lgc SrlComOutput.AVLSTMOMTxConf.Cnt_lgc SrlComOutput.AVL_PO_EPS.AVL_PO_EPS SrlComOutput.AVL_STMOM.AVL_FORC_GRD SrlComOutput.AVL_STMOM.AVL_STMOM_DV_ACT SrlComOutput.FR_DBG_EPS.Batt SrlComOutput.FR_DBG_EPS.CtrlTemp SrlComOutput.FR_DBG_EPS.DiffTrq SrlComOutput.FR_DBG_EPS.EstBattCurr SrlComOutput.FR_DBG_EPS.EstCuTemp SrlComOutput.FR_DBG_EPS.EstMtrTemp SrlComOutput.FR_DBG_EPS.MtrCurr SrlComOutput.FR_DBG_EPS.MtrTrqCmd SrlComOutput.FR_DBG_EPS.MtrTrqCmdLmtd SrlComOutput.FR_DBG_EPS.MtrVel SrlComOutput.FR_DBG_EPS.NTCNumber SrlComOutput.FR_DBG_EPS.Res_TBD SrlComOutput.FR_DBG_EPS.SWA SrlComOutput.FR_DBG_EPS.SystemState SrlComOutput.FR_DBG_EPS.Trq1 SrlComOutput.FR_DBG_EPS.Trq2 SrlComOutput.ST_EST.ST_EST SrlComOutput.SU_EPS.SU_EPS /end SUB_GROUP
 /begin FUNCTION_LIST /end FUNCTION_LIST
 /begin REF_CHARACTERISTIC /end REF_CHARACTERISTIC
 /begin REF_MEASUREMENT /end REF_MEASUREMENT
/end GROUP
/begin GROUP SrlComOutput.SrlComAVLPOEPS.AVL_PO_EPS "MICROSAR RTE" /begin SUB_GROUP /end SUB_GROUP /begin FUNCTION_LIST /end FUNCTION_LIST /begin REF_CHARACTERISTIC /end REF_CHARACTERISTIC
 /begin REF_MEASUREMENT SrlComOutput.SrlComAVLPOEPS.AVL_PO_EPS.ALIV_AVL_PO_EPS SrlComOutput.SrlComAVLPOEPS.AVL_PO_EPS.AVL_PO_EPS SrlComOutput.SrlComAVLPOEPS.AVL_PO_EPS.AVL_PO_IDX_EPS SrlComOutput.SrlComAVLPOEPS.AVL_PO_EPS.CRC_AVL_PO_EPS SrlComOutput.SrlComAVLPOEPS.AVL_PO_EPS.IDX_TORQ_SEN SrlComOutput.SrlComAVLPOEPS.AVL_PO_EPS.OFFS_GRD_MID_EPS SrlComOutput.SrlComAVLPOEPS.AVL_PO_EPS.QU_AVL_PO_EPS SrlComOutput.SrlComAVLPOEPS.AVL_PO_EPS.UN_PO_EPS /end REF_MEASUREMENT
/end GROUP
/begin GROUP SrlComOutput.SrlComAVLSTMOM.AVL_FORC_GRD "MICROSAR RTE" /begin SUB_GROUP /end SUB_GROUP /begin FUNCTION_LIST /end FUNCTION_LIST /begin REF_CHARACTERISTIC /end REF_CHARACTERISTIC
 /begin REF_MEASUREMENT SrlComOutput.SrlComAVLSTMOM.AVL_FORC_GRD.ALIV_AVL_FORC_GRD SrlComOutput.SrlComAVLSTMOM.AVL_FORC_GRD.AVL_FORC_GRD SrlComOutput.SrlComAVLSTMOM.AVL_FORC_GRD.AVL_FORC_GRD_0x0C_0x04 SrlComOutput.SrlComAVLSTMOM.AVL_FORC_GRD.AVL_PWR_EL_EPS_COOD SrlComOutput.SrlComAVLSTMOM.AVL_FORC_GRD.CRC_AVL_FORC_GRD SrlComOutput.SrlComAVLSTMOM.AVL_FORC_GRD.QU_AVL_FORC_GRD /end REF_MEASUREMENT
/end GROUP
/begin GROUP SrlComOutput.SrlComAVLSTMOM.AVL_STMOM_DV_ACT "MICROSAR RTE" /begin SUB_GROUP /end SUB_GROUP /begin FUNCTION_LIST /end FUNCTION_LIST /begin REF_CHARACTERISTIC /end REF_CHARACTERISTIC
 /begin REF_MEASUREMENT SrlComOutput.SrlComAVLSTMOM.AVL_STMOM_DV_ACT.ALIV_AVL_STMOM_DV_ACT SrlComOutput.SrlComAVLSTMOM.AVL_STMOM_DV_ACT.AVL_STMOM_DV_ACT SrlComOutput.SrlComAVLSTMOM.AVL_STMOM_DV_ACT.AVL_STMOM_DV_ACT_0x0C_0x04 SrlComOutput.SrlComAVLSTMOM.AVL_STMOM_DV_ACT.CRC_AVL_STMOM_DV_ACT SrlComOutput.SrlComAVLSTMOM.AVL_STMOM_DV_ACT.QU_AVL_STMOM_DV_ACT /end REF_MEASUREMENT
/end GROUP
/begin GROUP SrlComOutput.SrlComSTEST.ST_EST "MICROSAR RTE" /begin SUB_GROUP /end SUB_GROUP /begin FUNCTION_LIST /end FUNCTION_LIST /begin REF_CHARACTERISTIC /end REF_CHARACTERISTIC
 /begin REF_MEASUREMENT SrlComOutput.SrlComSTEST.ST_EST.ALIV_ST_EST_FTAX SrlComOutput.SrlComSTEST.ST_EST.CRC_ST_EST_FTAX SrlComOutput.SrlComSTEST.ST_EST.QU_FN_EST SrlComOutput.SrlComSTEST.ST_EST.QU_FN_VIB_EPS SrlComOutput.SrlComSTEST.ST_EST.QU_SER_STMOM_DV_ACT SrlComOutput.SrlComSTEST.ST_EST.ST_EST_0x10_0x08 /end REF_MEASUREMENT
/end GROUP
/begin GROUP SrlComOutput.SrlComSUEPS.SU_EPS "MICROSAR RTE" /begin SUB_GROUP /end SUB_GROUP /begin FUNCTION_LIST /end FUNCTION_LIST /begin REF_CHARACTERISTIC /end REF_CHARACTERISTIC
 /begin REF_MEASUREMENT SrlComOutput.SrlComSUEPS.SU_EPS.ALIV_SU_EPS SrlComOutput.SrlComSUEPS.SU_EPS.CRC_SU_EPS SrlComOutput.SrlComSUEPS.SU_EPS.SU_EPS_0x0E_0x20 SrlComOutput.SrlComSUEPS.SU_EPS.SU_EPS_0x2E_0x06 SrlComOutput.SrlComSUEPS.SU_EPS.TOT_STR_EPS SrlComOutput.SrlComSUEPS.SU_EPS.UN_TOT_STR_EPS /end REF_MEASUREMENT
/end GROUP
/begin GROUP SrlComOutput.SystemState.Mode "MICROSAR RTE" /begin SUB_GROUP /end SUB_GROUP /begin FUNCTION_LIST /end FUNCTION_LIST /begin REF_CHARACTERISTIC /end REF_CHARACTERISTIC /begin REF_MEASUREMENT SrlComOutput.SystemState.Mode /end REF_MEASUREMENT /end GROUP
/begin GROUP SrlComOutput.T1ADC.Volt_f32 "MICROSAR RTE" /begin SUB_GROUP /end SUB_GROUP /begin FUNCTION_LIST /end FUNCTION_LIST /begin REF_CHARACTERISTIC /end REF_CHARACTERISTIC /begin REF_MEASUREMENT SrlComOutput.T1ADC.Volt_f32 /end REF_MEASUREMENT /end GROUP
/begin GROUP SrlComOutput.T2ADC.Volt_f32 "MICROSAR RTE" /begin SUB_GROUP /end SUB_GROUP /begin FUNCTION_LIST /end FUNCTION_LIST /begin REF_CHARACTERISTIC /end REF_CHARACTERISTIC /begin REF_MEASUREMENT SrlComOutput.T2ADC.Volt_f32 /end REF_MEASUREMENT /end GROUP
/begin GROUP SrlComOutput.ThermLimitPerc.Uls_f32 "MICROSAR RTE" /begin SUB_GROUP /end SUB_GROUP /begin FUNCTION_LIST /end FUNCTION_LIST /begin REF_CHARACTERISTIC /end REF_CHARACTERISTIC /begin REF_MEASUREMENT SrlComOutput.ThermLimitPerc.Uls_f32 /end REF_MEASUREMENT /end GROUP
/begin GROUP SrlComOutput.TxDebugMsgEn.Cnt_lgc "MICROSAR RTE" /begin SUB_GROUP /end SUB_GROUP /begin FUNCTION_LIST /end FUNCTION_LIST /begin REF_CHARACTERISTIC /end REF_CHARACTERISTIC /begin REF_MEASUREMENT SrlComOutput.TxDebugMsgEn.Cnt_lgc /end REF_MEASUREMENT /end GROUP
/begin GROUP SrlComOutput.Vecu.Volt_f32 "MICROSAR RTE" /begin SUB_GROUP /end SUB_GROUP /begin FUNCTION_LIST /end FUNCTION_LIST /begin REF_CHARACTERISTIC /end REF_CHARACTERISTIC /begin REF_MEASUREMENT SrlComOutput.Vecu.Volt_f32 /end REF_MEASUREMENT /end GROUP
/begin GROUP SrlComOutput2 "MICROSAR RTE"
 /begin SUB_GROUP SrlComOutput2.ModeRequirePorts SrlComOutput2.ReceiverPorts SrlComOutput2.SenderPorts /end SUB_GROUP
 /begin FUNCTION_LIST /end FUNCTION_LIST
 /begin REF_CHARACTERISTIC /end REF_CHARACTERISTIC
 /begin REF_MEASUREMENT /end REF_MEASUREMENT
/end GROUP
/begin GROUP SrlComOutput2.AVLFORCGRDTxConf.Cnt_lgc "MICROSAR RTE" /begin SUB_GROUP /end SUB_GROUP /begin FUNCTION_LIST /end FUNCTION_LIST /begin REF_CHARACTERISTIC /end REF_CHARACTERISTIC /begin REF_MEASUREMENT SrlComOutput2.AVLFORCGRDTxConf.Cnt_lgc /end REF_MEASUREMENT /end GROUP
/begin GROUP SrlComOutput2.AVLSTMOMTxConf.Cnt_lgc "MICROSAR RTE" /begin SUB_GROUP /end SUB_GROUP /begin FUNCTION_LIST /end FUNCTION_LIST /begin REF_CHARACTERISTIC /end REF_CHARACTERISTIC /begin REF_MEASUREMENT SrlComOutput2.AVLSTMOMTxConf.Cnt_lgc /end REF_MEASUREMENT /end GROUP
/begin GROUP SrlComOutput2.CADASMSG.Cnt_lgc "MICROSAR RTE" /begin SUB_GROUP /end SUB_GROUP /begin FUNCTION_LIST /end FUNCTION_LIST /begin REF_CHARACTERISTIC /end REF_CHARACTERISTIC /begin REF_MEASUREMENT SrlComOutput2.CADASMSG.Cnt_lgc /end REF_MEASUREMENT /end GROUP
/begin GROUP SrlComOutput2.CDISPCCEPS.Cnt_u08 "MICROSAR RTE" /begin SUB_GROUP /end SUB_GROUP /begin FUNCTION_LIST /end FUNCTION_LIST /begin REF_CHARACTERISTIC /end REF_CHARACTERISTIC /begin REF_MEASUREMENT SrlComOutput2.CDISPCCEPS.Cnt_u08 /end REF_MEASUREMENT /end GROUP
/begin RECORD_LAYOUT RTE_RL_FLOAT32_IEEE FNC_VALUES 1 FLOAT32_IEEE ROW_DIR DIRECT /end RECORD_LAYOUT
/begin RECORD_LAYOUT RTE_RL_FLOAT64_IEEE FNC_VALUES 1 FLOAT64_IEEE ROW_DIR DIRECT /end RECORD_LAYOUT
/**********************************************************************************************************************
* COMPU_METHOD / COMPU_VTAB_RANGE
*********************************************************************************************************************/
/begin COMPU_METHOD RTE_CM_BOOLEAN "" TAB_VERB "%3.1" "" COMPU_TAB_REF RTE_CM_BOOLEAN /end COMPU_METHOD
/begin COMPU_VTAB_RANGE RTE_CM_BOOLEAN "" 2 0 0 "false" 1 255 "true" /end COMPU_VTAB_RANGE
/begin COMPU_METHOD RTE_CM_ENUM_ST_OFFS_QUAD_EPS "" TAB_VERB "%.1" "" COMPU_TAB_REF RTE_CM_ENUM_ST_OFFS_QUAD_EPS /end COMPU_METHOD
/begin COMPU_VTAB_RANGE RTE_CM_ENUM_ST_OFFS_QUAD_EPS "" 12 0 0 "STOFFSQUADEPS_SLEEP" 1 1 "STOFFSQUADEPS_CALCULATED" 2 2 "STOFFSQUADEPS_INDEX" 3 3 "STOFFSQUADEPS_MODELCOMP" 4 4 "STOFFSQUADEPS_LOCKTOLOCK" 5 5 "STOFFSQUADEPS_SUMSTEERINGANGLE" 6 6 "STOFFSQUADEPS_CHECK" 7 7 "STOFFSQUADEPS_CORRECTION" 8 8 "STOFFSQUADEPS_INITIALIZATION" 9 9 "STOFFSQUADEPS_DETERMINED" 11 11 "STOFFSQUADEPS_APPROXIMATED" 15 15 "STOFFSQUADEPS_INVALID" /end COMPU_VTAB_RANGE
/begin COMPU_METHOD RTE_CM_ENUM_StaMd_Mode "" TAB_VERB "%.1" "" COMPU_TAB_REF RTE_CM_ENUM_StaMd_Mode /end COMPU_METHOD
/begin COMPU_VTAB_RANGE RTE_CM_ENUM_StaMd_Mode "" 5 0 0 "RTE_MODE_StaMd_Mode_DISABLE" 1 1 "RTE_MODE_StaMd_Mode_OFF" 2 2 "RTE_MODE_StaMd_Mode_OPERATE" 3 3 "RTE_MODE_StaMd_Mode_WARMINIT" 4 4 "RTE_TRANSITION_StaMd_Mode" /end COMPU_VTAB_RANGE
/begin COMPU_METHOD RTE_CM_ENUM_QU_SER_STMOM_STMOM_DV_ACT "" TAB_VERB "%.1" "" COMPU_TAB_REF RTE_CM_ENUM_QU_SER_STMOM_STMOM_DV_ACT /end COMPU_METHOD
/begin COMPU_VTAB_RANGE RTE_CM_ENUM_QU_SER_STMOM_STMOM_DV_ACT "" 7 32 32 "Cx20_Schnittstelle_verfuegbar___funktionsbereit" 33 33 "Cx21_Schnittstelle_aktiv" 96 96 "Cx60_Service_nicht_verfuegbar___Fehler" 128 128 "Cx80_Schnittstelle_wird_initialisiert" 224 224 "CxE0_Service_nicht_verfuegbar___Standby___PMA" 225 225 "CxE1_Service_nicht_verfuegbar___Standby___EPS_Status" 255 255 "CxFF_Signal_ungueltig" /end COMPU_VTAB_RANGE
/begin COMPU_METHOD RTE_CM_ENUM_ManufModeType "" TAB_VERB "%.1" "" COMPU_TAB_REF RTE_CM_ENUM_ManufModeType /end COMPU_METHOD
/begin COMPU_VTAB_RANGE RTE_CM_ENUM_ManufModeType "" 3 0 0 "ProductionMode" 1 1 "ManufacturingMode" 2 2 "EngineeringMode" /end COMPU_VTAB_RANGE
/begin COMPU_METHOD RTE_CM_ENUM_CTR_ERRM_BN_U "" TAB_VERB "%.1" "" COMPU_TAB_REF RTE_CM_ENUM_CTR_ERRM_BN_U /end COMPU_METHOD
/begin COMPU_VTAB_RANGE RTE_CM_ENUM_CTR_ERRM_BN_U "" 9 0 0 "Cb0xxxx1_Unterspannung_Normalbetrieb" 0 0 "Cb0xxxx0_Keine_Unterspannung_Normalbetrieb" 0 0 "Cb0xxx1x_Unterspannung_MSA_Start" 0 0 "Cb0xxx0x_Keine_Unterspannung_MSA_Start" 0 0 "Cb0xx1xx_Ueberspannung" 0 0 "Cb0xx0xx_Keine_Ueberspannung" 61 61 "Cx3D_nicht_verfuegbar" 62 62 "Cx3E_Fehler" 63 63 "Cx3F_Signal_ungueltig" /end COMPU_VTAB_RANGE
/begin COMPU_METHOD RTE_CM_ENUM_ST_ILK_ERRM_FZM "" TAB_VERB "%.1" "" COMPU_TAB_REF RTE_CM_ENUM_ST_ILK_ERRM_FZM /end COMPU_METHOD
/begin COMPU_VTAB_RANGE RTE_CM_ENUM_ST_ILK_ERRM_FZM "" 4 0 0 "Cx0_Fehlerspeicherfreigabe" 1 1 "Cx1_Fehlerspeichersperre" 2 2 "Cx2_Reserve" 3 3 "Cx3_Signal_ungueltig" /end COMPU_VTAB_RANGE
/begin COMPU_METHOD RTE_CM_ENUM_EcuM_Mode "" TAB_VERB "%.1" "" COMPU_TAB_REF RTE_CM_ENUM_EcuM_Mode /end COMPU_METHOD
/begin COMPU_VTAB_RANGE RTE_CM_ENUM_EcuM_Mode "" 7 0 0 "RTE_MODE_EcuM_Mode_POST_RUN" 1 1 "RTE_MODE_EcuM_Mode_RUN" 2 2 "RTE_MODE_EcuM_Mode_SHUTDOWN" 3 3 "RTE_MODE_EcuM_Mode_SLEEP" 4 4 "RTE_MODE_EcuM_Mode_STARTUP" 5 5 "RTE_MODE_EcuM_Mode_WAKE_SLEEP" 6 6 "RTE_TRANSITION_EcuM_Mode" /end COMPU_VTAB_RANGE
/begin COMPU_METHOD RTE_CM_ENUM_ST_V_VEH_NSS "" TAB_VERB "%.1" "" COMPU_TAB_REF RTE_CM_ENUM_ST_V_VEH_NSS /end COMPU_METHOD
/begin COMPU_VTAB_RANGE RTE_CM_ENUM_ST_V_VEH_NSS "" 3 12 12 "CxC_Fahrzeug_im_stillstandsnahen_Bereich" 13 13 "CxD_Fahrzeug_nicht_im_stillstandsnahen_Bereich" 15 15 "CxF_Signal_ungueltig" /end COMPU_VTAB_RANGE
/begin COMPU_METHOD RTE_CM_ENUM_ALIV_COU_4 "" TAB_VERB "%.1" "" COMPU_TAB_REF RTE_CM_ENUM_ALIV_COU_4 /end COMPU_METHOD
/begin COMPU_VTAB_RANGE RTE_CM_ENUM_ALIV_COU_4 "" 2 0 14 "Cx0xE_Zaehlerstand_0__E" 15 15 "CxF_Signal_ungueltig" /end COMPU_VTAB_RANGE
/begin COMPU_METHOD RTE_CM_AVL_PINA_IDX_ICM "" RAT_FUNC "%." "" COEFFS 0 22.7555555555556 32767 0 0 1 /end COMPU_METHOD
/begin COMPU_METHOD RTE_CM_CRC8 "" RAT_FUNC "%." "" COEFFS 0 1 0 0 0 1 /end COMPU_METHOD
/begin COMPU_METHOD RTE_CM_OFFS_QUAD_PINA_EPS "" RAT_FUNC "%." "" COEFFS 0 1 127 0 0 1 /end COMPU_METHOD
/begin COMPU_METHOD RTE_CM_ENUM_ST_OFFS_QUAD_PINA_EPS "" TAB_VERB "%.1" "" COMPU_TAB_REF RTE_CM_ENUM_ST_OFFS_QUAD_PINA_EPS /end COMPU_METHOD
/begin COMPU_VTAB_RANGE RTE_CM_ENUM_ST_OFFS_QUAD_PINA_EPS "" 12 0 0 "Cx0_Algorithmus__Funktion__im_Sleep_Modus" 1 1 "Cx1_Offset__wird_ermittelt" 2 2 "Cx2_Offset_uebernehmen__Aufsetzen_ueber_Index" 3 3 "Cx3_Offset_uebernehmen__Aufsetzen_ueber_Modelvergleich" 4 4 "Cx4_Offset_uebernehmen__Aufsetzen_ueber_Anschlag_Anschlag" 5 5 "Cx5_Offset_uebernehmen__Aufsetzen_ueber_Summenlenkwinkel__im_AFS_Fall_" 6 6 "Cx6_Offset_in_Pruefung" 7 7 "Cx7_Offset_korrigieren" 8 8 "Cx8_Initialisierung" 9 9 "Cx9_Restoffset_wird_ermittelt" 11 11 "CxB_Offset_uebernehmen__Groboffset_ueber_Modell" 15 15 "CxF_Signal_ungueltig" /end COMPU_VTAB_RANGE
/begin COMPU_METHOD RTE_CM_ENUM_New_Coding_83 "" TAB_VERB "%.1" "" COMPU_TAB_REF RTE_CM_ENUM_New_Coding_83 /end COMPU_METHOD
/begin COMPU_VTAB_RANGE RTE_CM_ENUM_New_Coding_83 "" 6 0 0 "Cx0_Keine_Deaktivierung_EPS_Funktionen" 0 0 "Cb0xx1_Deaktivierung_EPS_Funktionen__Funktionsgruppe_1" 0 0 "Cb0x1x_Deaktivierung_EPS_Funktionen__Funktionsgruppe_2" 13 13 "CxD_Funktionsschnittstelle_ist_nicht_verfuegbar" 14 14 "CxE_Funktion_meldet_Fehler" 15 15 "CxF_Signal_unbefuellt" /end COMPU_VTAB_RANGE
/begin COMPU_METHOD RTE_CM_FACT_ASS_STMOM_FTAX "" RAT_FUNC "%." "" COEFFS 0 256 -256 0 0 1 /end COMPU_METHOD
/begin COMPU_METHOD RTE_CM_FACT_CTRR_STMOM_FTAX "" RAT_FUNC "%." "" COEFFS 0 256 -2 0 0 1 /end COMPU_METHOD
/begin COMPU_METHOD RTE_CM_ENUM_QU_TAR_FACT_STMOM_FTAX "" TAB_VERB "%.1" "" COMPU_TAB_REF RTE_CM_ENUM_QU_TAR_FACT_STMOM_FTAX /end COMPU_METHOD
/begin COMPU_VTAB_RANGE RTE_CM_ENUM_QU_TAR_FACT_STMOM_FTAX "" 4 2 2 "Cx2_Sollwerte_umsetzen" 7 7 "Cx7_Sollwerte_nicht_vorhanden" 14 14 "CxE_Standby__Sollwerte_nicht_umsetzen" 15 15 "CxF_Signal_ungueltig" /end COMPU_VTAB_RANGE
/begin COMPU_METHOD RTE_CM_ENUM_QU_TAR_QTA_STMOM_DV "" TAB_VERB "%.1" "" COMPU_TAB_REF RTE_CM_ENUM_QU_TAR_QTA_STMOM_DV /end COMPU_METHOD
/begin COMPU_VTAB_RANGE RTE_CM_ENUM_QU_TAR_QTA_STMOM_DV "" 4 2 2 "Cx2_Sollwerte_umsetzen" 7 7 "Cx7_Sollwerte_nicht_vorhanden" 14 14 "CxE_Sollwerte_nicht_umsetzen___Standby" 15 15 "CxF_Signal_ungueltig" /end COMPU_VTAB_RANGE
/begin COMPU_METHOD RTE_CM_STMOM_QTA_DV "" RAT_FUNC "%." "Nm" COEFFS 0 200 2000 0 0 1 /end COMPU_METHOD
/begin COMPU_METHOD RTE_CM_FACT_DMPNG_ADDON_STMOM_FTAX "" RAT_FUNC "%." "" COEFFS 0 64 0 0 0 1 STATUS_STRING_REF RTE_CM_ENUM_FACT_DMPNG_ADDON_STMOM_FTAX /end COMPU_METHOD
/begin COMPU_VTAB_RANGE RTE_CM_ENUM_FACT_DMPNG_ADDON_STMOM_FTAX "" 3 253 253 "CxFD_Reserviert" 254 254 "CxFE_Reserviert" 255 255 "CxFF_Signal_unbefuellt" /end COMPU_VTAB_RANGE
/begin COMPU_METHOD RTE_CM_ENUM_QU_TAR_DMPNG_ADDON_STMOM_FTAX "" TAB_VERB "%.1" "" COMPU_TAB_REF RTE_CM_ENUM_QU_TAR_DMPNG_ADDON_STMOM_FTAX /end COMPU_METHOD
/begin COMPU_VTAB_RANGE RTE_CM_ENUM_QU_TAR_DMPNG_ADDON_STMOM_FTAX "" 3 1 1 "Cx1_Sollwert_Zusatzdaempfung_nicht_umsetzen" 2 2 "Cx2_Sollwert_Zusatzdaempfung_nicht_umsetzen" 15 15 "CxF_Signal_unbefuellt" /end COMPU_VTAB_RANGE
/begin COMPU_METHOD RTE_CM_ENUM_QU_TAR_STMOM_DV_ACT "" TAB_VERB "%.1" "" COMPU_TAB_REF RTE_CM_ENUM_QU_TAR_STMOM_DV_ACT /end COMPU_METHOD
/begin COMPU_VTAB_RANGE RTE_CM_ENUM_QU_TAR_STMOM_DV_ACT "" 4 2 2 "Cx2_Sollwerte_umsetzen" 7 7 "Cx7_Sollwerte_nicht_vorhanden" 14 14 "CxE_Standby__Sollwerte_nicht_umsetzen" 15 15 "CxF_Signal_ungueltig" /end COMPU_VTAB_RANGE
/begin COMPU_METHOD RTE_CM_TAR_STMOM_DV_ACT "" RAT_FUNC "%." "Nm" COEFFS 0 166.666666666667 2000 0 0 1 /end COMPU_METHOD
/begin COMPU_METHOD RTE_CM_ENUM_ALIV_COU_V "" TAB_VERB "%.1" "" COMPU_TAB_REF RTE_CM_ENUM_ALIV_COU_V /end COMPU_METHOD
/begin COMPU_VTAB_RANGE RTE_CM_ENUM_ALIV_COU_V "" 2 0 14 "Cx0xE_Zaehlerstand_0__E" 15 15 "CxF_Signal_ungueltig" /end COMPU_VTAB_RANGE
/begin COMPU_METHOD RTE_CM_CRC_V_VEH "" RAT_FUNC "%." "" COEFFS 0 1 0 0 0 1 /end COMPU_METHOD
/begin COMPU_METHOD RTE_CM_ENUM_DVCO_VEH "" TAB_VERB "%.1" "" COMPU_TAB_REF RTE_CM_ENUM_DVCO_VEH /end COMPU_METHOD
/begin COMPU_VTAB_RANGE RTE_CM_ENUM_DVCO_VEH "" 8 0 0 "Cx0_Fahrzeug_steht" 1 1 "Cx1_Fahrzeug_faehrt_vorwaerts" 2 2 "Cx2_Fahrzeug_faehrt_rueckwaerts" 3 3 "Cx3_Fahrzeug_faehrt" 4 4 "Cx4_Fahrzeug_steht__Hinterachse_auf_Rollenpruefstand_erkannt" 5 5 "Cx5_Fahrzeug_steht__Zwei_Achs_Rollenbetrieb_gesetzt" 6 6 "Cx6_Fahrzeug_steht__Vorderachse_auf_Rollenpruefstand_erkannt" 7 7 "Cx7_Signal_ungueltig" /end COMPU_VTAB_RANGE
/begin COMPU_METHOD RTE_CM_ENUM_QU_V_VEH_COG "" TAB_VERB "%.1" "" COMPU_TAB_REF RTE_CM_ENUM_QU_V_VEH_COG /end COMPU_METHOD
/begin COMPU_VTAB_RANGE RTE_CM_ENUM_QU_V_VEH_COG "" 13 1 1 "Cx1_Signalwert_ist_gueltig_und_abgesichert_und_plausibilisiert" 2 2 "Cx2_Reserved" 3 3 "Cx3_Reserved" 4 4 "Cx4_Reserved" 6 6 "Cx6_Reserved" 7 7 "Cx7_Reserved" 8 8 "Cx8_Initialisierung" 9 9 "Cx9_Reserved" 10 10 "CxA_Signalwert_ist_gueltig__Zustand_Status_temporaer" 11 11 "CxB_Signalqualitaet_bzw__Ueberwachung_eingeschraenkt__Zustand_Status_temporaer" 12 12 "CxC_Reserved" 14 14 "CxE_Signalwert_ist_ungueltig__Zustand_Status_temporaer" 15 15 "CxF_Signal_ungueltig" /end COMPU_VTAB_RANGE
/begin COMPU_METHOD RTE_CM_V_VEH_COG "" RAT_FUNC "%." "km/h" COEFFS 0 64 0 0 0 1 /end COMPU_METHOD
/begin COMPU_METHOD RTE_CM_AVL_PINA_EPS "" RAT_FUNC "%." "" COEFFS 0 22.7555555555556 32767 0 0 1 /end COMPU_METHOD
/begin COMPU_METHOD RTE_CM_ENUM_IDX_TORQ_SEN "" TAB_VERB "%.1" "" COMPU_TAB_REF RTE_CM_ENUM_IDX_TORQ_SEN /end COMPU_METHOD
/begin COMPU_VTAB_RANGE RTE_CM_ENUM_IDX_TORQ_SEN "" 4 0 0 "Cx0_Initialisierung" 1 1 "Cx1_Keine_Index_Flanke" 2 2 "Cx2_Index_Flanke" 3 3 "Cx3_Signal_ungueltig" /end COMPU_VTAB_RANGE
/begin COMPU_METHOD RTE_CM_OFFS_GRD_MID_EPS "" RAT_FUNC "%." "" COEFFS 0 22.7555555555556 2047 0 0 1 /end COMPU_METHOD
/begin COMPU_METHOD RTE_CM_ENUM_QU_AVL_PINA_EPS "" TAB_VERB "%.1" "" COMPU_TAB_REF RTE_CM_ENUM_QU_AVL_PINA_EPS /end COMPU_METHOD
/begin COMPU_VTAB_RANGE RTE_CM_ENUM_QU_AVL_PINA_EPS "" 8 1 1 "Cx1_Signalwert_ist_gueltig_und_abgesichert_und_plausibilisiert" 2 2 "Cx2_Signalwert_ist_gueltig" 4 4 "Cx4_Ersatzwert_ist_im_Nutzsignal_gesetzt" 8 8 "Cx8_Initialisierung" 10 10 "CxA_Signalwert_ist_gueltig__Zustand_Status_temporaer" 12 12 "CxC_Abgleichwert_ist_im_Nutzsignal_gesetzt___Zustand_Status_temporaer" 14 14 "CxE_Signalwert_ist_ungueltig__Zustand_Status_temporaer" 15 15 "CxF_Signal_ungueltig" /end COMPU_VTAB_RANGE
/begin COMPU_METHOD RTE_CM_ENUM_UN_PO_EPS "" TAB_VERB "%.1" "" COMPU_TAB_REF RTE_CM_ENUM_UN_PO_EPS /end COMPU_METHOD
/begin COMPU_VTAB_RANGE RTE_CM_ENUM_UN_PO_EPS "" 3 0 0 "Cx0_Ritzelschnittstelle" 1 1 "Cx1_Zahnstangenhubschnittstelle" 3 3 "Cx3_Signal_ungueltig" /end COMPU_VTAB_RANGE
/begin COMPU_METHOD RTE_CM_AVL_FORC_GRD "" RAT_FUNC "%." "kN" COEFFS 0 119.047619047619 2023.80952380952 0 0 1 /end COMPU_METHOD
/begin COMPU_METHOD RTE_CM_AVL_PWR_EL "" RAT_FUNC "%." "kW" COEFFS 0 10 120 0 0 1 /end COMPU_METHOD
/begin COMPU_METHOD RTE_CM_ENUM_QU_AVL_FORC_GRD "" TAB_VERB "%.1" "" COMPU_TAB_REF RTE_CM_ENUM_QU_AVL_FORC_GRD /end COMPU_METHOD
/begin COMPU_VTAB_RANGE RTE_CM_ENUM_QU_AVL_FORC_GRD "" 4 2 2 "Cx2_Signalwert_ist_gueltig" 8 8 "Cx8_Initialisierung" 14 14 "CxE_Signalwert_ist_ungueltig__Zustand_Status_temporaer" 15 15 "CxF_Signal_ungueltig" /end COMPU_VTAB_RANGE
/begin COMPU_METHOD RTE_CM_ENUM_QU_AVL_STMOM_DV_ACT "" TAB_VERB "%.1" "" COMPU_TAB_REF RTE_CM_ENUM_QU_AVL_STMOM_DV_ACT /end COMPU_METHOD
/begin COMPU_VTAB_RANGE RTE_CM_ENUM_QU_AVL_STMOM_DV_ACT "" 5 1 1 "Cx1_Signalwert_ist_gueltig_und_abgesichert_und_plausibilisiert" 6 6 "Cx6_Signalwert_ist_ungueltig" 8 8 "Cx8_Initialisierung" 14 14 "CxE_Signalwert_ist_ungueltig__Zustand_Status_temporaer" 15 15 "CxF_Signal_ungueltig" /end COMPU_VTAB_RANGE
/begin COMPU_METHOD RTE_CM_ENUM_QU_FN_EST "" TAB_VERB "%.1" "" COMPU_TAB_REF RTE_CM_ENUM_QU_FN_EST /end COMPU_METHOD
/begin COMPU_VTAB_RANGE RTE_CM_ENUM_QU_FN_EST "" 12 49 49 "Cx31_Funktion_in_Rueckfallebene" 51 51 "Cx33_Funktion_in_Rueckfallebene__Notfallfunktion_Umwelteinfluesse__Aktiv" 96 96 "Cx60_Funktion_nicht_verfuegbar___Fehler" 128 128 "Cx80_Initialisierung" 160 160 "CxA0_Funktion_verfuegbar___Aktiv__12V_EPS" 162 162 "CxA2_Funktion_verfuegbar___Aktiv__Notfallfunktion_Umwelteinfluesse___Aktiv" 164 164 "CxA4_Funktion_verfuegbar___Aktiv__12V_EAS" 168 168 "CxA8_Funktion_verfuegbar___Aktiv__24V_EAS" 176 176 "CxB0_Funktion_temporaer_in_Rueckfallebene" 178 178 "CxB2_Funktion_temporaer_in_Rueckfallebene__Notfallfunktion_Umwelteinfluesse__Aktiv" 224 224 "CxE0_Funktion_nicht_verfuegbar___ausgeschaltet" 255 255 "CxFF_Signal_ungueltig" /end COMPU_VTAB_RANGE
/begin COMPU_METHOD RTE_CM_ENUM_New_Coding_50 "" TAB_VERB "%.1" "" COMPU_TAB_REF RTE_CM_ENUM_New_Coding_50 /end COMPU_METHOD
/begin COMPU_VTAB_RANGE RTE_CM_ENUM_New_Coding_50 "" 5 1 1 "Cx1_Funktion_verfuegbar_nicht_aktiv" 6 6 "Cx6_Fehler" 9 9 "Cx9_Funktion_verfuegbar_aktiv" 14 14 "CxE_Funktion_nicht_verfuegbar" 15 15 "CxF_Signal_unbefuellt" /end COMPU_VTAB_RANGE
/begin COMPU_METHOD RTE_CM_New_Coding_51 "" RAT_FUNC "%." "" COEFFS 0 1 0 0 0 1 /end COMPU_METHOD
/begin COMPU_METHOD RTE_CM_New_Coding_52 "" RAT_FUNC "%." "" COEFFS 0 1 0 0 0 1 /end COMPU_METHOD
/begin COMPU_METHOD RTE_CM_TOT_STR_EPS "" RAT_FUNC "%." "" COEFFS 0 81.8799639728159 0 0 0 1 /end COMPU_METHOD
/begin COMPU_METHOD RTE_CM_ENUM_UN_TOT_STR_EPS "" TAB_VERB "%.1" "" COMPU_TAB_REF RTE_CM_ENUM_UN_TOT_STR_EPS /end COMPU_METHOD
/begin COMPU_VTAB_RANGE RTE_CM_ENUM_UN_TOT_STR_EPS "" 3 0 0 "Cx0_Ritzelschnittstelle" 1 1 "Cx1_Zahnstangenhubschnittstelle" 3 3 "Cx3_Signal_ungueltig" /end COMPU_VTAB_RANGE
