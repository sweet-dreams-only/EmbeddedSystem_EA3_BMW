/begin MEASUREMENT SrlComOutput2.CEVIIF.Cnt_lgc "MICROSAR RTE" UBYTE RTE_CM_BOOLEAN 0 0 0 255 ECU_ADDRESS 0 SYMBOL_LINK "Rte_VehCfg_CEVIIF_Cnt_lgc" 0 DISPLAY_IDENTIFIER SrlComOutput2.ReceiverPorts.CEVIIF.Cnt_lgc /end MEASUREMENT
/begin MEASUREMENT SrlComOutput2.CFACTORIF.Cnt_lgc "MICROSAR RTE" UBYTE RTE_CM_BOOLEAN 0 0 0 255 ECU_ADDRESS 0 SYMBOL_LINK "Rte_VehCfg_CFACTORIF_Cnt_lgc" 0 DISPLAY_IDENTIFIER SrlComOutput2.ReceiverPorts.CFACTORIF.Cnt_lgc /end MEASUREMENT
/begin MEASUREMENT SrlComOutput2.CHWANGLEIF.Cnt_lgc "MICROSAR RTE" UBYTE RTE_CM_BOOLEAN 0 0 0 255 ECU_ADDRESS 0 SYMBOL_LINK "Rte_VehCfg_CHWANGLEIF_Cnt_lgc" 0 DISPLAY_IDENTIFIER SrlComOutput2.ReceiverPorts.CHWANGLEIF.Cnt_lgc /end MEASUREMENT
/begin MEASUREMENT SrlComOutput2.CHWTORQUEIF.Cnt_lgc "MICROSAR RTE" UBYTE RTE_CM_BOOLEAN 0 0 0 255 ECU_ADDRESS 0 SYMBOL_LINK "Rte_VehCfg_CHWTORQUEIF_Cnt_lgc" 0 DISPLAY_IDENTIFIER SrlComOutput2.ReceiverPorts.CHWTORQUEIF.Cnt_lgc /end MEASUREMENT
/begin MEASUREMENT SrlComOutput2.CMTTORQUEIF.Cnt_lgc "MICROSAR RTE" UBYTE RTE_CM_BOOLEAN 0 0 0 255 ECU_ADDRESS 0 SYMBOL_LINK "Rte_VehCfg_CMTTORQUEIF_Cnt_lgc" 0 DISPLAY_IDENTIFIER SrlComOutput2.ReceiverPorts.CMTTORQUEIF.Cnt_lgc /end MEASUREMENT
/begin MEASUREMENT SrlComOutput2.CustCurrLmt.Amp_f32 "MICROSAR RTE" FLOAT32_IEEE NO_COMPU_METHOD 0 0 1.175494351e-38 3.402823466e+38 ECU_ADDRESS 0 SYMBOL_LINK "Rte_SrlComInput_SupplyCurrLmt_Amp_f32" 0 DISPLAY_IDENTIFIER SrlComOutput2.ReceiverPorts.CustCurrLmt.Amp_f32 /end MEASUREMENT
/begin MEASUREMENT SrlComOutput2.DiagStsNonRecRmpToZeroFltPres.Cnt_lgc "MICROSAR RTE" UBYTE RTE_CM_BOOLEAN 0 0 0 255 ECU_ADDRESS 0 SYMBOL_LINK "Rte_DiagMgr10_DiagStsNonRecRmpToZeroFltPres_Cnt_lgc" 0 DISPLAY_IDENTIFIER SrlComOutput2.ReceiverPorts.DiagStsNonRecRmpToZeroFltPres.Cnt_lgc /end MEASUREMENT
/begin MEASUREMENT SrlComOutput2.DiagStsRecRmpToZeroFltPres.Cnt_lgc "MICROSAR RTE" UBYTE RTE_CM_BOOLEAN 0 0 0 255 ECU_ADDRESS 0 SYMBOL_LINK "Rte_DiagMgr10_DiagStsRecRmpToZeroFltPres_Cnt_lgc" 0 DISPLAY_IDENTIFIER SrlComOutput2.ReceiverPorts.DiagStsRecRmpToZeroFltPres.Cnt_lgc /end MEASUREMENT
/begin MEASUREMENT SrlComOutput2.DrvDynState.Cnt_u08 "MICROSAR RTE" UBYTE RTE_CM_ENUM_QU_SER_STMOM_STMOM_DV_ACT 0 0 0 255 ECU_ADDRESS 0 SYMBOL_LINK "Rte_DrvDynamicsEnable_DrvDynInterfaceState_Cnt_u08" 0 DISPLAY_IDENTIFIER SrlComOutput2.ReceiverPorts.DrvDynState.Cnt_u08 /end MEASUREMENT
/begin MEASUREMENT SrlComOutput2.ElecPower.Watts_f32 "MICROSAR RTE" FLOAT32_IEEE NO_COMPU_METHOD 0 0 1.175494351e-38 3.402823466e+38 ECU_ADDRESS 0 SYMBOL_LINK "Rte_ElecPwr_ElecPower_Watts_f32" 0 DISPLAY_IDENTIFIER SrlComOutput2.ReceiverPorts.ElecPower.Watts_f32 /end MEASUREMENT
/begin MEASUREMENT SrlComOutput2.FinHwPos.HwDeg_f32 "MICROSAR RTE" FLOAT32_IEEE NO_COMPU_METHOD 0 0 1.175494351e-38 3.402823466e+38 ECU_ADDRESS 0 SYMBOL_LINK "Rte_AbsHwPos_SrlComHwPos_HwDeg_f32" 0 DISPLAY_IDENTIFIER SrlComOutput2.ReceiverPorts.FinHwPos.HwDeg_f32 /end MEASUREMENT
/begin MEASUREMENT SrlComOutput2.FinHwPosAuth.Uls_f32 "MICROSAR RTE" FLOAT32_IEEE NO_COMPU_METHOD 0 0 1.175494351e-38 3.402823466e+38 ECU_ADDRESS 0 SYMBOL_LINK "Rte_AbsHwPos_HandwheelAuthority_Uls_f32" 0 DISPLAY_IDENTIFIER SrlComOutput2.ReceiverPorts.FinHwPosAuth.Uls_f32 /end MEASUREMENT
/begin MEASUREMENT SrlComOutput2.HaptcFbSt.Cnt_u08 "MICROSAR RTE" UBYTE NO_COMPU_METHOD 0 0 0 255 ECU_ADDRESS 0 SYMBOL_LINK "Rte_BmwHaptcFb_HaptcFbSt_Cnt_u08" 0 DISPLAY_IDENTIFIER SrlComOutput2.ReceiverPorts.HaptcFbSt.Cnt_u08 /end MEASUREMENT
/begin MEASUREMENT SrlComOutput2.HwTrq.HwNm_f32 "MICROSAR RTE" FLOAT32_IEEE NO_COMPU_METHOD 0 0 1.175494351e-38 3.402823466e+38 ECU_ADDRESS 0 SYMBOL_LINK "Rte_Sweep_OutputHwTrq_HwNm_f32" 0 DISPLAY_IDENTIFIER SrlComOutput2.ReceiverPorts.HwTrq.HwNm_f32 /end MEASUREMENT
/begin MEASUREMENT SrlComOutput2.LimitPercentFiltered.Uls_f32 "MICROSAR RTE" FLOAT32_IEEE NO_COMPU_METHOD 0 0 1.175494351e-38 3.402823466e+38 ECU_ADDRESS 0 SYMBOL_LINK "Rte_AssistSumnLmt_LimitPercentFiltered_Uls_f32" 0 DISPLAY_IDENTIFIER SrlComOutput2.ReceiverPorts.LimitPercentFiltered.Uls_f32 /end MEASUREMENT
/begin MEASUREMENT SrlComOutput2.PrkAstState.Cnt_u08 "MICROSAR RTE" UBYTE RTE_CM_ENUM_QU_SER_WSTA_EST_FTAX 0 0 0 255 ECU_ADDRESS 0 SYMBOL_LINK "Rte_ParkAssistEnable_PrkAssistState_Cnt_u08" 0 DISPLAY_IDENTIFIER SrlComOutput2.ReceiverPorts.PrkAstState.Cnt_u08 /end MEASUREMENT
/begin MEASUREMENT SrlComOutput2.RacktoVehCntrOffset.Cnt_u16 "MICROSAR RTE" UWORD NO_COMPU_METHOD 0 0 0 65535 ECU_ADDRESS 0 SYMBOL_LINK "Rte_AbsHwPos_RacktoVehCntrOffset_Cnt_u16" 0 DISPLAY_IDENTIFIER SrlComOutput2.ReceiverPorts.RacktoVehCntrOffset.Cnt_u16 /end MEASUREMENT
/begin MEASUREMENT SrlComOutput2.RevOffsetState.Cnt_u08 "MICROSAR RTE" UBYTE NO_COMPU_METHOD 0 0 0 255 ECU_ADDRESS 0 SYMBOL_LINK "Rte_AbsHwPos_RevOffsetState_Cnt_u08" 0 DISPLAY_IDENTIFIER SrlComOutput2.ReceiverPorts.RevOffsetState.Cnt_u08 /end MEASUREMENT
/begin MEASUREMENT SrlComOutput2.SrlComAVLPOEPS.AVL_PO_EPS.ALIV_AVL_PO_EPS "MICROSAR RTE" UBYTE RTE_CM_ENUM_ALIV_COU_4 0 0 0 15 ECU_ADDRESS 0 SYMBOL_LINK "Rte_SrlComOutput2_SrlComAVLPOEPS_AVL_PO_EPS.ALIV_AVL_PO_EPS" 0 DISPLAY_IDENTIFIER SrlComOutput2.SenderPorts.SrlComAVLPOEPS.AVL_PO_EPS.ALIV_AVL_PO_EPS /end MEASUREMENT
/begin MEASUREMENT SrlComOutput2.SrlComAVLPOEPS.AVL_PO_EPS.AVL_PO_EPS "MICROSAR RTE" UWORD RTE_CM_AVL_PINA_EPS 0 0 -1439.9560546875 1439.9560546875 ECU_ADDRESS 0 SYMBOL_LINK "Rte_SrlComOutput2_SrlComAVLPOEPS_AVL_PO_EPS.AVL_PO_EPS" 0 DISPLAY_IDENTIFIER SrlComOutput2.SenderPorts.SrlComAVLPOEPS.AVL_PO_EPS.AVL_PO_EPS /end MEASUREMENT
/begin MEASUREMENT SrlComOutput2.SrlComAVLPOEPS.AVL_PO_EPS.AVL_PO_IDX_EPS "MICROSAR RTE" UWORD RTE_CM_AVL_PINA_IDX_ICM 0 0 -1439.9560546875 1439.9560546875 ECU_ADDRESS 0 SYMBOL_LINK "Rte_SrlComOutput2_SrlComAVLPOEPS_AVL_PO_EPS.AVL_PO_IDX_EPS" 0 DISPLAY_IDENTIFIER SrlComOutput2.SenderPorts.SrlComAVLPOEPS.AVL_PO_EPS.AVL_PO_IDX_EPS /end MEASUREMENT
/begin MEASUREMENT SrlComOutput2.SrlComAVLPOEPS.AVL_PO_EPS.CRC_AVL_PO_EPS "MICROSAR RTE" UBYTE RTE_CM_CRC8 0 0 0 255 ECU_ADDRESS 0 SYMBOL_LINK "Rte_SrlComOutput2_SrlComAVLPOEPS_AVL_PO_EPS.CRC_AVL_PO_EPS" 0 DISPLAY_IDENTIFIER SrlComOutput2.SenderPorts.SrlComAVLPOEPS.AVL_PO_EPS.CRC_AVL_PO_EPS /end MEASUREMENT
/begin MEASUREMENT SrlComOutput2.SrlComAVLPOEPS.AVL_PO_EPS.IDX_TORQ_SEN "MICROSAR RTE" UBYTE RTE_CM_ENUM_IDX_TORQ_SEN 0 0 0 3 ECU_ADDRESS 0 SYMBOL_LINK "Rte_SrlComOutput2_SrlComAVLPOEPS_AVL_PO_EPS.IDX_TORQ_SEN" 0 DISPLAY_IDENTIFIER SrlComOutput2.SenderPorts.SrlComAVLPOEPS.AVL_PO_EPS.IDX_TORQ_SEN /end MEASUREMENT
/begin MEASUREMENT SrlComOutput2.SrlComAVLPOEPS.AVL_PO_EPS.OFFS_GRD_MID_EPS "MICROSAR RTE" UWORD RTE_CM_OFFS_GRD_MID_EPS 0 0 -89.9560546875 89.9560546875 ECU_ADDRESS 0 SYMBOL_LINK "Rte_SrlComOutput2_SrlComAVLPOEPS_AVL_PO_EPS.OFFS_GRD_MID_EPS" 0 DISPLAY_IDENTIFIER SrlComOutput2.SenderPorts.SrlComAVLPOEPS.AVL_PO_EPS.OFFS_GRD_MID_EPS /end MEASUREMENT
/begin MEASUREMENT SrlComOutput2.SrlComAVLPOEPS.AVL_PO_EPS.QU_AVL_PO_EPS "MICROSAR RTE" UBYTE RTE_CM_ENUM_QU_AVL_PINA_EPS 0 0 0 15 ECU_ADDRESS 0 SYMBOL_LINK "Rte_SrlComOutput2_SrlComAVLPOEPS_AVL_PO_EPS.QU_AVL_PO_EPS" 0 DISPLAY_IDENTIFIER SrlComOutput2.SenderPorts.SrlComAVLPOEPS.AVL_PO_EPS.QU_AVL_PO_EPS /end MEASUREMENT
/begin MEASUREMENT SrlComOutput2.SrlComAVLPOEPS.AVL_PO_EPS.UN_PO_EPS "MICROSAR RTE" UBYTE RTE_CM_ENUM_UN_PO_EPS 0 0 0 3 ECU_ADDRESS 0 SYMBOL_LINK "Rte_SrlComOutput2_SrlComAVLPOEPS_AVL_PO_EPS.UN_PO_EPS" 0 DISPLAY_IDENTIFIER SrlComOutput2.SenderPorts.SrlComAVLPOEPS.AVL_PO_EPS.UN_PO_EPS /end MEASUREMENT
/begin MEASUREMENT SrlComOutput2.SrlComAVLSTMOM.AVL_FORC_GRD.ALIV_AVL_FORC_GRD "MICROSAR RTE" UBYTE RTE_CM_ENUM_ALIV_COU_4 0 0 0 15 ECU_ADDRESS 0 SYMBOL_LINK "Rte_SrlComOutput2_SrlComAVLSTMOM_AVL_FORC_GRD.ALIV_AVL_FORC_GRD" 0 DISPLAY_IDENTIFIER SrlComOutput2.SenderPorts.SrlComAVLSTMOM.AVL_FORC_GRD.ALIV_AVL_FORC_GRD /end MEASUREMENT
/begin MEASUREMENT SrlComOutput2.SrlComAVLSTMOM.AVL_FORC_GRD.AVL_FORC_GRD "MICROSAR RTE" UWORD RTE_CM_AVL_FORC_GRD 0 0 -17 17.0032 ECU_ADDRESS 0 SYMBOL_LINK "Rte_SrlComOutput2_SrlComAVLSTMOM_AVL_FORC_GRD.AVL_FORC_GRD" 0 DISPLAY_IDENTIFIER SrlComOutput2.SenderPorts.SrlComAVLSTMOM.AVL_FORC_GRD.AVL_FORC_GRD /end MEASUREMENT
/begin MEASUREMENT SrlComOutput2.SrlComAVLSTMOM.AVL_FORC_GRD.AVL_FORC_GRD_0x0C_0x04 "MICROSAR RTE" UBYTE NO_COMPU_METHOD 0 0 0 15 ECU_ADDRESS 0 SYMBOL_LINK "Rte_SrlComOutput2_SrlComAVLSTMOM_AVL_FORC_GRD.AVL_FORC_GRD_0x0C_0x04" 0 DISPLAY_IDENTIFIER SrlComOutput2.SenderPorts.SrlComAVLSTMOM.AVL_FORC_GRD.AVL_FORC_GRD_0x0C_0x04 /end MEASUREMENT
/begin MEASUREMENT SrlComOutput2.SrlComAVLSTMOM.AVL_FORC_GRD.AVL_PWR_EL_EPS_COOD "MICROSAR RTE" UBYTE RTE_CM_AVL_PWR_EL 0 0 -12 12 ECU_ADDRESS 0 SYMBOL_LINK "Rte_SrlComOutput2_SrlComAVLSTMOM_AVL_FORC_GRD.AVL_PWR_EL_EPS_COOD" 0 DISPLAY_IDENTIFIER SrlComOutput2.SenderPorts.SrlComAVLSTMOM.AVL_FORC_GRD.AVL_PWR_EL_EPS_COOD /end MEASUREMENT
/begin MEASUREMENT SrlComOutput2.SrlComAVLSTMOM.AVL_FORC_GRD.CRC_AVL_FORC_GRD "MICROSAR RTE" UBYTE RTE_CM_CRC8 0 0 0 255 ECU_ADDRESS 0 SYMBOL_LINK "Rte_SrlComOutput2_SrlComAVLSTMOM_AVL_FORC_GRD.CRC_AVL_FORC_GRD" 0 DISPLAY_IDENTIFIER SrlComOutput2.SenderPorts.SrlComAVLSTMOM.AVL_FORC_GRD.CRC_AVL_FORC_GRD /end MEASUREMENT
/begin MEASUREMENT SrlComOutput2.SrlComAVLSTMOM.AVL_FORC_GRD.QU_AVL_FORC_GRD "MICROSAR RTE" UBYTE RTE_CM_ENUM_QU_AVL_FORC_GRD 0 0 0 15 ECU_ADDRESS 0 SYMBOL_LINK "Rte_SrlComOutput2_SrlComAVLSTMOM_AVL_FORC_GRD.QU_AVL_FORC_GRD" 0 DISPLAY_IDENTIFIER SrlComOutput2.SenderPorts.SrlComAVLSTMOM.AVL_FORC_GRD.QU_AVL_FORC_GRD /end MEASUREMENT
/begin MEASUREMENT SrlComOutput2.SrlComAVLSTMOM.AVL_STMOM_DV_ACT.ALIV_AVL_STMOM_DV_ACT "MICROSAR RTE" UBYTE RTE_CM_ENUM_ALIV_COU_4 0 0 0 15 ECU_ADDRESS 0 SYMBOL_LINK "Rte_SrlComOutput2_SrlComAVLSTMOM_AVL_STMOM_DV_ACT.ALIV_AVL_STMOM_DV_ACT" 0 DISPLAY_IDENTIFIER SrlComOutput2.SenderPorts.SrlComAVLSTMOM.AVL_STMOM_DV_ACT.ALIV_AVL_STMOM_DV_ACT /end MEASUREMENT
/begin MEASUREMENT SrlComOutput2.SrlComAVLSTMOM.AVL_STMOM_DV_ACT.AVL_STMOM_DV_ACT "MICROSAR RTE" UWORD RTE_CM_STMOM_QTA_DV 0 0 -10 10 ECU_ADDRESS 0 SYMBOL_LINK "Rte_SrlComOutput2_SrlComAVLSTMOM_AVL_STMOM_DV_ACT.AVL_STMOM_DV_ACT" 0 DISPLAY_IDENTIFIER SrlComOutput2.SenderPorts.SrlComAVLSTMOM.AVL_STMOM_DV_ACT.AVL_STMOM_DV_ACT /end MEASUREMENT
/begin MEASUREMENT SrlComOutput2.SrlComAVLSTMOM.AVL_STMOM_DV_ACT.AVL_STMOM_DV_ACT_0x0C_0x04 "MICROSAR RTE" UBYTE NO_COMPU_METHOD 0 0 0 15 ECU_ADDRESS 0 SYMBOL_LINK "Rte_SrlComOutput2_SrlComAVLSTMOM_AVL_STMOM_DV_ACT.AVL_STMOM_DV_ACT_0x0C_0x04" 0 DISPLAY_IDENTIFIER SrlComOutput2.SenderPorts.SrlComAVLSTMOM.AVL_STMOM_DV_ACT.AVL_STMOM_DV_ACT_0x0C_0x04 /end MEASUREMENT
/begin MEASUREMENT SrlComOutput2.SrlComAVLSTMOM.AVL_STMOM_DV_ACT.CRC_AVL_STMOM_DV_ACT "MICROSAR RTE" UBYTE RTE_CM_CRC8 0 0 0 255 ECU_ADDRESS 0 SYMBOL_LINK "Rte_SrlComOutput2_SrlComAVLSTMOM_AVL_STMOM_DV_ACT.CRC_AVL_STMOM_DV_ACT" 0 DISPLAY_IDENTIFIER SrlComOutput2.SenderPorts.SrlComAVLSTMOM.AVL_STMOM_DV_ACT.CRC_AVL_STMOM_DV_ACT /end MEASUREMENT
/begin MEASUREMENT SrlComOutput2.SrlComAVLSTMOM.AVL_STMOM_DV_ACT.QU_AVL_STMOM_DV_ACT "MICROSAR RTE" UBYTE RTE_CM_ENUM_QU_AVL_STMOM_DV_ACT 0 0 0 15 ECU_ADDRESS 0 SYMBOL_LINK "Rte_SrlComOutput2_SrlComAVLSTMOM_AVL_STMOM_DV_ACT.QU_AVL_STMOM_DV_ACT" 0 DISPLAY_IDENTIFIER SrlComOutput2.SenderPorts.SrlComAVLSTMOM.AVL_STMOM_DV_ACT.QU_AVL_STMOM_DV_ACT /end MEASUREMENT
/begin MEASUREMENT SrlComOutput2.SrlComHwTrqValid.Cnt_lgc "MICROSAR RTE" UBYTE RTE_CM_BOOLEAN 0 0 0 255 ECU_ADDRESS 0 SYMBOL_LINK "Rte_HwTrq_SrlComHwTrqValid_Cnt_lgc" 0 DISPLAY_IDENTIFIER SrlComOutput2.ReceiverPorts.SrlComHwTrqValid.Cnt_lgc /end MEASUREMENT
/begin MEASUREMENT SrlComOutput2.SrlComSTEST.ST_EST.ALIV_ST_EST_FTAX "MICROSAR RTE" UBYTE RTE_CM_ENUM_ALIV_COU_4 0 0 0 15 ECU_ADDRESS 0 SYMBOL_LINK "Rte_SrlComOutput2_SrlComSTEST_ST_EST.ALIV_ST_EST_FTAX" 0 DISPLAY_IDENTIFIER SrlComOutput2.SenderPorts.SrlComSTEST.ST_EST.ALIV_ST_EST_FTAX /end MEASUREMENT
/begin MEASUREMENT SrlComOutput2.SrlComSTEST.ST_EST.CRC_ST_EST_FTAX "MICROSAR RTE" UBYTE RTE_CM_CRC8 0 0 0 255 ECU_ADDRESS 0 SYMBOL_LINK "Rte_SrlComOutput2_SrlComSTEST_ST_EST.CRC_ST_EST_FTAX" 0 DISPLAY_IDENTIFIER SrlComOutput2.SenderPorts.SrlComSTEST.ST_EST.CRC_ST_EST_FTAX /end MEASUREMENT
/begin MEASUREMENT SrlComOutput2.SrlComSTEST.ST_EST.QU_FN_EST "MICROSAR RTE" UBYTE RTE_CM_ENUM_QU_FN_EST 0 0 0 255 ECU_ADDRESS 0 SYMBOL_LINK "Rte_SrlComOutput2_SrlComSTEST_ST_EST.QU_FN_EST" 0 DISPLAY_IDENTIFIER SrlComOutput2.SenderPorts.SrlComSTEST.ST_EST.QU_FN_EST /end MEASUREMENT
/begin MEASUREMENT SrlComOutput2.SrlComSTEST.ST_EST.QU_FN_VIB_EPS "MICROSAR RTE" UBYTE RTE_CM_ENUM_New_Coding_50 0 0 0 15 ECU_ADDRESS 0 SYMBOL_LINK "Rte_SrlComOutput2_SrlComSTEST_ST_EST.QU_FN_VIB_EPS" 0 DISPLAY_IDENTIFIER SrlComOutput2.SenderPorts.SrlComSTEST.ST_EST.QU_FN_VIB_EPS /end MEASUREMENT
/begin MEASUREMENT SrlComOutput2.SrlComSTEST.ST_EST.QU_SER_STMOM_DV_ACT "MICROSAR RTE" UBYTE RTE_CM_ENUM_QU_SER_STMOM_STMOM_DV_ACT 0 0 0 255 ECU_ADDRESS 0 SYMBOL_LINK "Rte_SrlComOutput2_SrlComSTEST_ST_EST.QU_SER_STMOM_DV_ACT" 0 DISPLAY_IDENTIFIER SrlComOutput2.SenderPorts.SrlComSTEST.ST_EST.QU_SER_STMOM_DV_ACT /end MEASUREMENT
/begin MEASUREMENT SrlComOutput2.SrlComSTEST.ST_EST.ST_EST_0x10_0x08 "MICROSAR RTE" UBYTE NO_COMPU_METHOD 0 0 0 255 ECU_ADDRESS 0 SYMBOL_LINK "Rte_SrlComOutput2_SrlComSTEST_ST_EST.ST_EST_0x10_0x08" 0 DISPLAY_IDENTIFIER SrlComOutput2.SenderPorts.SrlComSTEST.ST_EST.ST_EST_0x10_0x08 /end MEASUREMENT
/begin MEASUREMENT SrlComOutput2.SrlComSUEPS.SU_EPS.ALIV_SU_EPS "MICROSAR RTE" UBYTE RTE_CM_New_Coding_51 0 0 0 14 ECU_ADDRESS 0 SYMBOL_LINK "Rte_SrlComOutput2_SrlComSUEPS_SU_EPS.ALIV_SU_EPS" 0 DISPLAY_IDENTIFIER SrlComOutput2.SenderPorts.SrlComSUEPS.SU_EPS.ALIV_SU_EPS /end MEASUREMENT
/begin MEASUREMENT SrlComOutput2.SrlComSUEPS.SU_EPS.CRC_SU_EPS "MICROSAR RTE" UBYTE RTE_CM_New_Coding_52 0 0 0 255 ECU_ADDRESS 0 SYMBOL_LINK "Rte_SrlComOutput2_SrlComSUEPS_SU_EPS.CRC_SU_EPS" 0 DISPLAY_IDENTIFIER SrlComOutput2.SenderPorts.SrlComSUEPS.SU_EPS.CRC_SU_EPS /end MEASUREMENT
/begin MEASUREMENT SrlComOutput2.SrlComSUEPS.SU_EPS.SU_EPS_0x0E_0x20 "MICROSAR RTE" ULONG NO_COMPU_METHOD 0 0 0 4294967295 ECU_ADDRESS 0 SYMBOL_LINK "Rte_SrlComOutput2_SrlComSUEPS_SU_EPS.SU_EPS_0x0E_0x20" 0 DISPLAY_IDENTIFIER SrlComOutput2.SenderPorts.SrlComSUEPS.SU_EPS.SU_EPS_0x0E_0x20 /end MEASUREMENT
/begin MEASUREMENT SrlComOutput2.SrlComSUEPS.SU_EPS.SU_EPS_0x2E_0x06 "MICROSAR RTE" UBYTE NO_COMPU_METHOD 0 0 0 63 ECU_ADDRESS 0 SYMBOL_LINK "Rte_SrlComOutput2_SrlComSUEPS_SU_EPS.SU_EPS_0x2E_0x06" 0 DISPLAY_IDENTIFIER SrlComOutput2.SenderPorts.SrlComSUEPS.SU_EPS.SU_EPS_0x2E_0x06 /end MEASUREMENT
/begin MEASUREMENT SrlComOutput2.SrlComSUEPS.SU_EPS.TOT_STR_EPS "MICROSAR RTE" UWORD RTE_CM_TOT_STR_EPS 0 0 0 50.000022 ECU_ADDRESS 0 SYMBOL_LINK "Rte_SrlComOutput2_SrlComSUEPS_SU_EPS.TOT_STR_EPS" 0 DISPLAY_IDENTIFIER SrlComOutput2.SenderPorts.SrlComSUEPS.SU_EPS.TOT_STR_EPS /end MEASUREMENT
/begin MEASUREMENT SrlComOutput2.SrlComSUEPS.SU_EPS.UN_TOT_STR_EPS "MICROSAR RTE" UBYTE RTE_CM_ENUM_UN_TOT_STR_EPS 0 0 0 3 ECU_ADDRESS 0 SYMBOL_LINK "Rte_SrlComOutput2_SrlComSUEPS_SU_EPS.UN_TOT_STR_EPS" 0 DISPLAY_IDENTIFIER SrlComOutput2.SenderPorts.SrlComSUEPS.SU_EPS.UN_TOT_STR_EPS /end MEASUREMENT
/begin MEASUREMENT SrlComOutput2.SupplyCur.Amp_f32 "MICROSAR RTE" FLOAT32_IEEE NO_COMPU_METHOD 0 0 1.175494351e-38 3.402823466e+38 ECU_ADDRESS 0 SYMBOL_LINK "Rte_ElecPwr_SupplyCur_Amp_f32" 0 DISPLAY_IDENTIFIER SrlComOutput2.ReceiverPorts.SupplyCur.Amp_f32 /end MEASUREMENT
/begin MEASUREMENT SrlComOutput2.SystemState.Mode "MICROSAR RTE" UBYTE RTE_CM_ENUM_StaMd_Mode 0 0 0 255 ECU_ADDRESS 0 SYMBOL_LINK "Rte_ModeMachine_StaMd_SystemState_Mode" 0 DISPLAY_IDENTIFIER SrlComOutput2.ModeRequirePorts.SystemState.Mode /end MEASUREMENT
/begin MEASUREMENT StOpCtrl.DiagRampRate.XpmS_f32 "MICROSAR RTE" FLOAT32_IEEE NO_COMPU_METHOD 0 0 1.175494351e-38 3.402823466e+38 ECU_ADDRESS 0 SYMBOL_LINK "Rte_DiagMgr10_DiagRampRate_XpmS_f32" 0 DISPLAY_IDENTIFIER StOpCtrl.ReceiverPorts.DiagRampRate.XpmS_f32 /end MEASUREMENT
/begin MEASUREMENT StOpCtrl.DiagRampValue.Uls_f32 "MICROSAR RTE" FLOAT32_IEEE NO_COMPU_METHOD 0 0 1.175494351e-38 3.402823466e+38 ECU_ADDRESS 0 SYMBOL_LINK "Rte_DiagMgr10_DiagRampValue_Uls_f32" 0 DISPLAY_IDENTIFIER StOpCtrl.ReceiverPorts.DiagRampValue.Uls_f32 /end MEASUREMENT
/begin MEASUREMENT StOpCtrl.DiagStsDiagRmpActive.Cnt_lgc "MICROSAR RTE" UBYTE RTE_CM_BOOLEAN 0 0 0 255 ECU_ADDRESS 0 SYMBOL_LINK "Rte_DiagMgr10_DiagRmpToZeroActive_Cnt_lgc" 0 DISPLAY_IDENTIFIER StOpCtrl.ReceiverPorts.DiagStsDiagRmpActive.Cnt_lgc /end MEASUREMENT
/begin MEASUREMENT StOpCtrl.OperRampRate.XpmS_f32 "MICROSAR RTE" FLOAT32_IEEE NO_COMPU_METHOD 0 0 1.175494351e-38 3.402823466e+38 ECU_ADDRESS 0 SYMBOL_LINK "Rte_VehPwrMd_OperRampRate_XpmS_f32" 0 DISPLAY_IDENTIFIER StOpCtrl.ReceiverPorts.OperRampRate.XpmS_f32 /end MEASUREMENT
/begin MEASUREMENT StOpCtrl.OperRampValue.Uls_f32 "MICROSAR RTE" FLOAT32_IEEE NO_COMPU_METHOD 0 0 1.175494351e-38 3.402823466e+38 ECU_ADDRESS 0 SYMBOL_LINK "Rte_VehPwrMd_OperRampValue_Uls_f32" 0 DISPLAY_IDENTIFIER StOpCtrl.ReceiverPorts.OperRampValue.Uls_f32 /end MEASUREMENT
/begin MEASUREMENT StOpCtrl.OutputRampMult.Uls_f32 "MICROSAR RTE" FLOAT32_IEEE NO_COMPU_METHOD 0 0 1.175494351e-38 3.402823466e+38 ECU_ADDRESS 0 SYMBOL_LINK "Rte_StOpCtrl_OutputRampMult_Uls_f32" 0 DISPLAY_IDENTIFIER StOpCtrl.SenderPorts.OutputRampMult.Uls_f32 /end MEASUREMENT
/begin MEASUREMENT StOpCtrl.RampDwnStatusComplete.Cnt_lgc "MICROSAR RTE" UBYTE RTE_CM_BOOLEAN 0 0 0 255 ECU_ADDRESS 0 SYMBOL_LINK "Rte_StOpCtrl_RampDwnStatusComplete_Cnt_lgc" 0 DISPLAY_IDENTIFIER StOpCtrl.SenderPorts.RampDwnStatusComplete.Cnt_lgc /end MEASUREMENT
/begin MEASUREMENT StOpCtrl.RampSrlComSvcDft.Cnt_lgc "MICROSAR RTE" UBYTE RTE_CM_BOOLEAN 0 0 0 255 ECU_ADDRESS 0 SYMBOL_LINK "Rte_CDDInterface9_TrqRmpSrlComSvcDft_Cnt_lgc" 0 DISPLAY_IDENTIFIER StOpCtrl.ReceiverPorts.RampSrlComSvcDft.Cnt_lgc /end MEASUREMENT
/begin MEASUREMENT StaMd.ATerm.Cnt_lgc "MICROSAR RTE" UBYTE RTE_CM_BOOLEAN 0 0 0 255 ECU_ADDRESS 0 SYMBOL_LINK "Rte_VehPwrMd_ATermActive_Cnt_lgc" 0 DISPLAY_IDENTIFIER StaMd.ReceiverPorts.ATerm.Cnt_lgc /end MEASUREMENT
/begin MEASUREMENT StaMd.CTerm.Cnt_lgc "MICROSAR RTE" UBYTE RTE_CM_BOOLEAN 0 0 0 255 ECU_ADDRESS 0 SYMBOL_LINK "Rte_VehPwrMd_CTermActive_Cnt_lgc" 0 DISPLAY_IDENTIFIER StaMd.ReceiverPorts.CTerm.Cnt_lgc /end MEASUREMENT
/begin MEASUREMENT StaMd.ControlledDampStatusComplete.Cnt_lgc "MICROSAR RTE" UBYTE RTE_CM_BOOLEAN 0 0 0 255 ECU_ADDRESS 0 SYMBOL_LINK "Rte_CtrldDisShtdn_CtrldDmpStsCmp_Cnt_lgc" 0 DISPLAY_IDENTIFIER StaMd.ReceiverPorts.ControlledDampStatusComplete.Cnt_lgc /end MEASUREMENT
/begin MEASUREMENT StaMd.CurrentSystemState.Mode "MICROSAR RTE" UBYTE RTE_CM_ENUM_StaMd_Mode 0 0 0 255 ECU_ADDRESS 0 SYMBOL_LINK "Rte_ModeMachine_StaMd_SystemState_Mode" 0 DISPLAY_IDENTIFIER StaMd.ModeRequirePorts.CurrentSystemState.Mode /end MEASUREMENT
/begin MEASUREMENT StaMd.FTerm.Cnt_lgc "MICROSAR RTE" UBYTE RTE_CM_BOOLEAN 0 0 0 255 ECU_ADDRESS 0 SYMBOL_LINK "Rte_DiagMgr10_DiagRmpToZeroActive_Cnt_lgc" 0 DISPLAY_IDENTIFIER StaMd.ReceiverPorts.FTerm.Cnt_lgc /end MEASUREMENT
/begin MEASUREMENT StaMd.InitiatePwrDnFastWrite.Cnt_lgc "MICROSAR RTE" UBYTE RTE_CM_BOOLEAN 0 0 0 255 ECU_ADDRESS 0 SYMBOL_LINK "Rte_StaMd_InitiatePwrDnFastWrite_Cnt_lgc" 0 DISPLAY_IDENTIFIER StaMd.SenderPorts.InitiatePwrDnFastWrite.Cnt_lgc /end MEASUREMENT
/begin MEASUREMENT StaMd.InitiatePwrDnNormalWrite.Cnt_lgc "MICROSAR RTE" UBYTE RTE_CM_BOOLEAN 0 0 0 255 ECU_ADDRESS 0 SYMBOL_LINK "Rte_StaMd_InitiatePwrDnNormalWrite_Cnt_lgc" 0 DISPLAY_IDENTIFIER StaMd.SenderPorts.InitiatePwrDnNormalWrite.Cnt_lgc /end MEASUREMENT
/begin MEASUREMENT StaMd.PwrDnFastWriteComplete.Cnt_lgc "MICROSAR RTE" UBYTE RTE_CM_BOOLEAN 0 0 0 255 ECU_ADDRESS 0 SYMBOL_LINK "Rte_StaMd_PwrDnFastWriteComplete_Cnt_lgc" 0 DISPLAY_IDENTIFIER StaMd.SenderPorts.PwrDnFastWriteComplete.Cnt_lgc /end MEASUREMENT
/begin MEASUREMENT StaMd.RampStatusComplete.Cnt_lgc "MICROSAR RTE" UBYTE RTE_CM_BOOLEAN 0 0 0 255 ECU_ADDRESS 0 SYMBOL_LINK "Rte_StOpCtrl_RampDwnStatusComplete_Cnt_lgc" 0 DISPLAY_IDENTIFIER StaMd.ReceiverPorts.RampStatusComplete.Cnt_lgc /end MEASUREMENT
/begin MEASUREMENT StaMd.SystemState.Mode "MICROSAR RTE" UBYTE RTE_CM_ENUM_StaMd_Mode 0 0 0 255 ECU_ADDRESS 0 SYMBOL_LINK "Rte_ModeMachine_StaMd_SystemState_Mode" 0 DISPLAY_IDENTIFIER StaMd.ModeProvidePorts.SystemState.Mode /end MEASUREMENT
/begin MEASUREMENT StaMd.TMFTestComplete.Cnt_lgc "MICROSAR RTE" UBYTE RTE_CM_BOOLEAN 0 0 0 255 ECU_ADDRESS 0 SYMBOL_LINK "Rte_TmprlMon_TMFTestComplete_Cnt_lgc" 0 DISPLAY_IDENTIFIER StaMd.ReceiverPorts.TMFTestComplete.Cnt_lgc /end MEASUREMENT
/begin MEASUREMENT StaMd11.SystemState11.Mode "MICROSAR RTE" UBYTE RTE_CM_ENUM_StaMd_Mode 0 0 0 255 ECU_ADDRESS 0 SYMBOL_LINK "Rte_ModeMachine_StaMd11_SystemState11_Mode" 0 DISPLAY_IDENTIFIER StaMd11.ModeProvidePorts.SystemState11.Mode /end MEASUREMENT
/begin MEASUREMENT StaMd7.SystemState7.Mode "MICROSAR RTE" UBYTE RTE_CM_ENUM_StaMd_Mode 0 0 0 255 ECU_ADDRESS 0 SYMBOL_LINK "Rte_ModeMachine_StaMd7_SystemState7_Mode" 0 DISPLAY_IDENTIFIER StaMd7.ModeProvidePorts.SystemState7.Mode /end MEASUREMENT
/begin MEASUREMENT StaMd8.ATerm.Cnt_lgc "MICROSAR RTE" UBYTE RTE_CM_BOOLEAN 0 0 0 255 ECU_ADDRESS 0 SYMBOL_LINK "Rte_VehPwrMd_ATermActive_Cnt_lgc" 0 DISPLAY_IDENTIFIER StaMd8.ReceiverPorts.ATerm.Cnt_lgc /end MEASUREMENT
/begin MEASUREMENT StaMd8.CTerm.Cnt_lgc "MICROSAR RTE" UBYTE RTE_CM_BOOLEAN 0 0 0 255 ECU_ADDRESS 0 SYMBOL_LINK "Rte_VehPwrMd_CTermActive_Cnt_lgc" 0 DISPLAY_IDENTIFIER StaMd8.ReceiverPorts.CTerm.Cnt_lgc /end MEASUREMENT
/begin MEASUREMENT StaMd8.ControlledDampStatusComplete.Cnt_lgc "MICROSAR RTE" UBYTE RTE_CM_BOOLEAN 0 0 0 255 ECU_ADDRESS 0 SYMBOL_LINK "Rte_CtrldDisShtdn_CtrldDmpStsCmp_Cnt_lgc" 0 DISPLAY_IDENTIFIER StaMd8.ReceiverPorts.ControlledDampStatusComplete.Cnt_lgc /end MEASUREMENT
/begin MEASUREMENT StaMd8.FTerm.Cnt_lgc "MICROSAR RTE" UBYTE RTE_CM_BOOLEAN 0 0 0 255 ECU_ADDRESS 0 SYMBOL_LINK "Rte_DiagMgr10_DiagRmpToZeroActive_Cnt_lgc" 0 DISPLAY_IDENTIFIER StaMd8.ReceiverPorts.FTerm.Cnt_lgc /end MEASUREMENT
/begin MEASUREMENT StaMd8.RampStatusComplete.Cnt_lgc "MICROSAR RTE" UBYTE RTE_CM_BOOLEAN 0 0 0 255 ECU_ADDRESS 0 SYMBOL_LINK "Rte_StOpCtrl_RampDwnStatusComplete_Cnt_lgc" 0 DISPLAY_IDENTIFIER StaMd8.ReceiverPorts.RampStatusComplete.Cnt_lgc /end MEASUREMENT
/begin MEASUREMENT StaMd8.SystemState8.Mode "MICROSAR RTE" UBYTE RTE_CM_ENUM_StaMd_Mode 0 0 0 255 ECU_ADDRESS 0 SYMBOL_LINK "Rte_ModeMachine_StaMd8_SystemState8_Mode" 0 DISPLAY_IDENTIFIER StaMd8.ModeProvidePorts.SystemState8.Mode /end MEASUREMENT
/begin MEASUREMENT StaMd8.TMFTestComplete.Cnt_lgc "MICROSAR RTE" UBYTE RTE_CM_BOOLEAN 0 0 0 255 ECU_ADDRESS 0 SYMBOL_LINK "Rte_TmprlMon_TMFTestComplete_Cnt_lgc" 0 DISPLAY_IDENTIFIER StaMd8.ReceiverPorts.TMFTestComplete.Cnt_lgc /end MEASUREMENT
/begin MEASUREMENT StaMd9.SystemState9.Mode "MICROSAR RTE" UBYTE RTE_CM_ENUM_StaMd_Mode 0 0 0 255 ECU_ADDRESS 0 SYMBOL_LINK "Rte_ModeMachine_StaMd9_SystemState9_Mode" 0 DISPLAY_IDENTIFIER StaMd9.ModeProvidePorts.SystemState9.Mode /end MEASUREMENT
/begin MEASUREMENT StabilityComp.AssistCmd.MtrNm_f32 "MICROSAR RTE" FLOAT32_IEEE NO_COMPU_METHOD 0 0 1.175494351e-38 3.402823466e+38 ECU_ADDRESS 0 SYMBOL_LINK "Rte_StabilityComp_AssistCmd_MtrNm_f32" 0 DISPLAY_IDENTIFIER StabilityComp.SenderPorts.AssistCmd.MtrNm_f32 /end MEASUREMENT
/begin MEASUREMENT StabilityComp.AssistDDFactor.Uls_f32 "MICROSAR RTE" FLOAT32_IEEE NO_COMPU_METHOD 0 0 1.175494351e-38 3.402823466e+38 ECU_ADDRESS 0 SYMBOL_LINK "Rte_DrvDynCtrl_AssistDDFactor_Uls_f32" 0 DISPLAY_IDENTIFIER StabilityComp.ReceiverPorts.AssistDDFactor.Uls_f32 /end MEASUREMENT
/begin MEASUREMENT StabilityComp.AsstFWActive.Uls_f32 "MICROSAR RTE" FLOAT32_IEEE NO_COMPU_METHOD 0 0 1.175494351e-38 3.402823466e+38 ECU_ADDRESS 0 SYMBOL_LINK "Rte_AssistFirewall_AsstFirewallActive_Uls_f32" 0 DISPLAY_IDENTIFIER StabilityComp.ReceiverPorts.AsstFWActive.Uls_f32 /end MEASUREMENT
/begin MEASUREMENT StabilityComp.CombinedAssist.MtrNm_f32 "MICROSAR RTE" FLOAT32_IEEE NO_COMPU_METHOD 0 0 1.175494351e-38 3.402823466e+38 ECU_ADDRESS 0 SYMBOL_LINK "Rte_AssistFirewall_CombinedAssist_MtrNm_f32" 0 DISPLAY_IDENTIFIER StabilityComp.ReceiverPorts.CombinedAssist.MtrNm_f32 /end MEASUREMENT
/begin MEASUREMENT StabilityComp.HwTorque.HwNm_f32 "MICROSAR RTE" FLOAT32_IEEE NO_COMPU_METHOD 0 0 1.175494351e-38 3.402823466e+38 ECU_ADDRESS 0 SYMBOL_LINK "Rte_Sweep_OutputHwTrq_HwNm_f32" 0 DISPLAY_IDENTIFIER StabilityComp.ReceiverPorts.HwTorque.HwNm_f32 /end MEASUREMENT
/begin MEASUREMENT StabilityComp.SysAssistCmd_MtrNm.MtrNm_f32 "MICROSAR RTE" FLOAT32_IEEE NO_COMPU_METHOD 0 0 1.175494351e-38 3.402823466e+38 ECU_ADDRESS 0 SYMBOL_LINK "Rte_StabilityComp2_SysAssistCmd_MtrNm_f32" 0 DISPLAY_IDENTIFIER StabilityComp.ReceiverPorts.SysAssistCmd_MtrNm.MtrNm_f32 /end MEASUREMENT
/begin MEASUREMENT StabilityComp.VehicleSpeed.Kph_f32 "MICROSAR RTE" FLOAT32_IEEE NO_COMPU_METHOD 0 0 1.175494351e-38 3.402823466e+38 ECU_ADDRESS 0 SYMBOL_LINK "Rte_SignlCondn_VehicleSpeed_Kph_f32" 0 DISPLAY_IDENTIFIER StabilityComp.ReceiverPorts.VehicleSpeed.Kph_f32 /end MEASUREMENT
/begin MEASUREMENT StabilityComp2.AssistDDFactor.Uls_f32 "MICROSAR RTE" FLOAT32_IEEE NO_COMPU_METHOD 0 0 1.175494351e-38 3.402823466e+38 ECU_ADDRESS 0 SYMBOL_LINK "Rte_DrvDynCtrl_AssistDDFactor_Uls_f32" 0 DISPLAY_IDENTIFIER StabilityComp2.ReceiverPorts.AssistDDFactor.Uls_f32 /end MEASUREMENT
/begin MEASUREMENT StabilityComp2.AsstFWActive.Uls_f32 "MICROSAR RTE" FLOAT32_IEEE NO_COMPU_METHOD 0 0 1.175494351e-38 3.402823466e+38 ECU_ADDRESS 0 SYMBOL_LINK "Rte_AssistFirewall_AsstFirewallActive_Uls_f32" 0 DISPLAY_IDENTIFIER StabilityComp2.ReceiverPorts.AsstFWActive.Uls_f32 /end MEASUREMENT
/begin MEASUREMENT StabilityComp2.CombinedAssist.MtrNm_f32 "MICROSAR RTE" FLOAT32_IEEE NO_COMPU_METHOD 0 0 1.175494351e-38 3.402823466e+38 ECU_ADDRESS 0 SYMBOL_LINK "Rte_AssistFirewall_CombinedAssist_MtrNm_f32" 0 DISPLAY_IDENTIFIER StabilityComp2.ReceiverPorts.CombinedAssist.MtrNm_f32 /end MEASUREMENT
/begin MEASUREMENT StabilityComp2.HwTorque.HwNm_f32 "MICROSAR RTE" FLOAT32_IEEE NO_COMPU_METHOD 0 0 1.175494351e-38 3.402823466e+38 ECU_ADDRESS 0 SYMBOL_LINK "Rte_Sweep_OutputHwTrq_HwNm_f32" 0 DISPLAY_IDENTIFIER StabilityComp2.ReceiverPorts.HwTorque.HwNm_f32 /end MEASUREMENT
/begin MEASUREMENT StabilityComp2.SysAssistCmd.MtrNm_f32 "MICROSAR RTE" FLOAT32_IEEE NO_COMPU_METHOD 0 0 1.175494351e-38 3.402823466e+38 ECU_ADDRESS 0 SYMBOL_LINK "Rte_StabilityComp2_SysAssistCmd_MtrNm_f32" 0 DISPLAY_IDENTIFIER StabilityComp2.SenderPorts.SysAssistCmd.MtrNm_f32 /end MEASUREMENT
/begin MEASUREMENT StabilityComp2.VehicleSpeed.Kph_f32 "MICROSAR RTE" FLOAT32_IEEE NO_COMPU_METHOD 0 0 1.175494351e-38 3.402823466e+38 ECU_ADDRESS 0 SYMBOL_LINK "Rte_SignlCondn_VehicleSpeed_Kph_f32" 0 DISPLAY_IDENTIFIER StabilityComp2.ReceiverPorts.VehicleSpeed.Kph_f32 /end MEASUREMENT
/begin MEASUREMENT Sweep.InputHwTrq.HwNm_f32 "MICROSAR RTE" FLOAT32_IEEE NO_COMPU_METHOD 0 0 1.175494351e-38 3.402823466e+38 ECU_ADDRESS 0 SYMBOL_LINK "Rte_HwTrq_AnaHwTorque_HwNm_f32" 0 DISPLAY_IDENTIFIER Sweep.ReceiverPorts.InputHwTrq.HwNm_f32 /end MEASUREMENT
/begin MEASUREMENT Sweep.OutputHwTrq.HwNm_f32 "MICROSAR RTE" FLOAT32_IEEE NO_COMPU_METHOD 0 0 1.175494351e-38 3.402823466e+38 ECU_ADDRESS 0 SYMBOL_LINK "Rte_Sweep_OutputHwTrq_HwNm_f32" 0 DISPLAY_IDENTIFIER Sweep.SenderPorts.OutputHwTrq.HwNm_f32 /end MEASUREMENT
/begin MEASUREMENT Sweep.VehSpd.Kph_f32 "MICROSAR RTE" FLOAT32_IEEE NO_COMPU_METHOD 0 0 1.175494351e-38 3.402823466e+38 ECU_ADDRESS 0 SYMBOL_LINK "Rte_SignlCondn_VehicleSpeed_Kph_f32" 0 DISPLAY_IDENTIFIER Sweep.ReceiverPorts.VehSpd.Kph_f32 /end MEASUREMENT
/begin MEASUREMENT Sweep.VehSpdValid.Cnt_lgc "MICROSAR RTE" UBYTE RTE_CM_BOOLEAN 0 0 0 255 ECU_ADDRESS 0 SYMBOL_LINK "Rte_SignlCondn_VehicleSpeedValid_Cnt_lgc" 0 DISPLAY_IDENTIFIER Sweep.ReceiverPorts.VehSpdValid.Cnt_lgc /end MEASUREMENT
/begin MEASUREMENT Sweep2.InputMtrTrq.MtrNm_f32 "MICROSAR RTE" FLOAT32_IEEE NO_COMPU_METHOD 0 0 1.175494351e-38 3.402823466e+38 ECU_ADDRESS 0 SYMBOL_LINK "Rte_AssistSumnLmt_PostLimitTorque_MtrNm_f32" 0 DISPLAY_IDENTIFIER Sweep2.ReceiverPorts.InputMtrTrq.MtrNm_f32 /end MEASUREMENT
/begin MEASUREMENT Sweep2.OutputMtrTrq.MtrNm_f32 "MICROSAR RTE" FLOAT32_IEEE NO_COMPU_METHOD 0 0 1.175494351e-38 3.402823466e+38 ECU_ADDRESS 0 SYMBOL_LINK "Rte_Sweep2_OutputMtrTrq_MtrNm_f32" 0 DISPLAY_IDENTIFIER Sweep2.SenderPorts.OutputMtrTrq.MtrNm_f32 /end MEASUREMENT
/begin MEASUREMENT ThrmlDutyCycle.CuTempEst.DegC_f32 "MICROSAR RTE" FLOAT32_IEEE NO_COMPU_METHOD 0 0 1.175494351e-38 3.402823466e+38 ECU_ADDRESS 0 SYMBOL_LINK "Rte_MtrTempEst_CuTempEst_DegC_f32" 0 DISPLAY_IDENTIFIER ThrmlDutyCycle.ReceiverPorts.CuTempEst.DegC_f32 /end MEASUREMENT
/begin MEASUREMENT ThrmlDutyCycle.DefeatDutySvc.Cnt_lgc "MICROSAR RTE" UBYTE RTE_CM_BOOLEAN 0 0 0 255 ECU_ADDRESS 0 SYMBOL_LINK "Rte_CDDInterface9_ThermalDCSrlComSvcDft_Cnt_lgc" 0 DISPLAY_IDENTIFIER ThrmlDutyCycle.ReceiverPorts.DefeatDutySvc.Cnt_lgc /end MEASUREMENT
/begin MEASUREMENT ThrmlDutyCycle.DutyCycleLevel.Uls_f32 "MICROSAR RTE" FLOAT32_IEEE NO_COMPU_METHOD 0 0 1.175494351e-38 3.402823466e+38 ECU_ADDRESS 0 SYMBOL_LINK "Rte_ThrmlDutyCycle_DutyCycleLevel_Uls_f32" 0 DISPLAY_IDENTIFIER ThrmlDutyCycle.SenderPorts.DutyCycleLevel.Uls_f32 /end MEASUREMENT
/begin MEASUREMENT ThrmlDutyCycle.FiltMeasTemp.DegC_f32 "MICROSAR RTE" FLOAT32_IEEE NO_COMPU_METHOD 0 0 1.175494351e-38 3.402823466e+38 ECU_ADDRESS 0 SYMBOL_LINK "Rte_CtrlTemp_FiltMeasTemp_DegC_f32" 0 DISPLAY_IDENTIFIER ThrmlDutyCycle.ReceiverPorts.FiltMeasTemp.DegC_f32 /end MEASUREMENT
/begin MEASUREMENT ThrmlDutyCycle.FilteredPkCurr.AmpSq_f32 "MICROSAR RTE" FLOAT32_IEEE NO_COMPU_METHOD 0 0 1.175494351e-38 3.402823466e+38 ECU_ADDRESS 0 SYMBOL_LINK "Rte_CurrentEst_FiltEstPkCurr_AmpSq_f32" 0 DISPLAY_IDENTIFIER ThrmlDutyCycle.ReceiverPorts.FilteredPkCurr.AmpSq_f32 /end MEASUREMENT
/begin MEASUREMENT ThrmlDutyCycle.IgnTimeOff.Cnt_u32 "MICROSAR RTE" ULONG NO_COMPU_METHOD 0 0 0 4294967295 ECU_ADDRESS 0 SYMBOL_LINK "Rte_SrlComInput_IgnTimeOff_Cnt_u32" 0 DISPLAY_IDENTIFIER ThrmlDutyCycle.ReceiverPorts.IgnTimeOff.Cnt_u32 /end MEASUREMENT
/begin MEASUREMENT ThrmlDutyCycle.MagTempEst.DegC_f32 "MICROSAR RTE" FLOAT32_IEEE NO_COMPU_METHOD 0 0 1.175494351e-38 3.402823466e+38 ECU_ADDRESS 0 SYMBOL_LINK "Rte_MtrTempEst_MagTempEst_DegC_f32" 0 DISPLAY_IDENTIFIER ThrmlDutyCycle.ReceiverPorts.MagTempEst.DegC_f32 /end MEASUREMENT
/begin MEASUREMENT ThrmlDutyCycle.MotorVelCRF.MtrRadpS_f32 "MICROSAR RTE" FLOAT32_IEEE NO_COMPU_METHOD 0 0 1.175494351e-38 3.402823466e+38 ECU_ADDRESS 0 SYMBOL_LINK "Rte_MtrVel_CRFMotorVel_MtrRadpS_f32" 0 DISPLAY_IDENTIFIER ThrmlDutyCycle.ReceiverPorts.MotorVelCRF.MtrRadpS_f32 /end MEASUREMENT
/begin MEASUREMENT ThrmlDutyCycle.MtrPkCurr.AmpSq_f32 "MICROSAR RTE" FLOAT32_IEEE NO_COMPU_METHOD 0 0 1.175494351e-38 3.402823466e+38 ECU_ADDRESS 0 SYMBOL_LINK "Rte_CurrentEst_EstPkCurr_AmpSq_f32" 0 DISPLAY_IDENTIFIER ThrmlDutyCycle.ReceiverPorts.MtrPkCurr.AmpSq_f32 /end MEASUREMENT
/begin MEASUREMENT ThrmlDutyCycle.SiTempEst.DegC_f32 "MICROSAR RTE" FLOAT32_IEEE NO_COMPU_METHOD 0 0 1.175494351e-38 3.402823466e+38 ECU_ADDRESS 0 SYMBOL_LINK "Rte_MtrTempEst_SiTempEst_DegC_f32" 0 DISPLAY_IDENTIFIER ThrmlDutyCycle.ReceiverPorts.SiTempEst.DegC_f32 /end MEASUREMENT
/begin MEASUREMENT ThrmlDutyCycle.ThermLimitPerc.Uls_f32 "MICROSAR RTE" FLOAT32_IEEE NO_COMPU_METHOD 0 0 1.175494351e-38 3.402823466e+38 ECU_ADDRESS 0 SYMBOL_LINK "Rte_ThrmlDutyCycle_ThermLimitPerc_Uls_f32" 0 DISPLAY_IDENTIFIER ThrmlDutyCycle.SenderPorts.ThermLimitPerc.Uls_f32 /end MEASUREMENT
/begin MEASUREMENT ThrmlDutyCycle.ThermalLimit.MtrNm_f32 "MICROSAR RTE" FLOAT32_IEEE NO_COMPU_METHOD 0 0 1.175494351e-38 3.402823466e+38 ECU_ADDRESS 0 SYMBOL_LINK "Rte_ThrmlDutyCycle_ThermalLimit_MtrNm_f32" 0 DISPLAY_IDENTIFIER ThrmlDutyCycle.SenderPorts.ThermalLimit.MtrNm_f32 /end MEASUREMENT
/begin MEASUREMENT ThrmlDutyCycle.ThrmlDutyCycle_FltStVal.Filt3Val_Cnt_u8 "MICROSAR RTE" UBYTE NO_COMPU_METHOD 0 0 0 255 ECU_ADDRESS 0 SYMBOL_LINK "Rte_ThrmlDutyCycle_ThrmlDutyCycle_FltStVal.Filt3Val_Cnt_u8" 0 DISPLAY_IDENTIFIER ThrmlDutyCycle.PerInstanceMemories.ThrmlDutyCycle_FltStVal.Filt3Val_Cnt_u8 READ_WRITE /end MEASUREMENT
/begin MEASUREMENT ThrmlDutyCycle.ThrmlDutyCycle_FltStVal.Filt4Val_Cnt_u8 "MICROSAR RTE" UBYTE NO_COMPU_METHOD 0 0 0 255 ECU_ADDRESS 0 SYMBOL_LINK "Rte_ThrmlDutyCycle_ThrmlDutyCycle_FltStVal.Filt4Val_Cnt_u8" 0 DISPLAY_IDENTIFIER ThrmlDutyCycle.PerInstanceMemories.ThrmlDutyCycle_FltStVal.Filt4Val_Cnt_u8 READ_WRITE /end MEASUREMENT
/begin MEASUREMENT ThrmlDutyCycle.ThrmlDutyCycle_FltStVal.Filt5Val_Cnt_u8 "MICROSAR RTE" UBYTE NO_COMPU_METHOD 0 0 0 255 ECU_ADDRESS 0 SYMBOL_LINK "Rte_ThrmlDutyCycle_ThrmlDutyCycle_FltStVal.Filt5Val_Cnt_u8" 0 DISPLAY_IDENTIFIER ThrmlDutyCycle.PerInstanceMemories.ThrmlDutyCycle_FltStVal.Filt5Val_Cnt_u8 READ_WRITE /end MEASUREMENT
/begin MEASUREMENT ThrmlDutyCycle.ThrmlDutyCycle_FltStVal.Filt6Val_Cnt_u8 "MICROSAR RTE" UBYTE NO_COMPU_METHOD 0 0 0 255 ECU_ADDRESS 0 SYMBOL_LINK "Rte_ThrmlDutyCycle_ThrmlDutyCycle_FltStVal.Filt6Val_Cnt_u8" 0 DISPLAY_IDENTIFIER ThrmlDutyCycle.PerInstanceMemories.ThrmlDutyCycle_FltStVal.Filt6Val_Cnt_u8 READ_WRITE /end MEASUREMENT
/begin MEASUREMENT ThrmlDutyCycle.VehTimeValid.Cnt_lgc "MICROSAR RTE" UBYTE RTE_CM_BOOLEAN 0 0 0 255 ECU_ADDRESS 0 SYMBOL_LINK "Rte_SrlComInput_VehTimeValid_Cnt_lgc" 0 DISPLAY_IDENTIFIER ThrmlDutyCycle.ReceiverPorts.VehTimeValid.Cnt_lgc /end MEASUREMENT
/begin MEASUREMENT TmprlMon.SystemState.Mode "MICROSAR RTE" UBYTE RTE_CM_ENUM_StaMd_Mode 0 0 0 255 ECU_ADDRESS 0 SYMBOL_LINK "Rte_ModeMachine_StaMd7_SystemState7_Mode" 0 DISPLAY_IDENTIFIER TmprlMon.ModeRequirePorts.SystemState.Mode /end MEASUREMENT
/begin MEASUREMENT TmprlMon.TMFTestComplete.Cnt_lgc "MICROSAR RTE" UBYTE RTE_CM_BOOLEAN 0 0 0 255 ECU_ADDRESS 0 SYMBOL_LINK "Rte_TmprlMon_TMFTestComplete_Cnt_lgc" 0 DISPLAY_IDENTIFIER TmprlMon.SenderPorts.TMFTestComplete.Cnt_lgc /end MEASUREMENT
/begin MEASUREMENT TmprlMon.TMFTestStart.Cnt_lgc "MICROSAR RTE" UBYTE RTE_CM_BOOLEAN 0 0 0 255 ECU_ADDRESS 0 SYMBOL_LINK "Rte_HwPwUp_TMFTestStart_Cnt_lgc" 0 DISPLAY_IDENTIFIER TmprlMon.ReceiverPorts.TMFTestStart.Cnt_lgc /end MEASUREMENT
/begin MEASUREMENT TrqBasedInrtCmp.HighFreqAssist.MtrNm_f32 "MICROSAR RTE" FLOAT32_IEEE NO_COMPU_METHOD 0 0 1.175494351e-38 3.402823466e+38 ECU_ADDRESS 0 SYMBOL_LINK "Rte_TrqBasedInrtCmp_HighFreqAssist_MtrNm_f32" 0 DISPLAY_IDENTIFIER TrqBasedInrtCmp.SenderPorts.HighFreqAssist.MtrNm_f32 /end MEASUREMENT
/begin MEASUREMENT TrqBasedInrtCmp.HwTorque.HwNm_f32 "MICROSAR RTE" FLOAT32_IEEE NO_COMPU_METHOD 0 0 1.175494351e-38 3.402823466e+38 ECU_ADDRESS 0 SYMBOL_LINK "Rte_Sweep_OutputHwTrq_HwNm_f32" 0 DISPLAY_IDENTIFIER TrqBasedInrtCmp.ReceiverPorts.HwTorque.HwNm_f32 /end MEASUREMENT
/begin MEASUREMENT TrqBasedInrtCmp.VehicleSpeed.Kph_f32 "MICROSAR RTE" FLOAT32_IEEE NO_COMPU_METHOD 0 0 1.175494351e-38 3.402823466e+38 ECU_ADDRESS 0 SYMBOL_LINK "Rte_SignlCondn_VehicleSpeed_Kph_f32" 0 DISPLAY_IDENTIFIER TrqBasedInrtCmp.ReceiverPorts.VehicleSpeed.Kph_f32 /end MEASUREMENT
/begin MEASUREMENT TrqCmdScl.MRFMtrTrqCmd.MtrNm_f32 "MICROSAR RTE" FLOAT32_IEEE NO_COMPU_METHOD 0 0 1.175494351e-38 3.402823466e+38 ECU_ADDRESS 0 SYMBOL_LINK "Rte_CtrldDisShtdn_CntDisMtrTrqCmdMRF_MtrNm_f32" 0 DISPLAY_IDENTIFIER TrqCmdScl.ReceiverPorts.MRFMtrTrqCmd.MtrNm_f32 /end MEASUREMENT
/begin MEASUREMENT TrqCmdScl.MRFMtrTrqCmdScl.MtrNm_f32 "MICROSAR RTE" FLOAT32_IEEE NO_COMPU_METHOD 0 0 1.175494351e-38 3.402823466e+38 ECU_ADDRESS 0 SYMBOL_LINK "Rte_TrqCmdScl_MRFMtrTrqCmdScl_MtrNm_f32" 0 DISPLAY_IDENTIFIER TrqCmdScl.SenderPorts.MRFMtrTrqCmdScl.MtrNm_f32 /end MEASUREMENT
/begin MEASUREMENT TrqCmdScl.TorqueCmdSF_Uls_f32 "MICROSAR RTE" FLOAT32_IEEE NO_COMPU_METHOD 0 0 1.175494351e-38 3.402823466e+38 ECU_ADDRESS 0 SYMBOL_LINK "Rte_TrqCmdScl_TorqueCmdSF_Uls_f32" 0 DISPLAY_IDENTIFIER TrqCmdScl.PerInstanceMemories.TorqueCmdSF_Uls_f32 READ_WRITE /end MEASUREMENT
/begin MEASUREMENT TrqOsc.TrqOscActv.Cnt_lgc "MICROSAR RTE" UBYTE RTE_CM_BOOLEAN 0 0 0 255 ECU_ADDRESS 0 SYMBOL_LINK "Rte_TrqOsc_TrqOscActv_Cnt_lgc" 0 DISPLAY_IDENTIFIER TrqOsc.SenderPorts.TrqOscActv.Cnt_lgc /end MEASUREMENT
/begin MEASUREMENT TrqOsc.TrqOscAmp.MtrNm_f32 "MICROSAR RTE" FLOAT32_IEEE NO_COMPU_METHOD 0 0 1.175494351e-38 3.402823466e+38 ECU_ADDRESS 0 SYMBOL_LINK "Rte_BmwHaptcFb_TrqOscAmp_MtrNm_f32" 0 DISPLAY_IDENTIFIER TrqOsc.ReceiverPorts.TrqOscAmp.MtrNm_f32 /end MEASUREMENT
/begin MEASUREMENT TrqOsc.TrqOscCmd.MtrNm_f32 "MICROSAR RTE" FLOAT32_IEEE NO_COMPU_METHOD 0 0 1.175494351e-38 3.402823466e+38 ECU_ADDRESS 0 SYMBOL_LINK "Rte_TrqOsc_TrqOscCmd_MtrNm_f32" 0 DISPLAY_IDENTIFIER TrqOsc.SenderPorts.TrqOscCmd.MtrNm_f32 /end MEASUREMENT
/begin MEASUREMENT TrqOsc.TrqOscDCExceeded.Cnt_lgc "MICROSAR RTE" UBYTE RTE_CM_BOOLEAN 0 0 0 255 ECU_ADDRESS 0 SYMBOL_LINK "Rte_TrqOsc_TrqOscDCExceeded_Cnt_lgc" 0 DISPLAY_IDENTIFIER TrqOsc.SenderPorts.TrqOscDCExceeded.Cnt_lgc /end MEASUREMENT
/begin MEASUREMENT TrqOsc.TrqOscEnable.Cnt_lgc "MICROSAR RTE" UBYTE RTE_CM_BOOLEAN 0 0 0 255 ECU_ADDRESS 0 SYMBOL_LINK "Rte_BmwHaptcFb_TrqOscEnable_Cnt_lgc" 0 DISPLAY_IDENTIFIER TrqOsc.ReceiverPorts.TrqOscEnable.Cnt_lgc /end MEASUREMENT
/begin MEASUREMENT TrqOsc.TrqOscFallRampRate.MtrNmpS_f32 "MICROSAR RTE" FLOAT32_IEEE NO_COMPU_METHOD 0 0 1.175494351e-38 3.402823466e+38 ECU_ADDRESS 0 SYMBOL_LINK "Rte_BmwHaptcFb_TrqOscFallingRampRate_MtrNmpS_f32" 0 DISPLAY_IDENTIFIER TrqOsc.ReceiverPorts.TrqOscFallRampRate.MtrNmpS_f32 /end MEASUREMENT
/begin MEASUREMENT TrqOsc.TrqOscFreq.Hz_f32 "MICROSAR RTE" FLOAT32_IEEE NO_COMPU_METHOD 0 0 1.175494351e-38 3.402823466e+38 ECU_ADDRESS 0 SYMBOL_LINK "Rte_BmwHaptcFb_TrqOscFreq_Hz_f32" 0 DISPLAY_IDENTIFIER TrqOsc.ReceiverPorts.TrqOscFreq.Hz_f32 /end MEASUREMENT
/begin MEASUREMENT TrqOsc.TrqOscRisngRampRate.MtrNmpS_f32 "MICROSAR RTE" FLOAT32_IEEE NO_COMPU_METHOD 0 0 1.175494351e-38 3.402823466e+38 ECU_ADDRESS 0 SYMBOL_LINK "Rte_BmwHaptcFb_TrqOscRisngRampRate_MtrNmpS_f32" 0 DISPLAY_IDENTIFIER TrqOsc.ReceiverPorts.TrqOscRisngRampRate.MtrNmpS_f32 /end MEASUREMENT
/begin MEASUREMENT TuningSelAuth.ActiveTunOvrPtrAddr.Cnt_u32 "MICROSAR RTE" ULONG NO_COMPU_METHOD 0 0 0 4294967295 ECU_ADDRESS 0 SYMBOL_LINK "Rte_ApXcp_ActiveTunOvrPtrAddr_Cnt_u32" 0 DISPLAY_IDENTIFIER TuningSelAuth.ReceiverPorts.ActiveTunOvrPtrAddr.Cnt_u32 /end MEASUREMENT
/begin MEASUREMENT TuningSelAuth.ActiveTunPers.Cnt_u16 "MICROSAR RTE" UWORD NO_COMPU_METHOD 0 0 0 65535 ECU_ADDRESS 0 SYMBOL_LINK "Rte_TuningSelAuth_ActiveTunPers_Cnt_u16" 0 DISPLAY_IDENTIFIER TuningSelAuth.SenderPorts.ActiveTunPers.Cnt_u16 /end MEASUREMENT
/begin MEASUREMENT TuningSelAuth.ActiveTunSet.Cnt_u16 "MICROSAR RTE" UWORD NO_COMPU_METHOD 0 0 0 65535 ECU_ADDRESS 0 SYMBOL_LINK "Rte_TuningSelAuth_ActiveTunSet_Cnt_u16" 0 DISPLAY_IDENTIFIER TuningSelAuth.SenderPorts.ActiveTunSet.Cnt_u16 /end MEASUREMENT
/begin MEASUREMENT TuningSelAuth.DesiredTunPers.Cnt_u16 "MICROSAR RTE" UWORD NO_COMPU_METHOD 0 0 0 65535 ECU_ADDRESS 0 SYMBOL_LINK "Rte_VehCfg_DesiredTunPers_Cnt_u16" 0 DISPLAY_IDENTIFIER TuningSelAuth.ReceiverPorts.DesiredTunPers.Cnt_u16 /end MEASUREMENT
/begin MEASUREMENT TuningSelAuth.DesiredTunSet.Cnt_u16 "MICROSAR RTE" UWORD NO_COMPU_METHOD 0 0 0 65535 ECU_ADDRESS 0 SYMBOL_LINK "Rte_VehCfg_DesiredTunSet_Cnt_u16" 0 DISPLAY_IDENTIFIER TuningSelAuth.ReceiverPorts.DesiredTunSet.Cnt_u16 /end MEASUREMENT
/begin MEASUREMENT TuningSelAuth.HwTorque.HwNm_f32 "MICROSAR RTE" FLOAT32_IEEE NO_COMPU_METHOD 0 0 1.175494351e-38 3.402823466e+38 ECU_ADDRESS 0 SYMBOL_LINK "Rte_Sweep_OutputHwTrq_HwNm_f32" 0 DISPLAY_IDENTIFIER TuningSelAuth.ReceiverPorts.HwTorque.HwNm_f32 /end MEASUREMENT
/begin MEASUREMENT TuningSelAuth.TuningSessionActPtr.Cnt_u8 "MICROSAR RTE" UBYTE RTE_CM_ENUM_TuningSessionAddrPtrEnum 0 0 0 255 ECU_ADDRESS 0 SYMBOL_LINK "Rte_ApXcp_TuningSessionActPtr_Cnt_u8" 0 DISPLAY_IDENTIFIER TuningSelAuth.ReceiverPorts.TuningSessionActPtr.Cnt_u8 /end MEASUREMENT
/begin MEASUREMENT TuningSelAuth.VehicleSpeed.Kph_f32 "MICROSAR RTE" FLOAT32_IEEE NO_COMPU_METHOD 0 0 1.175494351e-38 3.402823466e+38 ECU_ADDRESS 0 SYMBOL_LINK "Rte_SignlCondn_VehicleSpeed_Kph_f32" 0 DISPLAY_IDENTIFIER TuningSelAuth.ReceiverPorts.VehicleSpeed.Kph_f32 /end MEASUREMENT
/begin MEASUREMENT TurnsCounter.AlignedCumMtrPosMRF.Deg_f32 "MICROSAR RTE" FLOAT32_IEEE NO_COMPU_METHOD 0 0 1.175494351e-38 3.402823466e+38 ECU_ADDRESS 0 SYMBOL_LINK "Rte_MtrPos_AlignedCumMtrPosMRF_Deg_f32" 0 DISPLAY_IDENTIFIER TurnsCounter.ReceiverPorts.AlignedCumMtrPosMRF.Deg_f32 /end MEASUREMENT
/begin MEASUREMENT TurnsCounter.EOLTurnsCntrCals.TcEolCalChksm_Cnt_u08 "MICROSAR RTE" UBYTE NO_COMPU_METHOD 0 0 0 255 ECU_ADDRESS 0 SYMBOL_LINK "Rte_TurnsCounter_EOLTurnsCntrCals.TcEolCalChksm_Cnt_u08" 0 DISPLAY_IDENTIFIER TurnsCounter.PerInstanceMemories.EOLTurnsCntrCals.TcEolCalChksm_Cnt_u08 READ_WRITE /end MEASUREMENT
/begin MEASUREMENT TurnsCounter.EOLTurnsCntrCals.TcEolCosineOffset_Cnt_u08 "MICROSAR RTE" UBYTE NO_COMPU_METHOD 0 0 0 255 ECU_ADDRESS 0 SYMBOL_LINK "Rte_TurnsCounter_EOLTurnsCntrCals.TcEolCosineOffset_Cnt_u08" 0 DISPLAY_IDENTIFIER TurnsCounter.PerInstanceMemories.EOLTurnsCntrCals.TcEolCosineOffset_Cnt_u08 READ_WRITE /end MEASUREMENT
/begin MEASUREMENT TurnsCounter.EOLTurnsCntrCals.TcEolSin2CosGain_Cnt_u08 "MICROSAR RTE" UBYTE NO_COMPU_METHOD 0 0 0 255 ECU_ADDRESS 0 SYMBOL_LINK "Rte_TurnsCounter_EOLTurnsCntrCals.TcEolSin2CosGain_Cnt_u08" 0 DISPLAY_IDENTIFIER TurnsCounter.PerInstanceMemories.EOLTurnsCntrCals.TcEolSin2CosGain_Cnt_u08 READ_WRITE /end MEASUREMENT
/begin MEASUREMENT TurnsCounter.EOLTurnsCntrCals.TcEolSinVsCosMax_Cnt_u08 "MICROSAR RTE" UBYTE NO_COMPU_METHOD 0 0 0 255 ECU_ADDRESS 0 SYMBOL_LINK "Rte_TurnsCounter_EOLTurnsCntrCals.TcEolSinVsCosMax_Cnt_u08" 0 DISPLAY_IDENTIFIER TurnsCounter.PerInstanceMemories.EOLTurnsCntrCals.TcEolSinVsCosMax_Cnt_u08 READ_WRITE /end MEASUREMENT
/begin MEASUREMENT TurnsCounter.EOLTurnsCntrCals.TcEolSinVsCosMin_Cnt_u08 "MICROSAR RTE" UBYTE NO_COMPU_METHOD 0 0 0 255 ECU_ADDRESS 0 SYMBOL_LINK "Rte_TurnsCounter_EOLTurnsCntrCals.TcEolSinVsCosMin_Cnt_u08" 0 DISPLAY_IDENTIFIER TurnsCounter.PerInstanceMemories.EOLTurnsCntrCals.TcEolSinVsCosMin_Cnt_u08 READ_WRITE /end MEASUREMENT
/begin MEASUREMENT TurnsCounter.EOLTurnsCntrCals.TcEolSineOffset_Cnt_u08 "MICROSAR RTE" UBYTE NO_COMPU_METHOD 0 0 0 255 ECU_ADDRESS 0 SYMBOL_LINK "Rte_TurnsCounter_EOLTurnsCntrCals.TcEolSineOffset_Cnt_u08" 0 DISPLAY_IDENTIFIER TurnsCounter.PerInstanceMemories.EOLTurnsCntrCals.TcEolSineOffset_Cnt_u08 READ_WRITE /end MEASUREMENT
/begin MEASUREMENT TurnsCounter.EnergyModeState.Cnt_enum "MICROSAR RTE" UBYTE RTE_CM_ENUM_EnergyModeStateType 0 0 0 3 ECU_ADDRESS 0 SYMBOL_LINK "Rte_VehCfg_EnergyModeState_Cnt_enum" 0 DISPLAY_IDENTIFIER TurnsCounter.ReceiverPorts.EnergyModeState.Cnt_enum /end MEASUREMENT
/begin MEASUREMENT TurnsCounter.HwTargetAuthority.Uls_f32 "MICROSAR RTE" FLOAT32_IEEE NO_COMPU_METHOD 0 0 1.175494351e-38 3.402823466e+38 ECU_ADDRESS 0 SYMBOL_LINK "Rte_AbsHwPos_HwTargetAuthority_Uls_f32" 0 DISPLAY_IDENTIFIER TurnsCounter.ReceiverPorts.HwTargetAuthority.Uls_f32 /end MEASUREMENT
/begin MEASUREMENT TurnsCounter.ICMMtrPosMRF.Deg_f32 "MICROSAR RTE" FLOAT32_IEEE NO_COMPU_METHOD 0 0 1.175494351e-38 3.402823466e+38 ECU_ADDRESS 0 SYMBOL_LINK "Rte_AbsHwPos_ICMMtrPosMRF_Deg_f32" 0 DISPLAY_IDENTIFIER TurnsCounter.ReceiverPorts.ICMMtrPosMRF.Deg_f32 /end MEASUREMENT
/begin MEASUREMENT TurnsCounter.LTRackCntrComplete.Cnt_lgc "MICROSAR RTE" UBYTE RTE_CM_BOOLEAN 0 0 0 255 ECU_ADDRESS 0 SYMBOL_LINK "Rte_LnRkCr_LTRackCntrComplete_Cnt_lgc" 0 DISPLAY_IDENTIFIER TurnsCounter.ReceiverPorts.LTRackCntrComplete.Cnt_lgc /end MEASUREMENT
/begin MEASUREMENT TurnsCounter.LTVehCenterComplete.Cnt_lgc "MICROSAR RTE" UBYTE RTE_CM_BOOLEAN 0 0 0 255 ECU_ADDRESS 0 SYMBOL_LINK "Rte_AbsHwPos_LTVehCenterComplete_Cnt_lgc" 0 DISPLAY_IDENTIFIER TurnsCounter.ReceiverPorts.LTVehCenterComplete.Cnt_lgc /end MEASUREMENT
/begin MEASUREMENT TurnsCounter.MotorVelMRF.MtrRadpS_f32 "MICROSAR RTE" FLOAT32_IEEE NO_COMPU_METHOD 0 0 1.175494351e-38 3.402823466e+38 ECU_ADDRESS 0 SYMBOL_LINK "Rte_MtrVel_MRFMotorVel_MtrRadpS_f32" 0 DISPLAY_IDENTIFIER TurnsCounter.ReceiverPorts.MotorVelMRF.MtrRadpS_f32 /end MEASUREMENT
/begin MEASUREMENT TurnsCounter.RackCenterComplete.Cnt_lgc "MICROSAR RTE" UBYTE RTE_CM_BOOLEAN 0 0 0 255 ECU_ADDRESS 0 SYMBOL_LINK "Rte_LnRkCr_RackCntrComplete_Cnt_lgc" 0 DISPLAY_IDENTIFIER TurnsCounter.ReceiverPorts.RackCenterComplete.Cnt_lgc /end MEASUREMENT
/begin MEASUREMENT TurnsCounter.TCFlash.Cnt_lgc "MICROSAR RTE" UBYTE RTE_CM_BOOLEAN 0 0 0 255 ECU_ADDRESS 0 SYMBOL_LINK "Rte_CDDInterface9_TcReflashActive_Cnt_lgc" 0 DISPLAY_IDENTIFIER TurnsCounter.ReceiverPorts.TCFlash.Cnt_lgc /end MEASUREMENT
/begin MEASUREMENT TurnsCounter.TCMtrPosOffsMRF.Deg_f32 "MICROSAR RTE" FLOAT32_IEEE NO_COMPU_METHOD 0 0 1.175494351e-38 3.402823466e+38 ECU_ADDRESS 0 SYMBOL_LINK "Rte_TurnsCounter_TCMtrPosOffsMRF_Deg_f32" 0 DISPLAY_IDENTIFIER TurnsCounter.SenderPorts.TCMtrPosOffsMRF.Deg_f32 /end MEASUREMENT
/begin MEASUREMENT TurnsCounter.TcActivePN.Cnt_u32 "MICROSAR RTE" ULONG NO_COMPU_METHOD 0 0 0 4294967295 ECU_ADDRESS 0 SYMBOL_LINK "Rte_TurnsCounter_TcActivePN_Cnt_u32" 0 DISPLAY_IDENTIFIER TurnsCounter.SenderPorts.TcActivePN.Cnt_u32 /end MEASUREMENT
/begin MEASUREMENT TurnsCounter.TcActivePNVldCnt.Cnt_u32 "MICROSAR RTE" ULONG NO_COMPU_METHOD 0 0 0 4294967295 ECU_ADDRESS 0 SYMBOL_LINK "Rte_TurnsCounter_TcActivePNVldCnt_Cnt_u32" 0 DISPLAY_IDENTIFIER TurnsCounter.SenderPorts.TcActivePNVldCnt.Cnt_u32 /end MEASUREMENT
/begin MEASUREMENT TurnsCounter.TcFlashErrors.Cnt_u08 "MICROSAR RTE" UBYTE NO_COMPU_METHOD 0 0 0 255 ECU_ADDRESS 0 SYMBOL_LINK "Rte_CDDInterface9_TcFlashErrors_Cnt_u08" 0 DISPLAY_IDENTIFIER TurnsCounter.ReceiverPorts.TcFlashErrors.Cnt_u08 /end MEASUREMENT
/begin MEASUREMENT TurnsCounter.TcFlashVerify.Cnt_lgc "MICROSAR RTE" UBYTE RTE_CM_BOOLEAN 0 0 0 255 ECU_ADDRESS 0 SYMBOL_LINK "Rte_CDDInterface9_TcFlashVerify_Cnt_lgc" 0 DISPLAY_IDENTIFIER TurnsCounter.ReceiverPorts.TcFlashVerify.Cnt_lgc /end MEASUREMENT
/begin MEASUREMENT TurnsCounter.TurnsCntrValidity.Cnt_enum "MICROSAR RTE" UBYTE RTE_CM_ENUM_TurnsCntrValStateType 0 0 0 255 ECU_ADDRESS 0 SYMBOL_LINK "Rte_TurnsCounter_TurnsCntrValidity_Cnt_enum" 0 DISPLAY_IDENTIFIER TurnsCounter.SenderPorts.TurnsCntrValidity.Cnt_enum /end MEASUREMENT
/begin MEASUREMENT VehCfg.CADASIF.Cnt_lgc "MICROSAR RTE" UBYTE RTE_CM_BOOLEAN 0 0 0 255 ECU_ADDRESS 0 SYMBOL_LINK "Rte_VehCfg_CADASIF_Cnt_lgc" 0 DISPLAY_IDENTIFIER VehCfg.SenderPorts.CADASIF.Cnt_lgc /end MEASUREMENT
/begin MEASUREMENT VehCfg.CASSISTMSA.Cnt_lgc "MICROSAR RTE" UBYTE RTE_CM_BOOLEAN 0 0 0 255 ECU_ADDRESS 0 SYMBOL_LINK "Rte_VehCfg_CASSISTMSA_Cnt_lgc" 0 DISPLAY_IDENTIFIER VehCfg.SenderPorts.CASSISTMSA.Cnt_lgc /end MEASUREMENT
/begin MEASUREMENT VehCfg.CBATCURLIMITCURRENT.Amp_f32 "MICROSAR RTE" FLOAT32_IEEE NO_COMPU_METHOD 0 0 1.175494351e-38 3.402823466e+38 ECU_ADDRESS 0 SYMBOL_LINK "Rte_VehCfg_CBATCURLIMITCURRENT_Amp_f32" 0 DISPLAY_IDENTIFIER VehCfg.SenderPorts.CBATCURLIMITCURRENT.Amp_f32 /end MEASUREMENT
/begin MEASUREMENT VehCfg.CDISPCCDRDY02.Cnt_u08 "MICROSAR RTE" UBYTE NO_COMPU_METHOD 0 0 0 255 ECU_ADDRESS 0 SYMBOL_LINK "Rte_VehCfg_CDISPCCDRDY02_Cnt_u08" 0 DISPLAY_IDENTIFIER VehCfg.SenderPorts.CDISPCCDRDY02.Cnt_u08 /end MEASUREMENT
/begin MEASUREMENT VehCfg.CDRVDYNMSG.Cnt_lgc "MICROSAR RTE" UBYTE RTE_CM_BOOLEAN 0 0 0 255 ECU_ADDRESS 0 SYMBOL_LINK "Rte_VehCfg_CDRVDYNMSG_Cnt_lgc" 0 DISPLAY_IDENTIFIER VehCfg.SenderPorts.CDRVDYNMSG.Cnt_lgc /end MEASUREMENT
/begin MEASUREMENT VehCfg.CEFANMSG.Cnt_lgc "MICROSAR RTE" UBYTE RTE_CM_BOOLEAN 0 0 0 255 ECU_ADDRESS 0 SYMBOL_LINK "Rte_VehCfg_CEFANMSG_Cnt_lgc" 0 DISPLAY_IDENTIFIER VehCfg.SenderPorts.CEFANMSG.Cnt_lgc /end MEASUREMENT
/begin MEASUREMENT VehCfg.CEPSPWRMAX.Cnt_lgc "MICROSAR RTE" UBYTE RTE_CM_BOOLEAN 0 0 0 255 ECU_ADDRESS 0 SYMBOL_LINK "Rte_VehCfg_CEPSPWRMAX_Cnt_lgc" 0 DISPLAY_IDENTIFIER VehCfg.SenderPorts.CEPSPWRMAX.Cnt_lgc /end MEASUREMENT
/begin MEASUREMENT VehCfg.CERRMVOLTFALLBACK.Cnt_lgc "MICROSAR RTE" UBYTE RTE_CM_BOOLEAN 0 0 0 255 ECU_ADDRESS 0 SYMBOL_LINK "Rte_VehCfg_CERRMVOLTFALLBACK_Cnt_lgc" 0 DISPLAY_IDENTIFIER VehCfg.SenderPorts.CERRMVOLTFALLBACK.Cnt_lgc /end MEASUREMENT
/begin MEASUREMENT VehCfg.CEVIIF.Cnt_lgc "MICROSAR RTE" UBYTE RTE_CM_BOOLEAN 0 0 0 255 ECU_ADDRESS 0 SYMBOL_LINK "Rte_VehCfg_CEVIIF_Cnt_lgc" 0 DISPLAY_IDENTIFIER VehCfg.SenderPorts.CEVIIF.Cnt_lgc /end MEASUREMENT
/begin MEASUREMENT VehCfg.CFACTORIF.Cnt_lgc "MICROSAR RTE" UBYTE RTE_CM_BOOLEAN 0 0 0 255 ECU_ADDRESS 0 SYMBOL_LINK "Rte_VehCfg_CFACTORIF_Cnt_lgc" 0 DISPLAY_IDENTIFIER VehCfg.SenderPorts.CFACTORIF.Cnt_lgc /end MEASUREMENT
/begin MEASUREMENT VehCfg.CFRCOMPIF.Cnt_lgc "MICROSAR RTE" UBYTE RTE_CM_BOOLEAN 0 0 0 255 ECU_ADDRESS 0 SYMBOL_LINK "Rte_VehCfg_CFRCOMPIF_Cnt_lgc" 0 DISPLAY_IDENTIFIER VehCfg.SenderPorts.CFRCOMPIF.Cnt_lgc /end MEASUREMENT
/begin MEASUREMENT VehCfg.CHWACORRECTION.Cnt_lgc "MICROSAR RTE" UBYTE RTE_CM_BOOLEAN 0 0 0 255 ECU_ADDRESS 0 SYMBOL_LINK "Rte_VehCfg_CHWACORRECTION_Cnt_lgc" 0 DISPLAY_IDENTIFIER VehCfg.SenderPorts.CHWACORRECTION.Cnt_lgc /end MEASUREMENT
/begin MEASUREMENT VehCfg.CHWANGLEIF.Cnt_lgc "MICROSAR RTE" UBYTE RTE_CM_BOOLEAN 0 0 0 255 ECU_ADDRESS 0 SYMBOL_LINK "Rte_VehCfg_CHWANGLEIF_Cnt_lgc" 0 DISPLAY_IDENTIFIER VehCfg.SenderPorts.CHWANGLEIF.Cnt_lgc /end MEASUREMENT
/begin MEASUREMENT VehCfg.CHWTORQUEIF.Cnt_lgc "MICROSAR RTE" UBYTE RTE_CM_BOOLEAN 0 0 0 255 ECU_ADDRESS 0 SYMBOL_LINK "Rte_VehCfg_CHWTORQUEIF_Cnt_lgc" 0 DISPLAY_IDENTIFIER VehCfg.SenderPorts.CHWTORQUEIF.Cnt_lgc /end MEASUREMENT
/begin MEASUREMENT VehCfg.CMTTORQUEIF.Cnt_lgc "MICROSAR RTE" UBYTE RTE_CM_BOOLEAN 0 0 0 255 ECU_ADDRESS 0 SYMBOL_LINK "Rte_VehCfg_CMTTORQUEIF_Cnt_lgc" 0 DISPLAY_IDENTIFIER VehCfg.SenderPorts.CMTTORQUEIF.Cnt_lgc /end MEASUREMENT
/begin MEASUREMENT VehCfg.CPLCOMPIF.Cnt_lgc "MICROSAR RTE" UBYTE RTE_CM_BOOLEAN 0 0 0 255 ECU_ADDRESS 0 SYMBOL_LINK "Rte_VehCfg_CPLCOMPIF_Cnt_lgc" 0 DISPLAY_IDENTIFIER VehCfg.SenderPorts.CPLCOMPIF.Cnt_lgc /end MEASUREMENT
/begin MEASUREMENT VehCfg.CSELRETURN.Cnt_lgc "MICROSAR RTE" UBYTE RTE_CM_BOOLEAN 0 0 0 255 ECU_ADDRESS 0 SYMBOL_LINK "Rte_VehCfg_CSELRETURN_Cnt_lgc" 0 DISPLAY_IDENTIFIER VehCfg.SenderPorts.CSELRETURN.Cnt_lgc /end MEASUREMENT
/begin MEASUREMENT VehCfg.CSELTUNINGBASE.Cnt_u08 "MICROSAR RTE" UBYTE NO_COMPU_METHOD 0 0 0 255 ECU_ADDRESS 0 SYMBOL_LINK "Rte_VehCfg_CSELTUNINGBASE_Cnt_u08" 0 DISPLAY_IDENTIFIER VehCfg.SenderPorts.CSELTUNINGBASE.Cnt_u08 /end MEASUREMENT
/begin MEASUREMENT VehCfg.CSELTUNINGSPORT.Cnt_u08 "MICROSAR RTE" UBYTE NO_COMPU_METHOD 0 0 0 255 ECU_ADDRESS 0 SYMBOL_LINK "Rte_VehCfg_CSELTUNINGSPORT_Cnt_u08" 0 DISPLAY_IDENTIFIER VehCfg.SenderPorts.CSELTUNINGSPORT.Cnt_u08 /end MEASUREMENT
/begin MEASUREMENT VehCfg.CSELTUNINGSVT.Cnt_u08 "MICROSAR RTE" UBYTE NO_COMPU_METHOD 0 0 0 255 ECU_ADDRESS 0 SYMBOL_LINK "Rte_VehCfg_CSELTUNINGSVT_Cnt_u08" 0 DISPLAY_IDENTIFIER VehCfg.SenderPorts.CSELTUNINGSVT.Cnt_u08 /end MEASUREMENT
/begin MEASUREMENT VehCfg.CVEHSPDCURLIMITCURRENT.Amp_f32 "MICROSAR RTE" FLOAT32_IEEE NO_COMPU_METHOD 0 0 1.175494351e-38 3.402823466e+38 ECU_ADDRESS 0 SYMBOL_LINK "Rte_VehCfg_CVEHSPDCURLIMITCURRENT_Amp_f32" 0 DISPLAY_IDENTIFIER VehCfg.SenderPorts.CVEHSPDCURLIMITCURRENT.Amp_f32 /end MEASUREMENT
/begin MEASUREMENT VehCfg.CVEHSPDCURLIMITER.Cnt_lgc "MICROSAR RTE" UBYTE RTE_CM_BOOLEAN 0 0 0 255 ECU_ADDRESS 0 SYMBOL_LINK "Rte_VehCfg_CVEHSPDCURLIMITER_Cnt_lgc" 0 DISPLAY_IDENTIFIER VehCfg.SenderPorts.CVEHSPDCURLIMITER.Cnt_lgc /end MEASUREMENT
/begin MEASUREMENT VehCfg.CVEHSPDCURLIMITSPEED.Kph_f32 "MICROSAR RTE" FLOAT32_IEEE NO_COMPU_METHOD 0 0 1.175494351e-38 3.402823466e+38 ECU_ADDRESS 0 SYMBOL_LINK "Rte_VehCfg_CVEHSPDCURLIMITSPEED_Kph_f32" 0 DISPLAY_IDENTIFIER VehCfg.SenderPorts.CVEHSPDCURLIMITSPEED.Kph_f32 /end MEASUREMENT
/begin MEASUREMENT VehCfg.DesiredTunPers.Cnt_u16 "MICROSAR RTE" UWORD NO_COMPU_METHOD 0 0 0 65535 ECU_ADDRESS 0 SYMBOL_LINK "Rte_VehCfg_DesiredTunPers_Cnt_u16" 0 DISPLAY_IDENTIFIER VehCfg.SenderPorts.DesiredTunPers.Cnt_u16 /end MEASUREMENT
/begin MEASUREMENT VehCfg.DesiredTunSet.Cnt_u16 "MICROSAR RTE" UWORD NO_COMPU_METHOD 0 0 0 65535 ECU_ADDRESS 0 SYMBOL_LINK "Rte_VehCfg_DesiredTunSet_Cnt_u16" 0 DISPLAY_IDENTIFIER VehCfg.SenderPorts.DesiredTunSet.Cnt_u16 /end MEASUREMENT
/begin MEASUREMENT VehCfg.EnergyModeState.Cnt_enum "MICROSAR RTE" UBYTE RTE_CM_ENUM_EnergyModeStateType 0 0 0 3 ECU_ADDRESS 0 SYMBOL_LINK "Rte_VehCfg_EnergyModeState_Cnt_enum" 0 DISPLAY_IDENTIFIER VehCfg.SenderPorts.EnergyModeState.Cnt_enum /end MEASUREMENT
/begin MEASUREMENT VehCfg.NxtrMEC.Cnt_enum "MICROSAR RTE" UBYTE RTE_CM_ENUM_ManufModeType 0 0 0 2 ECU_ADDRESS 0 SYMBOL_LINK "Rte_CDDInterface9_NxtrMEC_Cnt_enum" 0 DISPLAY_IDENTIFIER VehCfg.ReceiverPorts.NxtrMEC.Cnt_enum /end MEASUREMENT
/begin MEASUREMENT VehCfg.PrevVldTuningSel.TuningPers "MICROSAR RTE" UWORD NO_COMPU_METHOD 0 0 0 65535 ECU_ADDRESS 0 SYMBOL_LINK "Rte_VehCfg_PrevVldTuningSel.TuningPers" 0 DISPLAY_IDENTIFIER VehCfg.PerInstanceMemories.PrevVldTuningSel.TuningPers READ_WRITE /end MEASUREMENT
/begin MEASUREMENT VehCfg.PrevVldTuningSel.TuningSet "MICROSAR RTE" UWORD NO_COMPU_METHOD 0 0 0 65535 ECU_ADDRESS 0 SYMBOL_LINK "Rte_VehCfg_PrevVldTuningSel.TuningSet" 0 DISPLAY_IDENTIFIER VehCfg.PerInstanceMemories.PrevVldTuningSel.TuningSet READ_WRITE /end MEASUREMENT
/begin MEASUREMENT VehCfg.PrkAssistState.Cnt_u08 "MICROSAR RTE" UBYTE RTE_CM_ENUM_QU_SER_WSTA_EST_FTAX 0 0 0 255 ECU_ADDRESS 0 SYMBOL_LINK "Rte_ParkAssistEnable_PrkAssistState_Cnt_u08" 0 DISPLAY_IDENTIFIER VehCfg.ReceiverPorts.PrkAssistState.Cnt_u08 /end MEASUREMENT
/begin MEASUREMENT VehCfg.TxDebugMsgEn.Cnt_lgc "MICROSAR RTE" UBYTE RTE_CM_BOOLEAN 0 0 0 255 ECU_ADDRESS 0 SYMBOL_LINK "Rte_VehCfg_TxDebugMsgEn_Cnt_lgc" 0 DISPLAY_IDENTIFIER VehCfg.SenderPorts.TxDebugMsgEn.Cnt_lgc /end MEASUREMENT
/begin MEASUREMENT VehCfg.VINValid.Cnt_lgc "MICROSAR RTE" UBYTE RTE_CM_BOOLEAN 0 0 0 255 ECU_ADDRESS 0 SYMBOL_LINK "Rte_SrlComInput_VINValid_Cnt_lgc" 0 DISPLAY_IDENTIFIER VehCfg.ReceiverPorts.VINValid.Cnt_lgc /end MEASUREMENT
/begin MEASUREMENT VehPwrMd.ATermActive.Cnt_lgc "MICROSAR RTE" UBYTE RTE_CM_BOOLEAN 0 0 0 255 ECU_ADDRESS 0 SYMBOL_LINK "Rte_VehPwrMd_ATermActive_Cnt_lgc" 0 DISPLAY_IDENTIFIER VehPwrMd.SenderPorts.ATermActive.Cnt_lgc /end MEASUREMENT
/begin MEASUREMENT VehPwrMd.CASSISTMSA.Cnt_lgc "MICROSAR RTE" UBYTE RTE_CM_BOOLEAN 0 0 0 255 ECU_ADDRESS 0 SYMBOL_LINK "Rte_VehCfg_CASSISTMSA_Cnt_lgc" 0 DISPLAY_IDENTIFIER VehPwrMd.ReceiverPorts.CASSISTMSA.Cnt_lgc /end MEASUREMENT
/begin MEASUREMENT VehPwrMd.CTermActive.Cnt_lgc "MICROSAR RTE" UBYTE RTE_CM_BOOLEAN 0 0 0 255 ECU_ADDRESS 0 SYMBOL_LINK "Rte_VehPwrMd_CTermActive_Cnt_lgc" 0 DISPLAY_IDENTIFIER VehPwrMd.SenderPorts.CTermActive.Cnt_lgc /end MEASUREMENT
/begin MEASUREMENT VehPwrMd.EngONSrlComSvcDft.Cnt_lgc "MICROSAR RTE" UBYTE RTE_CM_BOOLEAN 0 0 0 255 ECU_ADDRESS 0 SYMBOL_LINK "Rte_CDDInterface9_EngONSrlComSvcDft_Cnt_lgc" 0 DISPLAY_IDENTIFIER VehPwrMd.ReceiverPorts.EngONSrlComSvcDft.Cnt_lgc /end MEASUREMENT
/begin MEASUREMENT VehPwrMd.MSACommand.MSACmd_enum "MICROSAR RTE" UBYTE RTE_CM_ENUM_MSA_Cmd_Type 0 0 0 3 ECU_ADDRESS 0 SYMBOL_LINK "Rte_VehPwrMd_MSACommand_MSACmd_enum" 0 DISPLAY_IDENTIFIER VehPwrMd.SenderPorts.MSACommand.MSACmd_enum /end MEASUREMENT
/begin MEASUREMENT VehPwrMd.OperRampRate.XpmS_f32 "MICROSAR RTE" FLOAT32_IEEE NO_COMPU_METHOD 0 0 1.175494351e-38 3.402823466e+38 ECU_ADDRESS 0 SYMBOL_LINK "Rte_VehPwrMd_OperRampRate_XpmS_f32" 0 DISPLAY_IDENTIFIER VehPwrMd.SenderPorts.OperRampRate.XpmS_f32 /end MEASUREMENT
/begin MEASUREMENT VehPwrMd.OperRampValue.Uls_f32 "MICROSAR RTE" FLOAT32_IEEE NO_COMPU_METHOD 0 0 1.175494351e-38 3.402823466e+38 ECU_ADDRESS 0 SYMBOL_LINK "Rte_VehPwrMd_OperRampValue_Uls_f32" 0 DISPLAY_IDENTIFIER VehPwrMd.SenderPorts.OperRampValue.Uls_f32 /end MEASUREMENT
/begin MEASUREMENT VehPwrMd.SrlComVehNearStandstill.Cnt_u08 "MICROSAR RTE" UBYTE RTE_CM_ENUM_ST_V_VEH_NSS 0 0 0 15 ECU_ADDRESS 0 SYMBOL_LINK "Rte_SrlComInput2_SrlComVehNearStandstill_Cnt_u08" 0 DISPLAY_IDENTIFIER VehPwrMd.ReceiverPorts.SrlComVehNearStandstill.Cnt_u08 /end MEASUREMENT
/begin MEASUREMENT VehPwrMd.SystemState.Mode "MICROSAR RTE" UBYTE RTE_CM_ENUM_StaMd_Mode 0 0 0 255 ECU_ADDRESS 0 SYMBOL_LINK "Rte_ModeMachine_StaMd9_SystemState9_Mode" 0 DISPLAY_IDENTIFIER VehPwrMd.ModeRequirePorts.SystemState.Mode /end MEASUREMENT
/begin MEASUREMENT VehPwrMd.VehicleSpeed.Kph_f32 "MICROSAR RTE" FLOAT32_IEEE NO_COMPU_METHOD 0 0 1.175494351e-38 3.402823466e+38 ECU_ADDRESS 0 SYMBOL_LINK "Rte_SignlCondn_VehicleSpeed_Kph_f32" 0 DISPLAY_IDENTIFIER VehPwrMd.ReceiverPorts.VehicleSpeed.Kph_f32 /end MEASUREMENT
/begin MEASUREMENT VehPwrMd.VehicleSpeedValid.Cnt_lgc "MICROSAR RTE" UBYTE RTE_CM_BOOLEAN 0 0 0 255 ECU_ADDRESS 0 SYMBOL_LINK "Rte_SignlCondn_VehicleSpeedValid_Cnt_lgc" 0 DISPLAY_IDENTIFIER VehPwrMd.ReceiverPorts.VehicleSpeedValid.Cnt_lgc /end MEASUREMENT
/begin MEASUREMENT VehSpdLmt.AstVehSpdLimit.MtrNm_f32 "MICROSAR RTE" FLOAT32_IEEE NO_COMPU_METHOD 0 0 1.175494351e-38 3.402823466e+38 ECU_ADDRESS 0 SYMBOL_LINK "Rte_VehSpdLmt_AstVehSpdLimit_MtrNm_f32" 0 DISPLAY_IDENTIFIER VehSpdLmt.SenderPorts.AstVehSpdLimit.MtrNm_f32 /end MEASUREMENT
/begin MEASUREMENT VehSpdLmt.CCWPosition.HwDeg_f32 "MICROSAR RTE" FLOAT32_IEEE NO_COMPU_METHOD 0 0 1.175494351e-38 3.402823466e+38 ECU_ADDRESS 0 SYMBOL_LINK "Rte_LrnEOT_CCWPosition_HwDeg_f32" 0 DISPLAY_IDENTIFIER VehSpdLmt.ReceiverPorts.CCWPosition.HwDeg_f32 /end MEASUREMENT
/begin MEASUREMENT VehSpdLmt.CWPosition.HwDeg_f32 "MICROSAR RTE" FLOAT32_IEEE NO_COMPU_METHOD 0 0 1.175494351e-38 3.402823466e+38 ECU_ADDRESS 0 SYMBOL_LINK "Rte_LrnEOT_CWPosition_HwDeg_f32" 0 DISPLAY_IDENTIFIER VehSpdLmt.ReceiverPorts.CWPosition.HwDeg_f32 /end MEASUREMENT
/begin MEASUREMENT VehSpdLmt.HwPos.HwDeg_f32 "MICROSAR RTE" FLOAT32_IEEE NO_COMPU_METHOD 0 0 1.175494351e-38 3.402823466e+38 ECU_ADDRESS 0 SYMBOL_LINK "Rte_AbsHwPos_HandwheelPosition_HwDeg_f32" 0 DISPLAY_IDENTIFIER VehSpdLmt.ReceiverPorts.HwPos.HwDeg_f32 /end MEASUREMENT
/begin MEASUREMENT VehSpdLmt.HwPosAuth.Uls_f32 "MICROSAR RTE" FLOAT32_IEEE NO_COMPU_METHOD 0 0 1.175494351e-38 3.402823466e+38 ECU_ADDRESS 0 SYMBOL_LINK "Rte_AbsHwPos_HandwheelAuthority_Uls_f32" 0 DISPLAY_IDENTIFIER VehSpdLmt.ReceiverPorts.HwPosAuth.Uls_f32 /end MEASUREMENT
/begin MEASUREMENT VehSpdLmt.VehSpd.Kph_f32 "MICROSAR RTE" FLOAT32_IEEE NO_COMPU_METHOD 0 0 1.175494351e-38 3.402823466e+38 ECU_ADDRESS 0 SYMBOL_LINK "Rte_SignlCondn_VehicleSpeed_Kph_f32" 0 DISPLAY_IDENTIFIER VehSpdLmt.ReceiverPorts.VehSpd.Kph_f32 /end MEASUREMENT
/begin MEASUREMENT VltgCtrl.CCLMSAActive.Cnt_lgc "MICROSAR RTE" UBYTE RTE_CM_BOOLEAN 0 0 0 255 ECU_ADDRESS 0 SYMBOL_LINK "Rte_CustPL_CCLMSAActive_Cnt_lgc" 0 DISPLAY_IDENTIFIER VltgCtrl.ReceiverPorts.CCLMSAActive.Cnt_lgc /end MEASUREMENT
/begin MEASUREMENT VltgCtrl.CuTempEst.DegC_f32 "MICROSAR RTE" FLOAT32_IEEE NO_COMPU_METHOD 0 0 1.175494351e-38 3.402823466e+38 ECU_ADDRESS 0 SYMBOL_LINK "Rte_MtrTempEst_CuTempEst_DegC_f32" 0 DISPLAY_IDENTIFIER VltgCtrl.ReceiverPorts.CuTempEst.DegC_f32 /end MEASUREMENT
/begin MEASUREMENT VltgCtrl.EstKe.VpRadpS_f32 "MICROSAR RTE" FLOAT32_IEEE NO_COMPU_METHOD 0 0 1.175494351e-38 3.402823466e+38 ECU_ADDRESS 0 SYMBOL_LINK "Rte_ParamComp_EstKe_VpRadpS_f32" 0 DISPLAY_IDENTIFIER VltgCtrl.ReceiverPorts.EstKe.VpRadpS_f32 /end MEASUREMENT
/begin MEASUREMENT VltgCtrl.EstLd.Henry_f32 "MICROSAR RTE" FLOAT32_IEEE NO_COMPU_METHOD 0 0 1.175494351e-38 3.402823466e+38 ECU_ADDRESS 0 SYMBOL_LINK "Rte_ParamComp_EstLd_Henry_f32" 0 DISPLAY_IDENTIFIER VltgCtrl.ReceiverPorts.EstLd.Henry_f32 /end MEASUREMENT
/begin MEASUREMENT VltgCtrl.EstLq.Henry_f32 "MICROSAR RTE" FLOAT32_IEEE NO_COMPU_METHOD 0 0 1.175494351e-38 3.402823466e+38 ECU_ADDRESS 0 SYMBOL_LINK "Rte_ParamComp_EstLq_Henry_f32" 0 DISPLAY_IDENTIFIER VltgCtrl.ReceiverPorts.EstLq.Henry_f32 /end MEASUREMENT
/begin MEASUREMENT VltgCtrl.EstR.Ohm_f32 "MICROSAR RTE" FLOAT32_IEEE NO_COMPU_METHOD 0 0 1.175494351e-38 3.402823466e+38 ECU_ADDRESS 0 SYMBOL_LINK "Rte_ParamComp_EstR_Ohm_f32" 0 DISPLAY_IDENTIFIER VltgCtrl.ReceiverPorts.EstR.Ohm_f32 /end MEASUREMENT
/begin MEASUREMENT VltgCtrl.MRFMtrTrqCmdScl.MtrNm_f32 "MICROSAR RTE" FLOAT32_IEEE NO_COMPU_METHOD 0 0 1.175494351e-38 3.402823466e+38 ECU_ADDRESS 0 SYMBOL_LINK "Rte_TrqCmdScl_MRFMtrTrqCmdScl_MtrNm_f32" 0 DISPLAY_IDENTIFIER VltgCtrl.ReceiverPorts.MRFMtrTrqCmdScl.MtrNm_f32 /end MEASUREMENT
/begin MEASUREMENT VltgCtrl.MRFMtrVel.MtrRadpS_f32 "MICROSAR RTE" FLOAT32_IEEE NO_COMPU_METHOD 0 0 1.175494351e-38 3.402823466e+38 ECU_ADDRESS 0 SYMBOL_LINK "Rte_MtrVel_MRFMotorVel_MtrRadpS_f32" 0 DISPLAY_IDENTIFIER VltgCtrl.ReceiverPorts.MRFMtrVel.MtrRadpS_f32 /end MEASUREMENT
/begin MEASUREMENT VltgCtrl.ModIdx.Uls_f32 "MICROSAR RTE" FLOAT32_IEEE NO_COMPU_METHOD 0 0 1.175494351e-38 3.402823466e+38 ECU_ADDRESS 0 SYMBOL_LINK "Rte_VltgCtrl_ModIdx_Uls_f32" 0 DISPLAY_IDENTIFIER VltgCtrl.SenderPorts.ModIdx.Uls_f32 /end MEASUREMENT
/begin MEASUREMENT VltgCtrl.MtrEnvSpd.MtrRadpS_f32 "MICROSAR RTE" FLOAT32_IEEE NO_COMPU_METHOD 0 0 1.175494351e-38 3.402823466e+38 ECU_ADDRESS 0 SYMBOL_LINK "Rte_PwrLmtFunc_MtrEnvSpd_MtrRadpS_f32" 0 DISPLAY_IDENTIFIER VltgCtrl.ReceiverPorts.MtrEnvSpd.MtrRadpS_f32 /end MEASUREMENT
/begin MEASUREMENT VltgCtrl.MtrQuad.Cnt_u08 "MICROSAR RTE" UBYTE NO_COMPU_METHOD 0 0 0 255 ECU_ADDRESS 0 SYMBOL_LINK "Rte_QuadDet_MtrQuad_Cnt_u08" 0 DISPLAY_IDENTIFIER VltgCtrl.ReceiverPorts.MtrQuad.Cnt_u08 /end MEASUREMENT
/begin MEASUREMENT VltgCtrl.PDActivateTest.Cnt_lgc "MICROSAR RTE" UBYTE RTE_CM_BOOLEAN 0 0 0 255 ECU_ADDRESS 0 SYMBOL_LINK "Rte_PhaseDscnt_PDActivateTest_Cnt_lgc" 0 DISPLAY_IDENTIFIER VltgCtrl.ReceiverPorts.PDActivateTest.Cnt_lgc /end MEASUREMENT
/begin MEASUREMENT VltgCtrl.PDPhsAdvSel.Cnt_s16 "MICROSAR RTE" SWORD NO_COMPU_METHOD 0 0 -32768 32767 ECU_ADDRESS 0 SYMBOL_LINK "Rte_PhaseDscnt_PDPhaseAdvSelect_Cnt_s16" 0 DISPLAY_IDENTIFIER VltgCtrl.ReceiverPorts.PDPhsAdvSel.Cnt_s16 /end MEASUREMENT
/begin MEASUREMENT VltgCtrl.PDTestModIdx.Uls_f32 "MICROSAR RTE" FLOAT32_IEEE NO_COMPU_METHOD 0 0 1.175494351e-38 3.402823466e+38 ECU_ADDRESS 0 SYMBOL_LINK "Rte_PhaseDscnt_PDTestModIndex_Uls_f32" 0 DISPLAY_IDENTIFIER VltgCtrl.ReceiverPorts.PDTestModIdx.Uls_f32 /end MEASUREMENT
/begin MEASUREMENT VltgCtrl.PhsAdv.Cnt_s16 "MICROSAR RTE" SWORD NO_COMPU_METHOD 0 0 -32768 32767 ECU_ADDRESS 0 SYMBOL_LINK "Rte_VltgCtrl_PhsAdv_Cnt_s16" 0 DISPLAY_IDENTIFIER VltgCtrl.SenderPorts.PhsAdv.Cnt_s16 /end MEASUREMENT
/begin MEASUREMENT VltgCtrl.SystemState.Mode "MICROSAR RTE" UBYTE RTE_CM_ENUM_StaMd_Mode 0 0 0 255 ECU_ADDRESS 0 SYMBOL_LINK "Rte_ModeMachine_StaMd_SystemState_Mode" 0 DISPLAY_IDENTIFIER VltgCtrl.ModeRequirePorts.SystemState.Mode /end MEASUREMENT
/begin MEASUREMENT VltgCtrl.TermA.Volt_f32 "This signal is intended to communicate any type voltage signal measured by the ecu.  This signal has a lower limit of 0 which reequires users of the signal to provide divide by 0 protection if it is used as a denominator in a calculation.  See Vecu port p" FLOAT32_IEEE NO_COMPU_METHOD 0 0 1.175494351e-38 3.402823466e+38 ECU_ADDRESS 0 SYMBOL_LINK "Rte_VltgCtrl_TermA_Volt_f32" 0 DISPLAY_IDENTIFIER VltgCtrl.SenderPorts.TermA.Volt_f32 /end MEASUREMENT
/begin MEASUREMENT VltgCtrl.TermBSS.Volt_f32 "This signal is intended to communicate any type voltage signal measured by the ecu.  This signal has a lower limit of 0 which reequires users of the signal to provide divide by 0 protection if it is used as a denominator in a calculation.  See Vecu port p" FLOAT32_IEEE NO_COMPU_METHOD 0 0 1.175494351e-38 3.402823466e+38 ECU_ADDRESS 0 SYMBOL_LINK "Rte_VltgCtrl_TermBSS_Volt_f32" 0 DISPLAY_IDENTIFIER VltgCtrl.SenderPorts.TermBSS.Volt_f32 /end MEASUREMENT
/begin MEASUREMENT VltgCtrl.TermBTOT.Volt_f32 "This signal is intended to communicate any type voltage signal measured by the ecu.  This signal has a lower limit of 0 which reequires users of the signal to provide divide by 0 protection if it is used as a denominator in a calculation.  See Vecu port p" FLOAT32_IEEE NO_COMPU_METHOD 0 0 1.175494351e-38 3.402823466e+38 ECU_ADDRESS 0 SYMBOL_LINK "Rte_VltgCtrl_TermBTOT_Volt_f32" 0 DISPLAY_IDENTIFIER VltgCtrl.SenderPorts.TermBTOT.Volt_f32 /end MEASUREMENT
/begin MEASUREMENT VltgCtrl.TermXd.Uls_f32 "MICROSAR RTE" FLOAT32_IEEE NO_COMPU_METHOD 0 0 1.175494351e-38 3.402823466e+38 ECU_ADDRESS 0 SYMBOL_LINK "Rte_VltgCtrl_TermXd_Uls_f32" 0 DISPLAY_IDENTIFIER VltgCtrl.SenderPorts.TermXd.Uls_f32 /end MEASUREMENT
/begin MEASUREMENT VltgCtrl.TermXq.Uls_f32 "MICROSAR RTE" FLOAT32_IEEE NO_COMPU_METHOD 0 0 1.175494351e-38 3.402823466e+38 ECU_ADDRESS 0 SYMBOL_LINK "Rte_VltgCtrl_TermXq_Uls_f32" 0 DISPLAY_IDENTIFIER VltgCtrl.SenderPorts.TermXq.Uls_f32 /end MEASUREMENT
/begin MEASUREMENT VltgCtrl.TermY.Uls_f32 "MICROSAR RTE" FLOAT32_IEEE NO_COMPU_METHOD 0 0 1.175494351e-38 3.402823466e+38 ECU_ADDRESS 0 SYMBOL_LINK "Rte_VltgCtrl_TermY_Uls_f32" 0 DISPLAY_IDENTIFIER VltgCtrl.SenderPorts.TermY.Uls_f32 /end MEASUREMENT
/begin MEASUREMENT VltgCtrl.TermZ.Uls_f32 "MICROSAR RTE" FLOAT32_IEEE NO_COMPU_METHOD 0 0 1.175494351e-38 3.402823466e+38 ECU_ADDRESS 0 SYMBOL_LINK "Rte_VltgCtrl_TermZ_Uls_f32" 0 DISPLAY_IDENTIFIER VltgCtrl.SenderPorts.TermZ.Uls_f32 /end MEASUREMENT
/begin MEASUREMENT VltgCtrl.UnCorrPhsAdv.Cnt_s16 "MICROSAR RTE" SWORD NO_COMPU_METHOD 0 0 -32768 32767 ECU_ADDRESS 0 SYMBOL_LINK "Rte_VltgCtrl_UnCorrPhsAdv_Cnt_s16" 0 DISPLAY_IDENTIFIER VltgCtrl.SenderPorts.UnCorrPhsAdv.Cnt_s16 /end MEASUREMENT
/begin MEASUREMENT VltgCtrl.VdTerm.Volt_f32 "This signal is intended to communicate any type voltage signal measured by the ecu.  This signal has a lower limit of 0 which reequires users of the signal to provide divide by 0 protection if it is used as a denominator in a calculation.  See Vecu port p" FLOAT32_IEEE NO_COMPU_METHOD 0 0 1.175494351e-38 3.402823466e+38 ECU_ADDRESS 0 SYMBOL_LINK "Rte_VltgCtrl_VdTerm_Volt_f32" 0 DISPLAY_IDENTIFIER VltgCtrl.SenderPorts.VdTerm.Volt_f32 /end MEASUREMENT
/begin MEASUREMENT VltgCtrl.Vecu.Volt_f32 "This port prototype is inteded to communicate voltage signals that represent the ecu supplied voltage.  This signal has a lower limit, which is non-zero, to allow users of the signal to use it as a denominator in an expression without requiring a divide b" FLOAT32_IEEE NO_COMPU_METHOD 0 0 1.175494351e-38 3.402823466e+38 ECU_ADDRESS 0 SYMBOL_LINK "Rte_BatteryVoltage_Vecu_Volt_f32" 0 DISPLAY_IDENTIFIER VltgCtrl.ReceiverPorts.Vecu.Volt_f32 /end MEASUREMENT
/begin MEASUREMENT VltgCtrl.VqTerm.Volt_f32 "This signal is intended to communicate any type voltage signal measured by the ecu.  This signal has a lower limit of 0 which reequires users of the signal to provide divide by 0 protection if it is used as a denominator in a calculation.  See Vecu port p" FLOAT32_IEEE NO_COMPU_METHOD 0 0 1.175494351e-38 3.402823466e+38 ECU_ADDRESS 0 SYMBOL_LINK "Rte_VltgCtrl_VqTerm_Volt_f32" 0 DISPLAY_IDENTIFIER VltgCtrl.SenderPorts.VqTerm.Volt_f32 /end MEASUREMENT
/begin GROUP SrlComOutput2.CEVIIF.Cnt_lgc "MICROSAR RTE" /begin SUB_GROUP /end SUB_GROUP /begin FUNCTION_LIST /end FUNCTION_LIST /begin REF_CHARACTERISTIC /end REF_CHARACTERISTIC /begin REF_MEASUREMENT SrlComOutput2.CEVIIF.Cnt_lgc /end REF_MEASUREMENT /end GROUP
/begin GROUP SrlComOutput2.CFACTORIF.Cnt_lgc "MICROSAR RTE" /begin SUB_GROUP /end SUB_GROUP /begin FUNCTION_LIST /end FUNCTION_LIST /begin REF_CHARACTERISTIC /end REF_CHARACTERISTIC /begin REF_MEASUREMENT SrlComOutput2.CFACTORIF.Cnt_lgc /end REF_MEASUREMENT /end GROUP
/begin GROUP SrlComOutput2.CHWANGLEIF.Cnt_lgc "MICROSAR RTE" /begin SUB_GROUP /end SUB_GROUP /begin FUNCTION_LIST /end FUNCTION_LIST /begin REF_CHARACTERISTIC /end REF_CHARACTERISTIC /begin REF_MEASUREMENT SrlComOutput2.CHWANGLEIF.Cnt_lgc /end REF_MEASUREMENT /end GROUP
/begin GROUP SrlComOutput2.CHWTORQUEIF.Cnt_lgc "MICROSAR RTE" /begin SUB_GROUP /end SUB_GROUP /begin FUNCTION_LIST /end FUNCTION_LIST /begin REF_CHARACTERISTIC /end REF_CHARACTERISTIC /begin REF_MEASUREMENT SrlComOutput2.CHWTORQUEIF.Cnt_lgc /end REF_MEASUREMENT /end GROUP
/begin GROUP SrlComOutput2.CMTTORQUEIF.Cnt_lgc "MICROSAR RTE" /begin SUB_GROUP /end SUB_GROUP /begin FUNCTION_LIST /end FUNCTION_LIST /begin REF_CHARACTERISTIC /end REF_CHARACTERISTIC /begin REF_MEASUREMENT SrlComOutput2.CMTTORQUEIF.Cnt_lgc /end REF_MEASUREMENT /end GROUP
/begin GROUP SrlComOutput2.CustCurrLmt.Amp_f32 "MICROSAR RTE" /begin SUB_GROUP /end SUB_GROUP /begin FUNCTION_LIST /end FUNCTION_LIST /begin REF_CHARACTERISTIC /end REF_CHARACTERISTIC /begin REF_MEASUREMENT SrlComOutput2.CustCurrLmt.Amp_f32 /end REF_MEASUREMENT /end GROUP
/begin GROUP SrlComOutput2.DiagStsNonRecRmpToZeroFltPres.Cnt_lgc "MICROSAR RTE" /begin SUB_GROUP /end SUB_GROUP /begin FUNCTION_LIST /end FUNCTION_LIST /begin REF_CHARACTERISTIC /end REF_CHARACTERISTIC /begin REF_MEASUREMENT SrlComOutput2.DiagStsNonRecRmpToZeroFltPres.Cnt_lgc /end REF_MEASUREMENT /end GROUP
/begin GROUP SrlComOutput2.DiagStsRecRmpToZeroFltPres.Cnt_lgc "MICROSAR RTE" /begin SUB_GROUP /end SUB_GROUP /begin FUNCTION_LIST /end FUNCTION_LIST /begin REF_CHARACTERISTIC /end REF_CHARACTERISTIC /begin REF_MEASUREMENT SrlComOutput2.DiagStsRecRmpToZeroFltPres.Cnt_lgc /end REF_MEASUREMENT /end GROUP
/begin GROUP SrlComOutput2.DrvDynState.Cnt_u08 "MICROSAR RTE" /begin SUB_GROUP /end SUB_GROUP /begin FUNCTION_LIST /end FUNCTION_LIST /begin REF_CHARACTERISTIC /end REF_CHARACTERISTIC /begin REF_MEASUREMENT SrlComOutput2.DrvDynState.Cnt_u08 /end REF_MEASUREMENT /end GROUP
/begin GROUP SrlComOutput2.ElecPower.Watts_f32 "MICROSAR RTE" /begin SUB_GROUP /end SUB_GROUP /begin FUNCTION_LIST /end FUNCTION_LIST /begin REF_CHARACTERISTIC /end REF_CHARACTERISTIC /begin REF_MEASUREMENT SrlComOutput2.ElecPower.Watts_f32 /end REF_MEASUREMENT /end GROUP
/begin GROUP SrlComOutput2.FinHwPos.HwDeg_f32 "MICROSAR RTE" /begin SUB_GROUP /end SUB_GROUP /begin FUNCTION_LIST /end FUNCTION_LIST /begin REF_CHARACTERISTIC /end REF_CHARACTERISTIC /begin REF_MEASUREMENT SrlComOutput2.FinHwPos.HwDeg_f32 /end REF_MEASUREMENT /end GROUP
/begin GROUP SrlComOutput2.FinHwPosAuth.Uls_f32 "MICROSAR RTE" /begin SUB_GROUP /end SUB_GROUP /begin FUNCTION_LIST /end FUNCTION_LIST /begin REF_CHARACTERISTIC /end REF_CHARACTERISTIC /begin REF_MEASUREMENT SrlComOutput2.FinHwPosAuth.Uls_f32 /end REF_MEASUREMENT /end GROUP
/begin GROUP SrlComOutput2.HaptcFbSt.Cnt_u08 "MICROSAR RTE" /begin SUB_GROUP /end SUB_GROUP /begin FUNCTION_LIST /end FUNCTION_LIST /begin REF_CHARACTERISTIC /end REF_CHARACTERISTIC /begin REF_MEASUREMENT SrlComOutput2.HaptcFbSt.Cnt_u08 /end REF_MEASUREMENT /end GROUP
/begin GROUP SrlComOutput2.HwTrq.HwNm_f32 "MICROSAR RTE" /begin SUB_GROUP /end SUB_GROUP /begin FUNCTION_LIST /end FUNCTION_LIST /begin REF_CHARACTERISTIC /end REF_CHARACTERISTIC /begin REF_MEASUREMENT SrlComOutput2.HwTrq.HwNm_f32 /end REF_MEASUREMENT /end GROUP
/begin GROUP SrlComOutput2.LimitPercentFiltered.Uls_f32 "MICROSAR RTE" /begin SUB_GROUP /end SUB_GROUP /begin FUNCTION_LIST /end FUNCTION_LIST /begin REF_CHARACTERISTIC /end REF_CHARACTERISTIC /begin REF_MEASUREMENT SrlComOutput2.LimitPercentFiltered.Uls_f32 /end REF_MEASUREMENT /end GROUP
/begin GROUP SrlComOutput2.ModeRequirePorts "MICROSAR RTE" /begin SUB_GROUP SrlComOutput2.SystemState.Mode /end SUB_GROUP /begin FUNCTION_LIST /end FUNCTION_LIST /begin REF_CHARACTERISTIC /end REF_CHARACTERISTIC /begin REF_MEASUREMENT /end REF_MEASUREMENT /end GROUP
/begin GROUP SrlComOutput2.PrkAstState.Cnt_u08 "MICROSAR RTE" /begin SUB_GROUP /end SUB_GROUP /begin FUNCTION_LIST /end FUNCTION_LIST /begin REF_CHARACTERISTIC /end REF_CHARACTERISTIC /begin REF_MEASUREMENT SrlComOutput2.PrkAstState.Cnt_u08 /end REF_MEASUREMENT /end GROUP
/begin GROUP SrlComOutput2.RacktoVehCntrOffset.Cnt_u16 "MICROSAR RTE" /begin SUB_GROUP /end SUB_GROUP /begin FUNCTION_LIST /end FUNCTION_LIST /begin REF_CHARACTERISTIC /end REF_CHARACTERISTIC /begin REF_MEASUREMENT SrlComOutput2.RacktoVehCntrOffset.Cnt_u16 /end REF_MEASUREMENT /end GROUP
/begin GROUP SrlComOutput2.ReceiverPorts "MICROSAR RTE"
 /begin SUB_GROUP SrlComOutput2.AVLFORCGRDTxConf.Cnt_lgc SrlComOutput2.AVLSTMOMTxConf.Cnt_lgc SrlComOutput2.CADASMSG.Cnt_lgc SrlComOutput2.CDISPCCEPS.Cnt_u08 SrlComOutput2.CEVIIF.Cnt_lgc SrlComOutput2.CFACTORIF.Cnt_lgc SrlComOutput2.CHWANGLEIF.Cnt_lgc SrlComOutput2.CHWTORQUEIF.Cnt_lgc SrlComOutput2.CMTTORQUEIF.Cnt_lgc SrlComOutput2.CustCurrLmt.Amp_f32 SrlComOutput2.DiagStsNonRecRmpToZeroFltPres.Cnt_lgc SrlComOutput2.DiagStsRecRmpToZeroFltPres.Cnt_lgc SrlComOutput2.DrvDynState.Cnt_u08 SrlComOutput2.ElecPower.Watts_f32 SrlComOutput2.FinHwPos.HwDeg_f32 SrlComOutput2.FinHwPosAuth.Uls_f32 SrlComOutput2.HaptcFbSt.Cnt_u08 SrlComOutput2.HwTrq.HwNm_f32 SrlComOutput2.LimitPercentFiltered.Uls_f32 SrlComOutput2.PrkAstState.Cnt_u08 SrlComOutput2.RacktoVehCntrOffset.Cnt_u16 SrlComOutput2.RevOffsetState.Cnt_u08 SrlComOutput2.SrlComHwTrqValid.Cnt_lgc SrlComOutput2.SupplyCur.Amp_f32 /end SUB_GROUP
 /begin FUNCTION_LIST /end FUNCTION_LIST
 /begin REF_CHARACTERISTIC /end REF_CHARACTERISTIC
 /begin REF_MEASUREMENT /end REF_MEASUREMENT
/end GROUP
/begin GROUP SrlComOutput2.RevOffsetState.Cnt_u08 "MICROSAR RTE" /begin SUB_GROUP /end SUB_GROUP /begin FUNCTION_LIST /end FUNCTION_LIST /begin REF_CHARACTERISTIC /end REF_CHARACTERISTIC /begin REF_MEASUREMENT SrlComOutput2.RevOffsetState.Cnt_u08 /end REF_MEASUREMENT /end GROUP
/begin GROUP SrlComOutput2.SenderPorts "MICROSAR RTE"
 /begin SUB_GROUP SrlComOutput2.SrlComAVLPOEPS.AVL_PO_EPS SrlComOutput2.SrlComAVLSTMOM.AVL_FORC_GRD SrlComOutput2.SrlComAVLSTMOM.AVL_STMOM_DV_ACT SrlComOutput2.SrlComSTEST.ST_EST SrlComOutput2.SrlComSUEPS.SU_EPS /end SUB_GROUP
 /begin FUNCTION_LIST /end FUNCTION_LIST
 /begin REF_CHARACTERISTIC /end REF_CHARACTERISTIC
 /begin REF_MEASUREMENT /end REF_MEASUREMENT
/end GROUP
/begin GROUP SrlComOutput2.SrlComAVLPOEPS.AVL_PO_EPS "MICROSAR RTE" /begin SUB_GROUP /end SUB_GROUP /begin FUNCTION_LIST /end FUNCTION_LIST /begin REF_CHARACTERISTIC /end REF_CHARACTERISTIC
 /begin REF_MEASUREMENT SrlComOutput2.SrlComAVLPOEPS.AVL_PO_EPS.ALIV_AVL_PO_EPS SrlComOutput2.SrlComAVLPOEPS.AVL_PO_EPS.AVL_PO_EPS SrlComOutput2.SrlComAVLPOEPS.AVL_PO_EPS.AVL_PO_IDX_EPS SrlComOutput2.SrlComAVLPOEPS.AVL_PO_EPS.CRC_AVL_PO_EPS SrlComOutput2.SrlComAVLPOEPS.AVL_PO_EPS.IDX_TORQ_SEN SrlComOutput2.SrlComAVLPOEPS.AVL_PO_EPS.OFFS_GRD_MID_EPS SrlComOutput2.SrlComAVLPOEPS.AVL_PO_EPS.QU_AVL_PO_EPS SrlComOutput2.SrlComAVLPOEPS.AVL_PO_EPS.UN_PO_EPS /end REF_MEASUREMENT
/end GROUP
/begin GROUP SrlComOutput2.SrlComAVLSTMOM.AVL_FORC_GRD "MICROSAR RTE" /begin SUB_GROUP /end SUB_GROUP /begin FUNCTION_LIST /end FUNCTION_LIST /begin REF_CHARACTERISTIC /end REF_CHARACTERISTIC
 /begin REF_MEASUREMENT SrlComOutput2.SrlComAVLSTMOM.AVL_FORC_GRD.ALIV_AVL_FORC_GRD SrlComOutput2.SrlComAVLSTMOM.AVL_FORC_GRD.AVL_FORC_GRD SrlComOutput2.SrlComAVLSTMOM.AVL_FORC_GRD.AVL_FORC_GRD_0x0C_0x04 SrlComOutput2.SrlComAVLSTMOM.AVL_FORC_GRD.AVL_PWR_EL_EPS_COOD SrlComOutput2.SrlComAVLSTMOM.AVL_FORC_GRD.CRC_AVL_FORC_GRD SrlComOutput2.SrlComAVLSTMOM.AVL_FORC_GRD.QU_AVL_FORC_GRD /end REF_MEASUREMENT
/end GROUP
/begin GROUP SrlComOutput2.SrlComAVLSTMOM.AVL_STMOM_DV_ACT "MICROSAR RTE" /begin SUB_GROUP /end SUB_GROUP /begin FUNCTION_LIST /end FUNCTION_LIST /begin REF_CHARACTERISTIC /end REF_CHARACTERISTIC
 /begin REF_MEASUREMENT SrlComOutput2.SrlComAVLSTMOM.AVL_STMOM_DV_ACT.ALIV_AVL_STMOM_DV_ACT SrlComOutput2.SrlComAVLSTMOM.AVL_STMOM_DV_ACT.AVL_STMOM_DV_ACT SrlComOutput2.SrlComAVLSTMOM.AVL_STMOM_DV_ACT.AVL_STMOM_DV_ACT_0x0C_0x04 SrlComOutput2.SrlComAVLSTMOM.AVL_STMOM_DV_ACT.CRC_AVL_STMOM_DV_ACT SrlComOutput2.SrlComAVLSTMOM.AVL_STMOM_DV_ACT.QU_AVL_STMOM_DV_ACT /end REF_MEASUREMENT
/end GROUP
/begin GROUP SrlComOutput2.SrlComHwTrqValid.Cnt_lgc "MICROSAR RTE" /begin SUB_GROUP /end SUB_GROUP /begin FUNCTION_LIST /end FUNCTION_LIST /begin REF_CHARACTERISTIC /end REF_CHARACTERISTIC /begin REF_MEASUREMENT SrlComOutput2.SrlComHwTrqValid.Cnt_lgc /end REF_MEASUREMENT /end GROUP
/begin GROUP SrlComOutput2.SrlComSTEST.ST_EST "MICROSAR RTE" /begin SUB_GROUP /end SUB_GROUP /begin FUNCTION_LIST /end FUNCTION_LIST /begin REF_CHARACTERISTIC /end REF_CHARACTERISTIC
 /begin REF_MEASUREMENT SrlComOutput2.SrlComSTEST.ST_EST.ALIV_ST_EST_FTAX SrlComOutput2.SrlComSTEST.ST_EST.CRC_ST_EST_FTAX SrlComOutput2.SrlComSTEST.ST_EST.QU_FN_EST SrlComOutput2.SrlComSTEST.ST_EST.QU_FN_VIB_EPS SrlComOutput2.SrlComSTEST.ST_EST.QU_SER_STMOM_DV_ACT SrlComOutput2.SrlComSTEST.ST_EST.ST_EST_0x10_0x08 /end REF_MEASUREMENT
/end GROUP
/begin GROUP SrlComOutput2.SrlComSUEPS.SU_EPS "MICROSAR RTE" /begin SUB_GROUP /end SUB_GROUP /begin FUNCTION_LIST /end FUNCTION_LIST /begin REF_CHARACTERISTIC /end REF_CHARACTERISTIC
 /begin REF_MEASUREMENT SrlComOutput2.SrlComSUEPS.SU_EPS.ALIV_SU_EPS SrlComOutput2.SrlComSUEPS.SU_EPS.CRC_SU_EPS SrlComOutput2.SrlComSUEPS.SU_EPS.SU_EPS_0x0E_0x20 SrlComOutput2.SrlComSUEPS.SU_EPS.SU_EPS_0x2E_0x06 SrlComOutput2.SrlComSUEPS.SU_EPS.TOT_STR_EPS SrlComOutput2.SrlComSUEPS.SU_EPS.UN_TOT_STR_EPS /end REF_MEASUREMENT
/end GROUP
/begin GROUP SrlComOutput2.SupplyCur.Amp_f32 "MICROSAR RTE" /begin SUB_GROUP /end SUB_GROUP /begin FUNCTION_LIST /end FUNCTION_LIST /begin REF_CHARACTERISTIC /end REF_CHARACTERISTIC /begin REF_MEASUREMENT SrlComOutput2.SupplyCur.Amp_f32 /end REF_MEASUREMENT /end GROUP
/begin GROUP SrlComOutput2.SystemState.Mode "MICROSAR RTE" /begin SUB_GROUP /end SUB_GROUP /begin FUNCTION_LIST /end FUNCTION_LIST /begin REF_CHARACTERISTIC /end REF_CHARACTERISTIC /begin REF_MEASUREMENT SrlComOutput2.SystemState.Mode /end REF_MEASUREMENT /end GROUP
/begin GROUP StOpCtrl "MICROSAR RTE" /begin SUB_GROUP StOpCtrl.ReceiverPorts StOpCtrl.SenderPorts /end SUB_GROUP /begin FUNCTION_LIST /end FUNCTION_LIST /begin REF_CHARACTERISTIC /end REF_CHARACTERISTIC /begin REF_MEASUREMENT /end REF_MEASUREMENT /end GROUP
/begin GROUP StOpCtrl.DiagRampRate.XpmS_f32 "MICROSAR RTE" /begin SUB_GROUP /end SUB_GROUP /begin FUNCTION_LIST /end FUNCTION_LIST /begin REF_CHARACTERISTIC /end REF_CHARACTERISTIC /begin REF_MEASUREMENT StOpCtrl.DiagRampRate.XpmS_f32 /end REF_MEASUREMENT /end GROUP
/begin GROUP StOpCtrl.DiagRampValue.Uls_f32 "MICROSAR RTE" /begin SUB_GROUP /end SUB_GROUP /begin FUNCTION_LIST /end FUNCTION_LIST /begin REF_CHARACTERISTIC /end REF_CHARACTERISTIC /begin REF_MEASUREMENT StOpCtrl.DiagRampValue.Uls_f32 /end REF_MEASUREMENT /end GROUP
/begin GROUP StOpCtrl.DiagStsDiagRmpActive.Cnt_lgc "MICROSAR RTE" /begin SUB_GROUP /end SUB_GROUP /begin FUNCTION_LIST /end FUNCTION_LIST /begin REF_CHARACTERISTIC /end REF_CHARACTERISTIC /begin REF_MEASUREMENT StOpCtrl.DiagStsDiagRmpActive.Cnt_lgc /end REF_MEASUREMENT /end GROUP
/begin GROUP StOpCtrl.OperRampRate.XpmS_f32 "MICROSAR RTE" /begin SUB_GROUP /end SUB_GROUP /begin FUNCTION_LIST /end FUNCTION_LIST /begin REF_CHARACTERISTIC /end REF_CHARACTERISTIC /begin REF_MEASUREMENT StOpCtrl.OperRampRate.XpmS_f32 /end REF_MEASUREMENT /end GROUP
/begin GROUP StOpCtrl.OperRampValue.Uls_f32 "MICROSAR RTE" /begin SUB_GROUP /end SUB_GROUP /begin FUNCTION_LIST /end FUNCTION_LIST /begin REF_CHARACTERISTIC /end REF_CHARACTERISTIC /begin REF_MEASUREMENT StOpCtrl.OperRampValue.Uls_f32 /end REF_MEASUREMENT /end GROUP
/begin GROUP StOpCtrl.OutputRampMult.Uls_f32 "MICROSAR RTE" /begin SUB_GROUP /end SUB_GROUP /begin FUNCTION_LIST /end FUNCTION_LIST /begin REF_CHARACTERISTIC /end REF_CHARACTERISTIC /begin REF_MEASUREMENT StOpCtrl.OutputRampMult.Uls_f32 /end REF_MEASUREMENT /end GROUP
/begin GROUP StOpCtrl.RampDwnStatusComplete.Cnt_lgc "MICROSAR RTE" /begin SUB_GROUP /end SUB_GROUP /begin FUNCTION_LIST /end FUNCTION_LIST /begin REF_CHARACTERISTIC /end REF_CHARACTERISTIC /begin REF_MEASUREMENT StOpCtrl.RampDwnStatusComplete.Cnt_lgc /end REF_MEASUREMENT /end GROUP
/begin GROUP StOpCtrl.RampSrlComSvcDft.Cnt_lgc "MICROSAR RTE" /begin SUB_GROUP /end SUB_GROUP /begin FUNCTION_LIST /end FUNCTION_LIST /begin REF_CHARACTERISTIC /end REF_CHARACTERISTIC /begin REF_MEASUREMENT StOpCtrl.RampSrlComSvcDft.Cnt_lgc /end REF_MEASUREMENT /end GROUP
/begin GROUP StOpCtrl.ReceiverPorts "MICROSAR RTE"
 /begin SUB_GROUP StOpCtrl.DiagRampRate.XpmS_f32 StOpCtrl.DiagRampValue.Uls_f32 StOpCtrl.DiagStsDiagRmpActive.Cnt_lgc StOpCtrl.OperRampRate.XpmS_f32 StOpCtrl.OperRampValue.Uls_f32 StOpCtrl.RampSrlComSvcDft.Cnt_lgc /end SUB_GROUP
 /begin FUNCTION_LIST /end FUNCTION_LIST
 /begin REF_CHARACTERISTIC /end REF_CHARACTERISTIC
 /begin REF_MEASUREMENT /end REF_MEASUREMENT
/end GROUP
/begin GROUP StOpCtrl.SenderPorts "MICROSAR RTE"
 /begin SUB_GROUP StOpCtrl.OutputRampMult.Uls_f32 StOpCtrl.RampDwnStatusComplete.Cnt_lgc /end SUB_GROUP
 /begin FUNCTION_LIST /end FUNCTION_LIST
 /begin REF_CHARACTERISTIC /end REF_CHARACTERISTIC
 /begin REF_MEASUREMENT /end REF_MEASUREMENT
/end GROUP
/begin GROUP StaMd "MICROSAR RTE"
 /begin SUB_GROUP StaMd.ModeProvidePorts StaMd.ModeRequirePorts StaMd.ReceiverPorts StaMd.SenderPorts /end SUB_GROUP
 /begin FUNCTION_LIST /end FUNCTION_LIST
 /begin REF_CHARACTERISTIC /end REF_CHARACTERISTIC
 /begin REF_MEASUREMENT /end REF_MEASUREMENT
/end GROUP
/begin GROUP StaMd.ATerm.Cnt_lgc "MICROSAR RTE" /begin SUB_GROUP /end SUB_GROUP /begin FUNCTION_LIST /end FUNCTION_LIST /begin REF_CHARACTERISTIC /end REF_CHARACTERISTIC /begin REF_MEASUREMENT StaMd.ATerm.Cnt_lgc /end REF_MEASUREMENT /end GROUP
/begin GROUP StaMd.CTerm.Cnt_lgc "MICROSAR RTE" /begin SUB_GROUP /end SUB_GROUP /begin FUNCTION_LIST /end FUNCTION_LIST /begin REF_CHARACTERISTIC /end REF_CHARACTERISTIC /begin REF_MEASUREMENT StaMd.CTerm.Cnt_lgc /end REF_MEASUREMENT /end GROUP
/begin GROUP StaMd.ControlledDampStatusComplete.Cnt_lgc "MICROSAR RTE" /begin SUB_GROUP /end SUB_GROUP /begin FUNCTION_LIST /end FUNCTION_LIST /begin REF_CHARACTERISTIC /end REF_CHARACTERISTIC /begin REF_MEASUREMENT StaMd.ControlledDampStatusComplete.Cnt_lgc /end REF_MEASUREMENT /end GROUP
/begin GROUP StaMd.CurrentSystemState.Mode "MICROSAR RTE" /begin SUB_GROUP /end SUB_GROUP /begin FUNCTION_LIST /end FUNCTION_LIST /begin REF_CHARACTERISTIC /end REF_CHARACTERISTIC /begin REF_MEASUREMENT StaMd.CurrentSystemState.Mode /end REF_MEASUREMENT /end GROUP
/begin GROUP StaMd.FTerm.Cnt_lgc "MICROSAR RTE" /begin SUB_GROUP /end SUB_GROUP /begin FUNCTION_LIST /end FUNCTION_LIST /begin REF_CHARACTERISTIC /end REF_CHARACTERISTIC /begin REF_MEASUREMENT StaMd.FTerm.Cnt_lgc /end REF_MEASUREMENT /end GROUP
/begin GROUP StaMd.InitiatePwrDnFastWrite.Cnt_lgc "MICROSAR RTE" /begin SUB_GROUP /end SUB_GROUP /begin FUNCTION_LIST /end FUNCTION_LIST /begin REF_CHARACTERISTIC /end REF_CHARACTERISTIC /begin REF_MEASUREMENT StaMd.InitiatePwrDnFastWrite.Cnt_lgc /end REF_MEASUREMENT /end GROUP
/begin GROUP StaMd.InitiatePwrDnNormalWrite.Cnt_lgc "MICROSAR RTE" /begin SUB_GROUP /end SUB_GROUP /begin FUNCTION_LIST /end FUNCTION_LIST /begin REF_CHARACTERISTIC /end REF_CHARACTERISTIC /begin REF_MEASUREMENT StaMd.InitiatePwrDnNormalWrite.Cnt_lgc /end REF_MEASUREMENT /end GROUP
/begin GROUP StaMd.ModeProvidePorts "MICROSAR RTE" /begin SUB_GROUP StaMd.SystemState.Mode /end SUB_GROUP /begin FUNCTION_LIST /end FUNCTION_LIST /begin REF_CHARACTERISTIC /end REF_CHARACTERISTIC /begin REF_MEASUREMENT /end REF_MEASUREMENT /end GROUP
/begin GROUP StaMd.ModeRequirePorts "MICROSAR RTE" /begin SUB_GROUP StaMd.CurrentSystemState.Mode /end SUB_GROUP /begin FUNCTION_LIST /end FUNCTION_LIST /begin REF_CHARACTERISTIC /end REF_CHARACTERISTIC /begin REF_MEASUREMENT /end REF_MEASUREMENT /end GROUP
/begin GROUP StaMd.PwrDnFastWriteComplete.Cnt_lgc "MICROSAR RTE" /begin SUB_GROUP /end SUB_GROUP /begin FUNCTION_LIST /end FUNCTION_LIST /begin REF_CHARACTERISTIC /end REF_CHARACTERISTIC /begin REF_MEASUREMENT StaMd.PwrDnFastWriteComplete.Cnt_lgc /end REF_MEASUREMENT /end GROUP
/begin GROUP StaMd.RampStatusComplete.Cnt_lgc "MICROSAR RTE" /begin SUB_GROUP /end SUB_GROUP /begin FUNCTION_LIST /end FUNCTION_LIST /begin REF_CHARACTERISTIC /end REF_CHARACTERISTIC /begin REF_MEASUREMENT StaMd.RampStatusComplete.Cnt_lgc /end REF_MEASUREMENT /end GROUP
/begin GROUP StaMd.ReceiverPorts "MICROSAR RTE"
 /begin SUB_GROUP StaMd.ATerm.Cnt_lgc StaMd.CTerm.Cnt_lgc StaMd.ControlledDampStatusComplete.Cnt_lgc StaMd.FTerm.Cnt_lgc StaMd.RampStatusComplete.Cnt_lgc StaMd.TMFTestComplete.Cnt_lgc /end SUB_GROUP
 /begin FUNCTION_LIST /end FUNCTION_LIST
 /begin REF_CHARACTERISTIC /end REF_CHARACTERISTIC
 /begin REF_MEASUREMENT /end REF_MEASUREMENT
/end GROUP
/begin GROUP StaMd.SenderPorts "MICROSAR RTE"
 /begin SUB_GROUP StaMd.InitiatePwrDnFastWrite.Cnt_lgc StaMd.InitiatePwrDnNormalWrite.Cnt_lgc StaMd.PwrDnFastWriteComplete.Cnt_lgc /end SUB_GROUP
 /begin FUNCTION_LIST /end FUNCTION_LIST
 /begin REF_CHARACTERISTIC /end REF_CHARACTERISTIC
 /begin REF_MEASUREMENT /end REF_MEASUREMENT
/end GROUP
/begin GROUP StaMd.SystemState.Mode "MICROSAR RTE" /begin SUB_GROUP /end SUB_GROUP /begin FUNCTION_LIST /end FUNCTION_LIST /begin REF_CHARACTERISTIC /end REF_CHARACTERISTIC /begin REF_MEASUREMENT StaMd.SystemState.Mode /end REF_MEASUREMENT /end GROUP
/begin GROUP StaMd.TMFTestComplete.Cnt_lgc "MICROSAR RTE" /begin SUB_GROUP /end SUB_GROUP /begin FUNCTION_LIST /end FUNCTION_LIST /begin REF_CHARACTERISTIC /end REF_CHARACTERISTIC /begin REF_MEASUREMENT StaMd.TMFTestComplete.Cnt_lgc /end REF_MEASUREMENT /end GROUP
/begin GROUP StaMd11 "MICROSAR RTE" /begin SUB_GROUP StaMd11.ModeProvidePorts /end SUB_GROUP /begin FUNCTION_LIST /end FUNCTION_LIST /begin REF_CHARACTERISTIC /end REF_CHARACTERISTIC /begin REF_MEASUREMENT /end REF_MEASUREMENT /end GROUP
/begin GROUP StaMd11.ModeProvidePorts "MICROSAR RTE" /begin SUB_GROUP StaMd11.SystemState11.Mode /end SUB_GROUP /begin FUNCTION_LIST /end FUNCTION_LIST /begin REF_CHARACTERISTIC /end REF_CHARACTERISTIC /begin REF_MEASUREMENT /end REF_MEASUREMENT /end GROUP
/begin GROUP StaMd11.SystemState11.Mode "MICROSAR RTE" /begin SUB_GROUP /end SUB_GROUP /begin FUNCTION_LIST /end FUNCTION_LIST /begin REF_CHARACTERISTIC /end REF_CHARACTERISTIC /begin REF_MEASUREMENT StaMd11.SystemState11.Mode /end REF_MEASUREMENT /end GROUP
/begin GROUP StaMd7 "MICROSAR RTE" /begin SUB_GROUP StaMd7.ModeProvidePorts /end SUB_GROUP /begin FUNCTION_LIST /end FUNCTION_LIST /begin REF_CHARACTERISTIC /end REF_CHARACTERISTIC /begin REF_MEASUREMENT /end REF_MEASUREMENT /end GROUP
/begin GROUP StaMd7.ModeProvidePorts "MICROSAR RTE" /begin SUB_GROUP StaMd7.SystemState7.Mode /end SUB_GROUP /begin FUNCTION_LIST /end FUNCTION_LIST /begin REF_CHARACTERISTIC /end REF_CHARACTERISTIC /begin REF_MEASUREMENT /end REF_MEASUREMENT /end GROUP
/begin GROUP StaMd7.SystemState7.Mode "MICROSAR RTE" /begin SUB_GROUP /end SUB_GROUP /begin FUNCTION_LIST /end FUNCTION_LIST /begin REF_CHARACTERISTIC /end REF_CHARACTERISTIC /begin REF_MEASUREMENT StaMd7.SystemState7.Mode /end REF_MEASUREMENT /end GROUP
/begin GROUP StaMd8 "MICROSAR RTE" /begin SUB_GROUP StaMd8.ModeProvidePorts StaMd8.ReceiverPorts /end SUB_GROUP /begin FUNCTION_LIST /end FUNCTION_LIST /begin REF_CHARACTERISTIC /end REF_CHARACTERISTIC /begin REF_MEASUREMENT /end REF_MEASUREMENT /end GROUP
/begin GROUP StaMd8.ATerm.Cnt_lgc "MICROSAR RTE" /begin SUB_GROUP /end SUB_GROUP /begin FUNCTION_LIST /end FUNCTION_LIST /begin REF_CHARACTERISTIC /end REF_CHARACTERISTIC /begin REF_MEASUREMENT StaMd8.ATerm.Cnt_lgc /end REF_MEASUREMENT /end GROUP
/begin GROUP StaMd8.CTerm.Cnt_lgc "MICROSAR RTE" /begin SUB_GROUP /end SUB_GROUP /begin FUNCTION_LIST /end FUNCTION_LIST /begin REF_CHARACTERISTIC /end REF_CHARACTERISTIC /begin REF_MEASUREMENT StaMd8.CTerm.Cnt_lgc /end REF_MEASUREMENT /end GROUP
/begin GROUP StaMd8.ControlledDampStatusComplete.Cnt_lgc "MICROSAR RTE" /begin SUB_GROUP /end SUB_GROUP /begin FUNCTION_LIST /end FUNCTION_LIST /begin REF_CHARACTERISTIC /end REF_CHARACTERISTIC /begin REF_MEASUREMENT StaMd8.ControlledDampStatusComplete.Cnt_lgc /end REF_MEASUREMENT /end GROUP
/begin GROUP StaMd8.FTerm.Cnt_lgc "MICROSAR RTE" /begin SUB_GROUP /end SUB_GROUP /begin FUNCTION_LIST /end FUNCTION_LIST /begin REF_CHARACTERISTIC /end REF_CHARACTERISTIC /begin REF_MEASUREMENT StaMd8.FTerm.Cnt_lgc /end REF_MEASUREMENT /end GROUP
/begin GROUP StaMd8.ModeProvidePorts "MICROSAR RTE" /begin SUB_GROUP StaMd8.SystemState8.Mode /end SUB_GROUP /begin FUNCTION_LIST /end FUNCTION_LIST /begin REF_CHARACTERISTIC /end REF_CHARACTERISTIC /begin REF_MEASUREMENT /end REF_MEASUREMENT /end GROUP
/begin GROUP StaMd8.RampStatusComplete.Cnt_lgc "MICROSAR RTE" /begin SUB_GROUP /end SUB_GROUP /begin FUNCTION_LIST /end FUNCTION_LIST /begin REF_CHARACTERISTIC /end REF_CHARACTERISTIC /begin REF_MEASUREMENT StaMd8.RampStatusComplete.Cnt_lgc /end REF_MEASUREMENT /end GROUP
/begin GROUP StaMd8.ReceiverPorts "MICROSAR RTE"
 /begin SUB_GROUP StaMd8.ATerm.Cnt_lgc StaMd8.CTerm.Cnt_lgc StaMd8.ControlledDampStatusComplete.Cnt_lgc StaMd8.FTerm.Cnt_lgc StaMd8.RampStatusComplete.Cnt_lgc StaMd8.TMFTestComplete.Cnt_lgc /end SUB_GROUP
 /begin FUNCTION_LIST /end FUNCTION_LIST
 /begin REF_CHARACTERISTIC /end REF_CHARACTERISTIC
 /begin REF_MEASUREMENT /end REF_MEASUREMENT
/end GROUP
/begin GROUP StaMd8.SystemState8.Mode "MICROSAR RTE" /begin SUB_GROUP /end SUB_GROUP /begin FUNCTION_LIST /end FUNCTION_LIST /begin REF_CHARACTERISTIC /end REF_CHARACTERISTIC /begin REF_MEASUREMENT StaMd8.SystemState8.Mode /end REF_MEASUREMENT /end GROUP
/begin GROUP StaMd8.TMFTestComplete.Cnt_lgc "MICROSAR RTE" /begin SUB_GROUP /end SUB_GROUP /begin FUNCTION_LIST /end FUNCTION_LIST /begin REF_CHARACTERISTIC /end REF_CHARACTERISTIC /begin REF_MEASUREMENT StaMd8.TMFTestComplete.Cnt_lgc /end REF_MEASUREMENT /end GROUP
/begin GROUP StaMd9 "MICROSAR RTE" /begin SUB_GROUP StaMd9.ModeProvidePorts /end SUB_GROUP /begin FUNCTION_LIST /end FUNCTION_LIST /begin REF_CHARACTERISTIC /end REF_CHARACTERISTIC /begin REF_MEASUREMENT /end REF_MEASUREMENT /end GROUP
/begin GROUP StaMd9.ModeProvidePorts "MICROSAR RTE" /begin SUB_GROUP StaMd9.SystemState9.Mode /end SUB_GROUP /begin FUNCTION_LIST /end FUNCTION_LIST /begin REF_CHARACTERISTIC /end REF_CHARACTERISTIC /begin REF_MEASUREMENT /end REF_MEASUREMENT /end GROUP
/begin GROUP StaMd9.SystemState9.Mode "MICROSAR RTE" /begin SUB_GROUP /end SUB_GROUP /begin FUNCTION_LIST /end FUNCTION_LIST /begin REF_CHARACTERISTIC /end REF_CHARACTERISTIC /begin REF_MEASUREMENT StaMd9.SystemState9.Mode /end REF_MEASUREMENT /end GROUP
/begin GROUP StabilityComp "MICROSAR RTE" /begin SUB_GROUP StabilityComp.ReceiverPorts StabilityComp.SenderPorts /end SUB_GROUP /begin FUNCTION_LIST /end FUNCTION_LIST /begin REF_CHARACTERISTIC /end REF_CHARACTERISTIC /begin REF_MEASUREMENT /end REF_MEASUREMENT /end GROUP
/begin GROUP StabilityComp.AssistCmd.MtrNm_f32 "MICROSAR RTE" /begin SUB_GROUP /end SUB_GROUP /begin FUNCTION_LIST /end FUNCTION_LIST /begin REF_CHARACTERISTIC /end REF_CHARACTERISTIC /begin REF_MEASUREMENT StabilityComp.AssistCmd.MtrNm_f32 /end REF_MEASUREMENT /end GROUP
/begin GROUP StabilityComp.AssistDDFactor.Uls_f32 "MICROSAR RTE" /begin SUB_GROUP /end SUB_GROUP /begin FUNCTION_LIST /end FUNCTION_LIST /begin REF_CHARACTERISTIC /end REF_CHARACTERISTIC /begin REF_MEASUREMENT StabilityComp.AssistDDFactor.Uls_f32 /end REF_MEASUREMENT /end GROUP
/begin GROUP StabilityComp.AsstFWActive.Uls_f32 "MICROSAR RTE" /begin SUB_GROUP /end SUB_GROUP /begin FUNCTION_LIST /end FUNCTION_LIST /begin REF_CHARACTERISTIC /end REF_CHARACTERISTIC /begin REF_MEASUREMENT StabilityComp.AsstFWActive.Uls_f32 /end REF_MEASUREMENT /end GROUP
/begin GROUP StabilityComp.CombinedAssist.MtrNm_f32 "MICROSAR RTE" /begin SUB_GROUP /end SUB_GROUP /begin FUNCTION_LIST /end FUNCTION_LIST /begin REF_CHARACTERISTIC /end REF_CHARACTERISTIC /begin REF_MEASUREMENT StabilityComp.CombinedAssist.MtrNm_f32 /end REF_MEASUREMENT /end GROUP
/begin GROUP StabilityComp.HwTorque.HwNm_f32 "MICROSAR RTE" /begin SUB_GROUP /end SUB_GROUP /begin FUNCTION_LIST /end FUNCTION_LIST /begin REF_CHARACTERISTIC /end REF_CHARACTERISTIC /begin REF_MEASUREMENT StabilityComp.HwTorque.HwNm_f32 /end REF_MEASUREMENT /end GROUP
/begin GROUP StabilityComp.ReceiverPorts "MICROSAR RTE"
 /begin SUB_GROUP StabilityComp.AssistDDFactor.Uls_f32 StabilityComp.AsstFWActive.Uls_f32 StabilityComp.CombinedAssist.MtrNm_f32 StabilityComp.HwTorque.HwNm_f32 StabilityComp.SysAssistCmd_MtrNm.MtrNm_f32 StabilityComp.VehicleSpeed.Kph_f32 /end SUB_GROUP
 /begin FUNCTION_LIST /end FUNCTION_LIST
 /begin REF_CHARACTERISTIC /end REF_CHARACTERISTIC
 /begin REF_MEASUREMENT /end REF_MEASUREMENT
/end GROUP
/begin GROUP StabilityComp.SenderPorts "MICROSAR RTE" /begin SUB_GROUP StabilityComp.AssistCmd.MtrNm_f32 /end SUB_GROUP /begin FUNCTION_LIST /end FUNCTION_LIST /begin REF_CHARACTERISTIC /end REF_CHARACTERISTIC /begin REF_MEASUREMENT /end REF_MEASUREMENT /end GROUP
/begin GROUP StabilityComp.SysAssistCmd_MtrNm.MtrNm_f32 "MICROSAR RTE" /begin SUB_GROUP /end SUB_GROUP /begin FUNCTION_LIST /end FUNCTION_LIST /begin REF_CHARACTERISTIC /end REF_CHARACTERISTIC /begin REF_MEASUREMENT StabilityComp.SysAssistCmd_MtrNm.MtrNm_f32 /end REF_MEASUREMENT /end GROUP
/begin GROUP StabilityComp.VehicleSpeed.Kph_f32 "MICROSAR RTE" /begin SUB_GROUP /end SUB_GROUP /begin FUNCTION_LIST /end FUNCTION_LIST /begin REF_CHARACTERISTIC /end REF_CHARACTERISTIC /begin REF_MEASUREMENT StabilityComp.VehicleSpeed.Kph_f32 /end REF_MEASUREMENT /end GROUP
/begin GROUP StabilityComp2 "MICROSAR RTE" /begin SUB_GROUP StabilityComp2.ReceiverPorts StabilityComp2.SenderPorts /end SUB_GROUP /begin FUNCTION_LIST /end FUNCTION_LIST /begin REF_CHARACTERISTIC /end REF_CHARACTERISTIC /begin REF_MEASUREMENT /end REF_MEASUREMENT /end GROUP
/begin GROUP StabilityComp2.AssistDDFactor.Uls_f32 "MICROSAR RTE" /begin SUB_GROUP /end SUB_GROUP /begin FUNCTION_LIST /end FUNCTION_LIST /begin REF_CHARACTERISTIC /end REF_CHARACTERISTIC /begin REF_MEASUREMENT StabilityComp2.AssistDDFactor.Uls_f32 /end REF_MEASUREMENT /end GROUP
/begin GROUP StabilityComp2.AsstFWActive.Uls_f32 "MICROSAR RTE" /begin SUB_GROUP /end SUB_GROUP /begin FUNCTION_LIST /end FUNCTION_LIST /begin REF_CHARACTERISTIC /end REF_CHARACTERISTIC /begin REF_MEASUREMENT StabilityComp2.AsstFWActive.Uls_f32 /end REF_MEASUREMENT /end GROUP
/begin GROUP StabilityComp2.CombinedAssist.MtrNm_f32 "MICROSAR RTE" /begin SUB_GROUP /end SUB_GROUP /begin FUNCTION_LIST /end FUNCTION_LIST /begin REF_CHARACTERISTIC /end REF_CHARACTERISTIC /begin REF_MEASUREMENT StabilityComp2.CombinedAssist.MtrNm_f32 /end REF_MEASUREMENT /end GROUP
/begin GROUP StabilityComp2.HwTorque.HwNm_f32 "MICROSAR RTE" /begin SUB_GROUP /end SUB_GROUP /begin FUNCTION_LIST /end FUNCTION_LIST /begin REF_CHARACTERISTIC /end REF_CHARACTERISTIC /begin REF_MEASUREMENT StabilityComp2.HwTorque.HwNm_f32 /end REF_MEASUREMENT /end GROUP
/begin GROUP StabilityComp2.ReceiverPorts "MICROSAR RTE"
 /begin SUB_GROUP StabilityComp2.AssistDDFactor.Uls_f32 StabilityComp2.AsstFWActive.Uls_f32 StabilityComp2.CombinedAssist.MtrNm_f32 StabilityComp2.HwTorque.HwNm_f32 StabilityComp2.VehicleSpeed.Kph_f32 /end SUB_GROUP
 /begin FUNCTION_LIST /end FUNCTION_LIST
 /begin REF_CHARACTERISTIC /end REF_CHARACTERISTIC
 /begin REF_MEASUREMENT /end REF_MEASUREMENT
/end GROUP
/begin GROUP StabilityComp2.SenderPorts "MICROSAR RTE" /begin SUB_GROUP StabilityComp2.SysAssistCmd.MtrNm_f32 /end SUB_GROUP /begin FUNCTION_LIST /end FUNCTION_LIST /begin REF_CHARACTERISTIC /end REF_CHARACTERISTIC /begin REF_MEASUREMENT /end REF_MEASUREMENT /end GROUP
/begin GROUP StabilityComp2.SysAssistCmd.MtrNm_f32 "MICROSAR RTE" /begin SUB_GROUP /end SUB_GROUP /begin FUNCTION_LIST /end FUNCTION_LIST /begin REF_CHARACTERISTIC /end REF_CHARACTERISTIC /begin REF_MEASUREMENT StabilityComp2.SysAssistCmd.MtrNm_f32 /end REF_MEASUREMENT /end GROUP
/begin GROUP StabilityComp2.VehicleSpeed.Kph_f32 "MICROSAR RTE" /begin SUB_GROUP /end SUB_GROUP /begin FUNCTION_LIST /end FUNCTION_LIST /begin REF_CHARACTERISTIC /end REF_CHARACTERISTIC /begin REF_MEASUREMENT StabilityComp2.VehicleSpeed.Kph_f32 /end REF_MEASUREMENT /end GROUP
/begin GROUP Sweep "MICROSAR RTE" /begin SUB_GROUP Sweep.ReceiverPorts Sweep.SenderPorts /end SUB_GROUP /begin FUNCTION_LIST /end FUNCTION_LIST /begin REF_CHARACTERISTIC /end REF_CHARACTERISTIC /begin REF_MEASUREMENT /end REF_MEASUREMENT /end GROUP
/begin GROUP Sweep.InputHwTrq.HwNm_f32 "MICROSAR RTE" /begin SUB_GROUP /end SUB_GROUP /begin FUNCTION_LIST /end FUNCTION_LIST /begin REF_CHARACTERISTIC /end REF_CHARACTERISTIC /begin REF_MEASUREMENT Sweep.InputHwTrq.HwNm_f32 /end REF_MEASUREMENT /end GROUP
/begin GROUP Sweep.OutputHwTrq.HwNm_f32 "MICROSAR RTE" /begin SUB_GROUP /end SUB_GROUP /begin FUNCTION_LIST /end FUNCTION_LIST /begin REF_CHARACTERISTIC /end REF_CHARACTERISTIC /begin REF_MEASUREMENT Sweep.OutputHwTrq.HwNm_f32 /end REF_MEASUREMENT /end GROUP
/begin GROUP Sweep.ReceiverPorts "MICROSAR RTE"
 /begin SUB_GROUP Sweep.InputHwTrq.HwNm_f32 Sweep.VehSpd.Kph_f32 Sweep.VehSpdValid.Cnt_lgc /end SUB_GROUP
 /begin FUNCTION_LIST /end FUNCTION_LIST
 /begin REF_CHARACTERISTIC /end REF_CHARACTERISTIC
 /begin REF_MEASUREMENT /end REF_MEASUREMENT
/end GROUP
/begin GROUP Sweep.SenderPorts "MICROSAR RTE" /begin SUB_GROUP Sweep.OutputHwTrq.HwNm_f32 /end SUB_GROUP /begin FUNCTION_LIST /end FUNCTION_LIST /begin REF_CHARACTERISTIC /end REF_CHARACTERISTIC /begin REF_MEASUREMENT /end REF_MEASUREMENT /end GROUP
/begin GROUP Sweep.VehSpd.Kph_f32 "MICROSAR RTE" /begin SUB_GROUP /end SUB_GROUP /begin FUNCTION_LIST /end FUNCTION_LIST /begin REF_CHARACTERISTIC /end REF_CHARACTERISTIC /begin REF_MEASUREMENT Sweep.VehSpd.Kph_f32 /end REF_MEASUREMENT /end GROUP
/begin GROUP Sweep.VehSpdValid.Cnt_lgc "MICROSAR RTE" /begin SUB_GROUP /end SUB_GROUP /begin FUNCTION_LIST /end FUNCTION_LIST /begin REF_CHARACTERISTIC /end REF_CHARACTERISTIC /begin REF_MEASUREMENT Sweep.VehSpdValid.Cnt_lgc /end REF_MEASUREMENT /end GROUP
/begin GROUP Sweep2 "MICROSAR RTE" /begin SUB_GROUP Sweep2.ReceiverPorts Sweep2.SenderPorts /end SUB_GROUP /begin FUNCTION_LIST /end FUNCTION_LIST /begin REF_CHARACTERISTIC /end REF_CHARACTERISTIC /begin REF_MEASUREMENT /end REF_MEASUREMENT /end GROUP
/begin GROUP Sweep2.InputMtrTrq.MtrNm_f32 "MICROSAR RTE" /begin SUB_GROUP /end SUB_GROUP /begin FUNCTION_LIST /end FUNCTION_LIST /begin REF_CHARACTERISTIC /end REF_CHARACTERISTIC /begin REF_MEASUREMENT Sweep2.InputMtrTrq.MtrNm_f32 /end REF_MEASUREMENT /end GROUP
/begin GROUP Sweep2.OutputMtrTrq.MtrNm_f32 "MICROSAR RTE" /begin SUB_GROUP /end SUB_GROUP /begin FUNCTION_LIST /end FUNCTION_LIST /begin REF_CHARACTERISTIC /end REF_CHARACTERISTIC /begin REF_MEASUREMENT Sweep2.OutputMtrTrq.MtrNm_f32 /end REF_MEASUREMENT /end GROUP
/begin GROUP Sweep2.ReceiverPorts "MICROSAR RTE" /begin SUB_GROUP Sweep2.InputMtrTrq.MtrNm_f32 /end SUB_GROUP /begin FUNCTION_LIST /end FUNCTION_LIST /begin REF_CHARACTERISTIC /end REF_CHARACTERISTIC /begin REF_MEASUREMENT /end REF_MEASUREMENT /end GROUP
/begin GROUP Sweep2.SenderPorts "MICROSAR RTE" /begin SUB_GROUP Sweep2.OutputMtrTrq.MtrNm_f32 /end SUB_GROUP /begin FUNCTION_LIST /end FUNCTION_LIST /begin REF_CHARACTERISTIC /end REF_CHARACTERISTIC /begin REF_MEASUREMENT /end REF_MEASUREMENT /end GROUP
/begin GROUP ThrmlDutyCycle "MICROSAR RTE"
 /begin SUB_GROUP ThrmlDutyCycle.PerInstanceMemories ThrmlDutyCycle.ReceiverPorts ThrmlDutyCycle.SenderPorts /end SUB_GROUP
 /begin FUNCTION_LIST /end FUNCTION_LIST
 /begin REF_CHARACTERISTIC /end REF_CHARACTERISTIC
 /begin REF_MEASUREMENT /end REF_MEASUREMENT
/end GROUP
/begin GROUP ThrmlDutyCycle.CuTempEst.DegC_f32 "MICROSAR RTE" /begin SUB_GROUP /end SUB_GROUP /begin FUNCTION_LIST /end FUNCTION_LIST /begin REF_CHARACTERISTIC /end REF_CHARACTERISTIC /begin REF_MEASUREMENT ThrmlDutyCycle.CuTempEst.DegC_f32 /end REF_MEASUREMENT /end GROUP
/begin GROUP ThrmlDutyCycle.DefeatDutySvc.Cnt_lgc "MICROSAR RTE" /begin SUB_GROUP /end SUB_GROUP /begin FUNCTION_LIST /end FUNCTION_LIST /begin REF_CHARACTERISTIC /end REF_CHARACTERISTIC /begin REF_MEASUREMENT ThrmlDutyCycle.DefeatDutySvc.Cnt_lgc /end REF_MEASUREMENT /end GROUP
/begin GROUP ThrmlDutyCycle.DutyCycleLevel.Uls_f32 "MICROSAR RTE" /begin SUB_GROUP /end SUB_GROUP /begin FUNCTION_LIST /end FUNCTION_LIST /begin REF_CHARACTERISTIC /end REF_CHARACTERISTIC /begin REF_MEASUREMENT ThrmlDutyCycle.DutyCycleLevel.Uls_f32 /end REF_MEASUREMENT /end GROUP
/begin GROUP ThrmlDutyCycle.FiltMeasTemp.DegC_f32 "MICROSAR RTE" /begin SUB_GROUP /end SUB_GROUP /begin FUNCTION_LIST /end FUNCTION_LIST /begin REF_CHARACTERISTIC /end REF_CHARACTERISTIC /begin REF_MEASUREMENT ThrmlDutyCycle.FiltMeasTemp.DegC_f32 /end REF_MEASUREMENT /end GROUP
/begin GROUP ThrmlDutyCycle.FilteredPkCurr.AmpSq_f32 "MICROSAR RTE" /begin SUB_GROUP /end SUB_GROUP /begin FUNCTION_LIST /end FUNCTION_LIST /begin REF_CHARACTERISTIC /end REF_CHARACTERISTIC /begin REF_MEASUREMENT ThrmlDutyCycle.FilteredPkCurr.AmpSq_f32 /end REF_MEASUREMENT /end GROUP
/begin GROUP ThrmlDutyCycle.IgnTimeOff.Cnt_u32 "MICROSAR RTE" /begin SUB_GROUP /end SUB_GROUP /begin FUNCTION_LIST /end FUNCTION_LIST /begin REF_CHARACTERISTIC /end REF_CHARACTERISTIC /begin REF_MEASUREMENT ThrmlDutyCycle.IgnTimeOff.Cnt_u32 /end REF_MEASUREMENT /end GROUP
/begin GROUP ThrmlDutyCycle.MagTempEst.DegC_f32 "MICROSAR RTE" /begin SUB_GROUP /end SUB_GROUP /begin FUNCTION_LIST /end FUNCTION_LIST /begin REF_CHARACTERISTIC /end REF_CHARACTERISTIC /begin REF_MEASUREMENT ThrmlDutyCycle.MagTempEst.DegC_f32 /end REF_MEASUREMENT /end GROUP
/begin GROUP ThrmlDutyCycle.MotorVelCRF.MtrRadpS_f32 "MICROSAR RTE" /begin SUB_GROUP /end SUB_GROUP /begin FUNCTION_LIST /end FUNCTION_LIST /begin REF_CHARACTERISTIC /end REF_CHARACTERISTIC /begin REF_MEASUREMENT ThrmlDutyCycle.MotorVelCRF.MtrRadpS_f32 /end REF_MEASUREMENT /end GROUP
/begin GROUP ThrmlDutyCycle.MtrPkCurr.AmpSq_f32 "MICROSAR RTE" /begin SUB_GROUP /end SUB_GROUP /begin FUNCTION_LIST /end FUNCTION_LIST /begin REF_CHARACTERISTIC /end REF_CHARACTERISTIC /begin REF_MEASUREMENT ThrmlDutyCycle.MtrPkCurr.AmpSq_f32 /end REF_MEASUREMENT /end GROUP
/begin GROUP ThrmlDutyCycle.PerInstanceMemories "MICROSAR RTE" /begin SUB_GROUP ThrmlDutyCycle.ThrmlDutyCycle_FltStVal /end SUB_GROUP /begin FUNCTION_LIST /end FUNCTION_LIST /begin REF_CHARACTERISTIC /end REF_CHARACTERISTIC /begin REF_MEASUREMENT /end REF_MEASUREMENT /end GROUP
/begin GROUP ThrmlDutyCycle.ReceiverPorts "MICROSAR RTE"
 /begin SUB_GROUP ThrmlDutyCycle.CuTempEst.DegC_f32 ThrmlDutyCycle.DefeatDutySvc.Cnt_lgc ThrmlDutyCycle.FiltMeasTemp.DegC_f32 ThrmlDutyCycle.FilteredPkCurr.AmpSq_f32 ThrmlDutyCycle.IgnTimeOff.Cnt_u32 ThrmlDutyCycle.MagTempEst.DegC_f32 ThrmlDutyCycle.MotorVelCRF.MtrRadpS_f32 ThrmlDutyCycle.MtrPkCurr.AmpSq_f32 ThrmlDutyCycle.SiTempEst.DegC_f32 ThrmlDutyCycle.VehTimeValid.Cnt_lgc /end SUB_GROUP
 /begin FUNCTION_LIST /end FUNCTION_LIST
 /begin REF_CHARACTERISTIC /end REF_CHARACTERISTIC
 /begin REF_MEASUREMENT /end REF_MEASUREMENT
/end GROUP
/begin GROUP ThrmlDutyCycle.SenderPorts "MICROSAR RTE"
 /begin SUB_GROUP ThrmlDutyCycle.DutyCycleLevel.Uls_f32 ThrmlDutyCycle.ThermLimitPerc.Uls_f32 ThrmlDutyCycle.ThermalLimit.MtrNm_f32 /end SUB_GROUP
 /begin FUNCTION_LIST /end FUNCTION_LIST
 /begin REF_CHARACTERISTIC /end REF_CHARACTERISTIC
 /begin REF_MEASUREMENT /end REF_MEASUREMENT
/end GROUP
/begin GROUP ThrmlDutyCycle.SiTempEst.DegC_f32 "MICROSAR RTE" /begin SUB_GROUP /end SUB_GROUP /begin FUNCTION_LIST /end FUNCTION_LIST /begin REF_CHARACTERISTIC /end REF_CHARACTERISTIC /begin REF_MEASUREMENT ThrmlDutyCycle.SiTempEst.DegC_f32 /end REF_MEASUREMENT /end GROUP
/begin GROUP ThrmlDutyCycle.ThermLimitPerc.Uls_f32 "MICROSAR RTE" /begin SUB_GROUP /end SUB_GROUP /begin FUNCTION_LIST /end FUNCTION_LIST /begin REF_CHARACTERISTIC /end REF_CHARACTERISTIC /begin REF_MEASUREMENT ThrmlDutyCycle.ThermLimitPerc.Uls_f32 /end REF_MEASUREMENT /end GROUP
/begin GROUP ThrmlDutyCycle.ThermalLimit.MtrNm_f32 "MICROSAR RTE" /begin SUB_GROUP /end SUB_GROUP /begin FUNCTION_LIST /end FUNCTION_LIST /begin REF_CHARACTERISTIC /end REF_CHARACTERISTIC /begin REF_MEASUREMENT ThrmlDutyCycle.ThermalLimit.MtrNm_f32 /end REF_MEASUREMENT /end GROUP
/begin GROUP ThrmlDutyCycle.ThrmlDutyCycle_FltStVal "MICROSAR RTE" /begin SUB_GROUP /end SUB_GROUP /begin FUNCTION_LIST /end FUNCTION_LIST /begin REF_CHARACTERISTIC /end REF_CHARACTERISTIC
 /begin REF_MEASUREMENT ThrmlDutyCycle.ThrmlDutyCycle_FltStVal.Filt3Val_Cnt_u8 ThrmlDutyCycle.ThrmlDutyCycle_FltStVal.Filt4Val_Cnt_u8 ThrmlDutyCycle.ThrmlDutyCycle_FltStVal.Filt5Val_Cnt_u8 ThrmlDutyCycle.ThrmlDutyCycle_FltStVal.Filt6Val_Cnt_u8 /end REF_MEASUREMENT
/end GROUP
/begin GROUP ThrmlDutyCycle.VehTimeValid.Cnt_lgc "MICROSAR RTE" /begin SUB_GROUP /end SUB_GROUP /begin FUNCTION_LIST /end FUNCTION_LIST /begin REF_CHARACTERISTIC /end REF_CHARACTERISTIC /begin REF_MEASUREMENT ThrmlDutyCycle.VehTimeValid.Cnt_lgc /end REF_MEASUREMENT /end GROUP
/begin GROUP TmprlMon "MICROSAR RTE"
 /begin SUB_GROUP TmprlMon.ModeRequirePorts TmprlMon.ReceiverPorts TmprlMon.SenderPorts /end SUB_GROUP
 /begin FUNCTION_LIST /end FUNCTION_LIST
 /begin REF_CHARACTERISTIC /end REF_CHARACTERISTIC
 /begin REF_MEASUREMENT /end REF_MEASUREMENT
/end GROUP
/begin GROUP TmprlMon.ModeRequirePorts "MICROSAR RTE" /begin SUB_GROUP TmprlMon.SystemState.Mode /end SUB_GROUP /begin FUNCTION_LIST /end FUNCTION_LIST /begin REF_CHARACTERISTIC /end REF_CHARACTERISTIC /begin REF_MEASUREMENT /end REF_MEASUREMENT /end GROUP
/begin GROUP TmprlMon.ReceiverPorts "MICROSAR RTE" /begin SUB_GROUP TmprlMon.TMFTestStart.Cnt_lgc /end SUB_GROUP /begin FUNCTION_LIST /end FUNCTION_LIST /begin REF_CHARACTERISTIC /end REF_CHARACTERISTIC /begin REF_MEASUREMENT /end REF_MEASUREMENT /end GROUP
/begin GROUP TmprlMon.SenderPorts "MICROSAR RTE" /begin SUB_GROUP TmprlMon.TMFTestComplete.Cnt_lgc /end SUB_GROUP /begin FUNCTION_LIST /end FUNCTION_LIST /begin REF_CHARACTERISTIC /end REF_CHARACTERISTIC /begin REF_MEASUREMENT /end REF_MEASUREMENT /end GROUP
/begin GROUP TmprlMon.SystemState.Mode "MICROSAR RTE" /begin SUB_GROUP /end SUB_GROUP /begin FUNCTION_LIST /end FUNCTION_LIST /begin REF_CHARACTERISTIC /end REF_CHARACTERISTIC /begin REF_MEASUREMENT TmprlMon.SystemState.Mode /end REF_MEASUREMENT /end GROUP
/begin GROUP TmprlMon.TMFTestComplete.Cnt_lgc "MICROSAR RTE" /begin SUB_GROUP /end SUB_GROUP /begin FUNCTION_LIST /end FUNCTION_LIST /begin REF_CHARACTERISTIC /end REF_CHARACTERISTIC /begin REF_MEASUREMENT TmprlMon.TMFTestComplete.Cnt_lgc /end REF_MEASUREMENT /end GROUP
/begin GROUP TmprlMon.TMFTestStart.Cnt_lgc "MICROSAR RTE" /begin SUB_GROUP /end SUB_GROUP /begin FUNCTION_LIST /end FUNCTION_LIST /begin REF_CHARACTERISTIC /end REF_CHARACTERISTIC /begin REF_MEASUREMENT TmprlMon.TMFTestStart.Cnt_lgc /end REF_MEASUREMENT /end GROUP
/begin GROUP TrqBasedInrtCmp "MICROSAR RTE" /begin SUB_GROUP TrqBasedInrtCmp.ReceiverPorts TrqBasedInrtCmp.SenderPorts /end SUB_GROUP /begin FUNCTION_LIST /end FUNCTION_LIST /begin REF_CHARACTERISTIC /end REF_CHARACTERISTIC /begin REF_MEASUREMENT /end REF_MEASUREMENT /end GROUP
/begin GROUP TrqBasedInrtCmp.HighFreqAssist.MtrNm_f32 "MICROSAR RTE" /begin SUB_GROUP /end SUB_GROUP /begin FUNCTION_LIST /end FUNCTION_LIST /begin REF_CHARACTERISTIC /end REF_CHARACTERISTIC /begin REF_MEASUREMENT TrqBasedInrtCmp.HighFreqAssist.MtrNm_f32 /end REF_MEASUREMENT /end GROUP
/begin GROUP TrqBasedInrtCmp.HwTorque.HwNm_f32 "MICROSAR RTE" /begin SUB_GROUP /end SUB_GROUP /begin FUNCTION_LIST /end FUNCTION_LIST /begin REF_CHARACTERISTIC /end REF_CHARACTERISTIC /begin REF_MEASUREMENT TrqBasedInrtCmp.HwTorque.HwNm_f32 /end REF_MEASUREMENT /end GROUP
/begin GROUP TrqBasedInrtCmp.ReceiverPorts "MICROSAR RTE"
 /begin SUB_GROUP TrqBasedInrtCmp.HwTorque.HwNm_f32 TrqBasedInrtCmp.VehicleSpeed.Kph_f32 /end SUB_GROUP
 /begin FUNCTION_LIST /end FUNCTION_LIST
 /begin REF_CHARACTERISTIC /end REF_CHARACTERISTIC
 /begin REF_MEASUREMENT /end REF_MEASUREMENT
/end GROUP
/begin GROUP TrqBasedInrtCmp.SenderPorts "MICROSAR RTE" /begin SUB_GROUP TrqBasedInrtCmp.HighFreqAssist.MtrNm_f32 /end SUB_GROUP /begin FUNCTION_LIST /end FUNCTION_LIST /begin REF_CHARACTERISTIC /end REF_CHARACTERISTIC /begin REF_MEASUREMENT /end REF_MEASUREMENT /end GROUP
/begin GROUP TrqBasedInrtCmp.VehicleSpeed.Kph_f32 "MICROSAR RTE" /begin SUB_GROUP /end SUB_GROUP /begin FUNCTION_LIST /end FUNCTION_LIST /begin REF_CHARACTERISTIC /end REF_CHARACTERISTIC /begin REF_MEASUREMENT TrqBasedInrtCmp.VehicleSpeed.Kph_f32 /end REF_MEASUREMENT /end GROUP
/begin GROUP TrqCmdScl "MICROSAR RTE"
 /begin SUB_GROUP TrqCmdScl.PerInstanceMemories TrqCmdScl.ReceiverPorts TrqCmdScl.SenderPorts /end SUB_GROUP
 /begin FUNCTION_LIST /end FUNCTION_LIST
 /begin REF_CHARACTERISTIC /end REF_CHARACTERISTIC
 /begin REF_MEASUREMENT /end REF_MEASUREMENT
/end GROUP
/begin GROUP TrqCmdScl.MRFMtrTrqCmd.MtrNm_f32 "MICROSAR RTE" /begin SUB_GROUP /end SUB_GROUP /begin FUNCTION_LIST /end FUNCTION_LIST /begin REF_CHARACTERISTIC /end REF_CHARACTERISTIC /begin REF_MEASUREMENT TrqCmdScl.MRFMtrTrqCmd.MtrNm_f32 /end REF_MEASUREMENT /end GROUP
/begin GROUP TrqCmdScl.MRFMtrTrqCmdScl.MtrNm_f32 "MICROSAR RTE" /begin SUB_GROUP /end SUB_GROUP /begin FUNCTION_LIST /end FUNCTION_LIST /begin REF_CHARACTERISTIC /end REF_CHARACTERISTIC /begin REF_MEASUREMENT TrqCmdScl.MRFMtrTrqCmdScl.MtrNm_f32 /end REF_MEASUREMENT /end GROUP
/begin GROUP TrqCmdScl.PerInstanceMemories "MICROSAR RTE" /begin SUB_GROUP TrqCmdScl.TorqueCmdSF_Uls_f32 /end SUB_GROUP /begin FUNCTION_LIST /end FUNCTION_LIST /begin REF_CHARACTERISTIC /end REF_CHARACTERISTIC /begin REF_MEASUREMENT /end REF_MEASUREMENT /end GROUP
/begin GROUP TrqCmdScl.ReceiverPorts "MICROSAR RTE" /begin SUB_GROUP TrqCmdScl.MRFMtrTrqCmd.MtrNm_f32 /end SUB_GROUP /begin FUNCTION_LIST /end FUNCTION_LIST /begin REF_CHARACTERISTIC /end REF_CHARACTERISTIC /begin REF_MEASUREMENT /end REF_MEASUREMENT /end GROUP
/begin GROUP TrqCmdScl.SenderPorts "MICROSAR RTE" /begin SUB_GROUP TrqCmdScl.MRFMtrTrqCmdScl.MtrNm_f32 /end SUB_GROUP /begin FUNCTION_LIST /end FUNCTION_LIST /begin REF_CHARACTERISTIC /end REF_CHARACTERISTIC /begin REF_MEASUREMENT /end REF_MEASUREMENT /end GROUP
/begin GROUP TrqCmdScl.TorqueCmdSF_Uls_f32 "MICROSAR RTE" /begin SUB_GROUP /end SUB_GROUP /begin FUNCTION_LIST /end FUNCTION_LIST /begin REF_CHARACTERISTIC /end REF_CHARACTERISTIC /begin REF_MEASUREMENT TrqCmdScl.TorqueCmdSF_Uls_f32 /end REF_MEASUREMENT /end GROUP
/begin GROUP TrqOsc "MICROSAR RTE" /begin SUB_GROUP TrqOsc.ReceiverPorts TrqOsc.SenderPorts /end SUB_GROUP /begin FUNCTION_LIST /end FUNCTION_LIST /begin REF_CHARACTERISTIC /end REF_CHARACTERISTIC /begin REF_MEASUREMENT /end REF_MEASUREMENT /end GROUP
/begin GROUP TrqOsc.ReceiverPorts "MICROSAR RTE"
 /begin SUB_GROUP TrqOsc.TrqOscAmp.MtrNm_f32 TrqOsc.TrqOscEnable.Cnt_lgc TrqOsc.TrqOscFallRampRate.MtrNmpS_f32 TrqOsc.TrqOscFreq.Hz_f32 TrqOsc.TrqOscRisngRampRate.MtrNmpS_f32 /end SUB_GROUP
 /begin FUNCTION_LIST /end FUNCTION_LIST
 /begin REF_CHARACTERISTIC /end REF_CHARACTERISTIC
 /begin REF_MEASUREMENT /end REF_MEASUREMENT
/end GROUP
/begin GROUP TrqOsc.SenderPorts "MICROSAR RTE"
 /begin SUB_GROUP TrqOsc.TrqOscActv.Cnt_lgc TrqOsc.TrqOscCmd.MtrNm_f32 TrqOsc.TrqOscDCExceeded.Cnt_lgc /end SUB_GROUP
 /begin FUNCTION_LIST /end FUNCTION_LIST
 /begin REF_CHARACTERISTIC /end REF_CHARACTERISTIC
 /begin REF_MEASUREMENT /end REF_MEASUREMENT
/end GROUP
/begin GROUP TrqOsc.TrqOscActv.Cnt_lgc "MICROSAR RTE" /begin SUB_GROUP /end SUB_GROUP /begin FUNCTION_LIST /end FUNCTION_LIST /begin REF_CHARACTERISTIC /end REF_CHARACTERISTIC /begin REF_MEASUREMENT TrqOsc.TrqOscActv.Cnt_lgc /end REF_MEASUREMENT /end GROUP
/begin GROUP TrqOsc.TrqOscAmp.MtrNm_f32 "MICROSAR RTE" /begin SUB_GROUP /end SUB_GROUP /begin FUNCTION_LIST /end FUNCTION_LIST /begin REF_CHARACTERISTIC /end REF_CHARACTERISTIC /begin REF_MEASUREMENT TrqOsc.TrqOscAmp.MtrNm_f32 /end REF_MEASUREMENT /end GROUP
/begin GROUP TrqOsc.TrqOscCmd.MtrNm_f32 "MICROSAR RTE" /begin SUB_GROUP /end SUB_GROUP /begin FUNCTION_LIST /end FUNCTION_LIST /begin REF_CHARACTERISTIC /end REF_CHARACTERISTIC /begin REF_MEASUREMENT TrqOsc.TrqOscCmd.MtrNm_f32 /end REF_MEASUREMENT /end GROUP
/begin GROUP TrqOsc.TrqOscDCExceeded.Cnt_lgc "MICROSAR RTE" /begin SUB_GROUP /end SUB_GROUP /begin FUNCTION_LIST /end FUNCTION_LIST /begin REF_CHARACTERISTIC /end REF_CHARACTERISTIC /begin REF_MEASUREMENT TrqOsc.TrqOscDCExceeded.Cnt_lgc /end REF_MEASUREMENT /end GROUP
/begin GROUP TrqOsc.TrqOscEnable.Cnt_lgc "MICROSAR RTE" /begin SUB_GROUP /end SUB_GROUP /begin FUNCTION_LIST /end FUNCTION_LIST /begin REF_CHARACTERISTIC /end REF_CHARACTERISTIC /begin REF_MEASUREMENT TrqOsc.TrqOscEnable.Cnt_lgc /end REF_MEASUREMENT /end GROUP
/begin GROUP TrqOsc.TrqOscFallRampRate.MtrNmpS_f32 "MICROSAR RTE" /begin SUB_GROUP /end SUB_GROUP /begin FUNCTION_LIST /end FUNCTION_LIST /begin REF_CHARACTERISTIC /end REF_CHARACTERISTIC /begin REF_MEASUREMENT TrqOsc.TrqOscFallRampRate.MtrNmpS_f32 /end REF_MEASUREMENT /end GROUP
/begin GROUP TrqOsc.TrqOscFreq.Hz_f32 "MICROSAR RTE" /begin SUB_GROUP /end SUB_GROUP /begin FUNCTION_LIST /end FUNCTION_LIST /begin REF_CHARACTERISTIC /end REF_CHARACTERISTIC /begin REF_MEASUREMENT TrqOsc.TrqOscFreq.Hz_f32 /end REF_MEASUREMENT /end GROUP
/begin GROUP TrqOsc.TrqOscRisngRampRate.MtrNmpS_f32 "MICROSAR RTE" /begin SUB_GROUP /end SUB_GROUP /begin FUNCTION_LIST /end FUNCTION_LIST /begin REF_CHARACTERISTIC /end REF_CHARACTERISTIC /begin REF_MEASUREMENT TrqOsc.TrqOscRisngRampRate.MtrNmpS_f32 /end REF_MEASUREMENT /end GROUP
/begin GROUP TuningSelAuth "MICROSAR RTE" /begin SUB_GROUP TuningSelAuth.ReceiverPorts TuningSelAuth.SenderPorts /end SUB_GROUP /begin FUNCTION_LIST /end FUNCTION_LIST /begin REF_CHARACTERISTIC /end REF_CHARACTERISTIC /begin REF_MEASUREMENT /end REF_MEASUREMENT /end GROUP
/begin GROUP TuningSelAuth.ActiveTunOvrPtrAddr.Cnt_u32 "MICROSAR RTE" /begin SUB_GROUP /end SUB_GROUP /begin FUNCTION_LIST /end FUNCTION_LIST /begin REF_CHARACTERISTIC /end REF_CHARACTERISTIC /begin REF_MEASUREMENT TuningSelAuth.ActiveTunOvrPtrAddr.Cnt_u32 /end REF_MEASUREMENT /end GROUP
/begin GROUP TuningSelAuth.ActiveTunPers.Cnt_u16 "MICROSAR RTE" /begin SUB_GROUP /end SUB_GROUP /begin FUNCTION_LIST /end FUNCTION_LIST /begin REF_CHARACTERISTIC /end REF_CHARACTERISTIC /begin REF_MEASUREMENT TuningSelAuth.ActiveTunPers.Cnt_u16 /end REF_MEASUREMENT /end GROUP
/begin GROUP TuningSelAuth.ActiveTunSet.Cnt_u16 "MICROSAR RTE" /begin SUB_GROUP /end SUB_GROUP /begin FUNCTION_LIST /end FUNCTION_LIST /begin REF_CHARACTERISTIC /end REF_CHARACTERISTIC /begin REF_MEASUREMENT TuningSelAuth.ActiveTunSet.Cnt_u16 /end REF_MEASUREMENT /end GROUP
/begin GROUP TuningSelAuth.DesiredTunPers.Cnt_u16 "MICROSAR RTE" /begin SUB_GROUP /end SUB_GROUP /begin FUNCTION_LIST /end FUNCTION_LIST /begin REF_CHARACTERISTIC /end REF_CHARACTERISTIC /begin REF_MEASUREMENT TuningSelAuth.DesiredTunPers.Cnt_u16 /end REF_MEASUREMENT /end GROUP
/begin GROUP TuningSelAuth.DesiredTunSet.Cnt_u16 "MICROSAR RTE" /begin SUB_GROUP /end SUB_GROUP /begin FUNCTION_LIST /end FUNCTION_LIST /begin REF_CHARACTERISTIC /end REF_CHARACTERISTIC /begin REF_MEASUREMENT TuningSelAuth.DesiredTunSet.Cnt_u16 /end REF_MEASUREMENT /end GROUP
/begin GROUP TuningSelAuth.HwTorque.HwNm_f32 "MICROSAR RTE" /begin SUB_GROUP /end SUB_GROUP /begin FUNCTION_LIST /end FUNCTION_LIST /begin REF_CHARACTERISTIC /end REF_CHARACTERISTIC /begin REF_MEASUREMENT TuningSelAuth.HwTorque.HwNm_f32 /end REF_MEASUREMENT /end GROUP
/begin GROUP TuningSelAuth.ReceiverPorts "MICROSAR RTE"
 /begin SUB_GROUP TuningSelAuth.ActiveTunOvrPtrAddr.Cnt_u32 TuningSelAuth.DesiredTunPers.Cnt_u16 TuningSelAuth.DesiredTunSet.Cnt_u16 TuningSelAuth.HwTorque.HwNm_f32 TuningSelAuth.TuningSessionActPtr.Cnt_u8 TuningSelAuth.VehicleSpeed.Kph_f32 /end SUB_GROUP
 /begin FUNCTION_LIST /end FUNCTION_LIST
 /begin REF_CHARACTERISTIC /end REF_CHARACTERISTIC
 /begin REF_MEASUREMENT /end REF_MEASUREMENT
/end GROUP
/begin GROUP TuningSelAuth.SenderPorts "MICROSAR RTE"
 /begin SUB_GROUP TuningSelAuth.ActiveTunPers.Cnt_u16 TuningSelAuth.ActiveTunSet.Cnt_u16 /end SUB_GROUP
 /begin FUNCTION_LIST /end FUNCTION_LIST
 /begin REF_CHARACTERISTIC /end REF_CHARACTERISTIC
 /begin REF_MEASUREMENT /end REF_MEASUREMENT
/end GROUP
/begin GROUP TuningSelAuth.TuningSessionActPtr.Cnt_u8 "MICROSAR RTE" /begin SUB_GROUP /end SUB_GROUP /begin FUNCTION_LIST /end FUNCTION_LIST /begin REF_CHARACTERISTIC /end REF_CHARACTERISTIC /begin REF_MEASUREMENT TuningSelAuth.TuningSessionActPtr.Cnt_u8 /end REF_MEASUREMENT /end GROUP
/begin GROUP TuningSelAuth.VehicleSpeed.Kph_f32 "MICROSAR RTE" /begin SUB_GROUP /end SUB_GROUP /begin FUNCTION_LIST /end FUNCTION_LIST /begin REF_CHARACTERISTIC /end REF_CHARACTERISTIC /begin REF_MEASUREMENT TuningSelAuth.VehicleSpeed.Kph_f32 /end REF_MEASUREMENT /end GROUP
/begin GROUP TurnsCounter "MICROSAR RTE"
 /begin SUB_GROUP TurnsCounter.PerInstanceMemories TurnsCounter.ReceiverPorts TurnsCounter.SenderPorts /end SUB_GROUP
 /begin FUNCTION_LIST /end FUNCTION_LIST
 /begin REF_CHARACTERISTIC /end REF_CHARACTERISTIC
 /begin REF_MEASUREMENT /end REF_MEASUREMENT
/end GROUP
/begin GROUP TurnsCounter.AlignedCumMtrPosMRF.Deg_f32 "MICROSAR RTE" /begin SUB_GROUP /end SUB_GROUP /begin FUNCTION_LIST /end FUNCTION_LIST /begin REF_CHARACTERISTIC /end REF_CHARACTERISTIC /begin REF_MEASUREMENT TurnsCounter.AlignedCumMtrPosMRF.Deg_f32 /end REF_MEASUREMENT /end GROUP
/begin GROUP TurnsCounter.EOLTurnsCntrCals "MICROSAR RTE" /begin SUB_GROUP /end SUB_GROUP /begin FUNCTION_LIST /end FUNCTION_LIST /begin REF_CHARACTERISTIC /end REF_CHARACTERISTIC
 /begin REF_MEASUREMENT TurnsCounter.EOLTurnsCntrCals.TcEolCalChksm_Cnt_u08 TurnsCounter.EOLTurnsCntrCals.TcEolCosineOffset_Cnt_u08 TurnsCounter.EOLTurnsCntrCals.TcEolSin2CosGain_Cnt_u08 TurnsCounter.EOLTurnsCntrCals.TcEolSinVsCosMax_Cnt_u08 TurnsCounter.EOLTurnsCntrCals.TcEolSinVsCosMin_Cnt_u08 TurnsCounter.EOLTurnsCntrCals.TcEolSineOffset_Cnt_u08 /end REF_MEASUREMENT
/end GROUP
/begin GROUP TurnsCounter.EnergyModeState.Cnt_enum "MICROSAR RTE" /begin SUB_GROUP /end SUB_GROUP /begin FUNCTION_LIST /end FUNCTION_LIST /begin REF_CHARACTERISTIC /end REF_CHARACTERISTIC /begin REF_MEASUREMENT TurnsCounter.EnergyModeState.Cnt_enum /end REF_MEASUREMENT /end GROUP
/begin GROUP TurnsCounter.HwTargetAuthority.Uls_f32 "MICROSAR RTE" /begin SUB_GROUP /end SUB_GROUP /begin FUNCTION_LIST /end FUNCTION_LIST /begin REF_CHARACTERISTIC /end REF_CHARACTERISTIC /begin REF_MEASUREMENT TurnsCounter.HwTargetAuthority.Uls_f32 /end REF_MEASUREMENT /end GROUP
/begin GROUP TurnsCounter.ICMMtrPosMRF.Deg_f32 "MICROSAR RTE" /begin SUB_GROUP /end SUB_GROUP /begin FUNCTION_LIST /end FUNCTION_LIST /begin REF_CHARACTERISTIC /end REF_CHARACTERISTIC /begin REF_MEASUREMENT TurnsCounter.ICMMtrPosMRF.Deg_f32 /end REF_MEASUREMENT /end GROUP
/begin GROUP TurnsCounter.LTRackCntrComplete.Cnt_lgc "MICROSAR RTE" /begin SUB_GROUP /end SUB_GROUP /begin FUNCTION_LIST /end FUNCTION_LIST /begin REF_CHARACTERISTIC /end REF_CHARACTERISTIC /begin REF_MEASUREMENT TurnsCounter.LTRackCntrComplete.Cnt_lgc /end REF_MEASUREMENT /end GROUP
/begin GROUP TurnsCounter.LTVehCenterComplete.Cnt_lgc "MICROSAR RTE" /begin SUB_GROUP /end SUB_GROUP /begin FUNCTION_LIST /end FUNCTION_LIST /begin REF_CHARACTERISTIC /end REF_CHARACTERISTIC /begin REF_MEASUREMENT TurnsCounter.LTVehCenterComplete.Cnt_lgc /end REF_MEASUREMENT /end GROUP
/begin GROUP TurnsCounter.MotorVelMRF.MtrRadpS_f32 "MICROSAR RTE" /begin SUB_GROUP /end SUB_GROUP /begin FUNCTION_LIST /end FUNCTION_LIST /begin REF_CHARACTERISTIC /end REF_CHARACTERISTIC /begin REF_MEASUREMENT TurnsCounter.MotorVelMRF.MtrRadpS_f32 /end REF_MEASUREMENT /end GROUP
/begin GROUP TurnsCounter.PerInstanceMemories "MICROSAR RTE" /begin SUB_GROUP TurnsCounter.EOLTurnsCntrCals /end SUB_GROUP /begin FUNCTION_LIST /end FUNCTION_LIST /begin REF_CHARACTERISTIC /end REF_CHARACTERISTIC /begin REF_MEASUREMENT /end REF_MEASUREMENT /end GROUP
/begin GROUP TurnsCounter.RackCenterComplete.Cnt_lgc "MICROSAR RTE" /begin SUB_GROUP /end SUB_GROUP /begin FUNCTION_LIST /end FUNCTION_LIST /begin REF_CHARACTERISTIC /end REF_CHARACTERISTIC /begin REF_MEASUREMENT TurnsCounter.RackCenterComplete.Cnt_lgc /end REF_MEASUREMENT /end GROUP
/begin GROUP TurnsCounter.ReceiverPorts "MICROSAR RTE"
 /begin SUB_GROUP TurnsCounter.AlignedCumMtrPosMRF.Deg_f32 TurnsCounter.EnergyModeState.Cnt_enum TurnsCounter.HwTargetAuthority.Uls_f32 TurnsCounter.ICMMtrPosMRF.Deg_f32 TurnsCounter.LTRackCntrComplete.Cnt_lgc TurnsCounter.LTVehCenterComplete.Cnt_lgc TurnsCounter.MotorVelMRF.MtrRadpS_f32 TurnsCounter.RackCenterComplete.Cnt_lgc TurnsCounter.TCFlash.Cnt_lgc TurnsCounter.TcFlashErrors.Cnt_u08 TurnsCounter.TcFlashVerify.Cnt_lgc /end SUB_GROUP
 /begin FUNCTION_LIST /end FUNCTION_LIST
 /begin REF_CHARACTERISTIC /end REF_CHARACTERISTIC
 /begin REF_MEASUREMENT /end REF_MEASUREMENT
/end GROUP
/begin GROUP TurnsCounter.SenderPorts "MICROSAR RTE"
 /begin SUB_GROUP TurnsCounter.TCMtrPosOffsMRF.Deg_f32 TurnsCounter.TcActivePN.Cnt_u32 TurnsCounter.TcActivePNVldCnt.Cnt_u32 TurnsCounter.TurnsCntrValidity.Cnt_enum /end SUB_GROUP
 /begin FUNCTION_LIST /end FUNCTION_LIST
 /begin REF_CHARACTERISTIC /end REF_CHARACTERISTIC
 /begin REF_MEASUREMENT /end REF_MEASUREMENT
/end GROUP
/begin GROUP TurnsCounter.TCFlash.Cnt_lgc "MICROSAR RTE" /begin SUB_GROUP /end SUB_GROUP /begin FUNCTION_LIST /end FUNCTION_LIST /begin REF_CHARACTERISTIC /end REF_CHARACTERISTIC /begin REF_MEASUREMENT TurnsCounter.TCFlash.Cnt_lgc /end REF_MEASUREMENT /end GROUP
/begin GROUP TurnsCounter.TCMtrPosOffsMRF.Deg_f32 "MICROSAR RTE" /begin SUB_GROUP /end SUB_GROUP /begin FUNCTION_LIST /end FUNCTION_LIST /begin REF_CHARACTERISTIC /end REF_CHARACTERISTIC /begin REF_MEASUREMENT TurnsCounter.TCMtrPosOffsMRF.Deg_f32 /end REF_MEASUREMENT /end GROUP
/begin GROUP TurnsCounter.TcActivePN.Cnt_u32 "MICROSAR RTE" /begin SUB_GROUP /end SUB_GROUP /begin FUNCTION_LIST /end FUNCTION_LIST /begin REF_CHARACTERISTIC /end REF_CHARACTERISTIC /begin REF_MEASUREMENT TurnsCounter.TcActivePN.Cnt_u32 /end REF_MEASUREMENT /end GROUP
/begin GROUP TurnsCounter.TcActivePNVldCnt.Cnt_u32 "MICROSAR RTE" /begin SUB_GROUP /end SUB_GROUP /begin FUNCTION_LIST /end FUNCTION_LIST /begin REF_CHARACTERISTIC /end REF_CHARACTERISTIC /begin REF_MEASUREMENT TurnsCounter.TcActivePNVldCnt.Cnt_u32 /end REF_MEASUREMENT /end GROUP
/begin GROUP TurnsCounter.TcFlashErrors.Cnt_u08 "MICROSAR RTE" /begin SUB_GROUP /end SUB_GROUP /begin FUNCTION_LIST /end FUNCTION_LIST /begin REF_CHARACTERISTIC /end REF_CHARACTERISTIC /begin REF_MEASUREMENT TurnsCounter.TcFlashErrors.Cnt_u08 /end REF_MEASUREMENT /end GROUP
/begin GROUP TurnsCounter.TcFlashVerify.Cnt_lgc "MICROSAR RTE" /begin SUB_GROUP /end SUB_GROUP /begin FUNCTION_LIST /end FUNCTION_LIST /begin REF_CHARACTERISTIC /end REF_CHARACTERISTIC /begin REF_MEASUREMENT TurnsCounter.TcFlashVerify.Cnt_lgc /end REF_MEASUREMENT /end GROUP
/begin GROUP TurnsCounter.TurnsCntrValidity.Cnt_enum "MICROSAR RTE" /begin SUB_GROUP /end SUB_GROUP /begin FUNCTION_LIST /end FUNCTION_LIST /begin REF_CHARACTERISTIC /end REF_CHARACTERISTIC /begin REF_MEASUREMENT TurnsCounter.TurnsCntrValidity.Cnt_enum /end REF_MEASUREMENT /end GROUP
/begin GROUP VehCfg "MICROSAR RTE"
 /begin SUB_GROUP VehCfg.PerInstanceMemories VehCfg.ReceiverPorts VehCfg.SenderPorts /end SUB_GROUP
 /begin FUNCTION_LIST /end FUNCTION_LIST
 /begin REF_CHARACTERISTIC /end REF_CHARACTERISTIC
 /begin REF_MEASUREMENT /end REF_MEASUREMENT
/end GROUP
/begin GROUP VehCfg.CADASIF.Cnt_lgc "MICROSAR RTE" /begin SUB_GROUP /end SUB_GROUP /begin FUNCTION_LIST /end FUNCTION_LIST /begin REF_CHARACTERISTIC /end REF_CHARACTERISTIC /begin REF_MEASUREMENT VehCfg.CADASIF.Cnt_lgc /end REF_MEASUREMENT /end GROUP
/begin GROUP VehCfg.CASSISTMSA.Cnt_lgc "MICROSAR RTE" /begin SUB_GROUP /end SUB_GROUP /begin FUNCTION_LIST /end FUNCTION_LIST /begin REF_CHARACTERISTIC /end REF_CHARACTERISTIC /begin REF_MEASUREMENT VehCfg.CASSISTMSA.Cnt_lgc /end REF_MEASUREMENT /end GROUP
/begin GROUP VehCfg.CBATCURLIMITCURRENT.Amp_f32 "MICROSAR RTE" /begin SUB_GROUP /end SUB_GROUP /begin FUNCTION_LIST /end FUNCTION_LIST /begin REF_CHARACTERISTIC /end REF_CHARACTERISTIC /begin REF_MEASUREMENT VehCfg.CBATCURLIMITCURRENT.Amp_f32 /end REF_MEASUREMENT /end GROUP
/begin GROUP VehCfg.CDISPCCDRDY02.Cnt_u08 "MICROSAR RTE" /begin SUB_GROUP /end SUB_GROUP /begin FUNCTION_LIST /end FUNCTION_LIST /begin REF_CHARACTERISTIC /end REF_CHARACTERISTIC /begin REF_MEASUREMENT VehCfg.CDISPCCDRDY02.Cnt_u08 /end REF_MEASUREMENT /end GROUP
/begin GROUP VehCfg.CDRVDYNMSG.Cnt_lgc "MICROSAR RTE" /begin SUB_GROUP /end SUB_GROUP /begin FUNCTION_LIST /end FUNCTION_LIST /begin REF_CHARACTERISTIC /end REF_CHARACTERISTIC /begin REF_MEASUREMENT VehCfg.CDRVDYNMSG.Cnt_lgc /end REF_MEASUREMENT /end GROUP
/begin GROUP VehCfg.CEFANMSG.Cnt_lgc "MICROSAR RTE" /begin SUB_GROUP /end SUB_GROUP /begin FUNCTION_LIST /end FUNCTION_LIST /begin REF_CHARACTERISTIC /end REF_CHARACTERISTIC /begin REF_MEASUREMENT VehCfg.CEFANMSG.Cnt_lgc /end REF_MEASUREMENT /end GROUP
/begin GROUP VehCfg.CEPSPWRMAX.Cnt_lgc "MICROSAR RTE" /begin SUB_GROUP /end SUB_GROUP /begin FUNCTION_LIST /end FUNCTION_LIST /begin REF_CHARACTERISTIC /end REF_CHARACTERISTIC /begin REF_MEASUREMENT VehCfg.CEPSPWRMAX.Cnt_lgc /end REF_MEASUREMENT /end GROUP
/begin GROUP VehCfg.CERRMVOLTFALLBACK.Cnt_lgc "MICROSAR RTE" /begin SUB_GROUP /end SUB_GROUP /begin FUNCTION_LIST /end FUNCTION_LIST /begin REF_CHARACTERISTIC /end REF_CHARACTERISTIC /begin REF_MEASUREMENT VehCfg.CERRMVOLTFALLBACK.Cnt_lgc /end REF_MEASUREMENT /end GROUP
/begin GROUP VehCfg.CEVIIF.Cnt_lgc "MICROSAR RTE" /begin SUB_GROUP /end SUB_GROUP /begin FUNCTION_LIST /end FUNCTION_LIST /begin REF_CHARACTERISTIC /end REF_CHARACTERISTIC /begin REF_MEASUREMENT VehCfg.CEVIIF.Cnt_lgc /end REF_MEASUREMENT /end GROUP
/begin GROUP VehCfg.CFACTORIF.Cnt_lgc "MICROSAR RTE" /begin SUB_GROUP /end SUB_GROUP /begin FUNCTION_LIST /end FUNCTION_LIST /begin REF_CHARACTERISTIC /end REF_CHARACTERISTIC /begin REF_MEASUREMENT VehCfg.CFACTORIF.Cnt_lgc /end REF_MEASUREMENT /end GROUP
/begin GROUP VehCfg.CFRCOMPIF.Cnt_lgc "MICROSAR RTE" /begin SUB_GROUP /end SUB_GROUP /begin FUNCTION_LIST /end FUNCTION_LIST /begin REF_CHARACTERISTIC /end REF_CHARACTERISTIC /begin REF_MEASUREMENT VehCfg.CFRCOMPIF.Cnt_lgc /end REF_MEASUREMENT /end GROUP
/begin GROUP VehCfg.CHWACORRECTION.Cnt_lgc "MICROSAR RTE" /begin SUB_GROUP /end SUB_GROUP /begin FUNCTION_LIST /end FUNCTION_LIST /begin REF_CHARACTERISTIC /end REF_CHARACTERISTIC /begin REF_MEASUREMENT VehCfg.CHWACORRECTION.Cnt_lgc /end REF_MEASUREMENT /end GROUP
/begin GROUP VehCfg.CHWANGLEIF.Cnt_lgc "MICROSAR RTE" /begin SUB_GROUP /end SUB_GROUP /begin FUNCTION_LIST /end FUNCTION_LIST /begin REF_CHARACTERISTIC /end REF_CHARACTERISTIC /begin REF_MEASUREMENT VehCfg.CHWANGLEIF.Cnt_lgc /end REF_MEASUREMENT /end GROUP
/begin GROUP VehCfg.CHWTORQUEIF.Cnt_lgc "MICROSAR RTE" /begin SUB_GROUP /end SUB_GROUP /begin FUNCTION_LIST /end FUNCTION_LIST /begin REF_CHARACTERISTIC /end REF_CHARACTERISTIC /begin REF_MEASUREMENT VehCfg.CHWTORQUEIF.Cnt_lgc /end REF_MEASUREMENT /end GROUP
/begin GROUP VehCfg.CMTTORQUEIF.Cnt_lgc "MICROSAR RTE" /begin SUB_GROUP /end SUB_GROUP /begin FUNCTION_LIST /end FUNCTION_LIST /begin REF_CHARACTERISTIC /end REF_CHARACTERISTIC /begin REF_MEASUREMENT VehCfg.CMTTORQUEIF.Cnt_lgc /end REF_MEASUREMENT /end GROUP
/begin GROUP VehCfg.CPLCOMPIF.Cnt_lgc "MICROSAR RTE" /begin SUB_GROUP /end SUB_GROUP /begin FUNCTION_LIST /end FUNCTION_LIST /begin REF_CHARACTERISTIC /end REF_CHARACTERISTIC /begin REF_MEASUREMENT VehCfg.CPLCOMPIF.Cnt_lgc /end REF_MEASUREMENT /end GROUP
/begin GROUP VehCfg.CSELRETURN.Cnt_lgc "MICROSAR RTE" /begin SUB_GROUP /end SUB_GROUP /begin FUNCTION_LIST /end FUNCTION_LIST /begin REF_CHARACTERISTIC /end REF_CHARACTERISTIC /begin REF_MEASUREMENT VehCfg.CSELRETURN.Cnt_lgc /end REF_MEASUREMENT /end GROUP
/begin GROUP VehCfg.CSELTUNINGBASE.Cnt_u08 "MICROSAR RTE" /begin SUB_GROUP /end SUB_GROUP /begin FUNCTION_LIST /end FUNCTION_LIST /begin REF_CHARACTERISTIC /end REF_CHARACTERISTIC /begin REF_MEASUREMENT VehCfg.CSELTUNINGBASE.Cnt_u08 /end REF_MEASUREMENT /end GROUP
/begin GROUP VehCfg.CSELTUNINGSPORT.Cnt_u08 "MICROSAR RTE" /begin SUB_GROUP /end SUB_GROUP /begin FUNCTION_LIST /end FUNCTION_LIST /begin REF_CHARACTERISTIC /end REF_CHARACTERISTIC /begin REF_MEASUREMENT VehCfg.CSELTUNINGSPORT.Cnt_u08 /end REF_MEASUREMENT /end GROUP
/begin GROUP VehCfg.CSELTUNINGSVT.Cnt_u08 "MICROSAR RTE" /begin SUB_GROUP /end SUB_GROUP /begin FUNCTION_LIST /end FUNCTION_LIST /begin REF_CHARACTERISTIC /end REF_CHARACTERISTIC /begin REF_MEASUREMENT VehCfg.CSELTUNINGSVT.Cnt_u08 /end REF_MEASUREMENT /end GROUP
/begin GROUP VehCfg.CVEHSPDCURLIMITCURRENT.Amp_f32 "MICROSAR RTE" /begin SUB_GROUP /end SUB_GROUP /begin FUNCTION_LIST /end FUNCTION_LIST /begin REF_CHARACTERISTIC /end REF_CHARACTERISTIC /begin REF_MEASUREMENT VehCfg.CVEHSPDCURLIMITCURRENT.Amp_f32 /end REF_MEASUREMENT /end GROUP
/begin GROUP VehCfg.CVEHSPDCURLIMITER.Cnt_lgc "MICROSAR RTE" /begin SUB_GROUP /end SUB_GROUP /begin FUNCTION_LIST /end FUNCTION_LIST /begin REF_CHARACTERISTIC /end REF_CHARACTERISTIC /begin REF_MEASUREMENT VehCfg.CVEHSPDCURLIMITER.Cnt_lgc /end REF_MEASUREMENT /end GROUP
/begin GROUP VehCfg.CVEHSPDCURLIMITSPEED.Kph_f32 "MICROSAR RTE" /begin SUB_GROUP /end SUB_GROUP /begin FUNCTION_LIST /end FUNCTION_LIST /begin REF_CHARACTERISTIC /end REF_CHARACTERISTIC /begin REF_MEASUREMENT VehCfg.CVEHSPDCURLIMITSPEED.Kph_f32 /end REF_MEASUREMENT /end GROUP
/begin GROUP VehCfg.DesiredTunPers.Cnt_u16 "MICROSAR RTE" /begin SUB_GROUP /end SUB_GROUP /begin FUNCTION_LIST /end FUNCTION_LIST /begin REF_CHARACTERISTIC /end REF_CHARACTERISTIC /begin REF_MEASUREMENT VehCfg.DesiredTunPers.Cnt_u16 /end REF_MEASUREMENT /end GROUP
/begin GROUP VehCfg.DesiredTunSet.Cnt_u16 "MICROSAR RTE" /begin SUB_GROUP /end SUB_GROUP /begin FUNCTION_LIST /end FUNCTION_LIST /begin REF_CHARACTERISTIC /end REF_CHARACTERISTIC /begin REF_MEASUREMENT VehCfg.DesiredTunSet.Cnt_u16 /end REF_MEASUREMENT /end GROUP
/begin GROUP VehCfg.EnergyModeState.Cnt_enum "MICROSAR RTE" /begin SUB_GROUP /end SUB_GROUP /begin FUNCTION_LIST /end FUNCTION_LIST /begin REF_CHARACTERISTIC /end REF_CHARACTERISTIC /begin REF_MEASUREMENT VehCfg.EnergyModeState.Cnt_enum /end REF_MEASUREMENT /end GROUP
/begin GROUP VehCfg.NxtrMEC.Cnt_enum "MICROSAR RTE" /begin SUB_GROUP /end SUB_GROUP /begin FUNCTION_LIST /end FUNCTION_LIST /begin REF_CHARACTERISTIC /end REF_CHARACTERISTIC /begin REF_MEASUREMENT VehCfg.NxtrMEC.Cnt_enum /end REF_MEASUREMENT /end GROUP
/begin GROUP VehCfg.PerInstanceMemories "MICROSAR RTE" /begin SUB_GROUP VehCfg.PrevVldTuningSel /end SUB_GROUP /begin FUNCTION_LIST /end FUNCTION_LIST /begin REF_CHARACTERISTIC /end REF_CHARACTERISTIC /begin REF_MEASUREMENT /end REF_MEASUREMENT /end GROUP
/begin GROUP VehCfg.PrevVldTuningSel "MICROSAR RTE" /begin SUB_GROUP /end SUB_GROUP /begin FUNCTION_LIST /end FUNCTION_LIST /begin REF_CHARACTERISTIC /end REF_CHARACTERISTIC
 /begin REF_MEASUREMENT VehCfg.PrevVldTuningSel.TuningPers VehCfg.PrevVldTuningSel.TuningSet /end REF_MEASUREMENT
/end GROUP
/begin GROUP VehCfg.PrkAssistState.Cnt_u08 "MICROSAR RTE" /begin SUB_GROUP /end SUB_GROUP /begin FUNCTION_LIST /end FUNCTION_LIST /begin REF_CHARACTERISTIC /end REF_CHARACTERISTIC /begin REF_MEASUREMENT VehCfg.PrkAssistState.Cnt_u08 /end REF_MEASUREMENT /end GROUP
/begin GROUP VehCfg.ReceiverPorts "MICROSAR RTE"
 /begin SUB_GROUP VehCfg.NxtrMEC.Cnt_enum VehCfg.PrkAssistState.Cnt_u08 VehCfg.VINValid.Cnt_lgc /end SUB_GROUP
 /begin FUNCTION_LIST /end FUNCTION_LIST
 /begin REF_CHARACTERISTIC /end REF_CHARACTERISTIC
 /begin REF_MEASUREMENT /end REF_MEASUREMENT
/end GROUP
/begin GROUP VehCfg.SenderPorts "MICROSAR RTE"
 /begin SUB_GROUP VehCfg.CADASIF.Cnt_lgc VehCfg.CASSISTMSA.Cnt_lgc VehCfg.CBATCURLIMITCURRENT.Amp_f32 VehCfg.CDISPCCDRDY02.Cnt_u08 VehCfg.CDRVDYNMSG.Cnt_lgc VehCfg.CEFANMSG.Cnt_lgc VehCfg.CEPSPWRMAX.Cnt_lgc VehCfg.CERRMVOLTFALLBACK.Cnt_lgc VehCfg.CEVIIF.Cnt_lgc VehCfg.CFACTORIF.Cnt_lgc VehCfg.CFRCOMPIF.Cnt_lgc VehCfg.CHWACORRECTION.Cnt_lgc VehCfg.CHWANGLEIF.Cnt_lgc VehCfg.CHWTORQUEIF.Cnt_lgc VehCfg.CMTTORQUEIF.Cnt_lgc VehCfg.CPLCOMPIF.Cnt_lgc VehCfg.CSELRETURN.Cnt_lgc VehCfg.CSELTUNINGBASE.Cnt_u08 VehCfg.CSELTUNINGSPORT.Cnt_u08 VehCfg.CSELTUNINGSVT.Cnt_u08 VehCfg.CVEHSPDCURLIMITCURRENT.Amp_f32 VehCfg.CVEHSPDCURLIMITER.Cnt_lgc VehCfg.CVEHSPDCURLIMITSPEED.Kph_f32 VehCfg.DesiredTunPers.Cnt_u16 VehCfg.DesiredTunSet.Cnt_u16 VehCfg.EnergyModeState.Cnt_enum VehCfg.TxDebugMsgEn.Cnt_lgc /end SUB_GROUP
 /begin FUNCTION_LIST /end FUNCTION_LIST
 /begin REF_CHARACTERISTIC /end REF_CHARACTERISTIC
 /begin REF_MEASUREMENT /end REF_MEASUREMENT
/end GROUP
/begin GROUP VehCfg.TxDebugMsgEn.Cnt_lgc "MICROSAR RTE" /begin SUB_GROUP /end SUB_GROUP /begin FUNCTION_LIST /end FUNCTION_LIST /begin REF_CHARACTERISTIC /end REF_CHARACTERISTIC /begin REF_MEASUREMENT VehCfg.TxDebugMsgEn.Cnt_lgc /end REF_MEASUREMENT /end GROUP
/begin GROUP VehCfg.VINValid.Cnt_lgc "MICROSAR RTE" /begin SUB_GROUP /end SUB_GROUP /begin FUNCTION_LIST /end FUNCTION_LIST /begin REF_CHARACTERISTIC /end REF_CHARACTERISTIC /begin REF_MEASUREMENT VehCfg.VINValid.Cnt_lgc /end REF_MEASUREMENT /end GROUP
/begin GROUP VehPwrMd "MICROSAR RTE"
 /begin SUB_GROUP VehPwrMd.ModeRequirePorts VehPwrMd.ReceiverPorts VehPwrMd.SenderPorts /end SUB_GROUP
 /begin FUNCTION_LIST /end FUNCTION_LIST
 /begin REF_CHARACTERISTIC /end REF_CHARACTERISTIC
 /begin REF_MEASUREMENT /end REF_MEASUREMENT
/end GROUP
/begin GROUP VehPwrMd.ATermActive.Cnt_lgc "MICROSAR RTE" /begin SUB_GROUP /end SUB_GROUP /begin FUNCTION_LIST /end FUNCTION_LIST /begin REF_CHARACTERISTIC /end REF_CHARACTERISTIC /begin REF_MEASUREMENT VehPwrMd.ATermActive.Cnt_lgc /end REF_MEASUREMENT /end GROUP
/begin GROUP VehPwrMd.CASSISTMSA.Cnt_lgc "MICROSAR RTE" /begin SUB_GROUP /end SUB_GROUP /begin FUNCTION_LIST /end FUNCTION_LIST /begin REF_CHARACTERISTIC /end REF_CHARACTERISTIC /begin REF_MEASUREMENT VehPwrMd.CASSISTMSA.Cnt_lgc /end REF_MEASUREMENT /end GROUP
/begin GROUP VehPwrMd.CTermActive.Cnt_lgc "MICROSAR RTE" /begin SUB_GROUP /end SUB_GROUP /begin FUNCTION_LIST /end FUNCTION_LIST /begin REF_CHARACTERISTIC /end REF_CHARACTERISTIC /begin REF_MEASUREMENT VehPwrMd.CTermActive.Cnt_lgc /end REF_MEASUREMENT /end GROUP
/begin GROUP VehPwrMd.EngONSrlComSvcDft.Cnt_lgc "MICROSAR RTE" /begin SUB_GROUP /end SUB_GROUP /begin FUNCTION_LIST /end FUNCTION_LIST /begin REF_CHARACTERISTIC /end REF_CHARACTERISTIC /begin REF_MEASUREMENT VehPwrMd.EngONSrlComSvcDft.Cnt_lgc /end REF_MEASUREMENT /end GROUP
/begin GROUP VehPwrMd.MSACommand.MSACmd_enum "MICROSAR RTE" /begin SUB_GROUP /end SUB_GROUP /begin FUNCTION_LIST /end FUNCTION_LIST /begin REF_CHARACTERISTIC /end REF_CHARACTERISTIC /begin REF_MEASUREMENT VehPwrMd.MSACommand.MSACmd_enum /end REF_MEASUREMENT /end GROUP
/begin GROUP VehPwrMd.ModeRequirePorts "MICROSAR RTE" /begin SUB_GROUP VehPwrMd.SystemState.Mode /end SUB_GROUP /begin FUNCTION_LIST /end FUNCTION_LIST /begin REF_CHARACTERISTIC /end REF_CHARACTERISTIC /begin REF_MEASUREMENT /end REF_MEASUREMENT /end GROUP
/begin GROUP VehPwrMd.OperRampRate.XpmS_f32 "MICROSAR RTE" /begin SUB_GROUP /end SUB_GROUP /begin FUNCTION_LIST /end FUNCTION_LIST /begin REF_CHARACTERISTIC /end REF_CHARACTERISTIC /begin REF_MEASUREMENT VehPwrMd.OperRampRate.XpmS_f32 /end REF_MEASUREMENT /end GROUP
/begin GROUP VehPwrMd.OperRampValue.Uls_f32 "MICROSAR RTE" /begin SUB_GROUP /end SUB_GROUP /begin FUNCTION_LIST /end FUNCTION_LIST /begin REF_CHARACTERISTIC /end REF_CHARACTERISTIC /begin REF_MEASUREMENT VehPwrMd.OperRampValue.Uls_f32 /end REF_MEASUREMENT /end GROUP
/begin GROUP VehPwrMd.ReceiverPorts "MICROSAR RTE"
 /begin SUB_GROUP VehPwrMd.CASSISTMSA.Cnt_lgc VehPwrMd.EngONSrlComSvcDft.Cnt_lgc VehPwrMd.SrlComVehNearStandstill.Cnt_u08 VehPwrMd.VehicleSpeed.Kph_f32 VehPwrMd.VehicleSpeedValid.Cnt_lgc /end SUB_GROUP
 /begin FUNCTION_LIST /end FUNCTION_LIST
 /begin REF_CHARACTERISTIC /end REF_CHARACTERISTIC
 /begin REF_MEASUREMENT /end REF_MEASUREMENT
/end GROUP
/begin GROUP VehPwrMd.SenderPorts "MICROSAR RTE"
 /begin SUB_GROUP VehPwrMd.ATermActive.Cnt_lgc VehPwrMd.CTermActive.Cnt_lgc VehPwrMd.MSACommand.MSACmd_enum VehPwrMd.OperRampRate.XpmS_f32 VehPwrMd.OperRampValue.Uls_f32 /end SUB_GROUP
 /begin FUNCTION_LIST /end FUNCTION_LIST
 /begin REF_CHARACTERISTIC /end REF_CHARACTERISTIC
 /begin REF_MEASUREMENT /end REF_MEASUREMENT
/end GROUP
/begin GROUP VehPwrMd.SrlComVehNearStandstill.Cnt_u08 "MICROSAR RTE" /begin SUB_GROUP /end SUB_GROUP /begin FUNCTION_LIST /end FUNCTION_LIST /begin REF_CHARACTERISTIC /end REF_CHARACTERISTIC /begin REF_MEASUREMENT VehPwrMd.SrlComVehNearStandstill.Cnt_u08 /end REF_MEASUREMENT /end GROUP
/begin GROUP VehPwrMd.SystemState.Mode "MICROSAR RTE" /begin SUB_GROUP /end SUB_GROUP /begin FUNCTION_LIST /end FUNCTION_LIST /begin REF_CHARACTERISTIC /end REF_CHARACTERISTIC /begin REF_MEASUREMENT VehPwrMd.SystemState.Mode /end REF_MEASUREMENT /end GROUP
/begin GROUP VehPwrMd.VehicleSpeed.Kph_f32 "MICROSAR RTE" /begin SUB_GROUP /end SUB_GROUP /begin FUNCTION_LIST /end FUNCTION_LIST /begin REF_CHARACTERISTIC /end REF_CHARACTERISTIC /begin REF_MEASUREMENT VehPwrMd.VehicleSpeed.Kph_f32 /end REF_MEASUREMENT /end GROUP
/begin GROUP VehPwrMd.VehicleSpeedValid.Cnt_lgc "MICROSAR RTE" /begin SUB_GROUP /end SUB_GROUP /begin FUNCTION_LIST /end FUNCTION_LIST /begin REF_CHARACTERISTIC /end REF_CHARACTERISTIC /begin REF_MEASUREMENT VehPwrMd.VehicleSpeedValid.Cnt_lgc /end REF_MEASUREMENT /end GROUP
/begin GROUP VehSpdLmt "MICROSAR RTE" /begin SUB_GROUP VehSpdLmt.ReceiverPorts VehSpdLmt.SenderPorts /end SUB_GROUP /begin FUNCTION_LIST /end FUNCTION_LIST /begin REF_CHARACTERISTIC /end REF_CHARACTERISTIC /begin REF_MEASUREMENT /end REF_MEASUREMENT /end GROUP
/begin GROUP VehSpdLmt.AstVehSpdLimit.MtrNm_f32 "MICROSAR RTE" /begin SUB_GROUP /end SUB_GROUP /begin FUNCTION_LIST /end FUNCTION_LIST /begin REF_CHARACTERISTIC /end REF_CHARACTERISTIC /begin REF_MEASUREMENT VehSpdLmt.AstVehSpdLimit.MtrNm_f32 /end REF_MEASUREMENT /end GROUP
/begin GROUP VehSpdLmt.CCWPosition.HwDeg_f32 "MICROSAR RTE" /begin SUB_GROUP /end SUB_GROUP /begin FUNCTION_LIST /end FUNCTION_LIST /begin REF_CHARACTERISTIC /end REF_CHARACTERISTIC /begin REF_MEASUREMENT VehSpdLmt.CCWPosition.HwDeg_f32 /end REF_MEASUREMENT /end GROUP
/begin GROUP VehSpdLmt.CWPosition.HwDeg_f32 "MICROSAR RTE" /begin SUB_GROUP /end SUB_GROUP /begin FUNCTION_LIST /end FUNCTION_LIST /begin REF_CHARACTERISTIC /end REF_CHARACTERISTIC /begin REF_MEASUREMENT VehSpdLmt.CWPosition.HwDeg_f32 /end REF_MEASUREMENT /end GROUP
/begin GROUP VehSpdLmt.HwPos.HwDeg_f32 "MICROSAR RTE" /begin SUB_GROUP /end SUB_GROUP /begin FUNCTION_LIST /end FUNCTION_LIST /begin REF_CHARACTERISTIC /end REF_CHARACTERISTIC /begin REF_MEASUREMENT VehSpdLmt.HwPos.HwDeg_f32 /end REF_MEASUREMENT /end GROUP
/begin GROUP VehSpdLmt.HwPosAuth.Uls_f32 "MICROSAR RTE" /begin SUB_GROUP /end SUB_GROUP /begin FUNCTION_LIST /end FUNCTION_LIST /begin REF_CHARACTERISTIC /end REF_CHARACTERISTIC /begin REF_MEASUREMENT VehSpdLmt.HwPosAuth.Uls_f32 /end REF_MEASUREMENT /end GROUP
/begin GROUP VehSpdLmt.ReceiverPorts "MICROSAR RTE"
 /begin SUB_GROUP VehSpdLmt.CCWPosition.HwDeg_f32 VehSpdLmt.CWPosition.HwDeg_f32 VehSpdLmt.HwPos.HwDeg_f32 VehSpdLmt.HwPosAuth.Uls_f32 VehSpdLmt.VehSpd.Kph_f32 /end SUB_GROUP
 /begin FUNCTION_LIST /end FUNCTION_LIST
 /begin REF_CHARACTERISTIC /end REF_CHARACTERISTIC
 /begin REF_MEASUREMENT /end REF_MEASUREMENT
/end GROUP
/begin GROUP VehSpdLmt.SenderPorts "MICROSAR RTE" /begin SUB_GROUP VehSpdLmt.AstVehSpdLimit.MtrNm_f32 /end SUB_GROUP /begin FUNCTION_LIST /end FUNCTION_LIST /begin REF_CHARACTERISTIC /end REF_CHARACTERISTIC /begin REF_MEASUREMENT /end REF_MEASUREMENT /end GROUP
/begin GROUP VehSpdLmt.VehSpd.Kph_f32 "MICROSAR RTE" /begin SUB_GROUP /end SUB_GROUP /begin FUNCTION_LIST /end FUNCTION_LIST /begin REF_CHARACTERISTIC /end REF_CHARACTERISTIC /begin REF_MEASUREMENT VehSpdLmt.VehSpd.Kph_f32 /end REF_MEASUREMENT /end GROUP
/begin GROUP VltgCtrl "MICROSAR RTE"
 /begin SUB_GROUP VltgCtrl.ModeRequirePorts VltgCtrl.ReceiverPorts VltgCtrl.SenderPorts /end SUB_GROUP
 /begin FUNCTION_LIST /end FUNCTION_LIST
 /begin REF_CHARACTERISTIC /end REF_CHARACTERISTIC
 /begin REF_MEASUREMENT /end REF_MEASUREMENT
/end GROUP
/begin GROUP VltgCtrl.CCLMSAActive.Cnt_lgc "MICROSAR RTE" /begin SUB_GROUP /end SUB_GROUP /begin FUNCTION_LIST /end FUNCTION_LIST /begin REF_CHARACTERISTIC /end REF_CHARACTERISTIC /begin REF_MEASUREMENT VltgCtrl.CCLMSAActive.Cnt_lgc /end REF_MEASUREMENT /end GROUP
/begin GROUP VltgCtrl.CuTempEst.DegC_f32 "MICROSAR RTE" /begin SUB_GROUP /end SUB_GROUP /begin FUNCTION_LIST /end FUNCTION_LIST /begin REF_CHARACTERISTIC /end REF_CHARACTERISTIC /begin REF_MEASUREMENT VltgCtrl.CuTempEst.DegC_f32 /end REF_MEASUREMENT /end GROUP
/begin GROUP VltgCtrl.EstKe.VpRadpS_f32 "MICROSAR RTE" /begin SUB_GROUP /end SUB_GROUP /begin FUNCTION_LIST /end FUNCTION_LIST /begin REF_CHARACTERISTIC /end REF_CHARACTERISTIC /begin REF_MEASUREMENT VltgCtrl.EstKe.VpRadpS_f32 /end REF_MEASUREMENT /end GROUP
/begin GROUP VltgCtrl.EstLd.Henry_f32 "MICROSAR RTE" /begin SUB_GROUP /end SUB_GROUP /begin FUNCTION_LIST /end FUNCTION_LIST /begin REF_CHARACTERISTIC /end REF_CHARACTERISTIC /begin REF_MEASUREMENT VltgCtrl.EstLd.Henry_f32 /end REF_MEASUREMENT /end GROUP
/begin GROUP VltgCtrl.EstLq.Henry_f32 "MICROSAR RTE" /begin SUB_GROUP /end SUB_GROUP /begin FUNCTION_LIST /end FUNCTION_LIST /begin REF_CHARACTERISTIC /end REF_CHARACTERISTIC /begin REF_MEASUREMENT VltgCtrl.EstLq.Henry_f32 /end REF_MEASUREMENT /end GROUP
/begin GROUP VltgCtrl.EstR.Ohm_f32 "MICROSAR RTE" /begin SUB_GROUP /end SUB_GROUP /begin FUNCTION_LIST /end FUNCTION_LIST /begin REF_CHARACTERISTIC /end REF_CHARACTERISTIC /begin REF_MEASUREMENT VltgCtrl.EstR.Ohm_f32 /end REF_MEASUREMENT /end GROUP
/begin GROUP VltgCtrl.MRFMtrTrqCmdScl.MtrNm_f32 "MICROSAR RTE" /begin SUB_GROUP /end SUB_GROUP /begin FUNCTION_LIST /end FUNCTION_LIST /begin REF_CHARACTERISTIC /end REF_CHARACTERISTIC /begin REF_MEASUREMENT VltgCtrl.MRFMtrTrqCmdScl.MtrNm_f32 /end REF_MEASUREMENT /end GROUP
/begin GROUP VltgCtrl.MRFMtrVel.MtrRadpS_f32 "MICROSAR RTE" /begin SUB_GROUP /end SUB_GROUP /begin FUNCTION_LIST /end FUNCTION_LIST /begin REF_CHARACTERISTIC /end REF_CHARACTERISTIC /begin REF_MEASUREMENT VltgCtrl.MRFMtrVel.MtrRadpS_f32 /end REF_MEASUREMENT /end GROUP
/begin GROUP VltgCtrl.ModIdx.Uls_f32 "MICROSAR RTE" /begin SUB_GROUP /end SUB_GROUP /begin FUNCTION_LIST /end FUNCTION_LIST /begin REF_CHARACTERISTIC /end REF_CHARACTERISTIC /begin REF_MEASUREMENT VltgCtrl.ModIdx.Uls_f32 /end REF_MEASUREMENT /end GROUP
/begin GROUP VltgCtrl.ModeRequirePorts "MICROSAR RTE" /begin SUB_GROUP VltgCtrl.SystemState.Mode /end SUB_GROUP /begin FUNCTION_LIST /end FUNCTION_LIST /begin REF_CHARACTERISTIC /end REF_CHARACTERISTIC /begin REF_MEASUREMENT /end REF_MEASUREMENT /end GROUP
/begin GROUP VltgCtrl.MtrEnvSpd.MtrRadpS_f32 "MICROSAR RTE" /begin SUB_GROUP /end SUB_GROUP /begin FUNCTION_LIST /end FUNCTION_LIST /begin REF_CHARACTERISTIC /end REF_CHARACTERISTIC /begin REF_MEASUREMENT VltgCtrl.MtrEnvSpd.MtrRadpS_f32 /end REF_MEASUREMENT /end GROUP
/begin GROUP VltgCtrl.MtrQuad.Cnt_u08 "MICROSAR RTE" /begin SUB_GROUP /end SUB_GROUP /begin FUNCTION_LIST /end FUNCTION_LIST /begin REF_CHARACTERISTIC /end REF_CHARACTERISTIC /begin REF_MEASUREMENT VltgCtrl.MtrQuad.Cnt_u08 /end REF_MEASUREMENT /end GROUP
/begin GROUP VltgCtrl.PDActivateTest.Cnt_lgc "MICROSAR RTE" /begin SUB_GROUP /end SUB_GROUP /begin FUNCTION_LIST /end FUNCTION_LIST /begin REF_CHARACTERISTIC /end REF_CHARACTERISTIC /begin REF_MEASUREMENT VltgCtrl.PDActivateTest.Cnt_lgc /end REF_MEASUREMENT /end GROUP
/begin GROUP VltgCtrl.PDPhsAdvSel.Cnt_s16 "MICROSAR RTE" /begin SUB_GROUP /end SUB_GROUP /begin FUNCTION_LIST /end FUNCTION_LIST /begin REF_CHARACTERISTIC /end REF_CHARACTERISTIC /begin REF_MEASUREMENT VltgCtrl.PDPhsAdvSel.Cnt_s16 /end REF_MEASUREMENT /end GROUP
/begin GROUP VltgCtrl.PDTestModIdx.Uls_f32 "MICROSAR RTE" /begin SUB_GROUP /end SUB_GROUP /begin FUNCTION_LIST /end FUNCTION_LIST /begin REF_CHARACTERISTIC /end REF_CHARACTERISTIC /begin REF_MEASUREMENT VltgCtrl.PDTestModIdx.Uls_f32 /end REF_MEASUREMENT /end GROUP
/begin GROUP VltgCtrl.PhsAdv.Cnt_s16 "MICROSAR RTE" /begin SUB_GROUP /end SUB_GROUP /begin FUNCTION_LIST /end FUNCTION_LIST /begin REF_CHARACTERISTIC /end REF_CHARACTERISTIC /begin REF_MEASUREMENT VltgCtrl.PhsAdv.Cnt_s16 /end REF_MEASUREMENT /end GROUP
/begin GROUP VltgCtrl.ReceiverPorts "MICROSAR RTE"
 /begin SUB_GROUP VltgCtrl.CCLMSAActive.Cnt_lgc VltgCtrl.CuTempEst.DegC_f32 VltgCtrl.EstKe.VpRadpS_f32 VltgCtrl.EstLd.Henry_f32 VltgCtrl.EstLq.Henry_f32 VltgCtrl.EstR.Ohm_f32 VltgCtrl.MRFMtrTrqCmdScl.MtrNm_f32 VltgCtrl.MRFMtrVel.MtrRadpS_f32 VltgCtrl.MtrEnvSpd.MtrRadpS_f32 VltgCtrl.MtrQuad.Cnt_u08 VltgCtrl.PDActivateTest.Cnt_lgc VltgCtrl.PDPhsAdvSel.Cnt_s16 VltgCtrl.PDTestModIdx.Uls_f32 VltgCtrl.Vecu.Volt_f32 /end SUB_GROUP
 /begin FUNCTION_LIST /end FUNCTION_LIST
 /begin REF_CHARACTERISTIC /end REF_CHARACTERISTIC
 /begin REF_MEASUREMENT /end REF_MEASUREMENT
/end GROUP
/begin GROUP VltgCtrl.SenderPorts "MICROSAR RTE"
 /begin SUB_GROUP VltgCtrl.ModIdx.Uls_f32 VltgCtrl.PhsAdv.Cnt_s16 VltgCtrl.TermA.Volt_f32 VltgCtrl.TermBSS.Volt_f32 VltgCtrl.TermBTOT.Volt_f32 VltgCtrl.TermXd.Uls_f32 VltgCtrl.TermXq.Uls_f32 VltgCtrl.TermY.Uls_f32 VltgCtrl.TermZ.Uls_f32 VltgCtrl.UnCorrPhsAdv.Cnt_s16 VltgCtrl.VdTerm.Volt_f32 VltgCtrl.VqTerm.Volt_f32 /end SUB_GROUP
 /begin FUNCTION_LIST /end FUNCTION_LIST
 /begin REF_CHARACTERISTIC /end REF_CHARACTERISTIC
 /begin REF_MEASUREMENT /end REF_MEASUREMENT
/end GROUP
/begin GROUP VltgCtrl.SystemState.Mode "MICROSAR RTE" /begin SUB_GROUP /end SUB_GROUP /begin FUNCTION_LIST /end FUNCTION_LIST /begin REF_CHARACTERISTIC /end REF_CHARACTERISTIC /begin REF_MEASUREMENT VltgCtrl.SystemState.Mode /end REF_MEASUREMENT /end GROUP
/begin GROUP VltgCtrl.TermA.Volt_f32 "MICROSAR RTE" /begin SUB_GROUP /end SUB_GROUP /begin FUNCTION_LIST /end FUNCTION_LIST /begin REF_CHARACTERISTIC /end REF_CHARACTERISTIC /begin REF_MEASUREMENT VltgCtrl.TermA.Volt_f32 /end REF_MEASUREMENT /end GROUP
/begin GROUP VltgCtrl.TermBSS.Volt_f32 "MICROSAR RTE" /begin SUB_GROUP /end SUB_GROUP /begin FUNCTION_LIST /end FUNCTION_LIST /begin REF_CHARACTERISTIC /end REF_CHARACTERISTIC /begin REF_MEASUREMENT VltgCtrl.TermBSS.Volt_f32 /end REF_MEASUREMENT /end GROUP
/begin GROUP VltgCtrl.TermBTOT.Volt_f32 "MICROSAR RTE" /begin SUB_GROUP /end SUB_GROUP /begin FUNCTION_LIST /end FUNCTION_LIST /begin REF_CHARACTERISTIC /end REF_CHARACTERISTIC /begin REF_MEASUREMENT VltgCtrl.TermBTOT.Volt_f32 /end REF_MEASUREMENT /end GROUP
/begin GROUP VltgCtrl.TermXd.Uls_f32 "MICROSAR RTE" /begin SUB_GROUP /end SUB_GROUP /begin FUNCTION_LIST /end FUNCTION_LIST /begin REF_CHARACTERISTIC /end REF_CHARACTERISTIC /begin REF_MEASUREMENT VltgCtrl.TermXd.Uls_f32 /end REF_MEASUREMENT /end GROUP
/begin GROUP VltgCtrl.TermXq.Uls_f32 "MICROSAR RTE" /begin SUB_GROUP /end SUB_GROUP /begin FUNCTION_LIST /end FUNCTION_LIST /begin REF_CHARACTERISTIC /end REF_CHARACTERISTIC /begin REF_MEASUREMENT VltgCtrl.TermXq.Uls_f32 /end REF_MEASUREMENT /end GROUP
/begin GROUP VltgCtrl.TermY.Uls_f32 "MICROSAR RTE" /begin SUB_GROUP /end SUB_GROUP /begin FUNCTION_LIST /end FUNCTION_LIST /begin REF_CHARACTERISTIC /end REF_CHARACTERISTIC /begin REF_MEASUREMENT VltgCtrl.TermY.Uls_f32 /end REF_MEASUREMENT /end GROUP
/begin GROUP VltgCtrl.TermZ.Uls_f32 "MICROSAR RTE" /begin SUB_GROUP /end SUB_GROUP /begin FUNCTION_LIST /end FUNCTION_LIST /begin REF_CHARACTERISTIC /end REF_CHARACTERISTIC /begin REF_MEASUREMENT VltgCtrl.TermZ.Uls_f32 /end REF_MEASUREMENT /end GROUP
/begin GROUP VltgCtrl.UnCorrPhsAdv.Cnt_s16 "MICROSAR RTE" /begin SUB_GROUP /end SUB_GROUP /begin FUNCTION_LIST /end FUNCTION_LIST /begin REF_CHARACTERISTIC /end REF_CHARACTERISTIC /begin REF_MEASUREMENT VltgCtrl.UnCorrPhsAdv.Cnt_s16 /end REF_MEASUREMENT /end GROUP
/begin GROUP VltgCtrl.VdTerm.Volt_f32 "MICROSAR RTE" /begin SUB_GROUP /end SUB_GROUP /begin FUNCTION_LIST /end FUNCTION_LIST /begin REF_CHARACTERISTIC /end REF_CHARACTERISTIC /begin REF_MEASUREMENT VltgCtrl.VdTerm.Volt_f32 /end REF_MEASUREMENT /end GROUP
/begin GROUP VltgCtrl.Vecu.Volt_f32 "MICROSAR RTE" /begin SUB_GROUP /end SUB_GROUP /begin FUNCTION_LIST /end FUNCTION_LIST /begin REF_CHARACTERISTIC /end REF_CHARACTERISTIC /begin REF_MEASUREMENT VltgCtrl.Vecu.Volt_f32 /end REF_MEASUREMENT /end GROUP
/begin GROUP VltgCtrl.VqTerm.Volt_f32 "MICROSAR RTE" /begin SUB_GROUP /end SUB_GROUP /begin FUNCTION_LIST /end FUNCTION_LIST /begin REF_CHARACTERISTIC /end REF_CHARACTERISTIC /begin REF_MEASUREMENT VltgCtrl.VqTerm.Volt_f32 /end REF_MEASUREMENT /end GROUP
/begin RECORD_LAYOUT RTE_RL_BOOLEAN FNC_VALUES 1 UBYTE ROW_DIR DIRECT /end RECORD_LAYOUT
/**********************************************************************************************************************
* COMPU_METHOD / COMPU_VTAB_RANGE
*********************************************************************************************************************/
/begin COMPU_METHOD RTE_CM_BOOLEAN "" TAB_VERB "%3.1" "" COMPU_TAB_REF RTE_CM_BOOLEAN /end COMPU_METHOD
/begin COMPU_VTAB_RANGE RTE_CM_BOOLEAN "" 2 0 0 "false" 1 255 "true" /end COMPU_VTAB_RANGE
/begin COMPU_METHOD RTE_CM_STRING "" TAB_VERB "%.1" "" COMPU_TAB_REF RTE_CM_STRING /end COMPU_METHOD
/begin COMPU_VTAB_RANGE RTE_CM_STRING "" 256 0 31 "UNDEFINED" 32 32 " " 33 33 "!" 34 34 "\"" 35 35 "#" 36 36 "$" 37 37 "%" 38 38 "&" 39 39 "'" 40 40 "(" 41 41 ")" 42 42 "*" 43 43 "+" 44 44 "," 45 45 "-" 46 46 "." 47 47 "/" 48 48 "0" 49 49 "1" 50 50 "2" 51 51 "3" 52 52 "4" 53 53 "5" 54 54 "6" 55 55 "7" 56 56 "8" 57 57 "9" 58 58 ":" 59 59 ";" 60 60 "<" 61 61 "=" 62 62 ">" 63 63 "?" 64 64 "@" 65 65 "A" 66 66 "B" 67 67 "C" 68 68 "D" 69 69 "E" 70 70 "F" 71 71 "G" 72 72 "H" 73 73 "I" 74 74 "J" 75 75 "K" 76 76 "L" 77 77 "M" 78 78 "N" 79 79 "O" 80 80 "P" 81 81 "Q" 82 82 "R" 83 83 "S" 84 84 "T" 85 85 "U" 86 86 "V" 87 87 "W" 88 88 "X" 89 89 "Y" 90 90 "Z" 91 91 "[" 92 92 "\\" 93 93 "]" 94 94 "^" 95 95 "_" 96 96 "`" 97 97 "a" 98 98 "b" 99 99 "c" 100 100 "d" 101 101 "e" 102 102 "f" 103 103 "g" 104 104 "h" 105 105 "i" 106 106 "j" 107 107 "k" 108 108 "l" 109 109 "m" 110 110 "n" 111 111 "o" 112 112 "p" 113 113 "q" 114 114 "r" 115 115 "s" 116 116 "t" 117 117 "u" 118 118 "v" 119 119 "w" 120 120 "x" 121 121 "y" 122 122 "z" 123 123 "{" 124 124 "|" 125 125 "}" 126 126 "~" 127 255 "UNDEFINED" /end COMPU_VTAB_RANGE
/begin COMPU_METHOD RTE_CM_ENUM_TurnsCntrValStateType "" TAB_VERB "%.1" "" COMPU_TAB_REF RTE_CM_ENUM_TurnsCntrValStateType /end COMPU_METHOD
/begin COMPU_VTAB_RANGE RTE_CM_ENUM_TurnsCntrValStateType "" 3 0 0 "TCV_COMPUTING" 100 100 "TCV_VALID" 255 255 "TCV_INVALID" /end COMPU_VTAB_RANGE
/begin COMPU_METHOD RTE_CM_ENUM_StaMd_Mode "" TAB_VERB "%.1" "" COMPU_TAB_REF RTE_CM_ENUM_StaMd_Mode /end COMPU_METHOD
/begin COMPU_VTAB_RANGE RTE_CM_ENUM_StaMd_Mode "" 5 0 0 "RTE_MODE_StaMd_Mode_DISABLE" 1 1 "RTE_MODE_StaMd_Mode_OFF" 2 2 "RTE_MODE_StaMd_Mode_OPERATE" 3 3 "RTE_MODE_StaMd_Mode_WARMINIT" 4 4 "RTE_TRANSITION_StaMd_Mode" /end COMPU_VTAB_RANGE
/begin COMPU_METHOD RTE_CM_ENUM_TuningSessionAddrPtrEnum "" TAB_VERB "%.1" "" COMPU_TAB_REF RTE_CM_ENUM_TuningSessionAddrPtrEnum /end COMPU_METHOD
/begin COMPU_VTAB_RANGE RTE_CM_ENUM_TuningSessionAddrPtrEnum "" 7 0 0 "TUN_SESSION_PTR_PERS" 1 1 "TUN_SESSION_PTR_SETS" 2 2 "TUN_SESSION_PTR_COMMON" 3 3 "TUN_SESSION_PTR_SETANDPER" 4 4 "TUN_SESSION_PTR_SETANDPERANDCOMMON" 16 16 "TUN_SESSION_PTR_CUSTSEG" 255 255 "TUN_SESSION_PTR_DISABLED" /end COMPU_VTAB_RANGE
/begin COMPU_METHOD RTE_CM_ENUM_QU_SER_STMOM_STMOM_DV_ACT "" TAB_VERB "%.1" "" COMPU_TAB_REF RTE_CM_ENUM_QU_SER_STMOM_STMOM_DV_ACT /end COMPU_METHOD
/begin COMPU_VTAB_RANGE RTE_CM_ENUM_QU_SER_STMOM_STMOM_DV_ACT "" 7 32 32 "Cx20_Schnittstelle_verfuegbar___funktionsbereit" 33 33 "Cx21_Schnittstelle_aktiv" 96 96 "Cx60_Service_nicht_verfuegbar___Fehler" 128 128 "Cx80_Schnittstelle_wird_initialisiert" 224 224 "CxE0_Service_nicht_verfuegbar___Standby___PMA" 225 225 "CxE1_Service_nicht_verfuegbar___Standby___EPS_Status" 255 255 "CxFF_Signal_ungueltig" /end COMPU_VTAB_RANGE
/begin COMPU_METHOD RTE_CM_ENUM_ManufModeType "" TAB_VERB "%.1" "" COMPU_TAB_REF RTE_CM_ENUM_ManufModeType /end COMPU_METHOD
/begin COMPU_VTAB_RANGE RTE_CM_ENUM_ManufModeType "" 3 0 0 "ProductionMode" 1 1 "ManufacturingMode" 2 2 "EngineeringMode" /end COMPU_VTAB_RANGE
/begin COMPU_METHOD RTE_CM_ENUM_MSA_Cmd_Type "" TAB_VERB "%.1" "" COMPU_TAB_REF RTE_CM_ENUM_MSA_Cmd_Type /end COMPU_METHOD
/begin COMPU_VTAB_RANGE RTE_CM_ENUM_MSA_Cmd_Type "" 4 0 0 "MSA_STOP_ANNOUNCEMENT" 1 1 "MSA_STOP_COMMAND" 2 2 "MSA_START_ANNOUNCEMENT" 3 3 "MSA_ENGINE_RUN" /end COMPU_VTAB_RANGE
/begin COMPU_METHOD RTE_CM_ENUM_QU_SER_WSTA_EST_FTAX "" TAB_VERB "%.1" "" COMPU_TAB_REF RTE_CM_ENUM_QU_SER_WSTA_EST_FTAX /end COMPU_METHOD
/begin COMPU_VTAB_RANGE RTE_CM_ENUM_QU_SER_WSTA_EST_FTAX "" 10 32 32 "Cx20_Schnittstelle_verfuegbar___funktionsbereit" 33 33 "Cx21_Schnittstelle_aktiv" 96 96 "Cx60_Service_nicht_verfuegbar___Fehler" 128 128 "Cx80_Schnittstelle_wird_initialisiert" 224 224 "CxE0_Funktion_in_Rueckfallebene___V_Fzg_____0" 226 226 "CxE2_Funktion_in_Rueckfallebene___Hands_On" 227 227 "CxE3_Funktion_in_Rueckfallebene___EPS_Status" 228 228 "CxE4_Schnittstelle_inaktiv___Stillstandsnaher_Bereich_verlassen" 231 231 "CxE7_Schnittstelle_aktiv_degradiert" 255 255 "CxFF_Signal_ungueltig" /end COMPU_VTAB_RANGE
/begin COMPU_METHOD RTE_CM_ENUM_ST_V_VEH_NSS "" TAB_VERB "%.1" "" COMPU_TAB_REF RTE_CM_ENUM_ST_V_VEH_NSS /end COMPU_METHOD
/begin COMPU_VTAB_RANGE RTE_CM_ENUM_ST_V_VEH_NSS "" 3 12 12 "CxC_Fahrzeug_im_stillstandsnahen_Bereich" 13 13 "CxD_Fahrzeug_nicht_im_stillstandsnahen_Bereich" 15 15 "CxF_Signal_ungueltig" /end COMPU_VTAB_RANGE
/begin COMPU_METHOD RTE_CM_ENUM_ALIV_COU_4 "" TAB_VERB "%.1" "" COMPU_TAB_REF RTE_CM_ENUM_ALIV_COU_4 /end COMPU_METHOD
/begin COMPU_VTAB_RANGE RTE_CM_ENUM_ALIV_COU_4 "" 2 0 14 "Cx0xE_Zaehlerstand_0__E" 15 15 "CxF_Signal_ungueltig" /end COMPU_VTAB_RANGE
/begin COMPU_METHOD RTE_CM_AVL_PINA_IDX_ICM "" RAT_FUNC "%." "" COEFFS 0 22.7555555555556 32767 0 0 1 /end COMPU_METHOD
/begin COMPU_METHOD RTE_CM_CRC8 "" RAT_FUNC "%." "" COEFFS 0 1 0 0 0 1 /end COMPU_METHOD
/begin COMPU_METHOD RTE_CM_STMOM_QTA_DV "" RAT_FUNC "%." "Nm" COEFFS 0 200 2000 0 0 1 /end COMPU_METHOD
/begin COMPU_METHOD RTE_CM_AVL_PINA_EPS "" RAT_FUNC "%." "" COEFFS 0 22.7555555555556 32767 0 0 1 /end COMPU_METHOD
/begin COMPU_METHOD RTE_CM_ENUM_IDX_TORQ_SEN "" TAB_VERB "%.1" "" COMPU_TAB_REF RTE_CM_ENUM_IDX_TORQ_SEN /end COMPU_METHOD
/begin COMPU_VTAB_RANGE RTE_CM_ENUM_IDX_TORQ_SEN "" 4 0 0 "Cx0_Initialisierung" 1 1 "Cx1_Keine_Index_Flanke" 2 2 "Cx2_Index_Flanke" 3 3 "Cx3_Signal_ungueltig" /end COMPU_VTAB_RANGE
/begin COMPU_METHOD RTE_CM_OFFS_GRD_MID_EPS "" RAT_FUNC "%." "" COEFFS 0 22.7555555555556 2047 0 0 1 /end COMPU_METHOD
/begin COMPU_METHOD RTE_CM_ENUM_QU_AVL_PINA_EPS "" TAB_VERB "%.1" "" COMPU_TAB_REF RTE_CM_ENUM_QU_AVL_PINA_EPS /end COMPU_METHOD
/begin COMPU_VTAB_RANGE RTE_CM_ENUM_QU_AVL_PINA_EPS "" 8 1 1 "Cx1_Signalwert_ist_gueltig_und_abgesichert_und_plausibilisiert" 2 2 "Cx2_Signalwert_ist_gueltig" 4 4 "Cx4_Ersatzwert_ist_im_Nutzsignal_gesetzt" 8 8 "Cx8_Initialisierung" 10 10 "CxA_Signalwert_ist_gueltig__Zustand_Status_temporaer" 12 12 "CxC_Abgleichwert_ist_im_Nutzsignal_gesetzt___Zustand_Status_temporaer" 14 14 "CxE_Signalwert_ist_ungueltig__Zustand_Status_temporaer" 15 15 "CxF_Signal_ungueltig" /end COMPU_VTAB_RANGE
/begin COMPU_METHOD RTE_CM_ENUM_UN_PO_EPS "" TAB_VERB "%.1" "" COMPU_TAB_REF RTE_CM_ENUM_UN_PO_EPS /end COMPU_METHOD
/begin COMPU_VTAB_RANGE RTE_CM_ENUM_UN_PO_EPS "" 3 0 0 "Cx0_Ritzelschnittstelle" 1 1 "Cx1_Zahnstangenhubschnittstelle" 3 3 "Cx3_Signal_ungueltig" /end COMPU_VTAB_RANGE
/begin COMPU_METHOD RTE_CM_AVL_FORC_GRD "" RAT_FUNC "%." "kN" COEFFS 0 119.047619047619 2023.80952380952 0 0 1 /end COMPU_METHOD
/begin COMPU_METHOD RTE_CM_AVL_PWR_EL "" RAT_FUNC "%." "kW" COEFFS 0 10 120 0 0 1 /end COMPU_METHOD
/begin COMPU_METHOD RTE_CM_ENUM_QU_AVL_FORC_GRD "" TAB_VERB "%.1" "" COMPU_TAB_REF RTE_CM_ENUM_QU_AVL_FORC_GRD /end COMPU_METHOD
/begin COMPU_VTAB_RANGE RTE_CM_ENUM_QU_AVL_FORC_GRD "" 4 2 2 "Cx2_Signalwert_ist_gueltig" 8 8 "Cx8_Initialisierung" 14 14 "CxE_Signalwert_ist_ungueltig__Zustand_Status_temporaer" 15 15 "CxF_Signal_ungueltig" /end COMPU_VTAB_RANGE
/begin COMPU_METHOD RTE_CM_ENUM_QU_AVL_STMOM_DV_ACT "" TAB_VERB "%.1" "" COMPU_TAB_REF RTE_CM_ENUM_QU_AVL_STMOM_DV_ACT /end COMPU_METHOD
/begin COMPU_VTAB_RANGE RTE_CM_ENUM_QU_AVL_STMOM_DV_ACT "" 5 1 1 "Cx1_Signalwert_ist_gueltig_und_abgesichert_und_plausibilisiert" 6 6 "Cx6_Signalwert_ist_ungueltig" 8 8 "Cx8_Initialisierung" 14 14 "CxE_Signalwert_ist_ungueltig__Zustand_Status_temporaer" 15 15 "CxF_Signal_ungueltig" /end COMPU_VTAB_RANGE
/begin COMPU_METHOD RTE_CM_ENUM_QU_FN_EST "" TAB_VERB "%.1" "" COMPU_TAB_REF RTE_CM_ENUM_QU_FN_EST /end COMPU_METHOD
/begin COMPU_VTAB_RANGE RTE_CM_ENUM_QU_FN_EST "" 12 49 49 "Cx31_Funktion_in_Rueckfallebene" 51 51 "Cx33_Funktion_in_Rueckfallebene__Notfallfunktion_Umwelteinfluesse__Aktiv" 96 96 "Cx60_Funktion_nicht_verfuegbar___Fehler" 128 128 "Cx80_Initialisierung" 160 160 "CxA0_Funktion_verfuegbar___Aktiv__12V_EPS" 162 162 "CxA2_Funktion_verfuegbar___Aktiv__Notfallfunktion_Umwelteinfluesse___Aktiv" 164 164 "CxA4_Funktion_verfuegbar___Aktiv__12V_EAS" 168 168 "CxA8_Funktion_verfuegbar___Aktiv__24V_EAS" 176 176 "CxB0_Funktion_temporaer_in_Rueckfallebene" 178 178 "CxB2_Funktion_temporaer_in_Rueckfallebene__Notfallfunktion_Umwelteinfluesse__Aktiv" 224 224 "CxE0_Funktion_nicht_verfuegbar___ausgeschaltet" 255 255 "CxFF_Signal_ungueltig" /end COMPU_VTAB_RANGE
/begin COMPU_METHOD RTE_CM_ENUM_New_Coding_50 "" TAB_VERB "%.1" "" COMPU_TAB_REF RTE_CM_ENUM_New_Coding_50 /end COMPU_METHOD
/begin COMPU_VTAB_RANGE RTE_CM_ENUM_New_Coding_50 "" 5 1 1 "Cx1_Funktion_verfuegbar_nicht_aktiv" 6 6 "Cx6_Fehler" 9 9 "Cx9_Funktion_verfuegbar_aktiv" 14 14 "CxE_Funktion_nicht_verfuegbar" 15 15 "CxF_Signal_unbefuellt" /end COMPU_VTAB_RANGE
/begin COMPU_METHOD RTE_CM_New_Coding_51 "" RAT_FUNC "%." "" COEFFS 0 1 0 0 0 1 /end COMPU_METHOD
/begin COMPU_METHOD RTE_CM_New_Coding_52 "" RAT_FUNC "%." "" COEFFS 0 1 0 0 0 1 /end COMPU_METHOD
/begin COMPU_METHOD RTE_CM_TOT_STR_EPS "" RAT_FUNC "%." "" COEFFS 0 81.8799639728159 0 0 0 1 /end COMPU_METHOD
/begin COMPU_METHOD RTE_CM_ENUM_UN_TOT_STR_EPS "" TAB_VERB "%.1" "" COMPU_TAB_REF RTE_CM_ENUM_UN_TOT_STR_EPS /end COMPU_METHOD
/begin COMPU_VTAB_RANGE RTE_CM_ENUM_UN_TOT_STR_EPS "" 3 0 0 "Cx0_Ritzelschnittstelle" 1 1 "Cx1_Zahnstangenhubschnittstelle" 3 3 "Cx3_Signal_ungueltig" /end COMPU_VTAB_RANGE
/begin COMPU_METHOD RTE_CM_ENUM_EnergyModeStateType "" TAB_VERB "%.1" "" COMPU_TAB_REF RTE_CM_ENUM_EnergyModeStateType /end COMPU_METHOD
/begin COMPU_VTAB_RANGE RTE_CM_ENUM_EnergyModeStateType "" 4 0 0 "NORMAL" 1 1 "PRODUCTION" 2 2 "TRANSPORTATION" 3 3 "FLASH" /end COMPU_VTAB_RANGE
