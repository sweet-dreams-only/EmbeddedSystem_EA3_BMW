/begin COMPU_VTAB BooleanTable "Logic Table" TAB_VERB 2 0 "False" 1 "True" DEFAULT_VALUE "False" /end COMPU_VTAB
/begin COMPU_METHOD u4p12_T "" LINEAR "%0.0" "" COEFFS_LINEAR 0.000244140625 0 /end COMPU_METHOD
/begin COMPU_METHOD Boolean "" TAB_VERB "%0.0" "" COMPU_TAB_REF BooleanTable /end COMPU_METHOD
/begin COMPU_METHOD s11p20_T "" LINEAR "%0.0" "" COEFFS_LINEAR 9.5367431640625E-07 0 /end COMPU_METHOD
/begin COMPU_METHOD u2p14_T "" LINEAR "%0.0" "" COEFFS_LINEAR 0.00006103515625 0 /end COMPU_METHOD
/begin COMPU_METHOD u1p15_T "" LINEAR "%0.0" "" COEFFS_LINEAR 0.000030517578125 0 /end COMPU_METHOD
/begin COMPU_METHOD u0p16_T "" LINEAR "%0.0" "" COEFFS_LINEAR 1.52587890625E-05 0 /end COMPU_METHOD
/begin COMPU_METHOD s9p6_T "" LINEAR "%0.0" "" COEFFS_LINEAR 0.015625 0 /end COMPU_METHOD
/begin COMPU_METHOD s14p1_T "" LINEAR "%0.0" "" COEFFS_LINEAR 0.5 0 /end COMPU_METHOD
/begin COMPU_METHOD s6p9_T "" LINEAR "%0.0" "" COEFFS_LINEAR 0.001953125 0 /end COMPU_METHOD
/begin COMPU_METHOD s15p16_T "" LINEAR "%0.0" "" COEFFS_LINEAR 1.52587890625E-05 0 /end COMPU_METHOD
/begin COMPU_METHOD u5p11_T "" LINEAR "%0.0" "" COEFFS_LINEAR 0.00048828125 0 /end COMPU_METHOD
/begin COMPU_METHOD s24p7_T "" LINEAR "%0.0" "" COEFFS_LINEAR 0.0078125 0 /end COMPU_METHOD
/begin COMPU_METHOD s10p5_T "" LINEAR "%0.0" "" COEFFS_LINEAR 0.03125 0 /end COMPU_METHOD
/begin COMPU_METHOD u9p7_T "" LINEAR "%0.0" "" COEFFS_LINEAR 0.0078125 0 /end COMPU_METHOD
/begin COMPU_METHOD u8p8_T "" LINEAR "%0.0" "" COEFFS_LINEAR 0.00390625 0 /end COMPU_METHOD
/begin COMPU_METHOD u1p31_T "" LINEAR "%0.0" "" COEFFS_LINEAR 4.65661287307739E-10 0 /end COMPU_METHOD
/begin COMPU_METHOD s7p24_T "" LINEAR "%0.0" "" COEFFS_LINEAR 5.96046447753906E-08 0 /end COMPU_METHOD
/begin COMPU_METHOD u8p24_T "" LINEAR "%0.0" "" COEFFS_LINEAR 5.96046447753906E-08 0 /end COMPU_METHOD
/begin COMPU_METHOD s4p11_T "" LINEAR "%0.0" "" COEFFS_LINEAR 0.00048828125 0 /end COMPU_METHOD
/begin COMPU_METHOD s4p27_T "" LINEAR "%0.0" "" COEFFS_LINEAR 7.45058059692383E-09 0 /end COMPU_METHOD
/begin COMPU_METHOD s7p8_T "" LINEAR "%0.0" "" COEFFS_LINEAR 0.00390625 0 /end COMPU_METHOD
/begin COMPU_METHOD s8p7_T "" LINEAR "%0.0" "" COEFFS_LINEAR 0.0078125 0 /end COMPU_METHOD
/begin CHARACTERISTIC t_HysAddOffsetTblY_HwNm_u4p12 "HysAdd_t_Offset_HwNm Y-values for lookup table.  Driver torque at which slope calibration (above) begins. 3 0 to 16 2.4414e-004" CURVE 0x0 __UWORD_S 0 u4p12_T 0 10 /begin AXIS_DESCR COM_AXIS NO_INPUT_QUANTITY NO_COMPU_METHOD 0 0 0 /end AXIS_DESCR DISPLAY_IDENTIFIER HysAdd_t_Offset_HwNm FORMAT "%.15" MATRIX_DIM 8 1 1 PHYS_UNIT "HwNm" SYMBOL_LINK "k_TunPer0_Cnt_Str.t_HysAddOffsetTblY_HwNm_u4p12" 0 /end CHARACTERISTIC
/begin CHARACTERISTIC k_RtnOffsetRange_HWDeg_f32 "Valid offset range cal" VALUE 0x0 __FLOAT32_IEEE_S 0 NO_COMPU_METHOD 0 20 DISPLAY_IDENTIFIER Rtrn_k_OffsetLimit_HwDeg FORMAT "%.15" PHYS_UNIT "HWDeg" SYMBOL_LINK "k_TunPer0_Cnt_Str.k_RtnOffsetRange_HWDeg_f32" 0 /end CHARACTERISTIC
/begin CHARACTERISTIC k_RtnOffsetSlew_HwDegpS_f32 "Slew rate limit cal" VALUE 0x0 __FLOAT32_IEEE_S 0 NO_COMPU_METHOD 0 0.5 DISPLAY_IDENTIFIER Rtrn_k_OffsetSlew_HwDegpS FORMAT "%.15" PHYS_UNIT "HwDegpS" SYMBOL_LINK "k_TunPer0_Cnt_Str.k_RtnOffsetSlew_HwDegpS_f32" 0 /end CHARACTERISTIC
/begin CHARACTERISTIC k_PrkAstLimitPerc_Pct_f32 "Percent Limit indicating when PA should be deactivated" VALUE 0x0 __FLOAT32_IEEE_S 0 NO_COMPU_METHOD 0 100 DISPLAY_IDENTIFIER k_PrkAst_LimitPerc FORMAT "%.15" PHYS_UNIT "Percentage" SYMBOL_LINK "k_TunSet0_Cnt_Str.k_PrkAstLimitPerc_Pct_f32" 0 /end CHARACTERISTIC
/begin MEASUREMENT AbsHwPos_AlignedHwPos_HwDeg_f32 "This is aligned cumulative motor position, scaled and compensated into hw units." FLOAT32_IEEE NO_COMPU_METHOD 0 0 -1440.11 1440.11 DISPLAY_IDENTIFIER AlignedHwPos ECU_ADDRESS 0 PHYS_UNIT "HwDeg" READ_WRITE SYMBOL_LINK "Rte_AbsHwPos_AlignedHwPos_HwDeg_f32" 0 /end MEASUREMENT
/begin MEASUREMENT AlignedHwPos_HwDeg_M_f32 "" FLOAT32_IEEE NO_COMPU_METHOD 0 0 -1440.11 1440.11 DISPLAY_IDENTIFIER AlignedHwPos ECU_ADDRESS 0 PHYS_UNIT "HwDeg" READ_WRITE /end MEASUREMENT
/begin MEASUREMENT AllowCorrectionState_Cnt_M_lgc "" UBYTE Boolean 0 0 0 1 DISPLAY_IDENTIFIER AllowCorrectionState ECU_ADDRESS 0 PHYS_UNIT "Counts" READ_WRITE /end MEASUREMENT
/begin MEASUREMENT ComplError_HwDeg_D_f32 "" FLOAT32_IEEE NO_COMPU_METHOD 0 0 -1126.4 1126.4 DISPLAY_IDENTIFIER Compl_Error ECU_ADDRESS 0 PHYS_UNIT "HwDeg" READ_WRITE /end MEASUREMENT
/begin MEASUREMENT AbsHwPos_HandwheelAuthority_Uls_f32 "Final slewed authority of HW_Position in terms of confidence in position." FLOAT32_IEEE NO_COMPU_METHOD 0 0 0 1 DISPLAY_IDENTIFIER Handwheel_Authority ECU_ADDRESS 0 PHYS_UNIT "Unitless" READ_WRITE SYMBOL_LINK "Rte_AbsHwPos_HandwheelAuthority_Uls_f32" 0 /end MEASUREMENT
/begin MEASUREMENT HandwheelAuthority_Uls_M_f32 "" FLOAT32_IEEE NO_COMPU_METHOD 0 0 0 1 DISPLAY_IDENTIFIER Handwheel_Authority ECU_ADDRESS 0 PHYS_UNIT "Unitless" READ_WRITE /end MEASUREMENT
/begin MEASUREMENT AbsHwPos_HandwheelPosition_HwDeg_f32 "Absolute Hand Wheel Position used by EPS  application" FLOAT32_IEEE NO_COMPU_METHOD 0 0 -1440.11 1440.11 DISPLAY_IDENTIFIER Handwheel_Position ECU_ADDRESS 0 PHYS_UNIT "HwDeg" READ_WRITE SYMBOL_LINK "Rte_AbsHwPos_HandwheelPosition_HwDeg_f32" 0 /end MEASUREMENT
/begin MEASUREMENT HwPositionFiltSV_HwDeg_M_s11p20 "" SLONG s11p20_T 0 0 -1440.11 1440.11 ECU_ADDRESS 0 PHYS_UNIT "HwDeg" READ_WRITE /end MEASUREMENT
/begin MEASUREMENT AbsHwPos_HwTargetAuthority_Uls_f32 "Raw target authority of HW_Position in terms of confidence in position." FLOAT32_IEEE NO_COMPU_METHOD 0 0 0 1 DISPLAY_IDENTIFIER Hw_Target_Authority ECU_ADDRESS 0 PHYS_UNIT "Unitless" READ_WRITE SYMBOL_LINK "Rte_AbsHwPos_HwTargetAuthority_Uls_f32" 0 /end MEASUREMENT
/begin MEASUREMENT HwTargetAuthority_Uls_M_f32 "" FLOAT32_IEEE NO_COMPU_METHOD 0 0 0 1 DISPLAY_IDENTIFIER Hw_Target_Authority ECU_ADDRESS 0 PHYS_UNIT "Unitless" READ_WRITE /end MEASUREMENT
/begin MEASUREMENT ICMAuthority_Uls_M_f32 "" FLOAT32_IEEE NO_COMPU_METHOD 0 0 0 1 DISPLAY_IDENTIFIER ICM_Authority ECU_ADDRESS 0 PHYS_UNIT "Unitless" READ_WRITE /end MEASUREMENT
/begin MEASUREMENT AbsHwPos_ICMMtrPosMRF_Deg_f32 "ICM offset based calculated motor position in motor deg and converted into motor ref frame." FLOAT32_IEEE NO_COMPU_METHOD 0 0 -1006632960 1006632959.53125 DISPLAY_IDENTIFIER ICMMtrPos_MRF ECU_ADDRESS 0 PHYS_UNIT "Degrees" READ_WRITE SYMBOL_LINK "Rte_AbsHwPos_ICMMtrPosMRF_Deg_f32" 0 /end MEASUREMENT
/begin MEASUREMENT ICMMtrPosMRF_Deg_M_f32 "" FLOAT32_IEEE NO_COMPU_METHOD 0 0 -1006632960 1006632959.53125 DISPLAY_IDENTIFIER ICMMtrPos_MRF ECU_ADDRESS 0 PHYS_UNIT "Degrees" READ_WRITE /end MEASUREMENT
/begin MEASUREMENT ICMRevOffsetCRF_Rev_M_s16 "" SWORD NO_COMPU_METHOD 0 0 -127 127 DISPLAY_IDENTIFIER ICMRevOffset_CRF ECU_ADDRESS 0 PHYS_UNIT "Revolutions" READ_WRITE /end MEASUREMENT
/begin MEASUREMENT InpSigInvldTimer_mS_M_u32 "" ULONG NO_COMPU_METHOD 0 0 0 4294967295 DISPLAY_IDENTIFIER InpSignal_Invalid_Timer ECU_ADDRESS 0 PHYS_UNIT "mS" READ_WRITE /end MEASUREMENT
/begin MEASUREMENT LTRckCntrComplete_Cnt_M_lgc "" UBYTE Boolean 0 0 0 1 DISPLAY_IDENTIFIER LTRckCntr_Complete ECU_ADDRESS 0 PHYS_UNIT "Counts" READ_WRITE /end MEASUREMENT
/begin MEASUREMENT AbsHwPos_LTVehCenterComplete_Cnt_lgc "Boolean flag to indicate that the vehicle center signal is available for use" UBYTE Boolean 0 0 0 1 DISPLAY_IDENTIFIER LTVehCntr_Complete ECU_ADDRESS 0 PHYS_UNIT "Counts" READ_WRITE SYMBOL_LINK "Rte_AbsHwPos_LTVehCenterComplete_Cnt_lgc" 0 /end MEASUREMENT
/begin MEASUREMENT OffCorrTimer_mS_M_u32 "" ULONG NO_COMPU_METHOD 0 0 0 4294967295 DISPLAY_IDENTIFIER Offset_Correction_timer ECU_ADDRESS 0 PHYS_UNIT "mS" READ_WRITE /end MEASUREMENT
/begin MEASUREMENT Polarity_Cnt_M_s08 "" SBYTE NO_COMPU_METHOD 0 0 -1 1 DISPLAY_IDENTIFIER k_System_Polarity.AssistAssembly_Polarity ECU_ADDRESS 0 PHYS_UNIT "Counts" READ_WRITE /end MEASUREMENT
/begin MEASUREMENT RevOffsetMRF_Deg_M_f32 "" FLOAT32_IEEE NO_COMPU_METHOD 0 0 -1006632960 1006632959.53125 DISPLAY_IDENTIFIER RevOffset_MtrDeg_MRF ECU_ADDRESS 0 PHYS_UNIT "Degrees" READ_WRITE /end MEASUREMENT
/begin MEASUREMENT RevOffsetState_Cnt_M_enum "" UBYTE NO_COMPU_METHOD 0 0 0 5 ECU_ADDRESS 0 PHYS_UNIT "Counts" READ_WRITE /end MEASUREMENT
/begin MEASUREMENT AbsHwPos_RevOffsetState_Cnt_u08 "Qualifier value for the abs hw angle calculation." UBYTE NO_COMPU_METHOD 0 0 0 15 DISPLAY_IDENTIFIER RevOffset_State ECU_ADDRESS 0 PHYS_UNIT "Counts" READ_WRITE SYMBOL_LINK "Rte_AbsHwPos_RevOffsetState_Cnt_u08" 0 /end MEASUREMENT
/begin MEASUREMENT AbsHwPos_SrlComHwPos_HwDeg_f32 "Handwheel Position to be transmitted on the communication interface" FLOAT32_IEEE NO_COMPU_METHOD 0 0 -1440.11 1440.11 DISPLAY_IDENTIFIER SrlComHwPos ECU_ADDRESS 0 PHYS_UNIT "HwDeg" READ_WRITE SYMBOL_LINK "Rte_AbsHwPos_SrlComHwPos_HwDeg_f32" 0 /end MEASUREMENT
/begin MEASUREMENT SrlComHwPos_HwDeg_M_f32 "" FLOAT32_IEEE NO_COMPU_METHOD 0 0 -1440.11 1440.11 DISPLAY_IDENTIFIER SrlComHwPos ECU_ADDRESS 0 PHYS_UNIT "HwDeg" READ_WRITE /end MEASUREMENT
/begin MEASUREMENT TCMtrPosOffsMRF_Deg_M_f32 "" FLOAT32_IEEE NO_COMPU_METHOD 0 0 -1006632960 1006632959.53125 DISPLAY_IDENTIFIER TC_MtrPosOffs_MRF ECU_ADDRESS 0 PHYS_UNIT "Degrees" READ_WRITE /end MEASUREMENT
/begin MEASUREMENT TurnsCntrValidity_Cnt_M_enum "" UBYTE NO_COMPU_METHOD 0 0 0 255 DISPLAY_IDENTIFIER TurnsCntr_Validity ECU_ADDRESS 0 PHYS_UNIT "Counts" READ_WRITE /end MEASUREMENT
/begin MEASUREMENT VehCntrComplete_Cnt_M_lgc "" UBYTE Boolean 0 0 0 1 DISPLAY_IDENTIFIER VehCntr_Complete ECU_ADDRESS 0 PHYS_UNIT "Counts" READ_WRITE /end MEASUREMENT
/begin MEASUREMENT Assist_BaseAssistCmd_MtrNm_f32 "Assist command from base tables - does not include hysteresis, compensation, or high frequency components" FLOAT32_IEEE NO_COMPU_METHOD 0 0 -8.8 8.8 DISPLAY_IDENTIFIER BaseAssistCmd ECU_ADDRESS 0 PHYS_UNIT "MtrNm" READ_WRITE SYMBOL_LINK "Rte_Assist_BaseAssistCmd_MtrNm_f32" 0 /end MEASUREMENT
/begin MEASUREMENT ThermalAssistScl_Uls_D_u2p14 "" UWORD u2p14_T 0 0 0 1 DISPLAY_IDENTIFIER AsstThermScalar ECU_ADDRESS 0 PHYS_UNIT "Unitless" READ_WRITE /end MEASUREMENT
/begin MEASUREMENT WIRBlend_Uls_D_u2p14 "" UWORD u2p14_T 0 0 0 1 DISPLAY_IDENTIFIER Asst_WIRBlend ECU_ADDRESS 0 PHYS_UNIT "Unitless" READ_WRITE /end MEASUREMENT
/begin MEASUREMENT ActiveKSV_M_str.K_Uls_f32 "" FLOAT32_IEEE NO_COMPU_METHOD 0 0 1.25584782371357E-03 0.71539045666397 ECU_ADDRESS 0 PHYS_UNIT "Unitless" READ_WRITE /end MEASUREMENT
/begin MEASUREMENT ActiveKSV_M_str.SV_Uls_f32 "" FLOAT32_IEEE NO_COMPU_METHOD 0 0 -8.8 8.8 ECU_ADDRESS 0 PHYS_UNIT "Unitless" READ_WRITE /end MEASUREMENT
/begin MEASUREMENT ActiveRawAcc_Cnt_M_u16 "" UWORD NO_COMPU_METHOD 0 0 0 65535 DISPLAY_IDENTIFIER AsstFW_PNAccumulator ECU_ADDRESS 0 PHYS_UNIT "Counts" READ_WRITE /end MEASUREMENT
/begin MEASUREMENT AssistFirewall_AsstFirewallActive_Uls_f32 "Flag that indicates whether the function is actively limiting the outgoing signal" FLOAT32_IEEE NO_COMPU_METHOD 0 0 0 1 DISPLAY_IDENTIFIER AsstFirewall_Active ECU_ADDRESS 0 PHYS_UNIT "Unitless" READ_WRITE SYMBOL_LINK "Rte_AssistFirewall_AsstFirewallActive_Uls_f32" 0 /end MEASUREMENT
/begin MEASUREMENT AsstFWActiveRaw_Uls_D_f32 "" FLOAT32_IEEE NO_COMPU_METHOD 0 0 0 1 DISPLAY_IDENTIFIER AsstFW_ActiveRaw ECU_ADDRESS 0 PHYS_UNIT "Unitless" READ_WRITE /end MEASUREMENT
/begin MEASUREMENT AsstFWLowFreqInput_MtrNm_D_f32 "" FLOAT32_IEEE NO_COMPU_METHOD 0 0 -26.4 26.4 DISPLAY_IDENTIFIER AsstFW_LowFreqInput ECU_ADDRESS 0 PHYS_UNIT "MtrNm" READ_WRITE /end MEASUREMENT
/begin MEASUREMENT AsstFWLowFreqLimited_MtrNm_D_f32 "" FLOAT32_IEEE NO_COMPU_METHOD 0 0 -8.8 8.8 DISPLAY_IDENTIFIER AsstFW_LowFreqLimited ECU_ADDRESS 0 PHYS_UNIT "MtrNm" READ_WRITE /end MEASUREMENT
/begin MEASUREMENT AsstFWLwrBound_MtrNm_D_f32 "" FLOAT32_IEEE NO_COMPU_METHOD 0 0 -8.8 8.8 DISPLAY_IDENTIFIER AsstFW_LwrBound ECU_ADDRESS 0 PHYS_UNIT "MtrNm" READ_WRITE /end MEASUREMENT
/begin MEASUREMENT AsstFWLwrBoundFilt_MtrNm_D_f32 "" FLOAT32_IEEE NO_COMPU_METHOD 0 0 -8.8 8.8 DISPLAY_IDENTIFIER AsstFW_LwrBoundFilt ECU_ADDRESS 0 PHYS_UNIT "MtrNm" READ_WRITE /end MEASUREMENT
/begin MEASUREMENT AsstFWOverBound_Cnt_D_lgc "" UBYTE Boolean 0 0 0 1 DISPLAY_IDENTIFIER AsstFW_OverBound ECU_ADDRESS 0 PHYS_UNIT "Cnt" READ_WRITE /end MEASUREMENT
/begin MEASUREMENT AsstFWSumInput_MtrNm_D_f32 "" FLOAT32_IEEE NO_COMPU_METHOD 0 0 -26.4 26.4 DISPLAY_IDENTIFIER AsstFW_SumInput ECU_ADDRESS 0 PHYS_UNIT "MtrNm" READ_WRITE /end MEASUREMENT
/begin MEASUREMENT AsstFWUprBound_MtrNm_D_f32 "" FLOAT32_IEEE NO_COMPU_METHOD 0 0 -8.8 8.8 DISPLAY_IDENTIFIER AsstFW_UprBound ECU_ADDRESS 0 PHYS_UNIT "MtrNm" READ_WRITE /end MEASUREMENT
/begin MEASUREMENT AsstFWUprBoundFilt_MtrNm_D_f32 "" FLOAT32_IEEE NO_COMPU_METHOD 0 0 -8.8 8.8 DISPLAY_IDENTIFIER AsstFW_UprBoundFilt ECU_ADDRESS 0 PHYS_UNIT "MtrNm" READ_WRITE /end MEASUREMENT
/begin MEASUREMENT AsstReducedPerfSV_Cnt_M_lgc "" UBYTE Boolean 0 0 0 1 DISPLAY_IDENTIFIER AsstFW_ReducedPerf ECU_ADDRESS 0 PHYS_UNIT "Cnt" READ_WRITE /end MEASUREMENT
/begin MEASUREMENT CombAsstSV_MtrNm_M_f32 "" FLOAT32_IEEE NO_COMPU_METHOD 0 0 -8.8 8.8 DISPLAY_IDENTIFIER CombAsstSV ECU_ADDRESS 0 PHYS_UNIT "MtrNm" READ_WRITE /end MEASUREMENT
/begin MEASUREMENT AssistFirewall_CombinedAssist_MtrNm_f32 "Combined and limited motor torque commands" FLOAT32_IEEE NO_COMPU_METHOD 0 0 -26.4 26.4 DISPLAY_IDENTIFIER CombinedAssist ECU_ADDRESS 0 PHYS_UNIT "MtrNm" READ_WRITE SYMBOL_LINK "Rte_AssistFirewall_CombinedAssist_MtrNm_f32" 0 /end MEASUREMENT
/begin MEASUREMENT HiFreqKSV_M_str.CF_Uls_f32 "" FLOAT32_IEEE NO_COMPU_METHOD 0 0 1.00062863343003 2.09537952223205 ECU_ADDRESS 0 PHYS_UNIT "Unitless" READ_WRITE /end MEASUREMENT
/begin MEASUREMENT HiFreqKSV_M_str.LPF_Str.K_Uls_f32 "" FLOAT32_IEEE NO_COMPU_METHOD 0 0 1.25584782371357E-03 0.71539045666397 ECU_ADDRESS 0 PHYS_UNIT "Unitless" READ_WRITE /end MEASUREMENT
/begin MEASUREMENT HiFreqKSV_M_str.LPF_Str.SV_Uls_f32 "" FLOAT32_IEEE NO_COMPU_METHOD 0 0 -8.8 8.8 ECU_ADDRESS 0 PHYS_UNIT "Unitless" READ_WRITE /end MEASUREMENT
/begin MEASUREMENT LwrBoundKSV_M_str.K_Uls_f32 "" FLOAT32_IEEE NO_COMPU_METHOD 0 0 1.25584782371357E-03 0.71539045666397 ECU_ADDRESS 0 PHYS_UNIT "Unitless" READ_WRITE /end MEASUREMENT
/begin MEASUREMENT LwrBoundKSV_M_str.SV_Uls_f32 "" FLOAT32_IEEE NO_COMPU_METHOD 0 0 -8.8 8.8 ECU_ADDRESS 0 PHYS_UNIT "Unitless" READ_WRITE /end MEASUREMENT
/begin MEASUREMENT PNCountStatus_Cnt_M_lgc "" UBYTE Boolean 0 0 0 1 DISPLAY_IDENTIFIER AsstFW_PNCountStatus ECU_ADDRESS 0 PHYS_UNIT "Counts" READ_WRITE /end MEASUREMENT
/begin MEASUREMENT UprBoundKSV_M_str.K_Uls_f32 "" FLOAT32_IEEE NO_COMPU_METHOD 0 0 1.25584782371357E-03 0.71539045666397 ECU_ADDRESS 0 PHYS_UNIT "Unitless" READ_WRITE /end MEASUREMENT
/begin MEASUREMENT UprBoundKSV_M_str.SV_Uls_f32 "" FLOAT32_IEEE NO_COMPU_METHOD 0 0 -8.8 8.8 ECU_ADDRESS 0 PHYS_UNIT "Unitless" READ_WRITE /end MEASUREMENT
/begin MEASUREMENT CondPullComp_MtrNm_D_f32 "" FLOAT32_IEEE NO_COMPU_METHOD 0 0 -8.8 8.8 DISPLAY_IDENTIFIER SumLim_PlCmpLocal ECU_ADDRESS 0 PHYS_UNIT "MtrNm" READ_WRITE /end MEASUREMENT
/begin MEASUREMENT AssistSumnLmt_LimitPercentFiltered_Uls_f32 "" FLOAT32_IEEE NO_COMPU_METHOD 0 0 0 1 DISPLAY_IDENTIFIER Limit_Percent_Filtered ECU_ADDRESS 0 PHYS_UNIT "Uls" READ_WRITE SYMBOL_LINK "Rte_AssistSumnLmt_LimitPercentFiltered_Uls_f32" 0 /end MEASUREMENT
/begin MEASUREMENT LrnPnCntrTCmd_MtrNm_D_f32 "" FLOAT32_IEEE NO_COMPU_METHOD 0 0 -8.8 8.8 DISPLAY_IDENTIFIER SumLim_LrnPnCtrLocal ECU_ADDRESS 0 PHYS_UNIT "MtrNm" READ_WRITE /end MEASUREMENT
/begin MEASUREMENT ManualTrqCmd_MtrNm_M_f32 "" FLOAT32_IEEE NO_COMPU_METHOD 0 0 -8.8 8.8 DISPLAY_IDENTIFIER ManualTrqCmd ECU_ADDRESS 0 PHYS_UNIT "MtrNm" READ_WRITE /end MEASUREMENT
/begin MEASUREMENT OpTrqOvSV_MtrNm_M_f32 "" FLOAT32_IEEE NO_COMPU_METHOD 0 0 -8.8 8.8 DISPLAY_IDENTIFIER SumLim_OpTrqOvrLocal ECU_ADDRESS 0 PHYS_UNIT "MtrNm" READ_WRITE /end MEASUREMENT
/begin MEASUREMENT OpTrqRmpcomplete_Cnt_M_lgc "" UBYTE Boolean 0 0 0 1 DISPLAY_IDENTIFIER OpTrqRmpcomplete_lgc ECU_ADDRESS 0 PHYS_UNIT "Cnt" READ_WRITE /end MEASUREMENT
/begin MEASUREMENT AssistSumnLmt_PostLimitTorque_MtrNm_f32 "" FLOAT32_IEEE NO_COMPU_METHOD 0 0 -8.8 8.8 DISPLAY_IDENTIFIER PostLimitTorque ECU_ADDRESS 0 PHYS_UNIT "MtrNm" READ_WRITE SYMBOL_LINK "Rte_AssistSumnLmt_PostLimitTorque_MtrNm_f32" 0 /end MEASUREMENT
/begin MEASUREMENT AssistSumnLmt_PreLimitForPower_MtrNm_f32 "" FLOAT32_IEEE NO_COMPU_METHOD 0 0 0 8.8 DISPLAY_IDENTIFIER PreLimit_ForPower ECU_ADDRESS 0 PHYS_UNIT "MtrNm" READ_WRITE SYMBOL_LINK "Rte_AssistSumnLmt_PreLimitForPower_MtrNm_f32" 0 /end MEASUREMENT
/begin MEASUREMENT AssistSumnLmt_PreLimitForStall_MtrNm_f32 "" FLOAT32_IEEE NO_COMPU_METHOD 0 0 0 8.8 DISPLAY_IDENTIFIER PreLimit_ForStall ECU_ADDRESS 0 PHYS_UNIT "MtrNm" READ_WRITE SYMBOL_LINK "Rte_AssistSumnLmt_PreLimitForStall_MtrNm_f32" 0 /end MEASUREMENT
/begin MEASUREMENT AssistSumnLmt_PreLimitTorque_MtrNm_f32 "" FLOAT32_IEEE NO_COMPU_METHOD 0 0 -8.8 8.8 DISPLAY_IDENTIFIER PreLimitTorque ECU_ADDRESS 0 PHYS_UNIT "MtrNm" READ_WRITE SYMBOL_LINK "Rte_AssistSumnLmt_PreLimitTorque_MtrNm_f32" 0 /end MEASUREMENT
/begin MEASUREMENT PrkAstCmd_MtrNm_D_f32 "" FLOAT32_IEEE NO_COMPU_METHOD 0 0 -8.8 8.8 DISPLAY_IDENTIFIER SumLim_PrkAstLocal ECU_ADDRESS 0 PHYS_UNIT "MtrNm" READ_WRITE /end MEASUREMENT
/begin MEASUREMENT SlewRate_MtrNmpS_D_f32 "" FLOAT32_IEEE NO_COMPU_METHOD 0 0 1 4400 DISPLAY_IDENTIFIER SlewRate_MtrNmpS ECU_ADDRESS 0 PHYS_UNIT "MtrNMpS" READ_WRITE /end MEASUREMENT
/begin MEASUREMENT BatteryVoltage_SysC_Vecu_Volt_f32 "" FLOAT32_IEEE NO_COMPU_METHOD 0 0 5 31 DISPLAY_IDENTIFIER SysC_Vecu ECU_ADDRESS 0 PHYS_UNIT "Volts" READ_WRITE SYMBOL_LINK "Rte_BatteryVoltage_SysC_Vecu_Volt_f32" 0 /end MEASUREMENT
/begin MEASUREMENT SysCVecu_Volts_M_f32 "" FLOAT32_IEEE NO_COMPU_METHOD 0 0 5 31 ECU_ADDRESS 0 PHYS_UNIT "Volts" READ_WRITE /end MEASUREMENT
/begin MEASUREMENT BatteryVoltage_Vecu_Volts_f32 "Calculated Controller input voltage" FLOAT32_IEEE NO_COMPU_METHOD 0 0 5 31 DISPLAY_IDENTIFIER Vecu ECU_ADDRESS 0 PHYS_UNIT "Volts" READ_WRITE SYMBOL_LINK "Rte_BatteryVoltage_Vecu_Volts_f32" 0 /end MEASUREMENT
/begin MEASUREMENT Vecu_Volts_M_f32 "" FLOAT32_IEEE NO_COMPU_METHOD 0 0 5 31 ECU_ADDRESS 0 PHYS_UNIT "Volts" READ_WRITE /end MEASUREMENT
/begin MEASUREMENT VecuVbatCorrErrAcc_Cnt_M_u16 "" UWORD NO_COMPU_METHOD 0 0 0 255 DISPLAY_IDENTIFIER VecuVbat_CorrError_Acc ECU_ADDRESS 0 PHYS_UNIT "Cnt" READ_WRITE /end MEASUREMENT
/begin MEASUREMENT VecuVbatCorrLimDiff_Volts_D_f32 "" FLOAT32_IEEE NO_COMPU_METHOD 0 0 0 26 DISPLAY_IDENTIFIER VecuVbat_CorrLim_Diff ECU_ADDRESS 0 PHYS_UNIT "Volts" READ_WRITE /end MEASUREMENT
/begin MEASUREMENT BatteryVoltage_VswitchClosed_Cnt_lgc "Switch open/closed status" UBYTE Boolean 0 0 0 1 DISPLAY_IDENTIFIER VSswitchClosed ECU_ADDRESS 0 READ_WRITE SYMBOL_LINK "Rte_BatteryVoltage_VswitchClosed_Cnt_lgc" 0 /end MEASUREMENT
/begin MEASUREMENT VswitchClosed_Cnt_M_lgc "" UBYTE Boolean 0 0 0 1 ECU_ADDRESS 0 READ_WRITE /end MEASUREMENT
/begin MEASUREMENT VswitchCorrErrAcc_Cnt_M_u16 "" UWORD NO_COMPU_METHOD 0 0 0 255 DISPLAY_IDENTIFIER Vswitch_CorrError_Acc ECU_ADDRESS 0 PHYS_UNIT "Cnt" READ_WRITE /end MEASUREMENT
/begin MEASUREMENT VswitchCorrLimDiff_Volts_D_f32 "" FLOAT32_IEEE NO_COMPU_METHOD 0 0 0 26 DISPLAY_IDENTIFIER Vswitch_CorrLim_Diff ECU_ADDRESS 0 PHYS_UNIT "Volts" READ_WRITE /end MEASUREMENT
/begin MEASUREMENT LowClrInitBD_ms_M_u32p0 "" SLONG NO_COMPU_METHOD 0 0 0 65535 DISPLAY_IDENTIFIER Low_Clr_Init ECU_ADDRESS 0 PHYS_UNIT "ms" READ_WRITE /end MEASUREMENT
/begin MEASUREMENT LowSetInitBD_ms_M_u32p0 "" SLONG NO_COMPU_METHOD 0 0 0 65535 DISPLAY_IDENTIFIER Low_Set_Init ECU_ADDRESS 0 PHYS_UNIT "ms" READ_WRITE /end MEASUREMENT
/begin MEASUREMENT OvClrInitBD_ms_M_u32p0 "" SLONG NO_COMPU_METHOD 0 0 0 65535 DISPLAY_IDENTIFIER Ov_Clr_Init ECU_ADDRESS 0 PHYS_UNIT "ms" READ_WRITE /end MEASUREMENT
/begin MEASUREMENT OvSetInitBD_ms_M_u32p0 "" SLONG NO_COMPU_METHOD 0 0 0 65535 DISPLAY_IDENTIFIER Ov_Set_Init ECU_ADDRESS 0 PHYS_UNIT "ms" READ_WRITE /end MEASUREMENT
/begin MEASUREMENT CtrldDisShtdn_CntDisMtrTrqCmdCRF_MtrNm_f32 "" FLOAT32_IEEE NO_COMPU_METHOD 0 0 -8.8 8.8 DISPLAY_IDENTIFIER Torque_Cmd_CRF ECU_ADDRESS 0 PHYS_UNIT "MtrNm" READ_WRITE SYMBOL_LINK "Rte_CtrldDisShtdn_CntDisMtrTrqCmdCRF_MtrNm_f32" 0 /end MEASUREMENT
/begin MEASUREMENT CtrldDisShtdn_CntDisMtrTrqCmdMRF_MtrNm_f32 "" FLOAT32_IEEE NO_COMPU_METHOD 0 0 -8.8 8.8 DISPLAY_IDENTIFIER Torque_Cmd_MRF ECU_ADDRESS 0 PHYS_UNIT "MtrNm" READ_WRITE SYMBOL_LINK "Rte_CtrldDisShtdn_CntDisMtrTrqCmdMRF_MtrNm_f32" 0 /end MEASUREMENT
/begin MEASUREMENT CntrlDampElpsdTime_mS_D_u16 "" UWORD NO_COMPU_METHOD 0 0 0 65535 DISPLAY_IDENTIFIER ElapsedTime ECU_ADDRESS 0 PHYS_UNIT "mS" READ_WRITE /end MEASUREMENT
/begin MEASUREMENT CntrlDampTrq_MtrNm_D_f32 "" FLOAT32_IEEE NO_COMPU_METHOD 0 0 -5.75 5.75 DISPLAY_IDENTIFIER CntrlDampTrq ECU_ADDRESS 0 PHYS_UNIT "MtrNm" READ_WRITE /end MEASUREMENT
/begin MEASUREMENT CntrlDampVelTrq_MtrNm_D_f32 "" FLOAT32_IEEE NO_COMPU_METHOD 0 0 -2200 2200 DISPLAY_IDENTIFIER CntrlDamp_VelTrq ECU_ADDRESS 0 PHYS_UNIT "MtrNm" READ_WRITE /end MEASUREMENT
/begin MEASUREMENT CtrldDisShtdn_CtrldDmpStsCmp_Cnt_lgc "" UBYTE Boolean 0 0 0 1 DISPLAY_IDENTIFIER Controlled_Damp_Status_Complete ECU_ADDRESS 0 PHYS_UNIT "Counts" READ_WRITE SYMBOL_LINK "Rte_CtrldDisShtdn_CtrldDmpStsCmp_Cnt_lgc" 0 /end MEASUREMENT
/begin MEASUREMENT LastF2Fault_mS_M_u32 "" ULONG NO_COMPU_METHOD 0 0 0 1000 ECU_ADDRESS 0 PHYS_UNIT "mS" READ_WRITE /end MEASUREMENT
/begin MEASUREMENT CtrldDisShtdn_SysC_CRFMtrTrqCmd_MtrNm_f32 "" FLOAT32_IEEE NO_COMPU_METHOD 0 0 -8.8 8.8 DISPLAY_IDENTIFIER CntDisMtrTrqCmd_CRF ECU_ADDRESS 0 PHYS_UNIT "MtrNm" READ_WRITE SYMBOL_LINK "Rte_CtrldDisShtdn_SysC_CRFMtrTrqCmd_MtrNm_f32" 0 /end MEASUREMENT
/begin MEASUREMENT CtrldDisShtdn_SysC_MRFMtrTrqCmd_MtrNm_f32 "" FLOAT32_IEEE NO_COMPU_METHOD 0 0 -8.8 8.8 DISPLAY_IDENTIFIER SysC_MRFMtrTrqCmd_MtrNm_f32 ECU_ADDRESS 0 PHYS_UNIT "MtrNm" READ_WRITE SYMBOL_LINK "Rte_CtrldDisShtdn_SysC_MRFMtrTrqCmd_MtrNm_f32" 0 /end MEASUREMENT
/begin MEASUREMENT CtrlTemp_DegC_M_f32 "" FLOAT32_IEEE NO_COMPU_METHOD 0 0 -50 150 ECU_ADDRESS 0 PHYS_UNIT "DegC" READ_WRITE /end MEASUREMENT
/begin MEASUREMENT CtrlTempErrorAcc_Cnt_M_u16 "" UWORD NO_COMPU_METHOD 0 0 0 65535 ECU_ADDRESS 0 PHYS_UNIT "Counts" READ_WRITE /end MEASUREMENT
/begin MEASUREMENT CtrlTempFiltOut_DegC_D_f32 "" FLOAT32_IEEE NO_COMPU_METHOD 0 0 -50 150 DISPLAY_IDENTIFIER Temp_Filter_Output ECU_ADDRESS 0 PHYS_UNIT "DegC" READ_WRITE /end MEASUREMENT
/begin MEASUREMENT CtrlTemp_FiltMeasTemp_DegC_f32 "" FLOAT32_IEEE NO_COMPU_METHOD 0 0 -50 150 DISPLAY_IDENTIFIER Filt_Meas_Temp ECU_ADDRESS 0 PHYS_UNIT "DegC" READ_WRITE SYMBOL_LINK "Rte_CtrlTemp_FiltMeasTemp_DegC_f32" 0 /end MEASUREMENT
/begin MEASUREMENT CustPL_BMW_CCLMSAActive_Cnt_lgc "" UBYTE Boolean 0 0 0 1 DISPLAY_IDENTIFIER CCL_MSAActive ECU_ADDRESS 0 PHYS_UNIT "Cnt" READ_WRITE SYMBOL_LINK "Rte_CustPL_BMW_CCLMSAActive_Cnt_lgc" 0 /end MEASUREMENT
/begin MEASUREMENT CCLMSAActive_Cnt_M_lgc "" UBYTE Boolean 0 0 0 1 DISPLAY_IDENTIFIER CCL_MSAActive ECU_ADDRESS 0 PHYS_UNIT "Cnt" READ_WRITE /end MEASUREMENT
/begin MEASUREMENT CustPL_BMW_CustCurrLmt_Amps_f32 "" FLOAT32_IEEE NO_COMPU_METHOD 0 0 0 150 DISPLAY_IDENTIFIER CustCurrLmt_Amps ECU_ADDRESS 0 PHYS_UNIT "Amp" READ_WRITE SYMBOL_LINK "Rte_CustPL_BMW_CustCurrLmt_Amps_f32" 0 /end MEASUREMENT
/begin MEASUREMENT MSAAssistEnable_Cnt_D_lgc "" UBYTE Boolean 0 0 0 1 DISPLAY_IDENTIFIER MSAAssistEnable ECU_ADDRESS 0 PHYS_UNIT "Cnt" READ_WRITE /end MEASUREMENT
/begin MEASUREMENT MSACurrLimit_Amps_M_f32 "" FLOAT32_IEEE NO_COMPU_METHOD 0 0 0 150 DISPLAY_IDENTIFIER MSACurrLimit_Ampsn ECU_ADDRESS 0 PHYS_UNIT "Amp" READ_WRITE /end MEASUREMENT
/begin MEASUREMENT MSAImax_Amps_M_f32 "" FLOAT32_IEEE NO_COMPU_METHOD 0 0 0 150 DISPLAY_IDENTIFIER MSAImax_Amps ECU_ADDRESS 0 PHYS_UNIT "Amp" READ_WRITE /end MEASUREMENT
/begin MEASUREMENT PrevMSACurrLimit_Amps_M_f32 "" FLOAT32_IEEE NO_COMPU_METHOD 0 0 0 150 DISPLAY_IDENTIFIER MSACurrLimit_Ampsn1 ECU_ADDRESS 0 PHYS_UNIT "Amp" READ_WRITE /end MEASUREMENT
/begin MEASUREMENT PrevTMSAClock_Sec_M_f32 "" FLOAT32_IEEE NO_COMPU_METHOD 0 0 0 5 DISPLAY_IDENTIFIER tMSAClock_Secn1 ECU_ADDRESS 0 PHYS_UNIT "Sec" READ_WRITE /end MEASUREMENT
/begin MEASUREMENT Ramp1Complete_Cnt_D_lgc "" UBYTE Boolean 0 0 0 1 DISPLAY_IDENTIFIER Ramp1Complete ECU_ADDRESS 0 PHYS_UNIT "Cnt" READ_WRITE /end MEASUREMENT
/begin MEASUREMENT Ramp2Complete_Cnt_D_lgc "" UBYTE Boolean 0 0 0 1 DISPLAY_IDENTIFIER Ramp2Complete ECU_ADDRESS 0 PHYS_UNIT "Cnt" READ_WRITE /end MEASUREMENT
/begin MEASUREMENT Ramp3Complete_Cnt_D_lgc "" UBYTE Boolean 0 0 0 1 DISPLAY_IDENTIFIER Ramp3Complete ECU_ADDRESS 0 PHYS_UNIT "Cnt" READ_WRITE /end MEASUREMENT
/begin MEASUREMENT Ramp4Complete_Cnt_D_lgc "" UBYTE Boolean 0 0 0 1 DISPLAY_IDENTIFIER Ramp4Complete ECU_ADDRESS 0 PHYS_UNIT "Cnt" READ_WRITE /end MEASUREMENT
/begin MEASUREMENT RampIncDec_Amps_M_f32 "" FLOAT32_IEEE NO_COMPU_METHOD 0 0 0 150 DISPLAY_IDENTIFIER RampIncDec_Amps ECU_ADDRESS 0 PHYS_UNIT "Amp" READ_WRITE /end MEASUREMENT
/begin MEASUREMENT SupplyLmt_Amps_D_f32 "" FLOAT32_IEEE NO_COMPU_METHOD 0 0 0 150 DISPLAY_IDENTIFIER Supply_current_limit ECU_ADDRESS 0 PHYS_UNIT "Amp" READ_WRITE /end MEASUREMENT
/begin MEASUREMENT Thresh1_Amps_M_f32 "" FLOAT32_IEEE NO_COMPU_METHOD 0 0 0 150 DISPLAY_IDENTIFIER Thresh1_Amps ECU_ADDRESS 0 PHYS_UNIT "Amp" READ_WRITE /end MEASUREMENT
/begin MEASUREMENT TMSAClock_Sec_M_f32 "" FLOAT32_IEEE NO_COMPU_METHOD 0 0 0 5 DISPLAY_IDENTIFIER tMSAClock_Secn ECU_ADDRESS 0 PHYS_UNIT "Sec" READ_WRITE /end MEASUREMENT
/begin MEASUREMENT TMSAExpired_Cnt_D_lgc "" UBYTE Boolean 0 0 0 1 DISPLAY_IDENTIFIER tMSAExpired ECU_ADDRESS 0 PHYS_UNIT "Cnt" READ_WRITE /end MEASUREMENT
/begin MEASUREMENT VspdDepIbatLmt_Amps_D_f32 "" FLOAT32_IEEE NO_COMPU_METHOD 0 0 0 150 DISPLAY_IDENTIFIER Vspd_Dep_Ibat_Limit_Amps ECU_ADDRESS 0 PHYS_UNIT "Amp" READ_WRITE /end MEASUREMENT
/begin MEASUREMENT DampHPSc1_Uls_D_f32 "" FLOAT32_IEEE NO_COMPU_METHOD 0 0 -2147483648 2147483647 DISPLAY_IDENTIFIER Damp_HPSc1 ECU_ADDRESS 0 PHYS_UNIT "Uls" READ_WRITE /end MEASUREMENT
/begin MEASUREMENT DampHPSc2_Uls_D_f32 "" FLOAT32_IEEE NO_COMPU_METHOD 0 0 -2147483648 2147483647 DISPLAY_IDENTIFIER Damp_HPSc2 ECU_ADDRESS 0 PHYS_UNIT "Uls" READ_WRITE /end MEASUREMENT
/begin MEASUREMENT DampHPSc3_Uls_D_f32 "" FLOAT32_IEEE NO_COMPU_METHOD 0 0 -2147483648 2147483647 DISPLAY_IDENTIFIER Damp_HPSc3 ECU_ADDRESS 0 PHYS_UNIT "Uls" READ_WRITE /end MEASUREMENT
/begin MEASUREMENT DampHPSc4_Uls_D_f32 "" FLOAT32_IEEE NO_COMPU_METHOD 0 0 -2147483648 2147483647 DISPLAY_IDENTIFIER Damp_HPSc4 ECU_ADDRESS 0 PHYS_UNIT "Uls" READ_WRITE /end MEASUREMENT
/begin MEASUREMENT DampHPSDmp_MtrNm_D_f32 "" FLOAT32_IEEE NO_COMPU_METHOD 0 0 -2147483648 2147483647 DISPLAY_IDENTIFIER Damp_HPSDmp ECU_ADDRESS 0 PHYS_UNIT "MtrNm" READ_WRITE /end MEASUREMENT
/begin MEASUREMENT Damping_DampingCmd_MtrNm_f32 "" FLOAT32_IEEE NO_COMPU_METHOD 0 0 -8.8 8.8 DISPLAY_IDENTIFIER DampingCmd ECU_ADDRESS 0 PHYS_UNIT "MtrNm" READ_WRITE SYMBOL_LINK "Rte_Damping_DampingCmd_MtrNm_f32" 0 /end MEASUREMENT
/begin MEASUREMENT DampMtrVelDmp_MtrNm_D_f32 "" FLOAT32_IEEE NO_COMPU_METHOD 0 0 -2147483648 2147483647 DISPLAY_IDENTIFIER Damp_MtrVelDmp ECU_ADDRESS 0 PHYS_UNIT "MtrNm" READ_WRITE /end MEASUREMENT
/begin MEASUREMENT DampTempScale_Uls_D_u4p12 "" UWORD u4p12_T 0 0 0 15.999755 DISPLAY_IDENTIFIER Damp_TempScale ECU_ADDRESS 0 PHYS_UNIT "Uls" READ_WRITE /end MEASUREMENT
/begin MEASUREMENT DampTrqScale_Uls_D_u1p15 "" UWORD u1p15_T 0 0 0 1.99996948 DISPLAY_IDENTIFIER Damp_TrqScale ECU_ADDRESS 0 PHYS_UNIT "Uls" READ_WRITE /end MEASUREMENT
/begin MEASUREMENT MtrVelLPFKSV_Cnt_M_str.K_Uls_f32 "" FLOAT32_IEEE NO_COMPU_METHOD 0 0 0 1 ECU_ADDRESS 0 PHYS_UNIT "Uls" READ_WRITE /end MEASUREMENT
/begin MEASUREMENT MtrVelLPFKSV_Cnt_M_str.SV_Uls_f32 "" FLOAT32_IEEE NO_COMPU_METHOD 0 0 -1118 1118 ECU_ADDRESS 0 PHYS_UNIT "Uls" READ_WRITE /end MEASUREMENT
/begin MEASUREMENT QDDHwTorqueLPFKSV_Cnt_M_str.K_Uls_f32 "" FLOAT32_IEEE NO_COMPU_METHOD 0 0 0 1 ECU_ADDRESS 0 PHYS_UNIT "Uls" READ_WRITE /end MEASUREMENT
/begin MEASUREMENT QDDHwTorqueLPFKSV_Cnt_M_str.SV_Uls_f32 "" FLOAT32_IEEE NO_COMPU_METHOD 0 0 -10 10 ECU_ADDRESS 0 PHYS_UNIT "Uls" READ_WRITE /end MEASUREMENT
/begin MEASUREMENT QDDHwTrqBkLash_HwNm_M_f32 "" FLOAT32_IEEE NO_COMPU_METHOD 0 0 -10 10 DISPLAY_IDENTIFIER Damp_QDDHwTrqBkLash ECU_ADDRESS 0 PHYS_UNIT "HwNm" READ_WRITE /end MEASUREMENT
/begin MEASUREMENT QDDMtrVelBckLash_MtrRadpS_M_f32 "" FLOAT32_IEEE NO_COMPU_METHOD 0 0 -1118 1118 DISPLAY_IDENTIFIER Damp_QDDMtrVelBkLash ECU_ADDRESS 0 PHYS_UNIT "MtrRadpS" READ_WRITE /end MEASUREMENT
/begin MEASUREMENT QDDMtrVelLPFKSV_Cnt_M_str.K_Uls_f32 "" FLOAT32_IEEE NO_COMPU_METHOD 0 0 0 1 ECU_ADDRESS 0 PHYS_UNIT "Uls" READ_WRITE /end MEASUREMENT
/begin MEASUREMENT QDDMtrVelLPFKSV_Cnt_M_str.SV_Uls_f32 "" FLOAT32_IEEE NO_COMPU_METHOD 0 0 -1118 1118 ECU_ADDRESS 0 PHYS_UNIT "Uls" READ_WRITE /end MEASUREMENT
/begin MEASUREMENT QDDStFilt_Cnt_M_str.K_Uls_f32 "" FLOAT32_IEEE NO_COMPU_METHOD 0 0 0 1 ECU_ADDRESS 0 PHYS_UNIT "Uls" READ_WRITE /end MEASUREMENT
/begin MEASUREMENT QDDStFilt_Cnt_M_str.SV_Uls_f32 "" FLOAT32_IEEE NO_COMPU_METHOD 0 0 0 2 ECU_ADDRESS 0 PHYS_UNIT "Uls" READ_WRITE /end MEASUREMENT
/begin MEASUREMENT QDDStFilt_Uls_D_f32 "" FLOAT32_IEEE NO_COMPU_METHOD 0 0 0 2 DISPLAY_IDENTIFIER Damp_QDDSfFiltO ECU_ADDRESS 0 PHYS_UNIT "Uls" READ_WRITE /end MEASUREMENT
/begin MEASUREMENT ADDCoefCalc_MtrNmSpRad_D_u0p16 "" UWORD u0p16_T 0 0 0 0.05 DISPLAY_IDENTIFIER ADDCoefCalc_MtrNmSpRad ECU_ADDRESS 0 PHYS_UNIT "MtrNmSpRad" READ_WRITE /end MEASUREMENT
/begin MEASUREMENT DampingFirewall_CombinedDamping_MtrNm_f32 "Combined and limited motor torque commands" FLOAT32_IEEE NO_COMPU_METHOD 0 0 -8.8 -8.8 DISPLAY_IDENTIFIER CombinedDamping ECU_ADDRESS 0 PHYS_UNIT "MtrNm" READ_WRITE SYMBOL_LINK "Rte_DampingFirewall_CombinedDamping_MtrNm_f32" 0 /end MEASUREMENT
/begin MEASUREMENT DampFWActiveKSV_M_str.K_Uls_f32 "" FLOAT32_IEEE NO_COMPU_METHOD 0 0 1.25584782371357E-03 0.71539045666397 ECU_ADDRESS 0 PHYS_UNIT "Unitless" READ_WRITE /end MEASUREMENT
/begin MEASUREMENT DampFWActiveKSV_M_str.SV_Uls_f32 "" FLOAT32_IEEE NO_COMPU_METHOD 0 0 0 1 ECU_ADDRESS 0 PHYS_UNIT "Unitless" READ_WRITE /end MEASUREMENT
/begin MEASUREMENT DampFWAddedDamp_MtrNm_D_f32 "" FLOAT32_IEEE NO_COMPU_METHOD 0 0 -8.8 -8.8 DISPLAY_IDENTIFIER DampFW_AddedDamp ECU_ADDRESS 0 PHYS_UNIT "MtrNm" READ_WRITE /end MEASUREMENT
/begin MEASUREMENT DampFWAddedDampAFW_MtrNm_D_f32 "" FLOAT32_IEEE NO_COMPU_METHOD 0 0 -8.8 -8.8 DISPLAY_IDENTIFIER DampFW_AddedDampAFW ECU_ADDRESS 0 PHYS_UNIT "MtrNm" READ_WRITE /end MEASUREMENT
/begin MEASUREMENT DampFWAddedDampDFW_MtrNm_D_f32 "" FLOAT32_IEEE NO_COMPU_METHOD 0 0 -8.8 -8.8 DISPLAY_IDENTIFIER DampFW_AddedDampDFW ECU_ADDRESS 0 PHYS_UNIT "MtrNm" READ_WRITE /end MEASUREMENT
/begin MEASUREMENT DampFWDampActive_Uls_D_f32 "" FLOAT32_IEEE NO_COMPU_METHOD 0 0 0 1 DISPLAY_IDENTIFIER DampFW_Active ECU_ADDRESS 0 PHYS_UNIT "Uls" READ_WRITE /end MEASUREMENT
/begin MEASUREMENT DampFWDefltDamp_MtrNm_D_f32 "" FLOAT32_IEEE NO_COMPU_METHOD 0 0 -8.8 -8.8 DISPLAY_IDENTIFIER DampFW_DefaultDamp ECU_ADDRESS 0 PHYS_UNIT "MtrNm" READ_WRITE /end MEASUREMENT
/begin MEASUREMENT DampFWDiverseVBIC_MtrNm_D_f32 "" FLOAT32_IEEE NO_COMPU_METHOD 0 0 -8.8 8.8 DISPLAY_IDENTIFIER DampFW_DiverseVBIC ECU_ADDRESS 0 PHYS_UNIT "MtrNm" READ_WRITE /end MEASUREMENT
/begin MEASUREMENT DampFWInrtCmpPNStatus_Cnt_M_lgc "" UBYTE Boolean 0 0 0 1 ECU_ADDRESS 0 PHYS_UNIT "Cnt" READ_WRITE /end MEASUREMENT
/begin MEASUREMENT DampFWLimitedVBIC_MtrNm_D_f32 "" FLOAT32_IEEE NO_COMPU_METHOD 0 0 -8.8 8.8 DISPLAY_IDENTIFIER DampFW_VBICLimited ECU_ADDRESS 0 PHYS_UNIT "MtrNm" READ_WRITE /end MEASUREMENT
/begin MEASUREMENT DampFWLwrBound_MtrNm_D_f32 "" FLOAT32_IEEE NO_COMPU_METHOD 0 0 -8.8 -8.8 DISPLAY_IDENTIFIER DampFW_LwrBound ECU_ADDRESS 0 PHYS_UNIT "MtrNm" READ_WRITE /end MEASUREMENT
/begin MEASUREMENT DampFWOverBound_Cnt_D_lgc "" UBYTE Boolean 0 0 0 1 DISPLAY_IDENTIFIER DampFW_DampOverBound ECU_ADDRESS 0 PHYS_UNIT "Cnt" READ_WRITE /end MEASUREMENT
/begin MEASUREMENT DampFWPNCountStatus_Cnt_M_lgc "" UBYTE Boolean 0 0 0 1 DISPLAY_IDENTIFIER DampFW_DampPNStatus ECU_ADDRESS 0 PHYS_UNIT "Cnt" READ_WRITE /end MEASUREMENT
/begin MEASUREMENT DampFWPrev1PreAttnComp_MtrNm_M_s9p6 "" SWORD s9p6_T 0 0 -512 511.9843 ECU_ADDRESS 0 PHYS_UNIT "MtrNm" READ_WRITE /end MEASUREMENT
/begin MEASUREMENT DampFWPrev1SclDrvVel_MtrRadpS_M_s14p1 "" SWORD s14p1_T 0 0 -10000 10000 ECU_ADDRESS 0 PHYS_UNIT "RadpS" READ_WRITE /end MEASUREMENT
/begin MEASUREMENT DampFWPrev2PreAttnComp_MtrNm_M_s9p6 "" SWORD s9p6_T 0 0 -512 511.9843 ECU_ADDRESS 0 PHYS_UNIT "MtrNm" READ_WRITE /end MEASUREMENT
/begin MEASUREMENT DampFWPrev2SclDrvVel_MtrRadpS_M_s14p1 "" SWORD s14p1_T 0 0 -10000 10000 ECU_ADDRESS 0 PHYS_UNIT "RadpS" READ_WRITE /end MEASUREMENT
/begin MEASUREMENT DampFWPrevTbarAng_HwDeg_M_s6p9 "" SWORD s6p9_T 0 0 -40 40 ECU_ADDRESS 0 PHYS_UNIT "HwDeg" READ_WRITE /end MEASUREMENT
/begin MEASUREMENT DampFWSatDamp_MtrNm_D_f32 "" FLOAT32_IEEE NO_COMPU_METHOD 0 0 -8.8 -8.8 DISPLAY_IDENTIFIER DampFW_SatDamp ECU_ADDRESS 0 PHYS_UNIT "MtrNm" READ_WRITE /end MEASUREMENT
/begin MEASUREMENT DampFWTbarVelFiltSv_HwDegpSec_M_s15p16 "" SLONG s15p16_T 0 0 -32768 32767 ECU_ADDRESS 0 PHYS_UNIT "HwDegpSec" READ_WRITE /end MEASUREMENT
/begin MEASUREMENT DampFWTbarVelFiltSv_M_str.K_Uls_f32 "" FLOAT32_IEEE NO_COMPU_METHOD 0 0 1.25584782371357E-03 0.715390456663971 ECU_ADDRESS 0 PHYS_UNIT "Unitless" READ_WRITE /end MEASUREMENT
/begin MEASUREMENT DampFWTbarVelFiltSv_M_str.SV_Uls_f32 "" FLOAT32_IEEE NO_COMPU_METHOD 0 0 -2147483648 2147483647 ECU_ADDRESS 0 PHYS_UNIT "Unitless" READ_WRITE /end MEASUREMENT
/begin MEASUREMENT DampFWUprBound_MtrNm_D_f32 "" FLOAT32_IEEE NO_COMPU_METHOD 0 0 -8.8 -8.8 DISPLAY_IDENTIFIER DampFW_UprBound ECU_ADDRESS 0 PHYS_UNIT "MtrNm" READ_WRITE /end MEASUREMENT
/begin MEASUREMENT DampFWVBICOverThresh_Cnt_D_lgc "" UBYTE Boolean 0 0 0 1 DISPLAY_IDENTIFIER DampFW_VBICOverThresh ECU_ADDRESS 0 PHYS_UNIT "Cnt" READ_WRITE /end MEASUREMENT
/begin MEASUREMENT DampFWVBICReducedPerfSV_Cnt_M_lgc "" UBYTE Boolean 0 0 0 1 DISPLAY_IDENTIFIER DampFW_VBICReducedPerf ECU_ADDRESS 0 PHYS_UNIT "Cnt" READ_WRITE /end MEASUREMENT
/begin MEASUREMENT DampPNAcc_Cnt_M_u16 "" UWORD NO_COMPU_METHOD 0 0 0 65535 DISPLAY_IDENTIFIER DampFW_DampPNAccum ECU_ADDRESS 0 PHYS_UNIT "Counts" READ_WRITE /end MEASUREMENT
/begin MEASUREMENT DecelGain_Uls_D_u5p11 "" UWORD u5p11_T 0 0 1 10 DISPLAY_IDENTIFIER DecelGain_Uls ECU_ADDRESS 0 PHYS_UNIT "Uls" READ_WRITE /end MEASUREMENT
/begin MEASUREMENT DriverVel_MtrRadpSec_D_s24p7 "" SLONG s24p7_T 0 0 -36024.58504 36024.58504 DISPLAY_IDENTIFIER DriverVel_MtrRadpSec ECU_ADDRESS 0 PHYS_UNIT "MtrRadpSec" READ_WRITE /end MEASUREMENT
/begin MEASUREMENT FiltFreq_RadpS_D_s10p5 "" SWORD s10p5_T 0 0 6.2831 628.3185 DISPLAY_IDENTIFIER FiltFreq_RadpS ECU_ADDRESS 0 PHYS_UNIT "RadpS" READ_WRITE /end MEASUREMENT
/begin MEASUREMENT InertiaCompCalc_MtrNm_D_u9p7 "" UWORD u9p7_T 0 0 0 228.8085 DISPLAY_IDENTIFIER InertiaCompCalc_MtrNm ECU_ADDRESS 0 PHYS_UNIT "MtrNm" READ_WRITE /end MEASUREMENT
/begin MEASUREMENT InrtCmpPNAccum_Cnt_M_u16 "" UWORD NO_COMPU_METHOD 0 0 0 65535 DISPLAY_IDENTIFIER DampFW_VBICPNAccum ECU_ADDRESS 0 PHYS_UNIT "Counts" READ_WRITE /end MEASUREMENT
/begin MEASUREMENT LimitedDamp_MtrNm_D_f32 "" FLOAT32_IEEE NO_COMPU_METHOD 0 0 -8.8 8.8 DISPLAY_IDENTIFIER LimitedDamp_MtrNm ECU_ADDRESS 0 PHYS_UNIT "MtrNm" READ_WRITE /end MEASUREMENT
/begin MEASUREMENT OutputAtten_Uls_D_u8p8 "" UWORD u8p8_T 0 0 0 1 DISPLAY_IDENTIFIER OutputAtten_Uls ECU_ADDRESS 0 PHYS_UNIT "Uls" READ_WRITE /end MEASUREMENT
/begin MEASUREMENT PrevDecelGain_Uls_M_u5p11 "" UWORD u5p11_T 0 0 1 10 ECU_ADDRESS 0 PHYS_UNIT "Uls" READ_WRITE /end MEASUREMENT
/begin MEASUREMENT PrevRawDecelGain_Uls_M_u5p11 "" UWORD u5p11_T 0 0 1 10 ECU_ADDRESS 0 PHYS_UNIT "Uls" READ_WRITE /end MEASUREMENT
/begin MEASUREMENT RawDecelGain_Uls_D_u5p11 "" UWORD u5p11_T 0 0 1 10 DISPLAY_IDENTIFIER RawDecelGain_Uls ECU_ADDRESS 0 PHYS_UNIT "Uls" READ_WRITE /end MEASUREMENT
/begin MEASUREMENT ReducedPerfSV_Cnt_M_lgc "" UBYTE Boolean 0 0 0 1 DISPLAY_IDENTIFIER DampFW_DampReducedPerf ECU_ADDRESS 0 PHYS_UNIT "Cnt" READ_WRITE /end MEASUREMENT
/begin MEASUREMENT ScaledDriverVel_MtrRadpS_D_s14p1 "" SWORD s14p1_T 0 0 -10000 10000 DISPLAY_IDENTIFIER ScaledDriverVel_MtrRadpS ECU_ADDRESS 0 PHYS_UNIT "MtrRadpS" READ_WRITE /end MEASUREMENT
/begin MEASUREMENT DrvDynCtrl_AssistDDFactor_Uls_f32 "" FLOAT32_IEEE NO_COMPU_METHOD 0 0 0.0078125 1.9921875 DISPLAY_IDENTIFIER Assist_DDFactor ECU_ADDRESS 0 PHYS_UNIT "Uls" READ_WRITE SYMBOL_LINK "Rte_DrvDynCtrl_AssistDDFactor_Uls_f32" 0 /end MEASUREMENT
/begin MEASUREMENT AstApplySlewSV_Cnt_M_lgc "" UBYTE Boolean 0 0 0 1 ECU_ADDRESS 0 PHYS_UNIT "Cnt" READ_WRITE /end MEASUREMENT
/begin MEASUREMENT AstSlewVal_UlspS_D_f32 "" FLOAT32_IEEE NO_COMPU_METHOD 0 0 0.5 500 ECU_ADDRESS 0 PHYS_UNIT "UlspS" READ_WRITE /end MEASUREMENT
/begin MEASUREMENT CurrDDAstLimRqst_Uls_M_f32 "" FLOAT32_IEEE NO_COMPU_METHOD 0 0 1 2 ECU_ADDRESS 0 PHYS_UNIT "Uls" READ_WRITE /end MEASUREMENT
/begin MEASUREMENT CurrDDDmpLimRqst_Uls_M_f32 "" FLOAT32_IEEE NO_COMPU_METHOD 0 0 0 1 ECU_ADDRESS 0 PHYS_UNIT "Uls" READ_WRITE /end MEASUREMENT
/begin MEASUREMENT CurrDDRtnLimRqst_Uls_M_f32 "" FLOAT32_IEEE NO_COMPU_METHOD 0 0 0 1 ECU_ADDRESS 0 PHYS_UNIT "Uls" READ_WRITE /end MEASUREMENT
/begin MEASUREMENT DampApplySlewSV_Cnt_M_lgc "" UBYTE Boolean 0 0 0 1 ECU_ADDRESS 0 PHYS_UNIT "Cnt" READ_WRITE /end MEASUREMENT
/begin MEASUREMENT DrvDynCtrl_DampingDDFactor_Uls_f32 "" FLOAT32_IEEE NO_COMPU_METHOD 0 0 0.0078125 1 DISPLAY_IDENTIFIER Damping_DDFactor ECU_ADDRESS 0 PHYS_UNIT "Uls" READ_WRITE SYMBOL_LINK "Rte_DrvDynCtrl_DampingDDFactor_Uls_f32" 0 /end MEASUREMENT
/begin MEASUREMENT DDAstLimRqst_Uls_D_f32 "" FLOAT32_IEEE NO_COMPU_METHOD 0 0 1 2 ECU_ADDRESS 0 PHYS_UNIT "Uls" READ_WRITE /end MEASUREMENT
/begin MEASUREMENT DDDmpLimRqst_Uls_D_f32 "" FLOAT32_IEEE NO_COMPU_METHOD 0 0 0 1 ECU_ADDRESS 0 PHYS_UNIT "Uls" READ_WRITE /end MEASUREMENT
/begin MEASUREMENT DDRtnLimRqst_Uls_D_f32 "" FLOAT32_IEEE NO_COMPU_METHOD 0 0 0 1 ECU_ADDRESS 0 PHYS_UNIT "Uls" READ_WRITE /end MEASUREMENT
/begin MEASUREMENT DmpSlewVal_UlspS_D_f32 "" FLOAT32_IEEE NO_COMPU_METHOD 0 0 0.5 500 ECU_ADDRESS 0 PHYS_UNIT "UlspS" READ_WRITE /end MEASUREMENT
/begin MEASUREMENT PrevDrvDynActiveSV_Cnt_M_lgc "" UBYTE Boolean 0 0 0 1 ECU_ADDRESS 0 PHYS_UNIT "Cnt" READ_WRITE /end MEASUREMENT
/begin MEASUREMENT DrvDynCtrl_ReturnDDFactor_Uls_f32 "" FLOAT32_IEEE NO_COMPU_METHOD 0 0 0.0078125 1 DISPLAY_IDENTIFIER Return_DDFactor ECU_ADDRESS 0 PHYS_UNIT "Uls" READ_WRITE SYMBOL_LINK "Rte_DrvDynCtrl_ReturnDDFactor_Uls_f32" 0 /end MEASUREMENT
/begin MEASUREMENT RtnApplySlewSV_Cnt_M_lgc "" UBYTE Boolean 0 0 0 1 ECU_ADDRESS 0 PHYS_UNIT "Cnt" READ_WRITE /end MEASUREMENT
/begin MEASUREMENT RtnSlewVal_UlspS_D_f32 "" FLOAT32_IEEE NO_COMPU_METHOD 0 0 0.5 500 ECU_ADDRESS 0 PHYS_UNIT "UlspS" READ_WRITE /end MEASUREMENT
/begin MEASUREMENT DrvDynEnbl_DrvDynActive_Cnt_lgc "" UBYTE Boolean 0 0 0 1 DISPLAY_IDENTIFIER DrvDyn_Active ECU_ADDRESS 0 PHYS_UNIT "Cnt" READ_WRITE SYMBOL_LINK "Rte_DrvDynEnbl_DrvDynActive_Cnt_lgc" 0 /end MEASUREMENT
/begin MEASUREMENT DrvDynActive_Cnt_M_lgc "" UBYTE Boolean 0 0 0 1 DISPLAY_IDENTIFIER DrvDyn_Active ECU_ADDRESS 0 PHYS_UNIT "Cnt" READ_WRITE /end MEASUREMENT
/begin MEASUREMENT DrvDynEnbl_DrvDynInterfaceState_Cnt_u08 "" UBYTE NO_COMPU_METHOD 0 0 0 255 DISPLAY_IDENTIFIER DrvDynInterface_State ECU_ADDRESS 0 PHYS_UNIT "Cnt" READ_WRITE SYMBOL_LINK "Rte_DrvDynEnbl_DrvDynInterfaceState_Cnt_u08" 0 /end MEASUREMENT
/begin MEASUREMENT DrvDynEnbl_OpTrqOvRmpInEnable_Cnt_lgc "" UBYTE Boolean 0 0 0 1 DISPLAY_IDENTIFIER OpTrqOvRmpIn_Enable ECU_ADDRESS 0 PHYS_UNIT "Cnt" READ_WRITE SYMBOL_LINK "Rte_DrvDynEnbl_OpTrqOvRmpInEnable_Cnt_lgc" 0 /end MEASUREMENT
/begin MEASUREMENT OpTrqOvRmpInEnable_Cnt_M_lgc "" UBYTE Boolean 0 0 0 1 DISPLAY_IDENTIFIER OpTrqOvRmpIn_Enable ECU_ADDRESS 0 PHYS_UNIT "Cnt" READ_WRITE /end MEASUREMENT
/begin MEASUREMENT DropInPower_Watts_D_f32 "" FLOAT32_IEEE NO_COMPU_METHOD 0 0 -1400 1400 DISPLAY_IDENTIFIER Input_Power_Drop ECU_ADDRESS 0 PHYS_UNIT "Uls" READ_WRITE /end MEASUREMENT
/begin MEASUREMENT ElecMtrCmd_Volt_D_f32 "" FLOAT32_IEEE NO_COMPU_METHOD 0 0 0 31 DISPLAY_IDENTIFIER Internal_Calculation_of_VdcM ECU_ADDRESS 0 PHYS_UNIT "Volt" READ_WRITE /end MEASUREMENT
/begin MEASUREMENT ElecPwr_ElecPower_Watts_f32 "" FLOAT32_IEEE NO_COMPU_METHOD 0 0 -1400 1400 DISPLAY_IDENTIFIER Electric_Power ECU_ADDRESS 0 PHYS_UNIT "Watts" READ_WRITE SYMBOL_LINK "Rte_ElecPwr_ElecPower_Watts_f32" 0 /end MEASUREMENT
/begin MEASUREMENT ModInPower_Watts_D_f32 "" FLOAT32_IEEE NO_COMPU_METHOD 0 0 -1400 1400 DISPLAY_IDENTIFIER Modulator_Input_Power ECU_ADDRESS 0 PHYS_UNIT "Watts" READ_WRITE /end MEASUREMENT
/begin MEASUREMENT ElecPwr_SupplyCurr_Amp_f32 "" FLOAT32_IEEE NO_COMPU_METHOD 0 0 -150 150 DISPLAY_IDENTIFIER Supply_Current ECU_ADDRESS 0 PHYS_UNIT "Amp" READ_WRITE SYMBOL_LINK "Rte_ElecPwr_SupplyCurr_Amp_f32" 0 /end MEASUREMENT
/begin MEASUREMENT TermZ_Uls_D_f32 "" FLOAT32_IEEE NO_COMPU_METHOD 0 0 1 7561.4 DISPLAY_IDENTIFIER Z_term ECU_ADDRESS 0 PHYS_UNIT "Uls" READ_WRITE /end MEASUREMENT
/begin MEASUREMENT TrigTerm_Uls_D_f32 "" FLOAT32_IEEE NO_COMPU_METHOD 0 0 -275.028 275.028 DISPLAY_IDENTIFIER XsinphaseAdv_cosphaseAdv ECU_ADDRESS 0 PHYS_UNIT "Uls" READ_WRITE /end MEASUREMENT
/begin MEASUREMENT TrigTermCos_Uls_D_f32 "" FLOAT32_IEEE NO_COMPU_METHOD 0 0 0 1 DISPLAY_IDENTIFIER CosphaseAdv ECU_ADDRESS 0 PHYS_UNIT "Uls" READ_WRITE /end MEASUREMENT
/begin MEASUREMENT TrigTermSin_Uls_D_f32 "" FLOAT32_IEEE NO_COMPU_METHOD 0 0 0 1 DISPLAY_IDENTIFIER SinphaseAdv ECU_ADDRESS 0 PHYS_UNIT "Uls" READ_WRITE /end MEASUREMENT
/begin MEASUREMENT EOTActuatorMng_AssistEOTDamping_MtrNm_f32 "" FLOAT32_IEEE NO_COMPU_METHOD 0 0 -8.8 8.8 DISPLAY_IDENTIFIER Assist_EOTDamping ECU_ADDRESS 0 PHYS_UNIT "MtrNm" READ_WRITE SYMBOL_LINK "Rte_EOTActuatorMng_AssistEOTDamping_MtrNm_f32" 0 /end MEASUREMENT
/begin MEASUREMENT EOTActuatorMng_AssistEOTGain_Uls_f32 "" FLOAT32_IEEE NO_COMPU_METHOD 0 0 0 1 DISPLAY_IDENTIFIER Assist_EOTGain ECU_ADDRESS 0 PHYS_UNIT "MtrNm" READ_WRITE SYMBOL_LINK "Rte_EOTActuatorMng_AssistEOTGain_Uls_f32" 0 /end MEASUREMENT
/begin MEASUREMENT EOTActuatorMng_AssistEOTLimit_MtrNm_f32 "" FLOAT32_IEEE NO_COMPU_METHOD 0 0 0 8.8 DISPLAY_IDENTIFIER Assist_EOTLimit ECU_ADDRESS 0 PHYS_UNIT "MtrNm" READ_WRITE SYMBOL_LINK "Rte_EOTActuatorMng_AssistEOTLimit_MtrNm_f32" 0 /end MEASUREMENT
/begin MEASUREMENT EOTDamping_MtrNm_D_f32 "" FLOAT32_IEEE NO_COMPU_METHOD 0 0 -2147483648 2147483647 DISPLAY_IDENTIFIER EOTDamping ECU_ADDRESS 0 PHYS_UNIT "MtrNm" READ_WRITE /end MEASUREMENT
/begin MEASUREMENT EOTDet_Cnt_D_lgc "" UBYTE Boolean 0 0 0 1 DISPLAY_IDENTIFIER EotDet ECU_ADDRESS 0 PHYS_UNIT "Cnt" READ_WRITE /end MEASUREMENT
/begin MEASUREMENT EOTEnterGain_Uls_D_f32 "" FLOAT32_IEEE NO_COMPU_METHOD 0 0 -2147483648 2147483647 DISPLAY_IDENTIFIER EotEnterGain ECU_ADDRESS 0 PHYS_UNIT "Uls" READ_WRITE /end MEASUREMENT
/begin MEASUREMENT EOTExitgain_Uls_D_f32 "" FLOAT32_IEEE NO_COMPU_METHOD 0 0 -2147483648 2147483647 DISPLAY_IDENTIFIER EotExitGain ECU_ADDRESS 0 PHYS_UNIT "Uls" READ_WRITE /end MEASUREMENT
/begin MEASUREMENT EOTGain_Uls_D_f32 "" FLOAT32_IEEE NO_COMPU_METHOD 0 0 -2147483648 2147483647 DISPLAY_IDENTIFIER EotGain ECU_ADDRESS 0 PHYS_UNIT "Uls" READ_WRITE /end MEASUREMENT
/begin MEASUREMENT EOTImpact_HwDeg_D_f32 "" FLOAT32_IEEE NO_COMPU_METHOD 0 0 -2147483648 2147483647 DISPLAY_IDENTIFIER EotImpact ECU_ADDRESS 0 PHYS_UNIT "HwDeg" READ_WRITE /end MEASUREMENT
/begin MEASUREMENT EOTImpactPos_HwDeg_M_f32 "" FLOAT32_IEEE NO_COMPU_METHOD 0 0 0 1440.11 DISPLAY_IDENTIFIER Prev_EotGain ECU_ADDRESS 0 PHYS_UNIT "MtrNm" READ_WRITE /end MEASUREMENT
/begin MEASUREMENT FiltEOTGain_Uls_D_f32 "" FLOAT32_IEEE NO_COMPU_METHOD 0 0 -2147483648 2147483647 DISPLAY_IDENTIFIER Filtered_EOTGain ECU_ADDRESS 0 PHYS_UNIT "Uls" READ_WRITE /end MEASUREMENT
/begin MEASUREMENT FiltEOTGainSV_HwNm_M_u1p31 "" ULONG u1p31_T 0 0 0 1 ECU_ADDRESS 0 PHYS_UNIT "HwNm" READ_WRITE /end MEASUREMENT
/begin MEASUREMENT FiltHWTrqSV_HwNm_M_s7p24 "" SLONG s7p24_T 0 0 -10 10 ECU_ADDRESS 0 PHYS_UNIT "HwNm" READ_WRITE /end MEASUREMENT
/begin MEASUREMENT LimitPosition_HwDeg_D_f32 "" FLOAT32_IEEE NO_COMPU_METHOD 0 0 -2147483648 2147483647 DISPLAY_IDENTIFIER LimitPosition ECU_ADDRESS 0 PHYS_UNIT "HwDeg" READ_WRITE /end MEASUREMENT
/begin MEASUREMENT PrevEOTGain_Uls_M_f32 "Used to hold the value between runs of the ramp on the standard EOT" FLOAT32_IEEE NO_COMPU_METHOD 0 0 0 1 ECU_ADDRESS 0 PHYS_UNIT "HwDeg" READ_WRITE /end MEASUREMENT
/begin MEASUREMENT SESState_Uls_M_enum "" SBYTE NO_COMPU_METHOD 0 0 0 3 ECU_ADDRESS 0 READ_WRITE /end MEASUREMENT
/begin MEASUREMENT EtDmpFw_EOTDampingLtd_MtrNm_f32 "" FLOAT32_IEEE NO_COMPU_METHOD 0 0 -8.8 8.8 DISPLAY_IDENTIFIER Limited_EOTDamping ECU_ADDRESS 0 PHYS_UNIT "MtrNm" READ_WRITE SYMBOL_LINK "Rte_EtDmpFw_EOTDampingLtd_MtrNm_f32" 0 /end MEASUREMENT
/begin MEASUREMENT EOTDmpFWActvLtd_MtrNm_D_f32 "" FLOAT32_IEEE NO_COMPU_METHOD 0 0 -16 16 DISPLAY_IDENTIFIER EOTDmpFW_ActvLtd ECU_ADDRESS 0 PHYS_UNIT "MtrNm" READ_WRITE /end MEASUREMENT
/begin MEASUREMENT EOTDmpFWActvRegion_Cnt_D_lgc "" UBYTE Boolean 0 0 0 1 DISPLAY_IDENTIFIER EOTDmpFW_ActvRegion ECU_ADDRESS 0 PHYS_UNIT "Cnt" READ_WRITE /end MEASUREMENT
/begin MEASUREMENT EOTDmpFWHWAuth_Cnt_D_lgc "" UBYTE Boolean 0 0 0 1 DISPLAY_IDENTIFIER EOTDmpFW_HwAuth ECU_ADDRESS 0 PHYS_UNIT "Cnt" READ_WRITE /end MEASUREMENT
/begin MEASUREMENT EOTDmpFWInActvLtd_MtrNm_D_f32 "" FLOAT32_IEEE NO_COMPU_METHOD 0 0 -8.8 8.8 DISPLAY_IDENTIFIER EOTDmpFW_InactLtd ECU_ADDRESS 0 PHYS_UNIT "MtrNm" READ_WRITE /end MEASUREMENT
/begin MEASUREMENT LwrBndActive_MtrNm_D_f32 "" FLOAT32_IEEE NO_COMPU_METHOD 0 0 -16 16 DISPLAY_IDENTIFIER EOTDmpFW_ActvLwrBnd ECU_ADDRESS 0 PHYS_UNIT "MtrNm" READ_WRITE /end MEASUREMENT
/begin MEASUREMENT UprBndActive_MtrNm_D_f32 "" FLOAT32_IEEE NO_COMPU_METHOD 0 0 -16 16 DISPLAY_IDENTIFIER EOTDmpFW_ActvUprBnd ECU_ADDRESS 0 PHYS_UNIT "MtrNm" READ_WRITE /end MEASUREMENT
/begin MEASUREMENT CanapeParameters_M_Str.AssistDDFactor_Uls_f32 "This setting shall pre-select the value of the Assist_DDFactor to be written to this global variable for driving dynamics interface when the fault injection is triggered." FLOAT32_IEEE NO_COMPU_METHOD 0 0 1 2 DISPLAY_IDENTIFIER CANape_Parameters.Assist_DDFactor ECU_ADDRESS 0 PHYS_UNIT "Unitless" READ_WRITE /end MEASUREMENT
/begin MEASUREMENT CanapeParameters_M_Str.EnableManualTrigger_Cnt_lgc "This input enables/disables a fault injection test.  Additionally if the setup is configured to perform a manually triggered fault injection then the transition of this input from 0 to 1 will trigger the start of the fault injection." UBYTE Boolean 0 0 0 1 DISPLAY_IDENTIFIER CANape_Enable_ManualTrigger ECU_ADDRESS 0 PHYS_UNIT "Counts" READ_WRITE /end MEASUREMENT
/begin MEASUREMENT CanapeParameters_M_Str.FaultDuration_mS_u32 "The time duration parameter for the fault injection." ULONG NO_COMPU_METHOD 0 0 0 10000 DISPLAY_IDENTIFIER CANape_Parameters.Fault_Duration ECU_ADDRESS 0 PHYS_UNIT "mS" READ_WRITE /end MEASUREMENT
/begin MEASUREMENT CanapeParameters_M_Str.FaultInjectionLocation_Cnt_enum "This setting pre-selects which command path location shall receive the fault injection waveform when the fault is triggered." UBYTE NO_COMPU_METHOD 0 0 0 255 DISPLAY_IDENTIFIER Fault_Injection_Location ECU_ADDRESS 0 PHYS_UNIT "Counts" READ_WRITE /end MEASUREMENT
/begin MEASUREMENT CanapeParameters_M_Str.FaultOffset_Uls_f32 "This setting pre-selects the magnitude of a constant offset to be added to the signal command path when the fault injection is triggered." FLOAT32_IEEE NO_COMPU_METHOD 0 0 -15 15 DISPLAY_IDENTIFIER CANape_Parameters.Fault_Offset ECU_ADDRESS 0 PHYS_UNIT "Unitless" READ_WRITE /end MEASUREMENT
/begin MEASUREMENT CanapeParameters_M_Str.PathGain_Uls_f32 "This setting pre-selects the gain to apply to the fault injection command path when the fault injection is triggered." FLOAT32_IEEE NO_COMPU_METHOD 0 0 0 5 DISPLAY_IDENTIFIER CANape_Parameters.Path_Gain ECU_ADDRESS 0 PHYS_UNIT "Unitless" READ_WRITE /end MEASUREMENT
/begin MEASUREMENT CanapeParameters_M_Str.SinewaveAmplitude_Uls_f32 "This setting pre-selects the amplitude of a sinewave fault  injection." FLOAT32_IEEE NO_COMPU_METHOD 0 0 0 15 DISPLAY_IDENTIFIER CANape_Parameters.Sinewave_Amplitude ECU_ADDRESS 0 PHYS_UNIT "Unitless" READ_WRITE /end MEASUREMENT
/begin MEASUREMENT CanapeParameters_M_Str.SinewaveFrequency_Hz_f32 "This setting pre-selects the frequency of a sinewave fault injection." FLOAT32_IEEE NO_COMPU_METHOD 0 0 0.1 20 DISPLAY_IDENTIFIER CANape_Parameters.Sinewave_Frequency ECU_ADDRESS 0 PHYS_UNIT "Hz" READ_WRITE /end MEASUREMENT
/begin MEASUREMENT CanapeParameters_M_Str.VelocityTriggerSetpoint_MtrRadpS_f32 "The motor velocity trigger threshold when a velocity triggered fault event has been selected.  A manual trigger of the fault injection is the default when this parameter is set to zero (0)." FLOAT32_IEEE NO_COMPU_METHOD 0 0 0 800 DISPLAY_IDENTIFIER CANape_Parameters.Velocity_Trigger_Setpoint ECU_ADDRESS 0 PHYS_UNIT "MtrRadpS" READ_WRITE /end MEASUREMENT
/begin MEASUREMENT FaultDuration_mS_M_u32 "" ULONG NO_COMPU_METHOD 0 0 0 10000 DISPLAY_IDENTIFIER Fault_Duration ECU_ADDRESS 0 PHYS_UNIT "mS" READ_WRITE /end MEASUREMENT
/begin MEASUREMENT FaultInjectionLocation_Cnt_M_enum "" UBYTE NO_COMPU_METHOD 0 0 0 255 DISPLAY_IDENTIFIER Fault_Injection_Location ECU_ADDRESS 0 PHYS_UNIT "Counts" READ_WRITE /end MEASUREMENT
/begin MEASUREMENT FaultOffset_Uls_M_f32 "" FLOAT32_IEEE NO_COMPU_METHOD 0 0 -15 15 DISPLAY_IDENTIFIER Fault_Offset ECU_ADDRESS 0 PHYS_UNIT "Unitless" READ_WRITE /end MEASUREMENT
/begin MEASUREMENT FaultStartTime_mS_M_u32 "" ULONG NO_COMPU_METHOD 0 0 0 4294967295 ECU_ADDRESS 0 PHYS_UNIT "mS" READ_WRITE /end MEASUREMENT
/begin MEASUREMENT FaultTrigger_Cnt_M_lgc "" UBYTE Boolean 0 0 0 1 DISPLAY_IDENTIFIER Fault_Trigger ECU_ADDRESS 0 PHYS_UNIT "Counts" READ_WRITE /end MEASUREMENT
/begin MEASUREMENT ManualTriggerHangover_Cnt_M_lgc "" UBYTE Boolean 0 0 0 1 ECU_ADDRESS 0 PHYS_UNIT "Counts" READ_WRITE /end MEASUREMENT
/begin MEASUREMENT PathGain_Uls_M_f32 "" FLOAT32_IEEE NO_COMPU_METHOD 0 0 0 5 DISPLAY_IDENTIFIER Path_Gain ECU_ADDRESS 0 PHYS_UNIT "Unitless" READ_WRITE /end MEASUREMENT
/begin MEASUREMENT PathOffset_Uls_M_f32 "" FLOAT32_IEEE NO_COMPU_METHOD 0 0 -30 30 DISPLAY_IDENTIFIER Path_Offset ECU_ADDRESS 0 PHYS_UNIT "Unitless" READ_WRITE /end MEASUREMENT
/begin MEASUREMENT SineFactor_kHz_M_f32 "" FLOAT32_IEEE NO_COMPU_METHOD 0 0 0 0.125663706143592 ECU_ADDRESS 0 PHYS_UNIT "kHz" READ_WRITE /end MEASUREMENT
/begin MEASUREMENT SinewaveAmplitude_Uls_M_f32 "" FLOAT32_IEEE NO_COMPU_METHOD 0 0 0 15 DISPLAY_IDENTIFIER Sinewave_Amplitude ECU_ADDRESS 0 PHYS_UNIT "Unitless" READ_WRITE /end MEASUREMENT
/begin MEASUREMENT ADDCoef_MtrNmSpRad_D_f32 "" FLOAT32_IEEE NO_COMPU_METHOD 0 0 -2147483648 2147483647 DISPLAY_IDENTIFIER ADD_Coefficient ECU_ADDRESS 0 READ_WRITE /end MEASUREMENT
/begin MEASUREMENT DriverVelocity_MtrRadpS_D_f32 "" FLOAT32_IEEE NO_COMPU_METHOD 0 0 -2147483648 2147483647 DISPLAY_IDENTIFIER Driver_Velocity ECU_ADDRESS 0 READ_WRITE /end MEASUREMENT
/begin MEASUREMENT FDDAttenOut_MtrNm_D_f32 "" FLOAT32_IEEE NO_COMPU_METHOD 0 0 -2147483648 2147483647 DISPLAY_IDENTIFIER FDDAtten_Out ECU_ADDRESS 0 READ_WRITE /end MEASUREMENT
/begin MEASUREMENT FiltFreqLUBlnd_RadpS_D_f32 "" FLOAT32_IEEE NO_COMPU_METHOD 0 0 -2147483648 2147483647 ECU_ADDRESS 0 READ_WRITE /end MEASUREMENT
/begin MEASUREMENT FrqDepDmpnInrtCmp_FrqDepDmpnInrtCmp_MtrNm_f32 "" FLOAT32_IEEE NO_COMPU_METHOD 0 0 -8.8 8.8 DISPLAY_IDENTIFIER Compenstation ECU_ADDRESS 0 PHYS_UNIT "MtrNm" READ_WRITE SYMBOL_LINK "Rte_FrqDepDmpnInrtCmp_FrqDepDmpnInrtCmp_MtrNm_f32" 0 /end MEASUREMENT
/begin MEASUREMENT InertiaCompCalc_MtrNm_D_f32 "" FLOAT32_IEEE NO_COMPU_METHOD 0 0 -2147483648 2147483647 ECU_ADDRESS 0 READ_WRITE /end MEASUREMENT
/begin MEASUREMENT PreDecelGain_Uls_M_f32 "" FLOAT32_IEEE NO_COMPU_METHOD 0 0 1 2147483647 DISPLAY_IDENTIFIER DecelGain ECU_ADDRESS 0 PHYS_UNIT "Uls" READ_WRITE /end MEASUREMENT
/begin MEASUREMENT Prev1PreAttnComp_MtrNm_M_f32 "" FLOAT32_IEEE NO_COMPU_METHOD 0 0 -8.8 8.8 ECU_ADDRESS 0 PHYS_UNIT "MtrNm" READ_WRITE /end MEASUREMENT
/begin MEASUREMENT Prev1SclDrvVel_RadpS_M_f32 "" FLOAT32_IEEE NO_COMPU_METHOD 0 0 -12917.3 12917.3 ECU_ADDRESS 0 PHYS_UNIT "RadpS" READ_WRITE /end MEASUREMENT
/begin MEASUREMENT Prev2PreAttnComp_MtrNm_M_f32 "" FLOAT32_IEEE NO_COMPU_METHOD 0 0 -8.8 8.8 ECU_ADDRESS 0 PHYS_UNIT "MtrNm" READ_WRITE /end MEASUREMENT
/begin MEASUREMENT Prev2SclDrvVel_RadpS_M_f32 "" FLOAT32_IEEE NO_COMPU_METHOD 0 0 -12917.3 12917.3 ECU_ADDRESS 0 PHYS_UNIT "RadpS" READ_WRITE /end MEASUREMENT
/begin MEASUREMENT PrevTbarAng_HwDeg_M_f32 "" FLOAT32_IEEE NO_COMPU_METHOD 0 0 -6.6667 6.6667 ECU_ADDRESS 0 PHYS_UNIT "HwDeg" READ_WRITE /end MEASUREMENT
/begin MEASUREMENT RawDecelGain_Uls_D_f32 "" FLOAT32_IEEE NO_COMPU_METHOD 0 0 1 2147483647 DISPLAY_IDENTIFIER RawDecelGain ECU_ADDRESS 0 PHYS_UNIT "Uls" READ_WRITE /end MEASUREMENT
/begin MEASUREMENT TbarVelFiltSv_M_str.K_ULS_F32 "" FLOAT32_IEEE NO_COMPU_METHOD 0 0 0.001255848 0.715390457 ECU_ADDRESS 0 PHYS_UNIT "Uls" READ_WRITE /end MEASUREMENT
/begin MEASUREMENT TbarVelFiltSv_M_str.SV_ULS_F32 "" FLOAT32_IEEE NO_COMPU_METHOD 0 0 -6.6667 6.6667 ECU_ADDRESS 0 PHYS_UNIT "Uls" READ_WRITE /end MEASUREMENT
/begin MEASUREMENT TbarVelFiltVal_HwDegpSec_D_f32 "" FLOAT32_IEEE NO_COMPU_METHOD 0 0 -2147483648 2147483647 DISPLAY_IDENTIFIER TbarVelFiltVal_HwDegpSec ECU_ADDRESS 0 PHYS_UNIT "HwDegpSec" READ_WRITE /end MEASUREMENT
/begin MEASUREMENT ErrPending_Cnt_M_lgc "" UBYTE Boolean 0 0 0 1 ECU_ADDRESS 0 PHYS_UNIT "Cnt" READ_WRITE /end MEASUREMENT
/begin MEASUREMENT FrBusOffTmr_mS_M_u32 "" ULONG NO_COMPU_METHOD 0 0 0 4294967295 DISPLAY_IDENTIFIER FrBusOffTmr ECU_ADDRESS 0 PHYS_UNIT "mS" READ_WRITE /end MEASUREMENT
/begin MEASUREMENT FrErrorInfo_Cnt_D_u16 "" UWORD NO_COMPU_METHOD 0 0 0 65535 DISPLAY_IDENTIFIER FR_Error_Info ECU_ADDRESS 0 PHYS_UNIT "Cnt" READ_WRITE /end MEASUREMENT
/begin MEASUREMENT FrErrorInfo_Cnt_M_u16 "" UWORD NO_COMPU_METHOD 0 0 0 65535 DISPLAY_IDENTIFIER FrErrorInfo ECU_ADDRESS 0 PHYS_UNIT "Cnt" READ_WRITE /end MEASUREMENT
/begin MEASUREMENT FrTxcvrERRnAcc_Cnt_M_u16 "" UWORD NO_COMPU_METHOD 0 0 0 65535 DISPLAY_IDENTIFIER FrTxcvrERRn_Acc ECU_ADDRESS 0 PHYS_UNIT "Cnt" READ_WRITE /end MEASUREMENT
/begin MEASUREMENT FrTxcvrSPIAcc_Cnt_M_u16 "" UWORD NO_COMPU_METHOD 0 0 0 255 DISPLAY_IDENTIFIER FrTxcvrSPI_Acc ECU_ADDRESS 0 PHYS_UNIT "Cnt" READ_WRITE /end MEASUREMENT
/begin MEASUREMENT PhyFRERRn_Cnt_D_lgc "Output pin from the FlexRay transceiver to indicate error.  Fault is active low. Note that per FDD sec 5.2.2, TRUE in this signal means the pin has a low logic level." UBYTE Boolean 0 0 0 1 DISPLAY_IDENTIFIER Phy_FR_ERRn ECU_ADDRESS 0 PHYS_UNIT "Cnt" READ_WRITE /end MEASUREMENT
/begin MEASUREMENT CalculateFlag_Cnt_M_lgc "" UBYTE Boolean 0 0 0 1 ECU_ADDRESS 0 PHYS_UNIT "Cnt" READ_WRITE /end MEASUREMENT
/begin MEASUREMENT CmdState_Cnt_M_Enum "WAITING_STATE = 0\nACCELERATION_STATE = 1\nCONSTANT_VEL_STATE = 2\nDECELERATION_STATE = 3\nHOLD_STATE = 4" UBYTE NO_COMPU_METHOD 0 0 0 2 ECU_ADDRESS 0 PHYS_UNIT "Cnt" READ_WRITE /end MEASUREMENT
/begin MEASUREMENT HwAngleOffsetIn_HwDeg_M_f32 "" FLOAT32_IEEE NO_COMPU_METHOD 0 0 -1440.11 1440.11 ECU_ADDRESS 0 PHYS_UNIT "HwDeg" READ_WRITE /end MEASUREMENT
/begin MEASUREMENT HwPosInitial_HwDeg_M_f32 "" FLOAT32_IEEE NO_COMPU_METHOD 0 0 -1440.11 1440.11 ECU_ADDRESS 0 PHYS_UNIT "HwDeg" READ_WRITE /end MEASUREMENT
/begin MEASUREMENT GenPosTraj_PosTrajHwAngle_HwDeg_f32 "Time-based handwheel angle command signal in handwheel degree" FLOAT32_IEEE NO_COMPU_METHOD 0 0 -1440.11 1440.11 DISPLAY_IDENTIFIER PosTraj_HwAngle ECU_ADDRESS 0 PHYS_UNIT "HwDeg" READ_WRITE SYMBOL_LINK "Rte_GenPosTraj_PosTrajHwAngle_HwDeg_f32" 0 /end MEASUREMENT
/begin MEASUREMENT StateTime_Sec_M_f32 "" FLOAT32_IEEE NO_COMPU_METHOD 0 0 0 2880.22 ECU_ADDRESS 0 PHYS_UNIT "Sec" READ_WRITE /end MEASUREMENT
/begin MEASUREMENT TargetAcceleration_HwDegpSecSqr_M_f32 "" FLOAT32_IEEE NO_COMPU_METHOD 0 0 0.1 2000 ECU_ADDRESS 0 PHYS_UNIT "HwDegpSecSqr" READ_WRITE /end MEASUREMENT
/begin MEASUREMENT TargetAccelerationInitial_HwDegpSecSqr_M_f32 "" FLOAT32_IEEE NO_COMPU_METHOD 0 0 0.1 2000 ECU_ADDRESS 0 PHYS_UNIT "HwDegpSecSqr" READ_WRITE /end MEASUREMENT
/begin MEASUREMENT TargetAngle_HwDeg_M_f32 "" FLOAT32_IEEE NO_COMPU_METHOD 0 0 -100 100 ECU_ADDRESS 0 PHYS_UNIT "HwDeg" READ_WRITE /end MEASUREMENT
/begin MEASUREMENT TargetAngleInitial_HwDeg_M_f32 "" FLOAT32_IEEE NO_COMPU_METHOD 0 0 -100 100 ECU_ADDRESS 0 PHYS_UNIT "HwDeg" READ_WRITE /end MEASUREMENT
/begin MEASUREMENT TargetVelocity_HwDegpSec_M_f32 "" FLOAT32_IEEE NO_COMPU_METHOD 0 0 1 100 ECU_ADDRESS 0 PHYS_UNIT "HwDegpSec" READ_WRITE /end MEASUREMENT
/begin MEASUREMENT TargetVelocityInitial_HwDegpSec_M_f32 "" FLOAT32_IEEE NO_COMPU_METHOD 0 0 1 100 ECU_ADDRESS 0 PHYS_UNIT "HwDegpSec" READ_WRITE /end MEASUREMENT
/begin MEASUREMENT CumMtrPos_CRF_OverwriteFlt_Cnt_D_lgc "Cummulative Motor Position signal overwrite fault display variable" UBYTE Boolean 0 0 0 1 DISPLAY_IDENTIFIER CumMtrPos_CRF_OverwriteFlt ECU_ADDRESS 0 PHYS_UNIT "Cnt" READ_WRITE /end MEASUREMENT
/begin MEASUREMENT HwTorque_OverwriteFlt_Cnt_D_lgc "Handwheel Torque signal overwrite fault display variable" UBYTE Boolean 0 0 0 1 DISPLAY_IDENTIFIER HwTorque_OverwriteFlt ECU_ADDRESS 0 PHYS_UNIT "Cnt" READ_WRITE /end MEASUREMENT
/begin MEASUREMENT HwVel_OverwriteFlt_Cnt_D_lgc "Handwheel Velocity signal overwrite fault display variable" UBYTE Boolean 0 0 0 1 DISPLAY_IDENTIFIER HwVel_OverwriteFlt ECU_ADDRESS 0 PHYS_UNIT "Cnt" READ_WRITE /end MEASUREMENT
/begin MEASUREMENT MtrElecMech_Polarity_OverwriteFlt_Cnt_D_lgc "Motor Electrical-Mechanical Polarity signal overwrite fault display variable" UBYTE Boolean 0 0 0 1 DISPLAY_IDENTIFIER MtrElecMech_Polarity_OverwriteFlt ECU_ADDRESS 0 PHYS_UNIT "Cnt" READ_WRITE /end MEASUREMENT
/begin MEASUREMENT MtrPos_OverwriteFlt_Cnt_D_lgc "Motor Position signal overwrite fault display variable" UBYTE Boolean 0 0 0 1 DISPLAY_IDENTIFIER MtrPos_OverwriteFlt ECU_ADDRESS 0 PHYS_UNIT "Cnt" READ_WRITE /end MEASUREMENT
/begin MEASUREMENT MtrVel_CRF_OverwriteFlt_Cnt_D_lgc "Motor Velocity CRF signal overwrite fault display variable" UBYTE Boolean 0 0 0 1 DISPLAY_IDENTIFIER MtrVel_CRF_OverwriteFlt ECU_ADDRESS 0 PHYS_UNIT "Cnt" READ_WRITE /end MEASUREMENT
/begin MEASUREMENT MtrVel_OverwriteFlt_Cnt_D_lgc "Moto velocity signal overwrite fault display variable" UBYTE Boolean 0 0 0 1 DISPLAY_IDENTIFIER MtrVel_OverwriteFlt ECU_ADDRESS 0 PHYS_UNIT "Cnt" READ_WRITE /end MEASUREMENT
/begin MEASUREMENT TrqCmd_CRF_OverwriteFlt_Cnt_D_lgc "Torque Command CRF  signal overwrite fault display variable" UBYTE Boolean 0 0 0 1 DISPLAY_IDENTIFIER TorqCmd_CRF_OverwriteFlt ECU_ADDRESS 0 PHYS_UNIT "Cnt" READ_WRITE /end MEASUREMENT
/begin MEASUREMENT TrqCmd_MRF_OverwriteFlt_Cnt_D_lgc "Torque Command MRF signal overwrite fault display variable" UBYTE Boolean 0 0 0 1 DISPLAY_IDENTIFIER TorqCmd_MRF_OverwriteFlt ECU_ADDRESS 0 PHYS_UNIT "Cnt" READ_WRITE /end MEASUREMENT
/begin MEASUREMENT Vecu_OverwriteFlt_Cnt_D_lgc "Vecu  signal overwrite fault display variable" UBYTE Boolean 0 0 0 1 DISPLAY_IDENTIFIER Vecu_OverwriteFlt ECU_ADDRESS 0 PHYS_UNIT "Cnt" READ_WRITE /end MEASUREMENT
/begin MEASUREMENT HiLoadStall_AssistStallLimit_MtrNm_f32 "Limited assist torque command based on high torque levels at low motor speeds" FLOAT32_IEEE NO_COMPU_METHOD 0 0 0 8.8 DISPLAY_IDENTIFIER Assist_StallLimit ECU_ADDRESS 0 PHYS_UNIT "MtrNm" READ_WRITE SYMBOL_LINK "Rte_HiLoadStall_AssistStallLimit_MtrNm_f32" 0 /end MEASUREMENT
/begin MEASUREMENT FiltModPreLimit_MtrNm_D_u8p8 "" UWORD u8p8_T 0 0 0 8.8 DISPLAY_IDENTIFIER Filtered_Modified_PreLimitTorque ECU_ADDRESS 0 PHYS_UNIT "MtrNm" READ_WRITE /end MEASUREMENT
/begin MEASUREMENT ModPreLimit_MtrNm_D_u8p8 "" UWORD u8p8_T 0 0 0 8.8 DISPLAY_IDENTIFIER Modified_PreLimitTorque ECU_ADDRESS 0 PHYS_UNIT "MtrNm" READ_WRITE /end MEASUREMENT
/begin MEASUREMENT ModPreLimitFiltSV_MtrNm_M_u8p24 "" ULONG u8p24_T 0 0 0 8.8 ECU_ADDRESS 0 PHYS_UNIT "MtrNm" READ_WRITE /end MEASUREMENT
/begin MEASUREMENT PrevAssistStallLimit_MtrNm_M_f32 "" FLOAT32_IEEE NO_COMPU_METHOD 0 0 0 8.8 ECU_ADDRESS 0 PHYS_UNIT "MtrNm" READ_WRITE /end MEASUREMENT
/begin MEASUREMENT StallLimit_MtrNm_D_u8p8 "" UWORD u8p8_T 0 0 0 8.8 DISPLAY_IDENTIFIER StallThrmLmt ECU_ADDRESS 0 PHYS_UNIT "MtrNm" READ_WRITE /end MEASUREMENT
/begin MEASUREMENT HwPwUp_MtrDrvrInitStart_Cnt_lgc "" UBYTE Boolean 0 0 0 1 DISPLAY_IDENTIFIER MtrDrvrInitStart_Cnt_lgc ECU_ADDRESS 0 PHYS_UNIT "Counts" READ_WRITE SYMBOL_LINK "Rte_HwPwUp_MtrDrvrInitStart_Cnt_lgc" 0 /end MEASUREMENT
/begin MEASUREMENT MtrDrvrInitStart_Cnt_M_lgc "" UBYTE Boolean 0 0 0 1 ECU_ADDRESS 0 PHYS_UNIT "Counts" READ_WRITE /end MEASUREMENT
/begin MEASUREMENT HwPwUp_PhsDiscTestStart_Cnt_lgc "" UBYTE Boolean 0 0 0 1 DISPLAY_IDENTIFIER PhsDiscTestStart_Cnt_lgc ECU_ADDRESS 0 PHYS_UNIT "Counts" READ_WRITE SYMBOL_LINK "Rte_HwPwUp_PhsDiscTestStart_Cnt_lgc" 0 /end MEASUREMENT
/begin MEASUREMENT PhsDiscTestStart_Cnt_M_lgc "" UBYTE Boolean 0 0 0 1 ECU_ADDRESS 0 PHYS_UNIT "Counts" READ_WRITE /end MEASUREMENT
/begin MEASUREMENT PowerUpState_Cnt_M_enum "" UBYTE NO_COMPU_METHOD 0 0 0 6 ECU_ADDRESS 0 PHYS_UNIT "Counts" READ_WRITE /end MEASUREMENT
/begin MEASUREMENT HwPwUp_PwrDiscATestStart_Cnt_lgc "" UBYTE Boolean 0 0 0 1 DISPLAY_IDENTIFIER PwrDiscATestStart_Cnt_lgc ECU_ADDRESS 0 PHYS_UNIT "Counts" READ_WRITE SYMBOL_LINK "Rte_HwPwUp_PwrDiscATestStart_Cnt_lgc" 0 /end MEASUREMENT
/begin MEASUREMENT PwrDiscATestStart_Cnt_M_lgc "" UBYTE Boolean 0 0 0 1 ECU_ADDRESS 0 PHYS_UNIT "Counts" READ_WRITE /end MEASUREMENT
/begin MEASUREMENT HwPwUp_PwrDiscBTestStart_Cnt_lgc "" UBYTE Boolean 0 0 0 1 DISPLAY_IDENTIFIER PwrDiscBTestStart_Cnt_lgc ECU_ADDRESS 0 PHYS_UNIT "Counts" READ_WRITE SYMBOL_LINK "Rte_HwPwUp_PwrDiscBTestStart_Cnt_lgc" 0 /end MEASUREMENT
/begin MEASUREMENT PwrDiscBTestStart_Cnt_M_lgc "" UBYTE Boolean 0 0 0 1 ECU_ADDRESS 0 PHYS_UNIT "Counts" READ_WRITE /end MEASUREMENT
/begin MEASUREMENT HwPwUp_TMFTestStart_Cnt_lgc "" UBYTE Boolean 0 0 0 1 DISPLAY_IDENTIFIER TMFTestStart_Cnt_lgc ECU_ADDRESS 0 PHYS_UNIT "Counts" READ_WRITE SYMBOL_LINK "Rte_HwPwUp_TMFTestStart_Cnt_lgc" 0 /end MEASUREMENT
/begin MEASUREMENT TMFTestStart_Cnt_M_lgc "" UBYTE Boolean 0 0 0 1 ECU_ADDRESS 0 PHYS_UNIT "Counts" READ_WRITE /end MEASUREMENT
/begin MEASUREMENT HwTrq_AnaDiffHwTrq_Volt_f32 "Differential Hw Trq" FLOAT32_IEEE NO_COMPU_METHOD 0 0 -2.5 2.5 DISPLAY_IDENTIFIER Ana_DiffHwTrq ECU_ADDRESS 0 PHYS_UNIT "Volt" READ_WRITE SYMBOL_LINK "Rte_HwTrq_AnaDiffHwTrq_Volt_f32" 0 /end MEASUREMENT
/begin MEASUREMENT AnaDiffHwTrq_Volt_M_f32 "Differential Hw Trq" FLOAT32_IEEE NO_COMPU_METHOD 0 0 -2.5 2.5 ECU_ADDRESS 0 PHYS_UNIT "Volt" READ_WRITE /end MEASUREMENT
/begin MEASUREMENT HwTrq_AnaHwTorque_HwNm_f32 "Differential torque calculated from T1 and T2 with the differential torque trim applied, HW_Torque to be transmitted to an external control module" FLOAT32_IEEE NO_COMPU_METHOD 0 0 -10 10 DISPLAY_IDENTIFIER Ana_HW_Torque_SrlComHwTrq ECU_ADDRESS 0 PHYS_UNIT "HwNm" READ_WRITE SYMBOL_LINK "Rte_HwTrq_AnaHwTorque_HwNm_f32" 0 /end MEASUREMENT
/begin MEASUREMENT AnaHwTorque_HwNm_M_f32 "" FLOAT32_IEEE NO_COMPU_METHOD 0 0 -10 10 ECU_ADDRESS 0 PHYS_UNIT "HwNm" READ_WRITE /end MEASUREMENT
/begin MEASUREMENT AnaHwTorqueSqd_HwNmSq_D_f32 "" FLOAT32_IEEE NO_COMPU_METHOD 0 0 0 100 DISPLAY_IDENTIFIER Ana_HW_Torque_Sqd ECU_ADDRESS 0 PHYS_UNIT "HwNmSq" READ_WRITE /end MEASUREMENT
/begin MEASUREMENT CorrDiagFiltOut_Volt_M_s4p11 "Common mode compensation filter output" SWORD s4p11_T 0 0 -5 5 DISPLAY_IDENTIFIER CorrDiagFiltOut ECU_ADDRESS 0 PHYS_UNIT "Volt" READ_WRITE /end MEASUREMENT
/begin MEASUREMENT HwTrq_ErrorActiveAnalog_Cnt_enum "Status of the analog handwheel torque subsystem" UBYTE NO_COMPU_METHOD 0 0 0 2 DISPLAY_IDENTIFIER ErrorActive_Analog ECU_ADDRESS 0 PHYS_UNIT "Cnt" READ_WRITE SYMBOL_LINK "Rte_HwTrq_ErrorActiveAnalog_Cnt_enum" 0 /end MEASUREMENT
/begin MEASUREMENT HwTorqCh1vsCh2CorrLim_HwNmSq_D_f32 "" FLOAT32_IEEE NO_COMPU_METHOD 0 0 0 100 DISPLAY_IDENTIFIER HW_Torq_Ch1vsCh2_CorrLim ECU_ADDRESS 0 PHYS_UNIT "HwNmSq" READ_WRITE /end MEASUREMENT
/begin MEASUREMENT HWTorqCorrLimDiff_HwNmSq_D_f32 "" FLOAT32_IEEE NO_COMPU_METHOD 0 0 0 100 DISPLAY_IDENTIFIER HWTorq_CorrLim_Diff ECU_ADDRESS 0 PHYS_UNIT "HwNmSq" READ_WRITE /end MEASUREMENT
/begin MEASUREMENT HwTorqCorrLimErrAcc_Cnt_M_u16 "" UWORD NO_COMPU_METHOD 0 0 0 65535 DISPLAY_IDENTIFIER HWTorqCC_ErrorAcc ECU_ADDRESS 0 PHYS_UNIT "Cnt" READ_WRITE /end MEASUREMENT
/begin MEASUREMENT HwTrq_HwTrqScaleVal_VoltsPerDeg_f32 "EOL Hw torque scale" FLOAT32_IEEE NO_COMPU_METHOD 0 0 0.00390625 0.9375 DISPLAY_IDENTIFIER HwTrqScaleVal_VoltsPerDeg_f32 ECU_ADDRESS 0 PHYS_UNIT "VoltpDeg" READ_WRITE SYMBOL_LINK "Rte_HwTrq_HwTrqScaleVal_VoltsPerDeg_f32" 0 /end MEASUREMENT
/begin MEASUREMENT HwTrq_SrlComHwTrqValid_Cnt_lgc "Validity of the SrlComHwTrq signal" UBYTE Boolean 0 0 0 1 DISPLAY_IDENTIFIER SrlComHwTrqValid ECU_ADDRESS 0 PHYS_UNIT "Cnt" READ_WRITE SYMBOL_LINK "Rte_HwTrq_SrlComHwTrqValid_Cnt_lgc" 0 /end MEASUREMENT
/begin MEASUREMENT SSDiagFiltOut_Volt_M_s4p11 "SS filter output" SWORD s4p11_T 0 0 -5 5 DISPLAY_IDENTIFIER SSFiltOut ECU_ADDRESS 0 PHYS_UNIT "Volt" READ_WRITE /end MEASUREMENT
/begin MEASUREMENT SSDiagFiltSV_Volt_M_s4p27 "SS filter state variable" SLONG s4p27_T 0 0 -5 5 ECU_ADDRESS 0 PHYS_UNIT "Volt" READ_WRITE /end MEASUREMENT
/begin MEASUREMENT SumFltOut_Volt_M_u5p11 "Sum filter output" UWORD u5p11_T 0 0 0 5 DISPLAY_IDENTIFIER SumFiltOut ECU_ADDRESS 0 PHYS_UNIT "Volt" READ_WRITE /end MEASUREMENT
/begin MEASUREMENT SysCAnaHwTorqueSqd_HwNmSq_D_f32 "" FLOAT32_IEEE NO_COMPU_METHOD 0 0 0 100 DISPLAY_IDENTIFIER SysC_Ana_HW_Torque_Sqd ECU_ADDRESS 0 PHYS_UNIT "HwNmSq" READ_WRITE /end MEASUREMENT
/begin MEASUREMENT SysCHwTorqCh1vsCh2CorrLim_HwNmSq_D_f32 "" FLOAT32_IEEE NO_COMPU_METHOD 0 0 0 100 DISPLAY_IDENTIFIER SysC_HW_Torq_Ch1vsCh2_CorrLim ECU_ADDRESS 0 PHYS_UNIT "HwNmSq" READ_WRITE /end MEASUREMENT
/begin MEASUREMENT SysCHWTorqCorrLimDiff_HwNmSq_D_f32 "" FLOAT32_IEEE NO_COMPU_METHOD 0 0 0 100 DISPLAY_IDENTIFIER SysC_HWTorq_CorrLim_Diff ECU_ADDRESS 0 PHYS_UNIT "HwNmSq" READ_WRITE /end MEASUREMENT
/begin MEASUREMENT SysCHwTorqCorrLimErrAcc_Cnt_M_u16 "" UWORD NO_COMPU_METHOD 0 0 0 65535 ECU_ADDRESS 0 PHYS_UNIT "Cnt" READ_WRITE /end MEASUREMENT
/begin MEASUREMENT HwTrq_SysCHwTorqueSqd_HwNmSq_f32 "" FLOAT32_IEEE NO_COMPU_METHOD 0 0 0 100 DISPLAY_IDENTIFIER SysC_HWTorque_Sqd ECU_ADDRESS 0 PHYS_UNIT "HwNmSq" READ_WRITE SYMBOL_LINK "Rte_HwTrq_SysCHwTorqueSqd_HwNmSq_f32" 0 /end MEASUREMENT
/begin MEASUREMENT SysCHwTorqueSqd_HwNmSq_M_f32 "" FLOAT32_IEEE NO_COMPU_METHOD 0 0 0 100 ECU_ADDRESS 0 PHYS_UNIT "HwNmSq" READ_WRITE /end MEASUREMENT
/begin MEASUREMENT T1RngErrAcc_Cnt_M_u16 "T1 diagnostic range accumulator" UWORD NO_COMPU_METHOD 0 0 0 65535 ECU_ADDRESS 0 PHYS_UNIT "Cnt" READ_WRITE /end MEASUREMENT
/begin MEASUREMENT HwTrq_T1TrimVal_Volt_f32 "EOL Torque 1 trim" FLOAT32_IEEE NO_COMPU_METHOD 0 0 0 5 DISPLAY_IDENTIFIER T1TrimVal_Volt_f32 ECU_ADDRESS 0 PHYS_UNIT "Volt" READ_WRITE SYMBOL_LINK "Rte_HwTrq_T1TrimVal_Volt_f32" 0 /end MEASUREMENT
/begin MEASUREMENT T2RngErrAcc_Cnt_M_u16 "T2 diagnostic range accumulator" UWORD NO_COMPU_METHOD 0 0 0 65535 ECU_ADDRESS 0 PHYS_UNIT "Cnt" READ_WRITE /end MEASUREMENT
/begin MEASUREMENT HwTrq_T2TrimVal_Volt_f32 "EOL Torque 2 trim" FLOAT32_IEEE NO_COMPU_METHOD 0 0 0 5 DISPLAY_IDENTIFIER T2TrimVal_Volt_f32 ECU_ADDRESS 0 PHYS_UNIT "Volt" READ_WRITE SYMBOL_LINK "Rte_HwTrq_T2TrimVal_Volt_f32" 0 /end MEASUREMENT
/begin MEASUREMENT TDiagFiltOut_Volt_M_s4p11 "Transient  filter output" SWORD s4p11_T 0 0 -5 5 ECU_ADDRESS 0 PHYS_UNIT "Volt" READ_WRITE /end MEASUREMENT
/begin MEASUREMENT TDiagFiltSV_Volt_M_s4p27 "Transient  filter state variable" SLONG s4p27_T 0 0 -5 5 ECU_ADDRESS 0 PHYS_UNIT "Volt" READ_WRITE /end MEASUREMENT
/begin MEASUREMENT TrqSensorRecDiagAcc_Cnt_M_u16 "Torque sensor recovery diagnostic accumulator" UWORD NO_COMPU_METHOD 0 0 0 65535 ECU_ADDRESS 0 PHYS_UNIT "Cnt" READ_WRITE /end MEASUREMENT
/begin MEASUREMENT TrqSum_Volt_M_s4p11 "Sum of the corrected T1 and T2" SWORD s4p11_T 0 0 -5 5 DISPLAY_IDENTIFIER TrqSum ECU_ADDRESS 0 PHYS_UNIT "Volt" READ_WRITE /end MEASUREMENT
/begin MEASUREMENT AvailHyst_HwNm_D_f32 "" FLOAT32_IEEE NO_COMPU_METHOD 0 0 0 10 DISPLAY_IDENTIFIER HysAdd_AvailHys ECU_ADDRESS 0 PHYS_UNIT "HwNm" READ_WRITE /end MEASUREMENT
/begin MEASUREMENT FiltHwTrq_HwNm_D_s7p8 "" SWORD s7p8_T 0 0 -10 10 DISPLAY_IDENTIFIER HysAdd_FiltHwTorq ECU_ADDRESS 0 PHYS_UNIT "HwNm" READ_WRITE /end MEASUREMENT
/begin MEASUREMENT Fraction_Uls_D_f32 "" FLOAT32_IEEE NO_COMPU_METHOD 0 0 0 1 DISPLAY_IDENTIFIER HysAdd_Fraction ECU_ADDRESS 0 PHYS_UNIT "HwNm" READ_WRITE /end MEASUREMENT
/begin MEASUREMENT HwTrqFiltSV_HwNm_M_s7p24 "" SLONG s7p24_T 0 0 -10 10 DISPLAY_IDENTIFIER filter_state_variable ECU_ADDRESS 0 PHYS_UNIT "HwNm" READ_WRITE /end MEASUREMENT
/begin MEASUREMENT HystAdd_HysAddHwTrq_HwNm_f32 "" FLOAT32_IEEE NO_COMPU_METHOD 0 0 -10 10 DISPLAY_IDENTIFIER Hw_Torque_HysAdd ECU_ADDRESS 0 PHYS_UNIT "HwNm" READ_WRITE SYMBOL_LINK "Rte_HystAdd_HysAddHwTrq_HwNm_f32" 0 /end MEASUREMENT
/begin MEASUREMENT PrevFiltHwTrq_HwNm_M_s7p8 "" SWORD s7p8_T 0 0 -10 10 DISPLAY_IDENTIFIER previous_FiltHwTorque ECU_ADDRESS 0 PHYS_UNIT "HwNm" READ_WRITE /end MEASUREMENT
/begin MEASUREMENT PrevHwTrq_HwNm_M_f32 "" FLOAT32_IEEE NO_COMPU_METHOD 0 0 -10 10 DISPLAY_IDENTIFIER previous_Hw_Torque ECU_ADDRESS 0 PHYS_UNIT "HwNm" READ_WRITE /end MEASUREMENT
/begin MEASUREMENT PrevHysAddHwTrq_HwNm_M_f32 "" FLOAT32_IEEE NO_COMPU_METHOD 0 0 -10 10 DISPLAY_IDENTIFIER PrevOutput_Hw_Torque_HysAdd ECU_ADDRESS 0 PHYS_UNIT "HwNm" READ_WRITE /end MEASUREMENT
/begin MEASUREMENT PrevHysPos_Uls_M_f32 "" FLOAT32_IEEE NO_COMPU_METHOD 0 0 -1 1 DISPLAY_IDENTIFIER prev_HysPosVal ECU_ADDRESS 0 PHYS_UNIT "Uls" READ_WRITE /end MEASUREMENT
/begin MEASUREMENT CoulFric_HwNm_D_f32 "" FLOAT32_IEEE NO_COMPU_METHOD 0 0 -10 10 DISPLAY_IDENTIFIER HysComp_CoulFric ECU_ADDRESS 0 PHYS_UNIT "HwNm" READ_WRITE /end MEASUREMENT
/begin MEASUREMENT HwTrqFilt_HwNm_D_f32 "" FLOAT32_IEEE NO_COMPU_METHOD 0 0 -10 10 DISPLAY_IDENTIFIER HysComp_HwTrqFilt ECU_ADDRESS 0 PHYS_UNIT "HwNm" READ_WRITE /end MEASUREMENT
/begin MEASUREMENT PosAvail_HwNm_D_f32 "" FLOAT32_IEEE NO_COMPU_METHOD 0 0 -10 10 DISPLAY_IDENTIFIER HysComp_PosAvail ECU_ADDRESS 0 PHYS_UNIT "HwNm" READ_WRITE /end MEASUREMENT
/begin MEASUREMENT AssistCmdFilt_HwNm_D_s8p7 "" SWORD s8p7_T 0 0 -128 127 DISPLAY_IDENTIFIER HysComp_AssistCmdFilt ECU_ADDRESS 0 PHYS_UNIT "HwNm" READ_WRITE /end MEASUREMENT
/begin MEASUREMENT AssistCmdLPFiltSV_HwNm_M_str "" SLONG NO_COMPU_METHOD 0 0 -2147483648 2147483647 DISPLAY_IDENTIFIER AssistCmdLPFiltSV ECU_ADDRESS 0 PHYS_UNIT "HwNm" READ_WRITE /end MEASUREMENT
/begin MEASUREMENT AstCmdLastUsed_HwNm_M_s8p7 "" SWORD s8p7_T 0 0 -255 255 ECU_ADDRESS 0 PHYS_UNIT "HwNm" READ_WRITE /end MEASUREMENT
/begin MEASUREMENT CompAvail_HwNm_D_f32 "" FLOAT32_IEEE NO_COMPU_METHOD 0 0 -15 15 DISPLAY_IDENTIFIER HysComp_CompAvail ECU_ADDRESS 0 PHYS_UNIT "HwNm" READ_WRITE /end MEASUREMENT
/begin MEASUREMENT EffCompTrq_HwNm_D_f32 "" FLOAT32_IEEE NO_COMPU_METHOD 0 0 -10 10 DISPLAY_IDENTIFIER HysComp_EffCompTrq ECU_ADDRESS 0 PHYS_UNIT "HwNm" READ_WRITE /end MEASUREMENT
/begin MEASUREMENT Fraction_Uls_M_f32 "" FLOAT32_IEEE NO_COMPU_METHOD 0 0 -1 1 DISPLAY_IDENTIFIER HysComp_Fraction ECU_ADDRESS 0 PHYS_UNIT "Uls" READ_WRITE /end MEASUREMENT
/begin MEASUREMENT HwTrqLastUsed_HwNm_M_f32 "" FLOAT32_IEEE NO_COMPU_METHOD 0 0 -10 10 DISPLAY_IDENTIFIER HwTrqLastUsed ECU_ADDRESS 0 PHYS_UNIT "HwNm" READ_WRITE /end MEASUREMENT
/begin MEASUREMENT HwTrqLPFiltSV_HwNm_M_str "" SLONG NO_COMPU_METHOD 0 0 -2147483648 2147483647 DISPLAY_IDENTIFIER HwTrqLPFiltSV ECU_ADDRESS 0 PHYS_UNIT "HwNm" READ_WRITE /end MEASUREMENT
/begin MEASUREMENT HystComp_HysteresisComp_MtrNm_f32 "Assist modifier provided to Stability Compensation function" FLOAT32_IEEE NO_COMPU_METHOD 0 0 -10 10 DISPLAY_IDENTIFIER Hysteresis_Comp ECU_ADDRESS 0 PHYS_UNIT "MtrNm" READ_WRITE SYMBOL_LINK "Rte_HystComp_HysteresisComp_MtrNm_f32" 0 /end MEASUREMENT
/begin MEASUREMENT NegAvail_HwNm_D_f32 "" FLOAT32_IEEE NO_COMPU_METHOD 0 0 -10 10 DISPLAY_IDENTIFIER HysComp_NegAvail ECU_ADDRESS 0 PHYS_UNIT "HwNm" READ_WRITE /end MEASUREMENT
/begin MEASUREMENT RawCalc_HwNm_M_f32 "" FLOAT32_IEEE NO_COMPU_METHOD 0 0 -15 15 DISPLAY_IDENTIFIER HysComp_RawCalc ECU_ADDRESS 0 PHYS_UNIT "HwNm" READ_WRITE /end MEASUREMENT
/begin MEASUREMENT RawHystCompLPFiltSV_HwNm_M_str "" SLONG NO_COMPU_METHOD 0 0 -2147483648 2147483647 DISPLAY_IDENTIFIER RawHystCompLPFiltSV ECU_ADDRESS 0 PHYS_UNIT "HwNm" READ_WRITE /end MEASUREMENT
/begin MEASUREMENT RiseX_HwNm_M_f32 "" FLOAT32_IEEE NO_COMPU_METHOD 0 0 -1 1 ECU_ADDRESS 0 PHYS_UNIT "HwNm" READ_WRITE /end MEASUREMENT
/begin MEASUREMENT CapturedHwPosition_HwDeg_M_f32 "" FLOAT32_IEEE NO_COMPU_METHOD 0 0 -1440.11 1440.11 ECU_ADDRESS 0 PHYS_UNIT "HwDeg" READ_WRITE /end MEASUREMENT
/begin MEASUREMENT CapturedStepMultFactor_Uls_M_f32 "" FLOAT32_IEEE NO_COMPU_METHOD 0 0 0.151835801980648 0.987512256523656 ECU_ADDRESS 0 PHYS_UNIT "Uls" READ_WRITE /end MEASUREMENT
/begin MEASUREMENT CapturedTargetVelocity_MtrRadpS_M_f32 "" FLOAT32_IEEE NO_COMPU_METHOD 0 0 0.174532925199432 17.4532925199432 ECU_ADDRESS 0 PHYS_UNIT "MtrRadpS" READ_WRITE /end MEASUREMENT
/begin MEASUREMENT ChangeStateStartTime_mS_M_u32 "" ULONG NO_COMPU_METHOD 0 0 0 4294967295 ECU_ADDRESS 0 PHYS_UNIT "mS" READ_WRITE /end MEASUREMENT
/begin MEASUREMENT EnableFlag_Cnt_M_lgc "" UBYTE Boolean 0 0 0 1 ECU_ADDRESS 0 PHYS_UNIT "Cnt" READ_WRITE /end MEASUREMENT
/begin MEASUREMENT HwDegtoMtrRad_Uls_M_f32 "" FLOAT32_IEEE NO_COMPU_METHOD 0 0 0.261799388 0.610865238 ECU_ADDRESS 0 PHYS_UNIT "Uls" READ_WRITE /end MEASUREMENT
/begin MEASUREMENT HwPosDeltaSigSV_HwDeg_M_f32 "" FLOAT32_IEEE NO_COMPU_METHOD 0 0 -2880.22 2880.22 ECU_ADDRESS 0 PHYS_UNIT "HwDeg" READ_WRITE /end MEASUREMENT
/begin MEASUREMENT HwPosFilterOpSV_HwDeg_M_f32 "" FLOAT32_IEEE NO_COMPU_METHOD 0 0 -1440.11 1440.11 ECU_ADDRESS 0 PHYS_UNIT "HwDeg" READ_WRITE /end MEASUREMENT
/begin MEASUREMENT HwPositionCmd_HwDeg_D_f32 "" FLOAT32_IEEE NO_COMPU_METHOD 0 0 -2147483648 2147483647 DISPLAY_IDENTIFIER LrnPnCtr_HwPos_Cmd ECU_ADDRESS 0 PHYS_UNIT "HwDeg" READ_WRITE /end MEASUREMENT
/begin MEASUREMENT HwStopPosition_HwDeg_M_f32 "" FLOAT32_IEEE NO_COMPU_METHOD 0 0 -1440.11 1440.11 ECU_ADDRESS 0 PHYS_UNIT "HwDeg" READ_WRITE /end MEASUREMENT
/begin MEASUREMENT ITermSV_HwDeg_M_f32 "" FLOAT32_IEEE NO_COMPU_METHOD 0 0 -51200 51200 ECU_ADDRESS 0 PHYS_UNIT "HwDeg" READ_WRITE /end MEASUREMENT
/begin MEASUREMENT LktoLkStr_LrnPnCntrCmd_MtrNm_f32 "Motor Torque command required to implement this function" FLOAT32_IEEE NO_COMPU_METHOD 0 0 -8.8 8.8 DISPLAY_IDENTIFIER LrnPnCntr_T_Cmd ECU_ADDRESS 0 PHYS_UNIT "MtrNm" READ_WRITE SYMBOL_LINK "Rte_LktoLkStr_LrnPnCntrCmd_MtrNm_f32" 0 /end MEASUREMENT
/begin MEASUREMENT LrnPnCntrCmd_MtrNm_M_f32 "" FLOAT32_IEEE NO_COMPU_METHOD 0 0 -8.8 8.8 ECU_ADDRESS 0 PHYS_UNIT "MtrNm" READ_WRITE /end MEASUREMENT
/begin MEASUREMENT LktoLkStr_LrnPnCntrHwCenter_HwDeg_f32 "Calculated Handwheel center angle" FLOAT32_IEEE NO_COMPU_METHOD 0 0 -1440.11 1440.11 DISPLAY_IDENTIFIER LrnPnCntr_Hw_Center ECU_ADDRESS 0 PHYS_UNIT "HwDeg" READ_WRITE SYMBOL_LINK "Rte_LktoLkStr_LrnPnCntrHwCenter_HwDeg_f32" 0 /end MEASUREMENT
/begin MEASUREMENT LrnPnCntrHwCenter_HwDeg_M_f32 "" FLOAT32_IEEE NO_COMPU_METHOD 0 0 -1440.11 1440.11 ECU_ADDRESS 0 PHYS_UNIT "HwDeg" READ_WRITE /end MEASUREMENT
/begin MEASUREMENT LktoLkStr_LrnPnCntrHwTravel_HwDeg_f32 "Calculated Handwheel travel from end stop to end stop" FLOAT32_IEEE NO_COMPU_METHOD 0 0 0 1440.11 DISPLAY_IDENTIFIER LrnPnCntr_Hw_Travel ECU_ADDRESS 0 PHYS_UNIT "HwDeg" READ_WRITE SYMBOL_LINK "Rte_LktoLkStr_LrnPnCntrHwTravel_HwDeg_f32" 0 /end MEASUREMENT
/begin MEASUREMENT LrnPnCntrHwTravel_HwDeg_M_f32 "" FLOAT32_IEEE NO_COMPU_METHOD 0 0 0 1440.11 ECU_ADDRESS 0 PHYS_UNIT "HwDeg" READ_WRITE /end MEASUREMENT
/begin MEASUREMENT LktoLkStr_LrnPnCntrState_Cnt_enum "State of this function                             *   HOLD (0U)\n *    POSANGVEL (1U)\n *   POSMTRTRQ (2U)\n *   NEGANGVEL (3U)\n *   NEGMTRTRQ (4U)\n *   MOVETO (5U)\n *   DONE (6U)\n *   TIMEOUT (7U)" UBYTE NO_COMPU_METHOD 0 0 0 7 DISPLAY_IDENTIFIER LrnPnCntr_State ECU_ADDRESS 0 PHYS_UNIT "Cnt" READ_WRITE SYMBOL_LINK "Rte_LktoLkStr_LrnPnCntrState_Cnt_enum" 0 /end MEASUREMENT
/begin MEASUREMENT MtrPosDeltaSigSV_MtrRad_M_f32 "" FLOAT32_IEEE NO_COMPU_METHOD 0 0 -603.185789 1482.89893 ECU_ADDRESS 0 PHYS_UNIT "MtrRad" READ_WRITE /end MEASUREMENT
/begin MEASUREMENT MtrPosFilterOpSV_MtrRad_M_f32 "" FLOAT32_IEEE NO_COMPU_METHOD 0 0 -603.185789 1482.89893 ECU_ADDRESS 0 PHYS_UNIT "MtrRad" READ_WRITE /end MEASUREMENT
/begin MEASUREMENT MtrTrqDeltaSigSV_MtrNm_M_f32 "" FLOAT32_IEEE NO_COMPU_METHOD 0 0 -8.8 8.8 ECU_ADDRESS 0 PHYS_UNIT "MtrNm" READ_WRITE /end MEASUREMENT
/begin MEASUREMENT MtrTrqFilterOpSV_MtrNm_M_f32 "" FLOAT32_IEEE NO_COMPU_METHOD 0 0 -8.8 8.8 ECU_ADDRESS 0 PHYS_UNIT "MtrNm" READ_WRITE /end MEASUREMENT
/begin MEASUREMENT PinionCtrState_Cnt_M_Enum "State of this function                             *   HOLD (0U)\n *    POSANGVEL (1U)\n *   POSMTRTRQ (2U)\n *   NEGANGVEL (3U)\n *   NEGMTRTRQ (4U)\n *   MOVETO (5U)\n *   DONE (6U)\n *   TIMEOUT (7U)" UBYTE NO_COMPU_METHOD 0 0 0 7 ECU_ADDRESS 0 PHYS_UNIT "Cnt" READ_WRITE /end MEASUREMENT
/begin MEASUREMENT TimeoutStartTime_mS_M_u32 "" ULONG NO_COMPU_METHOD 0 0 0 4294967295 ECU_ADDRESS 0 PHYS_UNIT "mS" READ_WRITE /end MEASUREMENT
/begin MEASUREMENT CurrAssistEOTGain_Uls_M_f32 "" FLOAT32_IEEE NO_COMPU_METHOD 0 0 0 1 ECU_ADDRESS 0 PHYS_UNIT "Uls" READ_WRITE /end MEASUREMENT
/begin MEASUREMENT CurrAssistEOTLimit_MtrNm_M_f32 "" FLOAT32_IEEE NO_COMPU_METHOD 0 0 0 8.8 ECU_ADDRESS 0 PHYS_UNIT "MtrNm" READ_WRITE /end MEASUREMENT
/begin MEASUREMENT CurrAssistStallLimit_MtrNm_M_f32 "" FLOAT32_IEEE NO_COMPU_METHOD 0 0 0 8.8 ECU_ADDRESS 0 PHYS_UNIT "MtrNm" READ_WRITE /end MEASUREMENT
/begin MEASUREMENT CurrAssistVehSpdLimit_MtrNm_M_f32 "" FLOAT32_IEEE NO_COMPU_METHOD 0 0 0 8.8 ECU_ADDRESS 0 PHYS_UNIT "MtrNm" READ_WRITE /end MEASUREMENT
/begin MEASUREMENT CurrOutputRampMult_Uls_M_f32 "" FLOAT32_IEEE NO_COMPU_METHOD 0 0 0 1 ECU_ADDRESS 0 PHYS_UNIT "Uls" READ_WRITE /end MEASUREMENT
/begin MEASUREMENT CurrThermalLimit_MtrNm_M_f32 "" FLOAT32_IEEE NO_COMPU_METHOD 0 0 0 8.8 ECU_ADDRESS 0 PHYS_UNIT "MtrNm" READ_WRITE /end MEASUREMENT
/begin MEASUREMENT LmtCod_EOTGainLtd_Uls_f32 "" FLOAT32_IEEE NO_COMPU_METHOD 0 0 0 1 DISPLAY_IDENTIFIER EOTGain_Ltd ECU_ADDRESS 0 PHYS_UNIT "Uls" READ_WRITE SYMBOL_LINK "Rte_LmtCod_EOTGainLtd_Uls_f32" 0 /end MEASUREMENT
/begin MEASUREMENT LmtCod_EOTLimitLtd_MtrNm_f32 "" FLOAT32_IEEE NO_COMPU_METHOD 0 0 0 8.8 DISPLAY_IDENTIFIER EOTLimit_Ltd ECU_ADDRESS 0 PHYS_UNIT "MtrNm" READ_WRITE SYMBOL_LINK "Rte_LmtCod_EOTLimitLtd_MtrNm_f32" 0 /end MEASUREMENT
/begin MEASUREMENT LmtCod_OutputRampMultLtd_Uls_f32 "" FLOAT32_IEEE NO_COMPU_METHOD 0 0 0 1 DISPLAY_IDENTIFIER OutputRampMult_Ltd ECU_ADDRESS 0 PHYS_UNIT "Uls" READ_WRITE SYMBOL_LINK "Rte_LmtCod_OutputRampMultLtd_Uls_f32" 0 /end MEASUREMENT
/begin MEASUREMENT LmtCod_StallLimitLtd_MtrNm_f32 "" FLOAT32_IEEE NO_COMPU_METHOD 0 0 0 8.8 DISPLAY_IDENTIFIER StallLimit_Ltd ECU_ADDRESS 0 PHYS_UNIT "MtrNm" READ_WRITE SYMBOL_LINK "Rte_LmtCod_StallLimitLtd_MtrNm_f32" 0 /end MEASUREMENT
/begin MEASUREMENT LmtCod_ThermalLimitLtd_MtrNm_f32 "" FLOAT32_IEEE NO_COMPU_METHOD 0 0 0 8.8 DISPLAY_IDENTIFIER ThermalLimit_Ltd ECU_ADDRESS 0 PHYS_UNIT "MtrNm" READ_WRITE SYMBOL_LINK "Rte_LmtCod_ThermalLimitLtd_MtrNm_f32" 0 /end MEASUREMENT
/begin MEASUREMENT LmtCod_VehSpdLimitLtd_MtrNm_f32 "" FLOAT32_IEEE NO_COMPU_METHOD 0 0 0 8.8 DISPLAY_IDENTIFIER VehSpdLimit_Ltd ECU_ADDRESS 0 PHYS_UNIT "MtrNm" READ_WRITE SYMBOL_LINK "Rte_LmtCod_VehSpdLimitLtd_MtrNm_f32" 0 /end MEASUREMENT
/begin MEASUREMENT LnRkCr_LTRackCntrComplete_Cnt_lgc "NVM Instance of the state of the rack center algorithm" UBYTE Boolean 0 0 0 1 DISPLAY_IDENTIFIER LTRckCntr_Complete ECU_ADDRESS 0 PHYS_UNIT "Counts" READ_WRITE SYMBOL_LINK "Rte_LnRkCr_LTRackCntrComplete_Cnt_lgc" 0 /end MEASUREMENT
/begin MEASUREMENT LnRkCr_RackCenter_HwDeg_f32 "Identifies the computed offset term for the rack center (in handwheel degrees)" FLOAT32_IEEE NO_COMPU_METHOD 0 0 -900 900 DISPLAY_IDENTIFIER RackCenter_HwDeg ECU_ADDRESS 0 PHYS_UNIT "HwDeg" READ_WRITE SYMBOL_LINK "Rte_LnRkCr_RackCenter_HwDeg_f32" 0 /end MEASUREMENT
/begin MEASUREMENT LnRkCr_RackCntrComplete_Cnt_lgc "RAM value that indicates if the computation of Rack Center has been performed" UBYTE Boolean 0 0 0 1 DISPLAY_IDENTIFIER RackCntr_Complete ECU_ADDRESS 0 PHYS_UNIT "Counts" READ_WRITE SYMBOL_LINK "Rte_LnRkCr_RackCntrComplete_Cnt_lgc" 0 /end MEASUREMENT
/begin MEASUREMENT RackCntrComplete_Cnt_M_lgc "" UBYTE Boolean 0 0 0 1 ECU_ADDRESS 0 PHYS_UNIT "Counts" READ_WRITE /end MEASUREMENT
/begin MEASUREMENT CcwEOTTimer_mS_M_u32 "" ULONG NO_COMPU_METHOD 0 0 0 4294967295 ECU_ADDRESS 0 PHYS_UNIT "mS" READ_WRITE /end MEASUREMENT
/begin MEASUREMENT LrnEOT_CCWFound_Cnt_lgc "Boolean indicating whether or not a learned position has been found in the counter clockwise direction" UBYTE Boolean 0 0 0 1 DISPLAY_IDENTIFIER Ccw_Found ECU_ADDRESS 0 PHYS_UNIT "Counts" READ_WRITE SYMBOL_LINK "Rte_LrnEOT_CCWFound_Cnt_lgc" 0 /end MEASUREMENT
/begin MEASUREMENT LrnEOT_CCWPosition_HwDeg_f32 "End of travel learned position in the counter-clockwise direction.  This is an NVM value that is both an input and output for the function" FLOAT32_IEEE NO_COMPU_METHOD 0 0 -900 900 DISPLAY_IDENTIFIER Ccw_EOT ECU_ADDRESS 0 PHYS_UNIT "HwDeg" READ_WRITE SYMBOL_LINK "Rte_LrnEOT_CCWPosition_HwDeg_f32" 0 /end MEASUREMENT
/begin MEASUREMENT CwEOTTimer_mS_M_u32 "" ULONG NO_COMPU_METHOD 0 0 0 4294967295 ECU_ADDRESS 0 PHYS_UNIT "mS" READ_WRITE /end MEASUREMENT
/begin MEASUREMENT LrnEOT_CWFound_Cnt_lgc "Boolean indicating whether or not a learned position has been found in the clockwise direction" UBYTE Boolean 0 0 0 1 DISPLAY_IDENTIFIER Cw_Found ECU_ADDRESS 0 PHYS_UNIT "Counts" READ_WRITE SYMBOL_LINK "Rte_LrnEOT_CWFound_Cnt_lgc" 0 /end MEASUREMENT
/begin MEASUREMENT LrnEOT_CWPosition_HwDeg_f32 "End of travel learned position in the clockwise direction.  This is an NVM value that is both an input and output for the function" FLOAT32_IEEE NO_COMPU_METHOD 0 0 -900 900 DISPLAY_IDENTIFIER Cw_EOT ECU_ADDRESS 0 PHYS_UNIT "HwDeg" READ_WRITE SYMBOL_LINK "Rte_LrnEOT_CWPosition_HwDeg_f32" 0 /end MEASUREMENT
/begin MEASUREMENT Position1Timer_mS_M_u32 "" ULONG NO_COMPU_METHOD 0 0 0 4294967295 ECU_ADDRESS 0 PHYS_UNIT "mS" READ_WRITE /end MEASUREMENT
/begin MEASUREMENT Position2Timer_mS_M_u32 "" ULONG NO_COMPU_METHOD 0 0 0 4294967295 ECU_ADDRESS 0 PHYS_UNIT "mS" READ_WRITE /end MEASUREMENT
/begin MEASUREMENT ResetLimitReq_Cnt_M_lgc "A Boolean signal indicating the desire to reset the end of travel learned data" UBYTE Boolean 0 0 0 1 DISPLAY_IDENTIFIER ResetLimitReq ECU_ADDRESS 0 PHYS_UNIT "Counts" READ_WRITE /end MEASUREMENT
/begin MEASUREMENT CDD_MetricsTraceIdx_Cnt_G_u16 "First unused index in MetricsTrace array." UWORD NO_COMPU_METHOD 0 0 0 65535 DISPLAY_IDENTIFIER None ECU_ADDRESS 0 READ_WRITE /end MEASUREMENT
/begin MEASUREMENT CDD_MetricsTraceOffset_uS_G_u32 "Time taken for system to reach GPT init." ULONG NO_COMPU_METHOD 0 0 0 4294967295 DISPLAY_IDENTIFIER None ECU_ADDRESS 0 PHYS_UNIT "uS" READ_WRITE /end MEASUREMENT
/begin MEASUREMENT Metrics_ActiveRunnable_Cnt_M_u16 "Runnable currently exectuing in active task." UWORD NO_COMPU_METHOD 0 0 0 65535 DISPLAY_IDENTIFIER None ECU_ADDRESS 0 READ_WRITE /end MEASUREMENT
/begin MEASUREMENT Metrics_ActiveTask_Cnt_M_u16 "Currently executing task." UWORD NO_COMPU_METHOD 0 0 0 65535 DISPLAY_IDENTIFIER None ECU_ADDRESS 0 READ_WRITE /end MEASUREMENT
/begin MEASUREMENT Metrics_BkgndLoopTimeMax_Cnt_M_u32 "Longest period of time spent in the background." ULONG NO_COMPU_METHOD 0 0 0 4294967296 DISPLAY_IDENTIFIER None ECU_ADDRESS 0 READ_WRITE /end MEASUREMENT
/begin MEASUREMENT Metrics_CpuUse_Pct_M_f32 "Overall CPU utilization." FLOAT32_IEEE NO_COMPU_METHOD 0 0 0 100 DISPLAY_IDENTIFIER None ECU_ADDRESS 0 PHYS_UNIT "%" READ_WRITE /end MEASUREMENT
/begin MEASUREMENT Metrics_LastStackUseCalc_uS_M_u32 "Time of last stack use calculation." ULONG NO_COMPU_METHOD 0 0 0 4294967296 DISPLAY_IDENTIFIER None ECU_ADDRESS 0 READ_WRITE /end MEASUREMENT
/begin MEASUREMENT Metrics_RunnableTimes_Str "Array structure containing runnable metrics." ULONG NO_COMPU_METHOD 0 0 0 4294967295 DISPLAY_IDENTIFIER None ECU_ADDRESS 0 READ_WRITE /end MEASUREMENT
/begin MEASUREMENT Metrics_StackSize_Cnt_M_u16 "Size of each task stack" UWORD NO_COMPU_METHOD 0 0 0 65536 DISPLAY_IDENTIFIER None ECU_ADDRESS 0 PHYS_UNIT "Bytes" READ_WRITE /end MEASUREMENT
/begin MEASUREMENT Metrics_StackUse_Cnt_M_u16 "Max used stack space." UWORD NO_COMPU_METHOD 0 0 0 65536 DISPLAY_IDENTIFIER None ECU_ADDRESS 0 PHYS_UNIT "Bytes" READ_WRITE /end MEASUREMENT
/begin MEASUREMENT Metrics_TaskTimes_Str "Array structure containing task metrics." ULONG NO_COMPU_METHOD 0 0 0 4294967295 DISPLAY_IDENTIFIER None ECU_ADDRESS 0 READ_WRITE /end MEASUREMENT
/begin MEASUREMENT AmbPwr_Watts_D_f32 "" FLOAT32_IEEE NO_COMPU_METHOD 0 0 0 62500 DISPLAY_IDENTIFIER Est_Watts ECU_ADDRESS 0 PHYS_UNIT "Watts" READ_WRITE /end MEASUREMENT
/begin MEASUREMENT AMCorr_DegC_D_f32 "" FLOAT32_IEEE NO_COMPU_METHOD 0 0 -50 150 DISPLAY_IDENTIFIER AM_CORR ECU_ADDRESS 0 PHYS_UNIT "DegC" READ_WRITE /end MEASUREMENT
/begin MEASUREMENT AMTempEst_DegC_M_f32 "" FLOAT32_IEEE NO_COMPU_METHOD 0 0 -100 100 ECU_ADDRESS 0 PHYS_UNIT "DegC" READ_WRITE /end MEASUREMENT
/begin MEASUREMENT AssistMechFilt_DegC_D_f32 "" FLOAT32_IEEE NO_COMPU_METHOD 0 0 -50 150 DISPLAY_IDENTIFIER AssistMechFilt ECU_ADDRESS 0 PHYS_UNIT "DegC" READ_WRITE /end MEASUREMENT
/begin MEASUREMENT AssistMechSlew_DegC_M_f32 "" FLOAT32_IEEE NO_COMPU_METHOD 0 0 0 10 ECU_ADDRESS 0 PHYS_UNIT "DegC" READ_WRITE /end MEASUREMENT
/begin MEASUREMENT MtrTempEst_AssistMechTempEst_DegC_f32 "" FLOAT32_IEEE NO_COMPU_METHOD 0 0 -50 150 DISPLAY_IDENTIFIER Assist_Mech_Temp_Est ECU_ADDRESS 0 PHYS_UNIT "DegC" READ_WRITE SYMBOL_LINK "Rte_MtrTempEst_AssistMechTempEst_DegC_f32" 0 /end MEASUREMENT
/begin MEASUREMENT AssMechFiltSV_DegC_M_f32 "" FLOAT32_IEEE NO_COMPU_METHOD 0 0 -150 150 ECU_ADDRESS 0 PHYS_UNIT "DegC" READ_WRITE /end MEASUREMENT
/begin MEASUREMENT AssMechInitComp_Cnt_M_lgc "" UBYTE Boolean 0 0 0 1 ECU_ADDRESS 0 PHYS_UNIT "Cnt" READ_WRITE /end MEASUREMENT
/begin MEASUREMENT AsstMechLPFiltSV_Watts_M_str.K_Uls_f32 "" SLONG NO_COMPU_METHOD 0 0 0.0000628299 0.060899 ECU_ADDRESS 0 PHYS_UNIT "Uls" READ_WRITE /end MEASUREMENT
/begin MEASUREMENT AsstMechLPFiltSV_Watts_M_str.SV_Uls_f32 "" SLONG NO_COMPU_METHOD 0 0 0 2048 ECU_ADDRESS 0 PHYS_UNIT "Watts" READ_WRITE /end MEASUREMENT
/begin MEASUREMENT CuAmbLPFiltSV_Watts_M_str.K_Uls_f32 "" SLONG NO_COMPU_METHOD 0 0 0.0000628299 0.060899 ECU_ADDRESS 0 PHYS_UNIT "Uls" READ_WRITE /end MEASUREMENT
/begin MEASUREMENT CuAmbLPFiltSV_Watts_M_str.SV_Uls_f32 "" SLONG NO_COMPU_METHOD 0 0 0 25 ECU_ADDRESS 0 PHYS_UNIT "Watts" READ_WRITE /end MEASUREMENT
/begin MEASUREMENT CuCorr_DegC_D_f32 "" FLOAT32_IEEE NO_COMPU_METHOD 0 0 -100 100 DISPLAY_IDENTIFIER CU_CORR ECU_ADDRESS 0 PHYS_UNIT "DegC" READ_WRITE /end MEASUREMENT
/begin MEASUREMENT CuLLFiltSV_DegC_M_f32 "" FLOAT32_IEEE NO_COMPU_METHOD 0 0 -50 150 ECU_ADDRESS 0 PHYS_UNIT "DegC" READ_WRITE /end MEASUREMENT
/begin MEASUREMENT MtrTempEst_CuTempEst_DegC_f32 "" FLOAT32_IEEE NO_COMPU_METHOD 0 0 -50 150 DISPLAY_IDENTIFIER Cu_Temp_Est ECU_ADDRESS 0 PHYS_UNIT "DegC" READ_WRITE SYMBOL_LINK "Rte_MtrTempEst_CuTempEst_DegC_f32" 0 /end MEASUREMENT
/begin MEASUREMENT EstMech_Watts_D_f32 "" FLOAT32_IEEE NO_COMPU_METHOD 0 0 0 250 DISPLAY_IDENTIFIER Est_Mech_Watts ECU_ADDRESS 0 PHYS_UNIT "Watts" READ_WRITE /end MEASUREMENT
/begin MEASUREMENT MagAmbLPFiltSV_Watts_M_str.K_Uls_f32 "" SLONG NO_COMPU_METHOD 0 0 0.0000628299 0.060899 ECU_ADDRESS 0 PHYS_UNIT "Uls" READ_WRITE /end MEASUREMENT
/begin MEASUREMENT MagAmbLPFiltSV_Watts_M_str.SV_Uls_f32 "" SLONG NO_COMPU_METHOD 0 0 0 25 ECU_ADDRESS 0 PHYS_UNIT "Watts" READ_WRITE /end MEASUREMENT
/begin MEASUREMENT MagCorr_DegC_D_f32 "" FLOAT32_IEEE NO_COMPU_METHOD 0 0 -100 100 DISPLAY_IDENTIFIER MAG_CORR ECU_ADDRESS 0 PHYS_UNIT "DegC" READ_WRITE /end MEASUREMENT
/begin MEASUREMENT MagLLFiltSV_DegC_M_f32 "" FLOAT32_IEEE NO_COMPU_METHOD 0 0 -50 150 ECU_ADDRESS 0 PHYS_UNIT "DegC" READ_WRITE /end MEASUREMENT
/begin MEASUREMENT MtrTempEst_MagTempEst_DegC_f32 "" FLOAT32_IEEE NO_COMPU_METHOD 0 0 -50 150 DISPLAY_IDENTIFIER Mag_Temp_Est ECU_ADDRESS 0 PHYS_UNIT "DegC" READ_WRITE SYMBOL_LINK "Rte_MtrTempEst_MagTempEst_DegC_f32" 0 /end MEASUREMENT
/begin MEASUREMENT ScaledAmbTemp_DegC_D_f32 "" FLOAT32_IEEE NO_COMPU_METHOD 0 0 -40 87.5 DISPLAY_IDENTIFIER Scaled_Amb_Temp ECU_ADDRESS 0 PHYS_UNIT "DegC" READ_WRITE /end MEASUREMENT
/begin MEASUREMENT ScaledEngTemp_DegC_D_f32 "" FLOAT32_IEEE NO_COMPU_METHOD 0 0 -40 215 DISPLAY_IDENTIFIER Scaled_EngineTemp ECU_ADDRESS 0 PHYS_UNIT "DegC" READ_WRITE /end MEASUREMENT
/begin MEASUREMENT SiAmbLPFiltSV_Watts_M_str.K_Uls_f32 "" SLONG NO_COMPU_METHOD 0 0 0.0000628299 0.060899 ECU_ADDRESS 0 PHYS_UNIT "Uls" READ_WRITE /end MEASUREMENT
/begin MEASUREMENT SiAmbLPFiltSV_Watts_M_str.SV_Uls_f32 "" SLONG NO_COMPU_METHOD 0 0 0 25 ECU_ADDRESS 0 PHYS_UNIT "Watts" READ_WRITE /end MEASUREMENT
/begin MEASUREMENT SiCorr_DegC_D_f32 "" FLOAT32_IEEE NO_COMPU_METHOD 0 0 -100 100 DISPLAY_IDENTIFIER SI_CORR ECU_ADDRESS 0 PHYS_UNIT "DegC" READ_WRITE /end MEASUREMENT
/begin MEASUREMENT SiLLFiltSV_DegC_M_f32 "" FLOAT32_IEEE NO_COMPU_METHOD 0 0 -50 150 ECU_ADDRESS 0 PHYS_UNIT "DegC" READ_WRITE /end MEASUREMENT
/begin MEASUREMENT MtrTempEst_SiTempEst_DegC_f32 "" FLOAT32_IEEE NO_COMPU_METHOD 0 0 -50 150 DISPLAY_IDENTIFIER Si_Temp_Est ECU_ADDRESS 0 PHYS_UNIT "DegC" READ_WRITE SYMBOL_LINK "Rte_MtrTempEst_SiTempEst_DegC_f32" 0 /end MEASUREMENT
/begin MEASUREMENT PrkAstMfgServCh2_LrnPnCntrDisable_Cnt_lgc "Output that disables the LrnPnCntrCmd" UBYTE Boolean 0 0 0 1 DISPLAY_IDENTIFIER SysC_LrnPnCtr_CC_Disable ECU_ADDRESS 0 PHYS_UNIT "Counts" READ_WRITE SYMBOL_LINK "Rte_PrkAstMfgServCh2_LrnPnCntrDisable_Cnt_lgc" 0 /end MEASUREMENT
/begin MEASUREMENT LrnPnCntrErrAcc_Cnt_M_u16 "Error Accumulator" UWORD NO_COMPU_METHOD 0 0 0 65535 DISPLAY_IDENTIFIER SysC_LrnPnCtr_ErrorAcc ECU_ADDRESS 0 PHYS_UNIT "Counts" READ_WRITE /end MEASUREMENT
/begin MEASUREMENT PrkAstMfgServCh2_PrkAssistDisable_Cnt_lgc "Output that disables the PrkAssistCmd" UBYTE Boolean 0 0 0 1 DISPLAY_IDENTIFIER SysC_PosServ_CC_Disable ECU_ADDRESS 0 PHYS_UNIT "Counts" READ_WRITE SYMBOL_LINK "Rte_PrkAstMfgServCh2_PrkAssistDisable_Cnt_lgc" 0 /end MEASUREMENT
/begin MEASUREMENT PrkAssistErrAcc_Cnt_M_u16 "Error Accumulator" UWORD NO_COMPU_METHOD 0 0 0 65535 DISPLAY_IDENTIFIER SysC_PosServ_ErrAcc ECU_ADDRESS 0 PHYS_UNIT "Counts" READ_WRITE /end MEASUREMENT
/begin MEASUREMENT CurrSrlComVehSpd_Kph_M_f32 "" FLOAT32_IEEE NO_COMPU_METHOD 0 0 0 350 ECU_ADDRESS 0 PHYS_UNIT "Kph" READ_WRITE /end MEASUREMENT
/begin MEASUREMENT SgnlCond_VehicleSpeed_Kph_f32 "Vehicle Speed Value, conditioned to a safe rate of change" FLOAT32_IEEE NO_COMPU_METHOD 0 0 0 350 DISPLAY_IDENTIFIER Vehicle_Speed ECU_ADDRESS 0 PHYS_UNIT "Kph" READ_WRITE SYMBOL_LINK "Rte_SgnlCond_VehicleSpeed_Kph_f32" 0 /end MEASUREMENT
/begin MEASUREMENT SteaPniOffsErrorCounter_Cnt_M_u16 "" UWORD NO_COMPU_METHOD 0 0 0 3 ECU_ADDRESS 0 PHYS_UNIT "Cnt" READ_WRITE /end MEASUREMENT
/begin MEASUREMENT SteaPniOffsErrorRecovery_Cnt_M_u16 "" UWORD NO_COMPU_METHOD 0 0 0 3 ECU_ADDRESS 0 PHYS_UNIT "Cnt" READ_WRITE /end MEASUREMENT
/begin MEASUREMENT SteaPniOffsInvalidCounter_Cnt_M_u16 "" UWORD NO_COMPU_METHOD 0 0 0 3 ECU_ADDRESS 0 PHYS_UNIT "Cnt" READ_WRITE /end MEASUREMENT
/begin MEASUREMENT SteaPniOffsLossFltCounter_Cnt_M_u16 "" UWORD NO_COMPU_METHOD 0 0 0 65535 ECU_ADDRESS 0 PHYS_UNIT "Cnt" READ_WRITE /end MEASUREMENT
/begin MEASUREMENT CTRERRMUpateTimer_Cnt_M_u32 "" ULONG NO_COMPU_METHOD 0 0 0 4294967295 ECU_ADDRESS 0 PHYS_UNIT "Cnt" READ_WRITE /end MEASUREMENT
/begin MEASUREMENT DTPT2AliveCntStart_Cnt_M_lgc "" UBYTE Boolean 0 0 0 1 ECU_ADDRESS 0 PHYS_UNIT "Cnt" READ_WRITE /end MEASUREMENT
/begin MEASUREMENT DTPT2AliveCounter_Cnt_M_u08 "" UBYTE NO_COMPU_METHOD 0 0 0 3 ECU_ADDRESS 0 PHYS_UNIT "Cnt" READ_WRITE /end MEASUREMENT
/begin MEASUREMENT DTPT2AliveFault_Cnt_M_u08 "" UBYTE NO_COMPU_METHOD 0 0 0 3 ECU_ADDRESS 0 PHYS_UNIT "Cnt" READ_WRITE /end MEASUREMENT
/begin MEASUREMENT DTPT2AliveFaultRecovery_Cnt_M_u08 "" UBYTE NO_COMPU_METHOD 0 0 0 3 ECU_ADDRESS 0 PHYS_UNIT "Cnt" READ_WRITE /end MEASUREMENT
/begin MEASUREMENT DTPT2ErrorCounter_Cnt_M_u16 "" UWORD NO_COMPU_METHOD 0 0 0 3 ECU_ADDRESS 0 PHYS_UNIT "Cnt" READ_WRITE /end MEASUREMENT
/begin MEASUREMENT DTPT2ErrorRecovery_Cnt_M_u16 "" UWORD NO_COMPU_METHOD 0 0 0 3 ECU_ADDRESS 0 PHYS_UNIT "Cnt" READ_WRITE /end MEASUREMENT
/begin MEASUREMENT DTPT2InvalidCounter_Cnt_M_u16 "" UWORD NO_COMPU_METHOD 0 0 0 3 ECU_ADDRESS 0 PHYS_UNIT "Cnt" READ_WRITE /end MEASUREMENT
/begin MEASUREMENT DTPT2LossFltCounter_Cnt_M_u16 "" UWORD NO_COMPU_METHOD 0 0 0 65535 ECU_ADDRESS 0 PHYS_UNIT "Cnt" READ_WRITE /end MEASUREMENT
/begin MEASUREMENT FrErrorStatus_Cnt_D_str.CHIHaltRequest "" UBYTE NO_COMPU_METHOD 0 0 0 255 ECU_ADDRESS 0 PHYS_UNIT "Cnt" READ_WRITE /end MEASUREMENT
/begin MEASUREMENT FrErrorStatus_Cnt_D_str.ColdstartNoise "" UBYTE NO_COMPU_METHOD 0 0 0 255 ECU_ADDRESS 0 PHYS_UNIT "Cnt" READ_WRITE /end MEASUREMENT
/begin MEASUREMENT FrErrorStatus_Cnt_D_str.ErrorMode "" UBYTE NO_COMPU_METHOD 0 0 0 255 ECU_ADDRESS 0 PHYS_UNIT "Cnt" READ_WRITE /end MEASUREMENT
/begin MEASUREMENT FrErrorStatus_Cnt_D_str.Freeze "" UBYTE NO_COMPU_METHOD 0 0 0 255 ECU_ADDRESS 0 PHYS_UNIT "Cnt" READ_WRITE /end MEASUREMENT
/begin MEASUREMENT FrErrorStatus_Cnt_D_str.SlotMode "" UBYTE NO_COMPU_METHOD 0 0 0 255 ECU_ADDRESS 0 PHYS_UNIT "Cnt" READ_WRITE /end MEASUREMENT
/begin MEASUREMENT FrErrorStatus_Cnt_D_str.StartupState "" UBYTE NO_COMPU_METHOD 0 0 0 255 ECU_ADDRESS 0 PHYS_UNIT "Cnt" READ_WRITE /end MEASUREMENT
/begin MEASUREMENT FrErrorStatus_Cnt_D_str.State "" UBYTE NO_COMPU_METHOD 0 0 0 255 ECU_ADDRESS 0 PHYS_UNIT "Cnt" READ_WRITE /end MEASUREMENT
/begin MEASUREMENT FrErrorStatus_Cnt_D_str.WakeupStatus "" UBYTE NO_COMPU_METHOD 0 0 0 255 ECU_ADDRESS 0 PHYS_UNIT "Cnt" READ_WRITE /end MEASUREMENT
/begin MEASUREMENT FZZSTDLossFltCounter_Cnt_M_u16 "" UWORD NO_COMPU_METHOD 0 0 0 500 ECU_ADDRESS 0 PHYS_UNIT "Cnt" READ_WRITE /end MEASUREMENT
/begin MEASUREMENT IgnoreDET_Cnt_M_u08 "" UBYTE NO_COMPU_METHOD 0 0 0 255 ECU_ADDRESS 0 PHYS_UNIT "Cnt" READ_WRITE /end MEASUREMENT
/begin MEASUREMENT InvldTuningSelCntr_Cnt_M_u8 "" UBYTE NO_COMPU_METHOD 0 0 0 3 ECU_ADDRESS 0 PHYS_UNIT "Cnt" READ_WRITE /end MEASUREMENT
/begin MEASUREMENT InvldTuningSelDataCntr_Cnt_M_u8 "" UBYTE NO_COMPU_METHOD 0 0 0 3 ECU_ADDRESS 0 PHYS_UNIT "Cnt" READ_WRITE /end MEASUREMENT
/begin MEASUREMENT KL15NAliveCntStart_Cnt_M_lgc "" UBYTE Boolean 0 0 0 1 ECU_ADDRESS 0 PHYS_UNIT "Cnt" READ_WRITE /end MEASUREMENT
/begin MEASUREMENT KL15NAliveCounter_Cnt_M_u08 "" UBYTE NO_COMPU_METHOD 0 0 0 3 ECU_ADDRESS 0 PHYS_UNIT "Cnt" READ_WRITE /end MEASUREMENT
/begin MEASUREMENT KL15NAliveFault_Cnt_M_u08 "" UBYTE NO_COMPU_METHOD 0 0 0 3 ECU_ADDRESS 0 PHYS_UNIT "Cnt" READ_WRITE /end MEASUREMENT
/begin MEASUREMENT KL15NAliveFaultRecovery_Cnt_M_u08 "" UBYTE NO_COMPU_METHOD 0 0 0 3 ECU_ADDRESS 0 PHYS_UNIT "Cnt" READ_WRITE /end MEASUREMENT
/begin MEASUREMENT KL15NErrorCounter_Cnt_M_u08 "" UBYTE NO_COMPU_METHOD 0 0 0 255 ECU_ADDRESS 0 PHYS_UNIT "Cnt" READ_WRITE /end MEASUREMENT
/begin MEASUREMENT KL15NErrorRecovery_Cnt_M_u16 "" UWORD NO_COMPU_METHOD 0 0 0 3 ECU_ADDRESS 0 PHYS_UNIT "Cnt" READ_WRITE /end MEASUREMENT
/begin MEASUREMENT KL15NLossFltCounter_Cnt_M_u16 "" UWORD NO_COMPU_METHOD 0 0 0 65535 ECU_ADDRESS 0 PHYS_UNIT "Cnt" READ_WRITE /end MEASUREMENT
/begin MEASUREMENT KL15NVldCounter_Cnt_M_u08 "" UBYTE NO_COMPU_METHOD 0 0 0 3 ECU_ADDRESS 0 PHYS_UNIT "Cnt" READ_WRITE /end MEASUREMENT
/begin MEASUREMENT MileKMLossFltCounter_Cnt_M_u16 "" UWORD NO_COMPU_METHOD 0 0 0 500 ECU_ADDRESS 0 PHYS_UNIT "Cnt" READ_WRITE /end MEASUREMENT
/begin MEASUREMENT PrevRxDrvVehDTPT2_Cnt_M_u16 "" UWORD NO_COMPU_METHOD 0 0 0 65535 ECU_ADDRESS 0 PHYS_UNIT "Cnt" READ_WRITE /end MEASUREMENT
/begin MEASUREMENT PrevSteaPinOffs_HwDeg_M_f32 "" FLOAT32_IEEE NO_COMPU_METHOD 0 0 -2147483648 2147483647 ECU_ADDRESS 0 PHYS_UNIT "HwDeg" READ_WRITE /end MEASUREMENT
/begin MEASUREMENT PwrLmt_Watts_M_f32 "" FLOAT32_IEEE NO_COMPU_METHOD 0 0 -2147483648 2147483647 ECU_ADDRESS 0 PHYS_UNIT "Watts" READ_WRITE /end MEASUREMENT
/begin MEASUREMENT PwrLmtErrorRecovery_Cnt_M_u08 "" UBYTE NO_COMPU_METHOD 0 0 0 3 ECU_ADDRESS 0 PHYS_UNIT "Cnt" READ_WRITE /end MEASUREMENT
/begin MEASUREMENT PwrLmtLossFltCounter_Cnt_M_u16 "" UWORD NO_COMPU_METHOD 0 0 0 65535 ECU_ADDRESS 0 PHYS_UNIT "Cnt" READ_WRITE /end MEASUREMENT
/begin MEASUREMENT PwrLmtVldCounter_Cnt_M_u08 "" UBYTE NO_COMPU_METHOD 0 0 0 3 ECU_ADDRESS 0 PHYS_UNIT "Cnt" READ_WRITE /end MEASUREMENT
/begin MEASUREMENT RevOffsetLossFltCounter_Cnt_M_u16 "" UWORD NO_COMPU_METHOD 0 0 0 65535 ECU_ADDRESS 0 PHYS_UNIT "Cnt" READ_WRITE /end MEASUREMENT
/begin MEASUREMENT RxDTPT2AliveCnt_Cnt_M_u16 "" UWORD NO_COMPU_METHOD 0 0 0 15 ECU_ADDRESS 0 PHYS_UNIT "Cnt" READ_WRITE /end MEASUREMENT
/begin MEASUREMENT RxKL15NAliveCnt_Cnt_M_u16 "" UWORD NO_COMPU_METHOD 0 0 0 15 ECU_ADDRESS 0 PHYS_UNIT "Cnt" READ_WRITE /end MEASUREMENT
/begin MEASUREMENT RxVIN_Cnt_M_Str.VIN_BYTE1 "" UBYTE NO_COMPU_METHOD 0 0 0 255 ECU_ADDRESS 0 PHYS_UNIT "Cnt" READ_WRITE /end MEASUREMENT
/begin MEASUREMENT RxVIN_Cnt_M_Str.VIN_BYTE2 "" UBYTE NO_COMPU_METHOD 0 0 0 255 ECU_ADDRESS 0 PHYS_UNIT "Cnt" READ_WRITE /end MEASUREMENT
/begin MEASUREMENT RxVIN_Cnt_M_Str.VIN_BYTE3 "" UBYTE NO_COMPU_METHOD 0 0 0 255 ECU_ADDRESS 0 PHYS_UNIT "Cnt" READ_WRITE /end MEASUREMENT
/begin MEASUREMENT RxVIN_Cnt_M_Str.VIN_BYTE4 "" UBYTE NO_COMPU_METHOD 0 0 0 255 ECU_ADDRESS 0 PHYS_UNIT "Cnt" READ_WRITE /end MEASUREMENT
/begin MEASUREMENT RxVIN_Cnt_M_Str.VIN_BYTE5 "" UBYTE NO_COMPU_METHOD 0 0 0 255 ECU_ADDRESS 0 PHYS_UNIT "Cnt" READ_WRITE /end MEASUREMENT
/begin MEASUREMENT RxVIN_Cnt_M_Str.VIN_BYTE6 "" UBYTE NO_COMPU_METHOD 0 0 0 255 ECU_ADDRESS 0 PHYS_UNIT "Cnt" READ_WRITE /end MEASUREMENT
/begin MEASUREMENT RxVIN_Cnt_M_Str.VIN_BYTE7 "" UBYTE NO_COMPU_METHOD 0 0 0 255 ECU_ADDRESS 0 PHYS_UNIT "Cnt" READ_WRITE /end MEASUREMENT
/begin MEASUREMENT SrlComEngCrank_Cnt_M_lgc "" UBYTE Boolean 0 0 0 1 ECU_ADDRESS 0 PHYS_UNIT "Cnt" READ_WRITE /end MEASUREMENT
/begin MEASUREMENT SrlComSVCTxReq_Cnt_M_b16 "" UWORD NO_COMPU_METHOD 0 0 0 65535 ECU_ADDRESS 0 PHYS_UNIT "Cnt" READ_WRITE /end MEASUREMENT
/begin MEASUREMENT StartUpDTCMaskActive_Cnt_M_lgc "" UBYTE Boolean 0 0 0 1 ECU_ADDRESS 0 PHYS_UNIT "Cnt" READ_WRITE /end MEASUREMENT
/begin MEASUREMENT StartUpDTCMaskTimer_Cnt_M_u32 "" ULONG NO_COMPU_METHOD 0 0 0 4294967295 ECU_ADDRESS 0 PHYS_UNIT "Cnt" READ_WRITE /end MEASUREMENT
/begin MEASUREMENT STVehConErrorRecovery_Cnt_M_u08 "" UBYTE NO_COMPU_METHOD 0 0 0 3 ECU_ADDRESS 0 PHYS_UNIT "Cnt" READ_WRITE /end MEASUREMENT
/begin MEASUREMENT STVEHCONInvalid_Cnt_M_lgc "" UBYTE Boolean 0 0 0 1 ECU_ADDRESS 0 PHYS_UNIT "Cnt" READ_WRITE /end MEASUREMENT
/begin MEASUREMENT STVehConUpateTimer_Cnt_M_u32 "" ULONG NO_COMPU_METHOD 0 0 0 4294967295 ECU_ADDRESS 0 PHYS_UNIT "Cnt" READ_WRITE /end MEASUREMENT
/begin MEASUREMENT STVehConVldCounter_Cnt_M_u08 "" UBYTE NO_COMPU_METHOD 0 0 0 3 ECU_ADDRESS 0 PHYS_UNIT "Cnt" READ_WRITE /end MEASUREMENT
/begin MEASUREMENT TarQtaStMomLossFltCounter_Cnt_M_u16 "" UWORD NO_COMPU_METHOD 0 0 0 65535 ECU_ADDRESS 0 PHYS_UNIT "Cnt" READ_WRITE /end MEASUREMENT
/begin MEASUREMENT TarStMomLossFltCounter_Cnt_M_u16 "" UWORD NO_COMPU_METHOD 0 0 0 65535 ECU_ADDRESS 0 PHYS_UNIT "Cnt" READ_WRITE /end MEASUREMENT
/begin MEASUREMENT TuningSelLossFltCounter_Cnt_M_u16 "" UWORD NO_COMPU_METHOD 0 0 0 65535 ECU_ADDRESS 0 PHYS_UNIT "Cnt" READ_WRITE /end MEASUREMENT
/begin MEASUREMENT VehSpdLossFltCounter_Cnt_M_u16 "" UWORD NO_COMPU_METHOD 0 0 0 65535 ECU_ADDRESS 0 PHYS_UNIT "Cnt" READ_WRITE /end MEASUREMENT
/begin MEASUREMENT VINErrorRecovery_Cnt_M_u16 "" UWORD NO_COMPU_METHOD 0 0 0 3 ECU_ADDRESS 0 PHYS_UNIT "Cnt" READ_WRITE /end MEASUREMENT
/begin MEASUREMENT VINLossFltCounter_Cnt_M_u16 "" UWORD NO_COMPU_METHOD 0 0 0 65535 ECU_ADDRESS 0 PHYS_UNIT "Cnt" READ_WRITE /end MEASUREMENT
/begin MEASUREMENT VINVldCounter_Cnt_M_u08 "" UBYTE NO_COMPU_METHOD 0 0 0 3 ECU_ADDRESS 0 PHYS_UNIT "Cnt" READ_WRITE /end MEASUREMENT
/begin MEASUREMENT AVLFORCGRDTxConf_Cnt_M_lgc "" UBYTE Boolean 0 0 0 1 ECU_ADDRESS 0 PHYS_UNIT "Cnt" READ_WRITE /end MEASUREMENT
/begin MEASUREMENT AVLPOEPSTxConf_Cnt_M_lgc "" UBYTE Boolean 0 0 0 1 ECU_ADDRESS 0 PHYS_UNIT "Cnt" READ_WRITE /end MEASUREMENT
/begin MEASUREMENT AVLSTMOMTxConf_Cnt_M_lgc "" UBYTE Boolean 0 0 0 1 ECU_ADDRESS 0 PHYS_UNIT "Cnt" READ_WRITE /end MEASUREMENT
/begin MEASUREMENT DisableModeEntry_Cnt_M_lgc "" UBYTE Boolean 0 0 0 1 ECU_ADDRESS 0 PHYS_UNIT "Cnt" READ_WRITE /end MEASUREMENT
/begin MEASUREMENT DispCcAliveCounter_Cnt_M_u08 "" UBYTE NO_COMPU_METHOD 0 0 0 15 ECU_ADDRESS 0 PHYS_UNIT "Cnt" READ_WRITE /end MEASUREMENT
/begin MEASUREMENT EPSFuncQual_Cnt_M_enum "" UBYTE NO_COMPU_METHOD 0 0 0 255 ECU_ADDRESS 0 PHYS_UNIT "Cnt" READ_WRITE /end MEASUREMENT
/begin MEASUREMENT FrCycOffline_Cnt_M_u08 "" UBYTE NO_COMPU_METHOD 0 0 0 1 ECU_ADDRESS 0 PHYS_UNIT "Cnt" READ_WRITE /end MEASUREMENT
/begin MEASUREMENT OnChangeTxActive_Cnt_M_lgc "" UBYTE Boolean 0 0 0 1 ECU_ADDRESS 0 PHYS_UNIT "Cnt" READ_WRITE /end MEASUREMENT
/begin MEASUREMENT StEst_M_Str.ALIV_ST_EST_FTAX "" UBYTE NO_COMPU_METHOD 0 0 0 255 ECU_ADDRESS 0 PHYS_UNIT "Cnt" READ_WRITE /end MEASUREMENT
/begin MEASUREMENT StEst_M_Str.CRC_ST_EST_FTAX "" UBYTE NO_COMPU_METHOD 0 0 0 255 ECU_ADDRESS 0 PHYS_UNIT "Cnt" READ_WRITE /end MEASUREMENT
/begin MEASUREMENT StEst_M_Str.QU_FN_EST "" UBYTE NO_COMPU_METHOD 0 0 0 255 ECU_ADDRESS 0 PHYS_UNIT "Cnt" READ_WRITE /end MEASUREMENT
/begin MEASUREMENT StEst_M_Str.QU_SER_PINA_EST_FTAX "" UBYTE NO_COMPU_METHOD 0 0 0 255 ECU_ADDRESS 0 PHYS_UNIT "Cnt" READ_WRITE /end MEASUREMENT
/begin MEASUREMENT StEst_M_Str.QU_SER_STMOM_DV_ACT "" UBYTE NO_COMPU_METHOD 0 0 0 255 ECU_ADDRESS 0 PHYS_UNIT "Cnt" READ_WRITE /end MEASUREMENT
/begin MEASUREMENT StEst_M_Str.ST_EST_0x0C_0x04 "" UBYTE NO_COMPU_METHOD 0 0 0 255 ECU_ADDRESS 0 PHYS_UNIT "Cnt" READ_WRITE /end MEASUREMENT
/begin MEASUREMENT StEstInitialTx_Cnt_M_lgc "" UBYTE Boolean 0 0 0 1 ECU_ADDRESS 0 PHYS_UNIT "Cnt" READ_WRITE /end MEASUREMENT
/begin MEASUREMENT StEstTxCounter_Cnt_M_u08 "" UBYTE NO_COMPU_METHOD 0 0 0 255 ECU_ADDRESS 0 PHYS_UNIT "Cnt" READ_WRITE /end MEASUREMENT
/begin MEASUREMENT StEstTxRepetitions_Cnt_M_u08 "" UBYTE NO_COMPU_METHOD 0 0 0 255 ECU_ADDRESS 0 PHYS_UNIT "Cnt" READ_WRITE /end MEASUREMENT
/begin MEASUREMENT TxSUEPS_Cnt_M_lgc "" UBYTE Boolean 0 0 0 1 ECU_ADDRESS 0 PHYS_UNIT "Cnt" READ_WRITE /end MEASUREMENT
/begin MEASUREMENT PrevOutputRampMult_Uls_M_f32 "" FLOAT32_IEEE NO_COMPU_METHOD 0 0 0 1 ECU_ADDRESS 0 PHYS_UNIT "Uls" READ_WRITE /end MEASUREMENT
/begin MEASUREMENT RampState_M_Str "" SWORD NO_COMPU_METHOD 0 0 -32768 32767 ECU_ADDRESS 0 READ_WRITE /end MEASUREMENT
/begin MEASUREMENT TMFTestComplete_Cnt_M_lgc "" UBYTE Boolean 0 0 0 1 ECU_ADDRESS 0 PHYS_UNIT "Counts" READ_WRITE /end MEASUREMENT
/begin MEASUREMENT IgnStuckStart_mS_M_u32 "" ULONG NO_COMPU_METHOD 0 0 0 4294967295 ECU_ADDRESS 0 PHYS_UNIT "ms" READ_WRITE /end MEASUREMENT
/begin MEASUREMENT Rate_XpmS_M_f32 "" FLOAT32_IEEE NO_COMPU_METHOD 0 0 0.0001 0.005 ECU_ADDRESS 0 PHYS_UNIT "XpmS" READ_WRITE /end MEASUREMENT
/begin MEASUREMENT Target_Uls_M_f32 "" FLOAT32_IEEE NO_COMPU_METHOD 0 0 0 1 ECU_ADDRESS 0 PHYS_UNIT "Uls" READ_WRITE /end MEASUREMENT
/begin GROUP FDDs "Data Dictionary Created Groupings based of FDDs" ROOT
 /begin SUB_GROUP SF25_HysteresisAdd SF02_Return FDD40A_TorqueOverlayInterfacesandParkAssistFunction FDD05C_AbsoluteHandwheelPositionFunction SF01_Assist SF34_AssistFirewall SF04_AssistSummationandLimiting SFD04_AssistSummationandLimitingFunction Unknown FDD08B_BatterySwitchedVoltage SER SF26_ControlledDisableShutdown SF06_TemperatureEstimation CF06_BMWCurrentLimit SF03_Damping SF35_DampingFirewall SF08_ElectricPowerConsumption SF18_EndofTravelActuatorManagement SF27_EOTDampingFirewall DF01_FaultInjection SF14_InertiaCompensationFrequencyDependentDamping FDD48_FlexrayErrorIndicationInterface SF21_GeneratePositionTrajectory SF37_GlobalSignalOverwriteDetection SF17_HighLoadStallThermalManagement FDD13B_HardwarePowerUpSequence FDD04A_AnalogHandwheelTorqueMeasurement SF12_HysteresisCompensation SF24_GenerateLocktoLockMotionToDeterminePinionCenter SF38_LimiterConditioning SF11_LearnedEndofTravelLimits None SF99_MotorControl FDD01B_CurrentMeasurement FDD06B_MotorPositionMeasurement FDD02B_MotorVelocity SF22_GenerateOscillationTrajectory FDD47_PhaseDisconnect FDD25_PolarityAssignments SF20_PositionTrackingServo SF19_PowerLimitFunction SF10_RackLoadEstimation SF36_ReturnFirewall FDD18_ShutdownMechanisms SF29_StabilityCompensation SF05_StateOutputControl FDD49_SineVoltageGenerationDiagnostics FDD15C_SineVoltageGenerationDrive SF09_ThermalDutyCycleProtection FDD19_TemporalMonitor SF30_TorqueBasedInertiaCompensation SF23_TuningSelectAuthority FDD20C_TurnsCounterColumnPositionSensor SF16_VehicleSpeedLimiting /end SUB_GROUP
/end GROUP
/begin GROUP SF25_HysteresisAdd "" /begin SUB_GROUP SF25.Internals SF25.Outputs SF25.Inputs /end SUB_GROUP /begin REF_CHARACTERISTIC t_HysAddOffsetTblY_HwNm_u4p12 /end REF_CHARACTERISTIC /end GROUP
/begin GROUP SF02_Return "" /begin SUB_GROUP SF02.Internals SF02.Outputs SF02.Inputs /end SUB_GROUP /begin REF_CHARACTERISTIC k_RtnOffsetRange_HWDeg_f32 k_RtnOffsetSlew_HwDegpS_f32 /end REF_CHARACTERISTIC /end GROUP
/begin GROUP FDD40A_TorqueOverlayInterfacesandParkAssistFunction "" /begin SUB_GROUP FDD40A.Internals FDD40A.Outputs FDD40A.Inputs /end SUB_GROUP /begin REF_CHARACTERISTIC k_PrkAstLimitPerc_Pct_f32 /end REF_CHARACTERISTIC /end GROUP
/begin GROUP FDD05C.Outputs ""
 /begin REF_MEASUREMENT AbsHwPos_AlignedHwPos_HwDeg_f32 AbsHwPos_HandwheelAuthority_Uls_f32 AbsHwPos_HandwheelPosition_HwDeg_f32 AbsHwPos_HwTargetAuthority_Uls_f32 AbsHwPos_ICMMtrPosMRF_Deg_f32 AbsHwPos_LTVehCenterComplete_Cnt_lgc AbsHwPos_RevOffsetState_Cnt_u08 AbsHwPos_SrlComHwPos_HwDeg_f32 /end REF_MEASUREMENT
/end GROUP
/begin GROUP FDD05C_AbsoluteHandwheelPositionFunction "" /begin SUB_GROUP FDD05C.Outputs FDD05C.Internals FDD05C.Inputs /end SUB_GROUP /end GROUP
/begin GROUP FDD05C.Internals ""
 /begin REF_MEASUREMENT AlignedHwPos_HwDeg_M_f32 AllowCorrectionState_Cnt_M_lgc ComplError_HwDeg_D_f32 HandwheelAuthority_Uls_M_f32 HwPositionFiltSV_HwDeg_M_s11p20 HwTargetAuthority_Uls_M_f32 ICMAuthority_Uls_M_f32 ICMMtrPosMRF_Deg_M_f32 ICMRevOffsetCRF_Rev_M_s16 InpSigInvldTimer_mS_M_u32 LTRckCntrComplete_Cnt_M_lgc OffCorrTimer_mS_M_u32 Polarity_Cnt_M_s08 RevOffsetMRF_Deg_M_f32 RevOffsetState_Cnt_M_enum SrlComHwPos_HwDeg_M_f32 TCMtrPosOffsMRF_Deg_M_f32 TurnsCntrValidity_Cnt_M_enum VehCntrComplete_Cnt_M_lgc /end REF_MEASUREMENT
/end GROUP
/begin GROUP SF01.Outputs "" /begin REF_MEASUREMENT Assist_BaseAssistCmd_MtrNm_f32 /end REF_MEASUREMENT /end GROUP
/begin GROUP SF01_Assist "" /begin SUB_GROUP SF01.Outputs SF01.Internals SF01.Inputs /end SUB_GROUP /end GROUP
/begin GROUP SF01.Internals "" /begin REF_MEASUREMENT ThermalAssistScl_Uls_D_u2p14 WIRBlend_Uls_D_u2p14 /end REF_MEASUREMENT /end GROUP
/begin GROUP SF34.Internals ""
 /begin REF_MEASUREMENT ActiveKSV_M_str.K_Uls_f32 ActiveKSV_M_str.SV_Uls_f32 ActiveRawAcc_Cnt_M_u16 AsstFWActiveRaw_Uls_D_f32 AsstFWLowFreqInput_MtrNm_D_f32 AsstFWLowFreqLimited_MtrNm_D_f32 AsstFWLwrBound_MtrNm_D_f32 AsstFWLwrBoundFilt_MtrNm_D_f32 AsstFWOverBound_Cnt_D_lgc AsstFWSumInput_MtrNm_D_f32 AsstFWUprBound_MtrNm_D_f32 AsstFWUprBoundFilt_MtrNm_D_f32 AsstReducedPerfSV_Cnt_M_lgc CombAsstSV_MtrNm_M_f32 HiFreqKSV_M_str.CF_Uls_f32 HiFreqKSV_M_str.LPF_Str.K_Uls_f32 HiFreqKSV_M_str.LPF_Str.SV_Uls_f32 LwrBoundKSV_M_str.K_Uls_f32 LwrBoundKSV_M_str.SV_Uls_f32 PNCountStatus_Cnt_M_lgc UprBoundKSV_M_str.K_Uls_f32 UprBoundKSV_M_str.SV_Uls_f32 /end REF_MEASUREMENT
/end GROUP
/begin GROUP SF34_AssistFirewall "" /begin SUB_GROUP SF34.Internals SF34.Outputs SF34.Inputs /end SUB_GROUP /end GROUP
/begin GROUP SF34.Outputs ""
 /begin REF_MEASUREMENT AssistFirewall_AsstFirewallActive_Uls_f32 AssistFirewall_CombinedAssist_MtrNm_f32 /end REF_MEASUREMENT
/end GROUP
/begin GROUP SF04.Internals ""
 /begin REF_MEASUREMENT CondPullComp_MtrNm_D_f32 OpTrqRmpcomplete_Cnt_M_lgc SlewRate_MtrNmpS_D_f32 /end REF_MEASUREMENT
/end GROUP
/begin GROUP SF04_AssistSummationandLimiting "" /begin SUB_GROUP SF04.Internals SF04.Outputs SF04.Inputs /end SUB_GROUP /end GROUP
/begin GROUP SF04.Outputs ""
 /begin REF_MEASUREMENT AssistSumnLmt_LimitPercentFiltered_Uls_f32 AssistSumnLmt_PostLimitTorque_MtrNm_f32 AssistSumnLmt_PreLimitForPower_MtrNm_f32 AssistSumnLmt_PreLimitForStall_MtrNm_f32 AssistSumnLmt_PreLimitTorque_MtrNm_f32 /end REF_MEASUREMENT
/end GROUP
/begin GROUP SFD04.Internals "" /begin REF_MEASUREMENT LrnPnCntrTCmd_MtrNm_D_f32 PrkAstCmd_MtrNm_D_f32 /end REF_MEASUREMENT /end GROUP
/begin GROUP SFD04_AssistSummationandLimitingFunction "" /begin SUB_GROUP SFD04.Internals /end SUB_GROUP /end GROUP
/begin GROUP Unknown.Internals ""
 /begin REF_MEASUREMENT ManualTrqCmd_MtrNm_M_f32 OpTrqOvSV_MtrNm_M_f32 SysCVecu_Volts_M_f32 Vecu_Volts_M_f32 VswitchClosed_Cnt_M_lgc AstApplySlewSV_Cnt_M_lgc AstSlewVal_UlspS_D_f32 CurrDDAstLimRqst_Uls_M_f32 CurrDDDmpLimRqst_Uls_M_f32 CurrDDRtnLimRqst_Uls_M_f32 DampApplySlewSV_Cnt_M_lgc DDAstLimRqst_Uls_D_f32 DDDmpLimRqst_Uls_D_f32 DDRtnLimRqst_Uls_D_f32 DmpSlewVal_UlspS_D_f32 PrevDrvDynActiveSV_Cnt_M_lgc RtnApplySlewSV_Cnt_M_lgc RtnSlewVal_UlspS_D_f32 DrvDynActive_Cnt_M_lgc OpTrqOvRmpInEnable_Cnt_M_lgc CurrAssistEOTGain_Uls_M_f32 CurrAssistEOTLimit_MtrNm_M_f32 CurrAssistStallLimit_MtrNm_M_f32 CurrAssistVehSpdLimit_MtrNm_M_f32 CurrOutputRampMult_Uls_M_f32 CurrThermalLimit_MtrNm_M_f32 LrnPnCntrErrAcc_Cnt_M_u16 PrkAssistErrAcc_Cnt_M_u16 CurrSrlComVehSpd_Kph_M_f32 PrevOutputRampMult_Uls_M_f32 RampState_M_Str TMFTestComplete_Cnt_M_lgc /end REF_MEASUREMENT
/end GROUP
/begin GROUP Unknown "" /begin SUB_GROUP Unknown.Internals Unknown.Outputs Unknown.Inputs /end SUB_GROUP /end GROUP
/begin GROUP FDD08B.Outputs ""
 /begin REF_MEASUREMENT BatteryVoltage_SysC_Vecu_Volt_f32 BatteryVoltage_Vecu_Volts_f32 BatteryVoltage_VswitchClosed_Cnt_lgc /end REF_MEASUREMENT
/end GROUP
/begin GROUP FDD08B_BatterySwitchedVoltage "" /begin SUB_GROUP FDD08B.Outputs FDD08B.Internals /end SUB_GROUP /end GROUP
/begin GROUP FDD08B.Internals ""
 /begin REF_MEASUREMENT VecuVbatCorrErrAcc_Cnt_M_u16 VecuVbatCorrLimDiff_Volts_D_f32 VswitchCorrErrAcc_Cnt_M_u16 VswitchCorrLimDiff_Volts_D_f32 /end REF_MEASUREMENT
/end GROUP
/begin GROUP SER.Internals ""
 /begin REF_MEASUREMENT LowClrInitBD_ms_M_u32p0 LowSetInitBD_ms_M_u32p0 OvClrInitBD_ms_M_u32p0 OvSetInitBD_ms_M_u32p0 IgnStuckStart_mS_M_u32 Rate_XpmS_M_f32 Target_Uls_M_f32 /end REF_MEASUREMENT
/end GROUP
/begin GROUP SER "" /begin SUB_GROUP SER.Internals SER.Outputs SER.Inputs /end SUB_GROUP /end GROUP
/begin GROUP SF26.Outputs ""
 /begin REF_MEASUREMENT CtrldDisShtdn_CntDisMtrTrqCmdCRF_MtrNm_f32 CtrldDisShtdn_CntDisMtrTrqCmdMRF_MtrNm_f32 CtrldDisShtdn_CtrldDmpStsCmp_Cnt_lgc CtrldDisShtdn_SysC_CRFMtrTrqCmd_MtrNm_f32 CtrldDisShtdn_SysC_MRFMtrTrqCmd_MtrNm_f32 /end REF_MEASUREMENT
/end GROUP
/begin GROUP SF26_ControlledDisableShutdown "" /begin SUB_GROUP SF26.Outputs SF26.Internals SF26.Inputs /end SUB_GROUP /end GROUP
/begin GROUP SF26.Internals ""
 /begin REF_MEASUREMENT CntrlDampElpsdTime_mS_D_u16 CntrlDampTrq_MtrNm_D_f32 CntrlDampVelTrq_MtrNm_D_f32 LastF2Fault_mS_M_u32 /end REF_MEASUREMENT
/end GROUP
/begin GROUP SF06.Internals ""
 /begin REF_MEASUREMENT CtrlTemp_DegC_M_f32 CtrlTempErrorAcc_Cnt_M_u16 CtrlTempFiltOut_DegC_D_f32 AmbPwr_Watts_D_f32 AMCorr_DegC_D_f32 AMTempEst_DegC_M_f32 AssistMechFilt_DegC_D_f32 AssistMechSlew_DegC_M_f32 AssMechFiltSV_DegC_M_f32 AssMechInitComp_Cnt_M_lgc AsstMechLPFiltSV_Watts_M_str.K_Uls_f32 AsstMechLPFiltSV_Watts_M_str.SV_Uls_f32 CuAmbLPFiltSV_Watts_M_str.K_Uls_f32 CuAmbLPFiltSV_Watts_M_str.SV_Uls_f32 CuCorr_DegC_D_f32 CuLLFiltSV_DegC_M_f32 EstMech_Watts_D_f32 MagAmbLPFiltSV_Watts_M_str.K_Uls_f32 MagAmbLPFiltSV_Watts_M_str.SV_Uls_f32 MagCorr_DegC_D_f32 MagLLFiltSV_DegC_M_f32 ScaledAmbTemp_DegC_D_f32 ScaledEngTemp_DegC_D_f32 SiAmbLPFiltSV_Watts_M_str.K_Uls_f32 SiAmbLPFiltSV_Watts_M_str.SV_Uls_f32 SiCorr_DegC_D_f32 SiLLFiltSV_DegC_M_f32 /end REF_MEASUREMENT
/end GROUP
/begin GROUP SF06_TemperatureEstimation "" /begin SUB_GROUP SF06.Internals SF06.Outputs SF06.Inputs /end SUB_GROUP /end GROUP
/begin GROUP SF06.Outputs ""
 /begin REF_MEASUREMENT CtrlTemp_FiltMeasTemp_DegC_f32 MtrTempEst_AssistMechTempEst_DegC_f32 MtrTempEst_CuTempEst_DegC_f32 MtrTempEst_MagTempEst_DegC_f32 MtrTempEst_SiTempEst_DegC_f32 /end REF_MEASUREMENT
/end GROUP
/begin GROUP CF06.Outputs ""
 /begin REF_MEASUREMENT CustPL_BMW_CCLMSAActive_Cnt_lgc CustPL_BMW_CustCurrLmt_Amps_f32 /end REF_MEASUREMENT
/end GROUP
/begin GROUP CF06_BMWCurrentLimit "" /begin SUB_GROUP CF06.Outputs CF06.Internals CF06.Inputs /end SUB_GROUP /end GROUP
/begin GROUP CF06.Internals ""
 /begin REF_MEASUREMENT CCLMSAActive_Cnt_M_lgc MSAAssistEnable_Cnt_D_lgc MSACurrLimit_Amps_M_f32 MSAImax_Amps_M_f32 PrevMSACurrLimit_Amps_M_f32 PrevTMSAClock_Sec_M_f32 Ramp1Complete_Cnt_D_lgc Ramp2Complete_Cnt_D_lgc Ramp3Complete_Cnt_D_lgc Ramp4Complete_Cnt_D_lgc RampIncDec_Amps_M_f32 SupplyLmt_Amps_D_f32 Thresh1_Amps_M_f32 TMSAClock_Sec_M_f32 TMSAExpired_Cnt_D_lgc VspdDepIbatLmt_Amps_D_f32 /end REF_MEASUREMENT
/end GROUP
/begin GROUP SF03.Internals ""
 /begin REF_MEASUREMENT DampHPSc1_Uls_D_f32 DampHPSc2_Uls_D_f32 DampHPSc3_Uls_D_f32 DampHPSc4_Uls_D_f32 DampHPSDmp_MtrNm_D_f32 DampMtrVelDmp_MtrNm_D_f32 DampTempScale_Uls_D_u4p12 DampTrqScale_Uls_D_u1p15 MtrVelLPFKSV_Cnt_M_str.K_Uls_f32 MtrVelLPFKSV_Cnt_M_str.SV_Uls_f32 QDDHwTorqueLPFKSV_Cnt_M_str.K_Uls_f32 QDDHwTorqueLPFKSV_Cnt_M_str.SV_Uls_f32 QDDHwTrqBkLash_HwNm_M_f32 QDDMtrVelBckLash_MtrRadpS_M_f32 QDDMtrVelLPFKSV_Cnt_M_str.K_Uls_f32 QDDMtrVelLPFKSV_Cnt_M_str.SV_Uls_f32 QDDStFilt_Cnt_M_str.K_Uls_f32 QDDStFilt_Cnt_M_str.SV_Uls_f32 QDDStFilt_Uls_D_f32 /end REF_MEASUREMENT
/end GROUP
/begin GROUP SF03_Damping "" /begin SUB_GROUP SF03.Internals SF03.Outputs SF03.Inputs /end SUB_GROUP /end GROUP
/begin GROUP SF03.Outputs "" /begin REF_MEASUREMENT Damping_DampingCmd_MtrNm_f32 /end REF_MEASUREMENT /end GROUP
/begin GROUP SF35.Internals ""
 /begin REF_MEASUREMENT ADDCoefCalc_MtrNmSpRad_D_u0p16 DampFWActiveKSV_M_str.K_Uls_f32 DampFWActiveKSV_M_str.SV_Uls_f32 DampFWAddedDamp_MtrNm_D_f32 DampFWAddedDampAFW_MtrNm_D_f32 DampFWAddedDampDFW_MtrNm_D_f32 DampFWDampActive_Uls_D_f32 DampFWDefltDamp_MtrNm_D_f32 DampFWDiverseVBIC_MtrNm_D_f32 DampFWInrtCmpPNStatus_Cnt_M_lgc DampFWLimitedVBIC_MtrNm_D_f32 DampFWLwrBound_MtrNm_D_f32 DampFWOverBound_Cnt_D_lgc DampFWPNCountStatus_Cnt_M_lgc DampFWPrev1PreAttnComp_MtrNm_M_s9p6 DampFWPrev1SclDrvVel_MtrRadpS_M_s14p1 DampFWPrev2PreAttnComp_MtrNm_M_s9p6 DampFWPrev2SclDrvVel_MtrRadpS_M_s14p1 DampFWPrevTbarAng_HwDeg_M_s6p9 DampFWSatDamp_MtrNm_D_f32 DampFWTbarVelFiltSv_HwDegpSec_M_s15p16 DampFWTbarVelFiltSv_M_str.K_Uls_f32 DampFWTbarVelFiltSv_M_str.SV_Uls_f32 DampFWUprBound_MtrNm_D_f32 DampFWVBICOverThresh_Cnt_D_lgc DampFWVBICReducedPerfSV_Cnt_M_lgc DampPNAcc_Cnt_M_u16 DecelGain_Uls_D_u5p11 DriverVel_MtrRadpSec_D_s24p7 FiltFreq_RadpS_D_s10p5 InertiaCompCalc_MtrNm_D_u9p7 InrtCmpPNAccum_Cnt_M_u16 LimitedDamp_MtrNm_D_f32 OutputAtten_Uls_D_u8p8 PrevDecelGain_Uls_M_u5p11 PrevRawDecelGain_Uls_M_u5p11 RawDecelGain_Uls_D_u5p11 ReducedPerfSV_Cnt_M_lgc ScaledDriverVel_MtrRadpS_D_s14p1 /end REF_MEASUREMENT
/end GROUP
/begin GROUP SF35_DampingFirewall "" /begin SUB_GROUP SF35.Internals SF35.Outputs SF35.Inputs /end SUB_GROUP /end GROUP
/begin GROUP SF35.Outputs "" /begin REF_MEASUREMENT DampingFirewall_CombinedDamping_MtrNm_f32 /end REF_MEASUREMENT /end GROUP
/begin GROUP Unknown.Outputs ""
 /begin REF_MEASUREMENT DrvDynCtrl_AssistDDFactor_Uls_f32 DrvDynCtrl_DampingDDFactor_Uls_f32 DrvDynCtrl_ReturnDDFactor_Uls_f32 DrvDynEnbl_DrvDynActive_Cnt_lgc DrvDynEnbl_DrvDynInterfaceState_Cnt_u08 DrvDynEnbl_OpTrqOvRmpInEnable_Cnt_lgc PrkAstMfgServCh2_LrnPnCntrDisable_Cnt_lgc PrkAstMfgServCh2_PrkAssistDisable_Cnt_lgc SgnlCond_VehicleSpeed_Kph_f32 /end REF_MEASUREMENT
/end GROUP
/begin GROUP SF08.Internals ""
 /begin REF_MEASUREMENT DropInPower_Watts_D_f32 ElecMtrCmd_Volt_D_f32 ModInPower_Watts_D_f32 TermZ_Uls_D_f32 TrigTerm_Uls_D_f32 TrigTermCos_Uls_D_f32 TrigTermSin_Uls_D_f32 /end REF_MEASUREMENT
/end GROUP
/begin GROUP SF08_ElectricPowerConsumption "" /begin SUB_GROUP SF08.Internals SF08.Outputs SF08.Inputs /end SUB_GROUP /end GROUP
/begin GROUP SF08.Outputs "" /begin REF_MEASUREMENT ElecPwr_ElecPower_Watts_f32 ElecPwr_SupplyCurr_Amp_f32 /end REF_MEASUREMENT /end GROUP
/begin GROUP SF18.Outputs ""
 /begin REF_MEASUREMENT EOTActuatorMng_AssistEOTDamping_MtrNm_f32 EOTActuatorMng_AssistEOTGain_Uls_f32 EOTActuatorMng_AssistEOTLimit_MtrNm_f32 /end REF_MEASUREMENT
/end GROUP
/begin GROUP SF18_EndofTravelActuatorManagement "" /begin SUB_GROUP SF18.Outputs SF18.Internals SF18.Inputs /end SUB_GROUP /end GROUP
/begin GROUP SF18.Internals ""
 /begin REF_MEASUREMENT EOTDamping_MtrNm_D_f32 EOTDet_Cnt_D_lgc EOTEnterGain_Uls_D_f32 EOTExitgain_Uls_D_f32 EOTGain_Uls_D_f32 EOTImpact_HwDeg_D_f32 EOTImpactPos_HwDeg_M_f32 FiltEOTGain_Uls_D_f32 FiltEOTGainSV_HwNm_M_u1p31 FiltHWTrqSV_HwNm_M_s7p24 LimitPosition_HwDeg_D_f32 PrevEOTGain_Uls_M_f32 SESState_Uls_M_enum /end REF_MEASUREMENT
/end GROUP
/begin GROUP SF27.Outputs "" /begin REF_MEASUREMENT EtDmpFw_EOTDampingLtd_MtrNm_f32 /end REF_MEASUREMENT /end GROUP
/begin GROUP SF27_EOTDampingFirewall "" /begin SUB_GROUP SF27.Outputs SF27.Internals SF27.Inputs /end SUB_GROUP /end GROUP
/begin GROUP SF27.Internals ""
 /begin REF_MEASUREMENT EOTDmpFWActvLtd_MtrNm_D_f32 EOTDmpFWActvRegion_Cnt_D_lgc EOTDmpFWHWAuth_Cnt_D_lgc EOTDmpFWInActvLtd_MtrNm_D_f32 LwrBndActive_MtrNm_D_f32 UprBndActive_MtrNm_D_f32 /end REF_MEASUREMENT
/end GROUP
/begin GROUP DF01.Internals ""
 /begin REF_MEASUREMENT CanapeParameters_M_Str.AssistDDFactor_Uls_f32 CanapeParameters_M_Str.EnableManualTrigger_Cnt_lgc CanapeParameters_M_Str.FaultDuration_mS_u32 CanapeParameters_M_Str.FaultInjectionLocation_Cnt_enum CanapeParameters_M_Str.FaultOffset_Uls_f32 CanapeParameters_M_Str.PathGain_Uls_f32 CanapeParameters_M_Str.SinewaveAmplitude_Uls_f32 CanapeParameters_M_Str.SinewaveFrequency_Hz_f32 CanapeParameters_M_Str.VelocityTriggerSetpoint_MtrRadpS_f32 FaultDuration_mS_M_u32 FaultInjectionLocation_Cnt_M_enum FaultOffset_Uls_M_f32 FaultStartTime_mS_M_u32 FaultTrigger_Cnt_M_lgc ManualTriggerHangover_Cnt_M_lgc PathGain_Uls_M_f32 PathOffset_Uls_M_f32 SineFactor_kHz_M_f32 SinewaveAmplitude_Uls_M_f32 /end REF_MEASUREMENT
/end GROUP
/begin GROUP DF01_FaultInjection "" /begin SUB_GROUP DF01.Internals DF01.Inputs /end SUB_GROUP /end GROUP
/begin GROUP SF14.Internals ""
 /begin REF_MEASUREMENT ADDCoef_MtrNmSpRad_D_f32 DriverVelocity_MtrRadpS_D_f32 FDDAttenOut_MtrNm_D_f32 FiltFreqLUBlnd_RadpS_D_f32 InertiaCompCalc_MtrNm_D_f32 PreDecelGain_Uls_M_f32 Prev1PreAttnComp_MtrNm_M_f32 Prev1SclDrvVel_RadpS_M_f32 Prev2PreAttnComp_MtrNm_M_f32 Prev2SclDrvVel_RadpS_M_f32 PrevTbarAng_HwDeg_M_f32 RawDecelGain_Uls_D_f32 TbarVelFiltSv_M_str.K_ULS_F32 TbarVelFiltSv_M_str.SV_ULS_F32 TbarVelFiltVal_HwDegpSec_D_f32 /end REF_MEASUREMENT
/end GROUP
/begin GROUP SF14_InertiaCompensationFrequencyDependentDamping "" /begin SUB_GROUP SF14.Internals SF14.Outputs SF14.Inputs /end SUB_GROUP /end GROUP
/begin GROUP SF14.Outputs ""
 /begin REF_MEASUREMENT FrqDepDmpnInrtCmp_FrqDepDmpnInrtCmp_MtrNm_f32 LnRkCr_RackCenter_HwDeg_f32 /end REF_MEASUREMENT
/end GROUP
/begin GROUP FDD48.Internals ""
 /begin REF_MEASUREMENT ErrPending_Cnt_M_lgc FrBusOffTmr_mS_M_u32 FrErrorInfo_Cnt_D_u16 FrErrorInfo_Cnt_M_u16 FrTxcvrERRnAcc_Cnt_M_u16 FrTxcvrSPIAcc_Cnt_M_u16 PhyFRERRn_Cnt_D_lgc /end REF_MEASUREMENT
/end GROUP
/begin GROUP FDD48_FlexrayErrorIndicationInterface "" /begin SUB_GROUP FDD48.Internals /end SUB_GROUP /end GROUP
/begin GROUP SF21.Internals ""
 /begin REF_MEASUREMENT CalculateFlag_Cnt_M_lgc CmdState_Cnt_M_Enum HwAngleOffsetIn_HwDeg_M_f32 HwPosInitial_HwDeg_M_f32 StateTime_Sec_M_f32 TargetAcceleration_HwDegpSecSqr_M_f32 TargetAccelerationInitial_HwDegpSecSqr_M_f32 TargetAngle_HwDeg_M_f32 TargetAngleInitial_HwDeg_M_f32 TargetVelocity_HwDegpSec_M_f32 TargetVelocityInitial_HwDegpSec_M_f32 /end REF_MEASUREMENT
/end GROUP
/begin GROUP SF21_GeneratePositionTrajectory "" /begin SUB_GROUP SF21.Internals SF21.Outputs SF21.Inputs /end SUB_GROUP /end GROUP
/begin GROUP SF21.Outputs "" /begin REF_MEASUREMENT GenPosTraj_PosTrajHwAngle_HwDeg_f32 /end REF_MEASUREMENT /end GROUP
/begin GROUP SF37.Internals ""
 /begin REF_MEASUREMENT CumMtrPos_CRF_OverwriteFlt_Cnt_D_lgc HwTorque_OverwriteFlt_Cnt_D_lgc HwVel_OverwriteFlt_Cnt_D_lgc MtrElecMech_Polarity_OverwriteFlt_Cnt_D_lgc MtrPos_OverwriteFlt_Cnt_D_lgc MtrVel_CRF_OverwriteFlt_Cnt_D_lgc MtrVel_OverwriteFlt_Cnt_D_lgc TrqCmd_CRF_OverwriteFlt_Cnt_D_lgc TrqCmd_MRF_OverwriteFlt_Cnt_D_lgc Vecu_OverwriteFlt_Cnt_D_lgc /end REF_MEASUREMENT
/end GROUP
/begin GROUP SF37_GlobalSignalOverwriteDetection "" /begin SUB_GROUP SF37.Internals SF37.Inputs /end SUB_GROUP /end GROUP
/begin GROUP SF17.Outputs "" /begin REF_MEASUREMENT HiLoadStall_AssistStallLimit_MtrNm_f32 /end REF_MEASUREMENT /end GROUP
/begin GROUP SF17_HighLoadStallThermalManagement "" /begin SUB_GROUP SF17.Outputs SF17.Internals SF17.Inputs /end SUB_GROUP /end GROUP
/begin GROUP SF17.Internals ""
 /begin REF_MEASUREMENT FiltModPreLimit_MtrNm_D_u8p8 ModPreLimit_MtrNm_D_u8p8 ModPreLimitFiltSV_MtrNm_M_u8p24 PrevAssistStallLimit_MtrNm_M_f32 StallLimit_MtrNm_D_u8p8 /end REF_MEASUREMENT
/end GROUP
/begin GROUP FDD13B.Outputs ""
 /begin REF_MEASUREMENT HwPwUp_MtrDrvrInitStart_Cnt_lgc HwPwUp_PhsDiscTestStart_Cnt_lgc HwPwUp_PwrDiscATestStart_Cnt_lgc HwPwUp_PwrDiscBTestStart_Cnt_lgc HwPwUp_TMFTestStart_Cnt_lgc /end REF_MEASUREMENT
/end GROUP
/begin GROUP FDD13B_HardwarePowerUpSequence "" /begin SUB_GROUP FDD13B.Outputs FDD13B.Internals /end SUB_GROUP /end GROUP
/begin GROUP FDD13B.Internals ""
 /begin REF_MEASUREMENT MtrDrvrInitStart_Cnt_M_lgc PhsDiscTestStart_Cnt_M_lgc PowerUpState_Cnt_M_enum PwrDiscATestStart_Cnt_M_lgc PwrDiscBTestStart_Cnt_M_lgc TMFTestStart_Cnt_M_lgc /end REF_MEASUREMENT
/end GROUP
/begin GROUP FDD04A.Outputs ""
 /begin REF_MEASUREMENT HwTrq_AnaDiffHwTrq_Volt_f32 HwTrq_AnaHwTorque_HwNm_f32 HwTrq_ErrorActiveAnalog_Cnt_enum HwTrq_HwTrqScaleVal_VoltsPerDeg_f32 HwTrq_SrlComHwTrqValid_Cnt_lgc HwTrq_SysCHwTorqueSqd_HwNmSq_f32 HwTrq_T1TrimVal_Volt_f32 HwTrq_T2TrimVal_Volt_f32 /end REF_MEASUREMENT
/end GROUP
/begin GROUP FDD04A_AnalogHandwheelTorqueMeasurement "" /begin SUB_GROUP FDD04A.Outputs FDD04A.Internals FDD04A.Inputs /end SUB_GROUP /end GROUP
/begin GROUP FDD04A.Internals ""
 /begin REF_MEASUREMENT AnaDiffHwTrq_Volt_M_f32 AnaHwTorque_HwNm_M_f32 AnaHwTorqueSqd_HwNmSq_D_f32 CorrDiagFiltOut_Volt_M_s4p11 HwTorqCh1vsCh2CorrLim_HwNmSq_D_f32 HWTorqCorrLimDiff_HwNmSq_D_f32 HwTorqCorrLimErrAcc_Cnt_M_u16 SSDiagFiltOut_Volt_M_s4p11 SSDiagFiltSV_Volt_M_s4p27 SumFltOut_Volt_M_u5p11 SysCAnaHwTorqueSqd_HwNmSq_D_f32 SysCHwTorqCh1vsCh2CorrLim_HwNmSq_D_f32 SysCHWTorqCorrLimDiff_HwNmSq_D_f32 SysCHwTorqCorrLimErrAcc_Cnt_M_u16 SysCHwTorqueSqd_HwNmSq_M_f32 T1RngErrAcc_Cnt_M_u16 T2RngErrAcc_Cnt_M_u16 TDiagFiltOut_Volt_M_s4p11 TDiagFiltSV_Volt_M_s4p27 TrqSensorRecDiagAcc_Cnt_M_u16 TrqSum_Volt_M_s4p11 /end REF_MEASUREMENT
/end GROUP
/begin GROUP SF25.Internals ""
 /begin REF_MEASUREMENT AvailHyst_HwNm_D_f32 FiltHwTrq_HwNm_D_s7p8 Fraction_Uls_D_f32 HwTrqFiltSV_HwNm_M_s7p24 PrevFiltHwTrq_HwNm_M_s7p8 PrevHwTrq_HwNm_M_f32 PrevHysAddHwTrq_HwNm_M_f32 PrevHysPos_Uls_M_f32 /end REF_MEASUREMENT
/end GROUP
/begin GROUP SF25.Outputs "" /begin REF_MEASUREMENT HystAdd_HysAddHwTrq_HwNm_f32 /end REF_MEASUREMENT /end GROUP
/begin GROUP SF12.Internals ""
 /begin REF_MEASUREMENT CoulFric_HwNm_D_f32 HwTrqFilt_HwNm_D_f32 PosAvail_HwNm_D_f32 AssistCmdFilt_HwNm_D_s8p7 AssistCmdLPFiltSV_HwNm_M_str AstCmdLastUsed_HwNm_M_s8p7 CompAvail_HwNm_D_f32 EffCompTrq_HwNm_D_f32 Fraction_Uls_M_f32 HwTrqLastUsed_HwNm_M_f32 HwTrqLPFiltSV_HwNm_M_str NegAvail_HwNm_D_f32 RawCalc_HwNm_M_f32 RawHystCompLPFiltSV_HwNm_M_str RiseX_HwNm_M_f32 /end REF_MEASUREMENT
/end GROUP
/begin GROUP SF12_HysteresisCompensation "" /begin SUB_GROUP SF12.Internals SF12.Outputs SF12.Inputs /end SUB_GROUP /end GROUP
/begin GROUP SF12.Outputs "" /begin REF_MEASUREMENT HystComp_HysteresisComp_MtrNm_f32 /end REF_MEASUREMENT /end GROUP
/begin GROUP SF24.Internals ""
 /begin REF_MEASUREMENT CapturedHwPosition_HwDeg_M_f32 CapturedStepMultFactor_Uls_M_f32 CapturedTargetVelocity_MtrRadpS_M_f32 ChangeStateStartTime_mS_M_u32 EnableFlag_Cnt_M_lgc HwDegtoMtrRad_Uls_M_f32 HwPosDeltaSigSV_HwDeg_M_f32 HwPosFilterOpSV_HwDeg_M_f32 HwPositionCmd_HwDeg_D_f32 HwStopPosition_HwDeg_M_f32 ITermSV_HwDeg_M_f32 LrnPnCntrCmd_MtrNm_M_f32 LrnPnCntrHwCenter_HwDeg_M_f32 LrnPnCntrHwTravel_HwDeg_M_f32 MtrPosDeltaSigSV_MtrRad_M_f32 MtrPosFilterOpSV_MtrRad_M_f32 MtrTrqDeltaSigSV_MtrNm_M_f32 MtrTrqFilterOpSV_MtrNm_M_f32 PinionCtrState_Cnt_M_Enum TimeoutStartTime_mS_M_u32 /end REF_MEASUREMENT
/end GROUP
/begin GROUP SF24_GenerateLocktoLockMotionToDeterminePinionCenter "" /begin SUB_GROUP SF24.Internals SF24.Outputs /end SUB_GROUP /end GROUP
/begin GROUP SF24.Outputs ""
 /begin REF_MEASUREMENT LktoLkStr_LrnPnCntrCmd_MtrNm_f32 LktoLkStr_LrnPnCntrHwCenter_HwDeg_f32 LktoLkStr_LrnPnCntrHwTravel_HwDeg_f32 LktoLkStr_LrnPnCntrState_Cnt_enum /end REF_MEASUREMENT
/end GROUP
/begin GROUP SF38.Outputs ""
 /begin REF_MEASUREMENT LmtCod_EOTGainLtd_Uls_f32 LmtCod_EOTLimitLtd_MtrNm_f32 LmtCod_OutputRampMultLtd_Uls_f32 LmtCod_StallLimitLtd_MtrNm_f32 LmtCod_ThermalLimitLtd_MtrNm_f32 LmtCod_VehSpdLimitLtd_MtrNm_f32 /end REF_MEASUREMENT
/end GROUP
/begin GROUP SF38_LimiterConditioning "" /begin SUB_GROUP SF38.Outputs SF38.Inputs /end SUB_GROUP /end GROUP
/begin GROUP SF11.Outputs ""
 /begin REF_MEASUREMENT LnRkCr_LTRackCntrComplete_Cnt_lgc LnRkCr_RackCntrComplete_Cnt_lgc LrnEOT_CCWFound_Cnt_lgc LrnEOT_CCWPosition_HwDeg_f32 LrnEOT_CWFound_Cnt_lgc LrnEOT_CWPosition_HwDeg_f32 /end REF_MEASUREMENT
/end GROUP
/begin GROUP SF11_LearnedEndofTravelLimits "" /begin SUB_GROUP SF11.Outputs SF11.Internals SF11.Inputs /end SUB_GROUP /end GROUP
/begin GROUP SF11.Internals ""
 /begin REF_MEASUREMENT RackCntrComplete_Cnt_M_lgc CcwEOTTimer_mS_M_u32 CwEOTTimer_mS_M_u32 Position1Timer_mS_M_u32 Position2Timer_mS_M_u32 ResetLimitReq_Cnt_M_lgc /end REF_MEASUREMENT
/end GROUP
/begin GROUP None.Internals ""
 /begin REF_MEASUREMENT CDD_MetricsTraceIdx_Cnt_G_u16 CDD_MetricsTraceOffset_uS_G_u32 Metrics_ActiveRunnable_Cnt_M_u16 Metrics_ActiveTask_Cnt_M_u16 Metrics_BkgndLoopTimeMax_Cnt_M_u32 Metrics_CpuUse_Pct_M_f32 Metrics_LastStackUseCalc_uS_M_u32 Metrics_RunnableTimes_Str Metrics_StackSize_Cnt_M_u16 Metrics_StackUse_Cnt_M_u16 Metrics_TaskTimes_Str SteaPniOffsErrorCounter_Cnt_M_u16 SteaPniOffsErrorRecovery_Cnt_M_u16 SteaPniOffsInvalidCounter_Cnt_M_u16 SteaPniOffsLossFltCounter_Cnt_M_u16 CTRERRMUpateTimer_Cnt_M_u32 DTPT2AliveCntStart_Cnt_M_lgc DTPT2AliveCounter_Cnt_M_u08 DTPT2AliveFault_Cnt_M_u08 DTPT2AliveFaultRecovery_Cnt_M_u08 DTPT2ErrorCounter_Cnt_M_u16 DTPT2ErrorRecovery_Cnt_M_u16 DTPT2InvalidCounter_Cnt_M_u16 DTPT2LossFltCounter_Cnt_M_u16 FrErrorStatus_Cnt_D_str.CHIHaltRequest FrErrorStatus_Cnt_D_str.ColdstartNoise FrErrorStatus_Cnt_D_str.ErrorMode FrErrorStatus_Cnt_D_str.Freeze FrErrorStatus_Cnt_D_str.SlotMode FrErrorStatus_Cnt_D_str.StartupState FrErrorStatus_Cnt_D_str.State FrErrorStatus_Cnt_D_str.WakeupStatus FZZSTDLossFltCounter_Cnt_M_u16 IgnoreDET_Cnt_M_u08 InvldTuningSelCntr_Cnt_M_u8 InvldTuningSelDataCntr_Cnt_M_u8 KL15NAliveCntStart_Cnt_M_lgc KL15NAliveCounter_Cnt_M_u08 KL15NAliveFault_Cnt_M_u08 KL15NAliveFaultRecovery_Cnt_M_u08 KL15NErrorCounter_Cnt_M_u08 KL15NErrorRecovery_Cnt_M_u16 KL15NLossFltCounter_Cnt_M_u16 KL15NVldCounter_Cnt_M_u08 MileKMLossFltCounter_Cnt_M_u16 PrevRxDrvVehDTPT2_Cnt_M_u16 PrevSteaPinOffs_HwDeg_M_f32 PwrLmt_Watts_M_f32 PwrLmtErrorRecovery_Cnt_M_u08 PwrLmtLossFltCounter_Cnt_M_u16 PwrLmtVldCounter_Cnt_M_u08 RevOffsetLossFltCounter_Cnt_M_u16 RxDTPT2AliveCnt_Cnt_M_u16 RxKL15NAliveCnt_Cnt_M_u16 RxVIN_Cnt_M_Str.VIN_BYTE1 RxVIN_Cnt_M_Str.VIN_BYTE2 RxVIN_Cnt_M_Str.VIN_BYTE3 RxVIN_Cnt_M_Str.VIN_BYTE4 RxVIN_Cnt_M_Str.VIN_BYTE5 RxVIN_Cnt_M_Str.VIN_BYTE6 RxVIN_Cnt_M_Str.VIN_BYTE7 SrlComEngCrank_Cnt_M_lgc SrlComSVCTxReq_Cnt_M_b16 StartUpDTCMaskActive_Cnt_M_lgc StartUpDTCMaskTimer_Cnt_M_u32 STVehConErrorRecovery_Cnt_M_u08 STVEHCONInvalid_Cnt_M_lgc STVehConUpateTimer_Cnt_M_u32 STVehConVldCounter_Cnt_M_u08 TarQtaStMomLossFltCounter_Cnt_M_u16 TarStMomLossFltCounter_Cnt_M_u16 TuningSelLossFltCounter_Cnt_M_u16 VehSpdLossFltCounter_Cnt_M_u16 VINErrorRecovery_Cnt_M_u16 VINLossFltCounter_Cnt_M_u16 VINVldCounter_Cnt_M_u08 AVLFORCGRDTxConf_Cnt_M_lgc AVLPOEPSTxConf_Cnt_M_lgc AVLSTMOMTxConf_Cnt_M_lgc DisableModeEntry_Cnt_M_lgc DispCcAliveCounter_Cnt_M_u08 EPSFuncQual_Cnt_M_enum FrCycOffline_Cnt_M_u08 OnChangeTxActive_Cnt_M_lgc StEst_M_Str.ALIV_ST_EST_FTAX StEst_M_Str.CRC_ST_EST_FTAX StEst_M_Str.QU_FN_EST StEst_M_Str.QU_SER_PINA_EST_FTAX StEst_M_Str.QU_SER_STMOM_DV_ACT StEst_M_Str.ST_EST_0x0C_0x04 StEstInitialTx_Cnt_M_lgc StEstTxCounter_Cnt_M_u08 StEstTxRepetitions_Cnt_M_u08 TxSUEPS_Cnt_M_lgc /end REF_MEASUREMENT
/end GROUP
/begin GROUP None "" /begin SUB_GROUP None.Internals /end SUB_GROUP /end GROUP
/begin GROUP FDD05C.Inputs ""
 /begin REF_MEASUREMENT CtrldDisShtdn_SysC_MRFMtrTrqCmd_MtrNm_f32 LnRkCr_LTRackCntrComplete_Cnt_lgc LnRkCr_RackCenter_HwDeg_f32 CtrldDisShtdn_CntDisMtrTrqCmdCRF_MtrNm_f32 SgnlCond_VehicleSpeed_Kph_f32 /end REF_MEASUREMENT
/end GROUP
/begin GROUP SF01.Inputs "" /begin REF_MEASUREMENT HystAdd_HysAddHwTrq_HwNm_f32 SgnlCond_VehicleSpeed_Kph_f32 /end REF_MEASUREMENT /end GROUP
/begin GROUP SF34.Inputs ""
 /begin REF_MEASUREMENT Assist_BaseAssistCmd_MtrNm_f32 HystComp_HysteresisComp_MtrNm_f32 SgnlCond_VehicleSpeed_Kph_f32 /end REF_MEASUREMENT
/end GROUP
/begin GROUP SF04.Inputs ""
 /begin REF_MEASUREMENT DrvDynEnbl_DrvDynActive_Cnt_lgc EtDmpFw_EOTDampingLtd_MtrNm_f32 LmtCod_EOTGainLtd_Uls_f32 LmtCod_EOTLimitLtd_MtrNm_f32 LktoLkStr_LrnPnCntrCmd_MtrNm_f32 DrvDynEnbl_OpTrqOvRmpInEnable_Cnt_lgc LmtCod_OutputRampMultLtd_Uls_f32 LmtCod_StallLimitLtd_MtrNm_f32 LmtCod_ThermalLimitLtd_MtrNm_f32 LmtCod_VehSpdLimitLtd_MtrNm_f32 /end REF_MEASUREMENT
/end GROUP
/begin GROUP SER.Inputs ""
 /begin REF_MEASUREMENT CustPL_BMW_CCLMSAActive_Cnt_lgc SgnlCond_VehicleSpeed_Kph_f32 /end REF_MEASUREMENT
/end GROUP
/begin GROUP SF26.Inputs "" /begin REF_MEASUREMENT CtrldDisShtdn_SysC_MRFMtrTrqCmd_MtrNm_f32 /end REF_MEASUREMENT /end GROUP
/begin GROUP SF03.Inputs ""
 /begin REF_MEASUREMENT MtrTempEst_AssistMechTempEst_DegC_f32 SgnlCond_VehicleSpeed_Kph_f32 /end REF_MEASUREMENT
/end GROUP
/begin GROUP SF35.Inputs ""
 /begin REF_MEASUREMENT Assist_BaseAssistCmd_MtrNm_f32 SgnlCond_VehicleSpeed_Kph_f32 /end REF_MEASUREMENT
/end GROUP
/begin GROUP Unknown.Inputs ""
 /begin REF_MEASUREMENT DrvDynEnbl_DrvDynActive_Cnt_lgc LktoLkStr_LrnPnCntrCmd_MtrNm_f32 /end REF_MEASUREMENT
/end GROUP
/begin GROUP SF08.Inputs "" /begin REF_MEASUREMENT BatteryVoltage_Vecu_Volts_f32 /end REF_MEASUREMENT /end GROUP
/begin GROUP SF18.Inputs ""
 /begin REF_MEASUREMENT LrnEOT_CCWPosition_HwDeg_f32 LrnEOT_CCWFound_Cnt_lgc LrnEOT_CWPosition_HwDeg_f32 LrnEOT_CWFound_Cnt_lgc AbsHwPos_HandwheelAuthority_Uls_f32 AbsHwPos_HandwheelPosition_HwDeg_f32 AssistSumnLmt_PreLimitTorque_MtrNm_f32 SgnlCond_VehicleSpeed_Kph_f32 /end REF_MEASUREMENT
/end GROUP
/begin GROUP SF27.Inputs ""
 /begin REF_MEASUREMENT EOTActuatorMng_AssistEOTDamping_MtrNm_f32 AbsHwPos_HandwheelAuthority_Uls_f32 AbsHwPos_HandwheelPosition_HwDeg_f32 /end REF_MEASUREMENT
/end GROUP
/begin GROUP SF14.Inputs ""
 /begin REF_MEASUREMENT Assist_BaseAssistCmd_MtrNm_f32 SgnlCond_VehicleSpeed_Kph_f32 /end REF_MEASUREMENT
/end GROUP
/begin GROUP SF37.Inputs ""
 /begin REF_MEASUREMENT BatteryVoltage_SysC_Vecu_Volt_f32 CtrldDisShtdn_CntDisMtrTrqCmdCRF_MtrNm_f32 CtrldDisShtdn_CntDisMtrTrqCmdMRF_MtrNm_f32 BatteryVoltage_Vecu_Volts_f32 /end REF_MEASUREMENT
/end GROUP
/begin GROUP SF17.Inputs "" /begin REF_MEASUREMENT AssistSumnLmt_PreLimitForStall_MtrNm_f32 /end REF_MEASUREMENT /end GROUP
/begin GROUP FDD04A.Inputs ""
 /begin REF_MEASUREMENT HwTrq_AnaDiffHwTrq_Volt_f32 HwTrq_AnaHwTorque_HwNm_f32 CtrldDisShtdn_SysC_MRFMtrTrqCmd_MtrNm_f32 HwTrq_SysCHwTorqueSqd_HwNmSq_f32 /end REF_MEASUREMENT
/end GROUP
/begin GROUP SF25.Inputs "" /begin REF_MEASUREMENT SgnlCond_VehicleSpeed_Kph_f32 /end REF_MEASUREMENT /end GROUP
/begin GROUP SF12.Inputs ""
 /begin REF_MEASUREMENT MtrTempEst_AssistMechTempEst_DegC_f32 Assist_BaseAssistCmd_MtrNm_f32 SgnlCond_VehicleSpeed_Kph_f32 /end REF_MEASUREMENT
/end GROUP
/begin GROUP SF38.Inputs ""
 /begin REF_MEASUREMENT EOTActuatorMng_AssistEOTGain_Uls_f32 EOTActuatorMng_AssistEOTLimit_MtrNm_f32 HiLoadStall_AssistStallLimit_MtrNm_f32 /end REF_MEASUREMENT
/end GROUP
/begin GROUP SF11.Inputs ""
 /begin REF_MEASUREMENT AbsHwPos_AlignedHwPos_HwDeg_f32 LktoLkStr_LrnPnCntrState_Cnt_enum AbsHwPos_HandwheelAuthority_Uls_f32 AbsHwPos_HandwheelPosition_HwDeg_f32 AssistSumnLmt_PostLimitTorque_MtrNm_f32 /end REF_MEASUREMENT
/end GROUP
/begin GROUP SF99.Inputs ""
 /begin REF_MEASUREMENT MtrTempEst_CuTempEst_DegC_f32 MtrTempEst_MagTempEst_DegC_f32 CtrldDisShtdn_CntDisMtrTrqCmdMRF_MtrNm_f32 MtrTempEst_SiTempEst_DegC_f32 BatteryVoltage_Vecu_Volts_f32 /end REF_MEASUREMENT
/end GROUP
/begin GROUP FDD06B.Inputs "" /begin REF_MEASUREMENT CtrldDisShtdn_SysC_MRFMtrTrqCmd_MtrNm_f32 /end REF_MEASUREMENT /end GROUP
/begin GROUP SF06.Inputs "" /begin REF_MEASUREMENT CtrlTemp_FiltMeasTemp_DegC_f32 /end REF_MEASUREMENT /end GROUP
/begin GROUP FDD02B.Inputs ""
 /begin REF_MEASUREMENT CtrldDisShtdn_SysC_MRFMtrTrqCmd_MtrNm_f32 SgnlCond_VehicleSpeed_Kph_f32 /end REF_MEASUREMENT
/end GROUP
/begin GROUP SF22.Inputs "" /begin REF_MEASUREMENT AbsHwPos_HandwheelPosition_HwDeg_f32 /end REF_MEASUREMENT /end GROUP
/begin GROUP FDD40A.Inputs ""
 /begin REF_MEASUREMENT AbsHwPos_HandwheelAuthority_Uls_f32 AbsHwPos_HandwheelPosition_HwDeg_f32 AssistSumnLmt_LimitPercentFiltered_Uls_f32 GenPosTraj_PosTrajHwAngle_HwDeg_f32 /end REF_MEASUREMENT
/end GROUP
/begin GROUP SF20.Inputs ""
 /begin REF_MEASUREMENT AbsHwPos_HandwheelPosition_HwDeg_f32 SgnlCond_VehicleSpeed_Kph_f32 /end REF_MEASUREMENT
/end GROUP
/begin GROUP SF19.Inputs ""
 /begin REF_MEASUREMENT CustPL_BMW_CustCurrLmt_Amps_f32 AssistSumnLmt_PreLimitForPower_MtrNm_f32 BatteryVoltage_Vecu_Volts_f32 CtrldDisShtdn_SysC_MRFMtrTrqCmd_MtrNm_f32 /end REF_MEASUREMENT
/end GROUP
/begin GROUP SF10.Inputs ""
 /begin REF_MEASUREMENT CtrldDisShtdn_CntDisMtrTrqCmdCRF_MtrNm_f32 AbsHwPos_HandwheelPosition_HwDeg_f32 AbsHwPos_HandwheelAuthority_Uls_f32 /end REF_MEASUREMENT
/end GROUP
/begin GROUP SF02.Inputs ""
 /begin REF_MEASUREMENT MtrTempEst_AssistMechTempEst_DegC_f32 AbsHwPos_HandwheelPosition_HwDeg_f32 AbsHwPos_HandwheelAuthority_Uls_f32 DrvDynCtrl_ReturnDDFactor_Uls_f32 SgnlCond_VehicleSpeed_Kph_f32 /end REF_MEASUREMENT
/end GROUP
/begin GROUP SF36.Inputs ""
 /begin REF_MEASUREMENT AbsHwPos_HandwheelPosition_HwDeg_f32 SgnlCond_VehicleSpeed_Kph_f32 /end REF_MEASUREMENT
/end GROUP
/begin GROUP SF29.Inputs ""
 /begin REF_MEASUREMENT DrvDynCtrl_AssistDDFactor_Uls_f32 AssistFirewall_CombinedAssist_MtrNm_f32 SgnlCond_VehicleSpeed_Kph_f32 /end REF_MEASUREMENT
/end GROUP
/begin GROUP FDD49.Inputs "" /begin REF_MEASUREMENT CtrldDisShtdn_SysC_MRFMtrTrqCmd_MtrNm_f32 /end REF_MEASUREMENT /end GROUP
/begin GROUP FDD15C.Inputs "" /begin REF_MEASUREMENT CtrldDisShtdn_SysC_MRFMtrTrqCmd_MtrNm_f32 /end REF_MEASUREMENT /end GROUP
/begin GROUP SF09.Inputs ""
 /begin REF_MEASUREMENT MtrTempEst_CuTempEst_DegC_f32 CtrlTemp_FiltMeasTemp_DegC_f32 MtrTempEst_MagTempEst_DegC_f32 MtrTempEst_SiTempEst_DegC_f32 /end REF_MEASUREMENT
/end GROUP
/begin GROUP FDD19.Inputs "" /begin REF_MEASUREMENT CtrldDisShtdn_SysC_MRFMtrTrqCmd_MtrNm_f32 /end REF_MEASUREMENT /end GROUP
/begin GROUP SF30.Inputs "" /begin REF_MEASUREMENT SgnlCond_VehicleSpeed_Kph_f32 /end REF_MEASUREMENT /end GROUP
/begin GROUP SF23.Inputs "" /begin REF_MEASUREMENT SgnlCond_VehicleSpeed_Kph_f32 /end REF_MEASUREMENT /end GROUP
/begin GROUP FDD20C.Inputs ""
 /begin REF_MEASUREMENT AbsHwPos_HwTargetAuthority_Uls_f32 AbsHwPos_ICMMtrPosMRF_Deg_f32 LnRkCr_LTRackCntrComplete_Cnt_lgc AbsHwPos_LTVehCenterComplete_Cnt_lgc /end REF_MEASUREMENT
/end GROUP
/begin GROUP SF16.Inputs ""
 /begin REF_MEASUREMENT LrnEOT_CCWPosition_HwDeg_f32 LrnEOT_CWPosition_HwDeg_f32 AbsHwPos_HandwheelPosition_HwDeg_f32 AbsHwPos_HandwheelAuthority_Uls_f32 SgnlCond_VehicleSpeed_Kph_f32 /end REF_MEASUREMENT
/end GROUP
