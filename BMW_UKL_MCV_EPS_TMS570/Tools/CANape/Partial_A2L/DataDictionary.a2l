/begin COMPU_VTAB BooleanTable "Logic Table" TAB_VERB 2 0 "False" 1 "True" DEFAULT_VALUE "False" /end COMPU_VTAB
/begin COMPU_METHOD Boolean "" TAB_VERB "%0.0" "" COMPU_TAB_REF BooleanTable /end COMPU_METHOD
/begin COMPU_METHOD s11p20_T "" LINEAR "%0.0" "" COEFFS_LINEAR 9.5367431640625E-07 0 /end COMPU_METHOD
/begin COMPU_METHOD u0p16_T "" LINEAR "%0.0" "" COEFFS_LINEAR 1.52587890625E-05 0 /end COMPU_METHOD
/begin COMPU_METHOD s15p16_T "" LINEAR "%0.0" "" COEFFS_LINEAR 1.52587890625E-05 0 /end COMPU_METHOD
/begin COMPU_METHOD u5p11_T "" LINEAR "%0.0" "" COEFFS_LINEAR 0.00048828125 0 /end COMPU_METHOD
/begin COMPU_METHOD u9p7_T "" LINEAR "%0.0" "" COEFFS_LINEAR 0.0078125 0 /end COMPU_METHOD
/begin COMPU_METHOD s7p24_T "" LINEAR "%0.0" "" COEFFS_LINEAR 5.96046447753906E-08 0 /end COMPU_METHOD
/begin COMPU_METHOD s4p11_T "" LINEAR "%0.0" "" COEFFS_LINEAR 0.00048828125 0 /end COMPU_METHOD
/begin COMPU_METHOD u16p16_T "" LINEAR "%0.0" "" COEFFS_LINEAR 1.52587890625E-05 0 /end COMPU_METHOD
/begin COMPU_METHOD u12p4_T "" LINEAR "%0.0" "" COEFFS_LINEAR 0.0625 0 /end COMPU_METHOD
/begin COMPU_METHOD u3p29_T "" LINEAR "%0.0" "" COEFFS_LINEAR 1.86264514923096E-09 0 /end COMPU_METHOD
/begin COMPU_METHOD s2p13_T "" LINEAR "%0.0" "" COEFFS_LINEAR 0.0001220703125 0 /end COMPU_METHOD
/begin COMPU_METHOD u3p13_T "" LINEAR "%0.0" "" COEFFS_LINEAR 0.0001220703125 0 /end COMPU_METHOD
/begin COMPU_METHOD s18p13_T "" LINEAR "%0.0" "" COEFFS_LINEAR 0.0001220703125 0 /end COMPU_METHOD
/begin COMPU_METHOD sm11p42_T "" LINEAR "%0.0" "" COEFFS_LINEAR 2.27373675443232E-13 0 /end COMPU_METHOD
/begin COMPU_METHOD s11p4_T "" LINEAR "%0.0" "" COEFFS_LINEAR 0.0625 0 /end COMPU_METHOD
/begin COMPU_METHOD s27p4_T "" LINEAR "%0.0" "" COEFFS_LINEAR 0.0625 0 /end COMPU_METHOD
/begin MEASUREMENT DaxCurrFiltSV_Amp_M_s11p20 "" SLONG s11p20_T 0 0 -250 250 ECU_ADDRESS 0 PHYS_UNIT "Amp" READ_WRITE /end MEASUREMENT
/begin MEASUREMENT Delta1_Cnt_D_u16 "" UWORD NO_COMPU_METHOD 0 0 0 192 DISPLAY_IDENTIFIER Delta1 ECU_ADDRESS 0 PHYS_UNIT "Counts" READ_WRITE /end MEASUREMENT
/begin MEASUREMENT Delta2_Cnt_D_s16 "" SWORD NO_COMPU_METHOD 0 0 -192 192 DISPLAY_IDENTIFIER Delta2 ECU_ADDRESS 0 PHYS_UNIT "Counts" READ_WRITE /end MEASUREMENT
/begin MEASUREMENT Delta3_Cnt_D_s16 "" SWORD NO_COMPU_METHOD 0 0 -192 192 DISPLAY_IDENTIFIER Delta3 ECU_ADDRESS 0 PHYS_UNIT "Counts" READ_WRITE /end MEASUREMENT
/begin MEASUREMENT DisplayAfterUncorrPhsAdv_Cnt_D_s16 "" SWORD NO_COMPU_METHOD 0 0 -192 192 ECU_ADDRESS 0 PHYS_UNIT "Counts" READ_WRITE /end MEASUREMENT
/begin MEASUREMENT MtrCtrl_VM_EstKe_VpRadpS_f32 "" FLOAT32_IEEE NO_COMPU_METHOD 0 0 0.025 0.075 DISPLAY_IDENTIFIER Ke_Estimate_post_limit ECU_ADDRESS 0 PHYS_UNIT "VpRadpSec" READ_WRITE SYMBOL_LINK "Rte_MtrCtrl_VM_EstKe_VpRadpS_f32" 0 /end MEASUREMENT
/begin MEASUREMENT EstKeFF_VpRadpS_M_f32 "" FLOAT32_IEEE NO_COMPU_METHOD 0 0 0.025 0.075 DISPLAY_IDENTIFIER Ke_Feedforward_Estimate ECU_ADDRESS 0 PHYS_UNIT "VpRadpSec" READ_WRITE /end MEASUREMENT
/begin MEASUREMENT MtrCtrl_VM_EstLd_Henry_f32 "" FLOAT32_IEEE NO_COMPU_METHOD 0 0 0.00003 0.00041 DISPLAY_IDENTIFIER EstLd_Henries_post_limit ECU_ADDRESS 0 PHYS_UNIT "Henry" READ_WRITE SYMBOL_LINK "Rte_MtrCtrl_VM_EstLd_Henry_f32" 0 /end MEASUREMENT
/begin MEASUREMENT MtrCtrl_VM_EstLq_Henry_f32 "" FLOAT32_IEEE NO_COMPU_METHOD 0 0 0.00003 0.00041 DISPLAY_IDENTIFIER EstLq_Henries_post_limit ECU_ADDRESS 0 PHYS_UNIT "Henry" READ_WRITE SYMBOL_LINK "Rte_MtrCtrl_VM_EstLq_Henry_f32" 0 /end MEASUREMENT
/begin MEASUREMENT MtrCtrl_VM_EstPkCurr_AmpSq_f32 "" FLOAT32_IEEE NO_COMPU_METHOD 0 0 0 250 DISPLAY_IDENTIFIER Mtr_PkCurr_AmpsSq ECU_ADDRESS 0 PHYS_UNIT "AmpSq" READ_WRITE SYMBOL_LINK "Rte_MtrCtrl_VM_EstPkCurr_AmpSq_f32" 0 /end MEASUREMENT
/begin MEASUREMENT EstPkCurrFiltSV_AmpSq_M_u16p16 "" ULONG u16p16_T 0 0 0 62500 ECU_ADDRESS 0 PHYS_UNIT "Amp" READ_WRITE /end MEASUREMENT
/begin MEASUREMENT MtrCtrl_VM_EstR_Ohm_f32 "" FLOAT32_IEEE NO_COMPU_METHOD 0 0 0.005 0.12565 DISPLAY_IDENTIFIER EstR_Ohms_post_limit ECU_ADDRESS 0 PHYS_UNIT "Ohm" READ_WRITE SYMBOL_LINK "Rte_MtrCtrl_VM_EstR_Ohm_f32" 0 /end MEASUREMENT
/begin MEASUREMENT EstRfetFF_Ohm_D_f32 "" FLOAT32_IEEE NO_COMPU_METHOD 0 0 0.005 0.12565 DISPLAY_IDENTIFIER FET_Silicon_Resistance_Feedforward_Estimate ECU_ADDRESS 0 PHYS_UNIT "Ohm" READ_WRITE /end MEASUREMENT
/begin MEASUREMENT EstRFF_Ohm_M_f32 "" FLOAT32_IEEE NO_COMPU_METHOD 0 0 0.005 0.12565 DISPLAY_IDENTIFIER Resistance_Feedforward_Estimate ECU_ADDRESS 0 PHYS_UNIT "Ohm" READ_WRITE /end MEASUREMENT
/begin MEASUREMENT EstRmtrFF_Ohm_D_f32 "" FLOAT32_IEEE NO_COMPU_METHOD 0 0 0.005 0.12565 DISPLAY_IDENTIFIER Motor_Copper_Resistance_Feedforward_Estimate ECU_ADDRESS 0 PHYS_UNIT "Ohm" READ_WRITE /end MEASUREMENT
/begin MEASUREMENT MtrCtrl_VM_ExpIq_Amp_f32 "" FLOAT32_IEEE NO_COMPU_METHOD 0 0 -250 250 DISPLAY_IDENTIFIER Exp_Iq_Amps ECU_ADDRESS 0 PHYS_UNIT "Amp" READ_WRITE SYMBOL_LINK "Rte_MtrCtrl_VM_ExpIq_Amp_f32" 0 /end MEASUREMENT
/begin MEASUREMENT MtrCtrl_VM_FiltEstPkCurr_AmpSq_f32 "" FLOAT32_IEEE NO_COMPU_METHOD 0 0 0 250 DISPLAY_IDENTIFIER Filtered_PkCurr_AmpsSq ECU_ADDRESS 0 PHYS_UNIT "AmpSq" READ_WRITE SYMBOL_LINK "Rte_MtrCtrl_VM_FiltEstPkCurr_AmpSq_f32" 0 /end MEASUREMENT
/begin MEASUREMENT FiltMtrCurEst_Id_Amp_D_f32 "" FLOAT32_IEEE NO_COMPU_METHOD 0 0 -250 250 DISPLAY_IDENTIFIER Id_est_filtered ECU_ADDRESS 0 PHYS_UNIT "Amp" READ_WRITE /end MEASUREMENT
/begin MEASUREMENT FiltMtrCurEst_Iq_Amp_D_f32 "" FLOAT32_IEEE NO_COMPU_METHOD 0 0 -250 250 DISPLAY_IDENTIFIER Iq_est_filtered ECU_ADDRESS 0 PHYS_UNIT "Amp" READ_WRITE /end MEASUREMENT
/begin MEASUREMENT IdDes_Amp_D_f32 "" FLOAT32_IEEE NO_COMPU_METHOD 0 0 -200 0 DISPLAY_IDENTIFIER Id_des ECU_ADDRESS 0 PHYS_UNIT "Amp" READ_WRITE /end MEASUREMENT
/begin MEASUREMENT IdDesRaw_Amp_D_f32 "" FLOAT32_IEEE NO_COMPU_METHOD 0 0 -200 0 DISPLAY_IDENTIFIER Id_des_raw ECU_ADDRESS 0 PHYS_UNIT "Amp" READ_WRITE /end MEASUREMENT
/begin MEASUREMENT IdDesTblX_MtrRadpS_M_u12p4 "" UWORD u12p4_T 0 0 0 1118 ECU_ADDRESS 0 MATRIX_DIM 32 1 1 PHYS_UNIT "MtrRadpS" READ_WRITE /end MEASUREMENT
/begin MEASUREMENT MtrCtrl_VM_IdEst_Amp_f32 "" FLOAT32_IEEE NO_COMPU_METHOD 0 0 -250 250 DISPLAY_IDENTIFIER Id_Est ECU_ADDRESS 0 PHYS_UNIT "Amp" READ_WRITE SYMBOL_LINK "Rte_MtrCtrl_VM_IdEst_Amp_f32" 0 /end MEASUREMENT
/begin MEASUREMENT MtrCtrl_VM_InstMtrDir_Cnt_s08 "Instantaneous Motor Direction" SBYTE NO_COMPU_METHOD 0 0 -1 1 DISPLAY_IDENTIFIER Instantaneous_Motor_Direction ECU_ADDRESS 0 PHYS_UNIT "Count" READ_WRITE SYMBOL_LINK "Rte_MtrCtrl_VM_InstMtrDir_Cnt_s08" 0 /end MEASUREMENT
/begin MEASUREMENT IntTermG_Volt_D_f32 "" FLOAT32_IEEE NO_COMPU_METHOD 0 0 0 0.5 DISPLAY_IDENTIFIER IntTermG ECU_ADDRESS 0 PHYS_UNIT "Uls" READ_WRITE /end MEASUREMENT
/begin MEASUREMENT KeIntError_Amp_D_f32 "" FLOAT32_IEEE NO_COMPU_METHOD 0 0 -255 255 DISPLAY_IDENTIFIER Ke_Integrator_Error ECU_ADDRESS 0 PHYS_UNIT "Amp" READ_WRITE /end MEASUREMENT
/begin MEASUREMENT KeIntgSV_Amp_M_f32 "" FLOAT32_IEEE NO_COMPU_METHOD 0 0 0 14000 ECU_ADDRESS 0 PHYS_UNIT "Amp" READ_WRITE /end MEASUREMENT
/begin MEASUREMENT KeIntValid_Cnt_D_lgc "" UBYTE Boolean 0 0 0 1 DISPLAY_IDENTIFIER Integration_Valid_Flag_Ke ECU_ADDRESS 0 PHYS_UNIT "Counts" READ_WRITE /end MEASUREMENT
/begin MEASUREMENT KeSatSclFac_Uls_D_f32 "" FLOAT32_IEEE NO_COMPU_METHOD 0 0 0 1 DISPLAY_IDENTIFIER Ke_Saturation_Scale_Factor ECU_ADDRESS 0 PHYS_UNIT "Unitless" READ_WRITE /end MEASUREMENT
/begin MEASUREMENT KTimeConstanst_Uls_D_f32 "" FLOAT32_IEEE NO_COMPU_METHOD 0 0 0 0.5 DISPLAY_IDENTIFIER KTimeConstanst_Uls ECU_ADDRESS 0 PHYS_UNIT "Volt" READ_WRITE /end MEASUREMENT
/begin MEASUREMENT LdSatSclFac_Uls_D_f32 "" FLOAT32_IEEE NO_COMPU_METHOD 0 0 0 2 DISPLAY_IDENTIFIER Ld_Saturation_Scale_Factor ECU_ADDRESS 0 PHYS_UNIT "Unitless" READ_WRITE /end MEASUREMENT
/begin MEASUREMENT LmtdModIdx_Uls_M_f32 "" FLOAT32_IEEE NO_COMPU_METHOD 0 0 -1 1 ECU_ADDRESS 0 PHYS_UNIT "Unitless" READ_WRITE /end MEASUREMENT
/begin MEASUREMENT LqSatSclFac_Uls_D_f32 "" FLOAT32_IEEE NO_COMPU_METHOD 0 0 0 2 DISPLAY_IDENTIFIER Lq_Saturation_Scale_Factor ECU_ADDRESS 0 PHYS_UNIT "Unitless" READ_WRITE /end MEASUREMENT
/begin MEASUREMENT MtrCtrl_VM_MRFMtrTrqCmdScl_MtrNm_f32 "Scaled torque command" FLOAT32_IEEE NO_COMPU_METHOD 0 0 -7.92 9.68 DISPLAY_IDENTIFIER TCMD_SCL ECU_ADDRESS 0 PHYS_UNIT "MtrNm" READ_WRITE SYMBOL_LINK "Rte_MtrCtrl_VM_MRFMtrTrqCmdScl_MtrNm_f32" 0 /end MEASUREMENT
/begin MEASUREMENT MtrCurEst_Id_Amp_D_f32 "" FLOAT32_IEEE NO_COMPU_METHOD 0 0 -250 250 DISPLAY_IDENTIFIER Id_Est ECU_ADDRESS 0 PHYS_UNIT "Amp" READ_WRITE /end MEASUREMENT
/begin MEASUREMENT MtrCurEst_Id_AmpSq_D_f32 "" FLOAT32_IEEE NO_COMPU_METHOD 0 0 0 62500 DISPLAY_IDENTIFIER Id_est_squared ECU_ADDRESS 0 PHYS_UNIT "AmpSq" READ_WRITE /end MEASUREMENT
/begin MEASUREMENT MtrCurEst_Iq_AmpSq_D_f32 "" FLOAT32_IEEE NO_COMPU_METHOD 0 0 0 62500 DISPLAY_IDENTIFIER Iq_est_squared ECU_ADDRESS 0 PHYS_UNIT "AmpSq" READ_WRITE /end MEASUREMENT
/begin MEASUREMENT MtrCtrl_VM_MtrQuad_Cnt_u08 "Motor Quadrant" UBYTE NO_COMPU_METHOD 0 0 1 4 DISPLAY_IDENTIFIER Motor_Quadrant ECU_ADDRESS 0 PHYS_UNIT "Count" READ_WRITE SYMBOL_LINK "Rte_MtrCtrl_VM_MtrQuad_Cnt_u08" 0 /end MEASUREMENT
/begin MEASUREMENT MtrTrqCmdSign_Cnt_D_s08 "Instantaneous Motor Torque Command Sign" SBYTE NO_COMPU_METHOD 0 0 -1 1 DISPLAY_IDENTIFIER Instantaneous_Motor_Torque_Command_Sign ECU_ADDRESS 0 PHYS_UNIT "Count" READ_WRITE /end MEASUREMENT
/begin MEASUREMENT MtrTrqCmdSign_Cnt_M_s08 "Instantaneous Motor Torque Command Sign" SBYTE NO_COMPU_METHOD 0 0 -1 1 DISPLAY_IDENTIFIER MtrTrqCmdSign ECU_ADDRESS 0 PHYS_UNIT "Count" READ_WRITE /end MEASUREMENT
/begin MEASUREMENT PDOverrideCounter_Cnt_M_u16 "" UWORD NO_COMPU_METHOD 0 0 0 200 DISPLAY_IDENTIFIER Phase_Advance ECU_ADDRESS 0 PHYS_UNIT "Counts" READ_WRITE /end MEASUREMENT
/begin MEASUREMENT PDTestTimeNOTElapsed_Cnt_M_lgc "" UBYTE Boolean 0 0 0 1 DISPLAY_IDENTIFIER PDActivateTest ECU_ADDRESS 0 READ_WRITE /end MEASUREMENT
/begin MEASUREMENT PhaseCorrec_Cnt_D_u16 "" UWORD NO_COMPU_METHOD 0 0 1 8 ECU_ADDRESS 0 PHYS_UNIT "Counts" READ_WRITE /end MEASUREMENT
/begin MEASUREMENT PhsAdv_Cnt_M_s16 "" SWORD NO_COMPU_METHOD 0 0 -1536 1536 DISPLAY_IDENTIFIER Phase_Advance ECU_ADDRESS 0 PHYS_UNIT "Counts" READ_WRITE /end MEASUREMENT
/begin MEASUREMENT MtrCtrl_VM_PhsAdv_Cnt_s16 "" SWORD NO_COMPU_METHOD 0 0 -1536 1536 DISPLAY_IDENTIFIER Phase_Advance ECU_ADDRESS 0 PHYS_UNIT "Counts" READ_WRITE SYMBOL_LINK "Rte_MtrCtrl_VM_PhsAdv_Cnt_s16" 0 /end MEASUREMENT
/begin MEASUREMENT PhsAdvY_Uls_D_f32 "" FLOAT32_IEEE NO_COMPU_METHOD 0 0 -27962.93124 27962.93124 DISPLAY_IDENTIFIER Phase_Advance_Y ECU_ADDRESS 0 PHYS_UNIT "Unitless" READ_WRITE /end MEASUREMENT
/begin MEASUREMENT PhsOffCorr_Cnt_D_s16 "" SWORD NO_COMPU_METHOD 0 0 -656 656 DISPLAY_IDENTIFIER DeltaCORR ECU_ADDRESS 0 PHYS_UNIT "Counts" READ_WRITE /end MEASUREMENT
/begin MEASUREMENT PreLmtEstKe_VpRadpS_D_f32 "" FLOAT32_IEEE NO_COMPU_METHOD 0 0 0.025 0.075 DISPLAY_IDENTIFIER Ke_Estimate_pre_limit ECU_ADDRESS 0 PHYS_UNIT "VpRadpSec" READ_WRITE /end MEASUREMENT
/begin MEASUREMENT PreLmtEstLd_Henry_D_f32 "" FLOAT32_IEEE NO_COMPU_METHOD 0 0 0.00003 0.00041 DISPLAY_IDENTIFIER EstLd_Henries_pre_limit ECU_ADDRESS 0 PHYS_UNIT "Henry" READ_WRITE /end MEASUREMENT
/begin MEASUREMENT PreLmtEstLq_Henry_D_f32 "" FLOAT32_IEEE NO_COMPU_METHOD 0 0 0.00003 0.00041 DISPLAY_IDENTIFIER EstLq_Henries_pre_limit ECU_ADDRESS 0 PHYS_UNIT "Henry" READ_WRITE /end MEASUREMENT
/begin MEASUREMENT PreLmtEstR_Ohm_D_f32 "" FLOAT32_IEEE NO_COMPU_METHOD 0 0 0.005 0.12565 DISPLAY_IDENTIFIER EstR_Ohms_pre_limit ECU_ADDRESS 0 PHYS_UNIT "Ohm" READ_WRITE /end MEASUREMENT
/begin MEASUREMENT PrevCumMtrPos_Deg_M_f32 "Previous Cumulative Motor Position" FLOAT32_IEEE NO_COMPU_METHOD 0 0 -11794480 11797200 DISPLAY_IDENTIFIER Previous_Cum_Mtr_Pos_MRF ECU_ADDRESS 0 PHYS_UNIT "Degrees" READ_WRITE /end MEASUREMENT
/begin MEASUREMENT PrevEstKe_VpRadpS_M_f32 "" FLOAT32_IEEE NO_COMPU_METHOD 0 0 0.025 0.075 ECU_ADDRESS 0 PHYS_UNIT "VpRadpSec" READ_WRITE /end MEASUREMENT
/begin MEASUREMENT PrevInstMtrDir_Cnt_M_s08 "Previous Instantaneous Motor Direction" SBYTE NO_COMPU_METHOD 0 0 -1 1 DISPLAY_IDENTIFIER Previous_Instantaneous_Motor_Direction ECU_ADDRESS 0 PHYS_UNIT "Count" READ_WRITE /end MEASUREMENT
/begin MEASUREMENT PrevMtrTrqCmd_MtrNm_M_f32 "" FLOAT32_IEEE NO_COMPU_METHOD 0 0 -8.8 8.8 ECU_ADDRESS 0 PHYS_UNIT "MtrNm" READ_WRITE /end MEASUREMENT
/begin MEASUREMENT PrvExpIq_Amp_M_f32 "" FLOAT32_IEEE NO_COMPU_METHOD 0 0 0 250 ECU_ADDRESS 0 MATRIX_DIM 3 1 1 PHYS_UNIT "Amp" READ_WRITE /end MEASUREMENT
/begin MEASUREMENT QaxCurrFiltSV_Amp_M_s11p20 "" SLONG s11p20_T 0 0 0 250 ECU_ADDRESS 0 PHYS_UNIT "Amp" READ_WRITE /end MEASUREMENT
/begin MEASUREMENT RIntError_Amp_D_f32 "" FLOAT32_IEEE NO_COMPU_METHOD 0 0 -250 250 DISPLAY_IDENTIFIER R_Integrator_Error ECU_ADDRESS 0 PHYS_UNIT "Amp" READ_WRITE /end MEASUREMENT
/begin MEASUREMENT RIntgSV_Amp_M_f32 "" FLOAT32_IEEE NO_COMPU_METHOD 0 0 0 170000 ECU_ADDRESS 0 PHYS_UNIT "Amp" READ_WRITE /end MEASUREMENT
/begin MEASUREMENT RIntValid_Cnt_D_lgc "" UBYTE Boolean 0 0 0 1 DISPLAY_IDENTIFIER Integration_Valid_Flag_R ECU_ADDRESS 0 PHYS_UNIT "Counts" READ_WRITE /end MEASUREMENT
/begin MEASUREMENT SineLkpTbl_Uls_D_f32 "" FLOAT32_IEEE NO_COMPU_METHOD 0 0 0 1 DISPLAY_IDENTIFIER sindelta ECU_ADDRESS 0 PHYS_UNIT "Uls" READ_WRITE /end MEASUREMENT
/begin MEASUREMENT MtrCtrl_VM_TermA_Volt_f32 "" FLOAT32_IEEE NO_COMPU_METHOD 0 0 -83.9 83.9 DISPLAY_IDENTIFIER Term_A ECU_ADDRESS 0 PHYS_UNIT "Volt" READ_WRITE SYMBOL_LINK "Rte_MtrCtrl_VM_TermA_Volt_f32" 0 /end MEASUREMENT
/begin MEASUREMENT TermA_Volt_M_f32 "" FLOAT32_IEEE NO_COMPU_METHOD 0 0 -83.9 83.9 ECU_ADDRESS 0 PHYS_UNIT "Volt" READ_WRITE /end MEASUREMENT
/begin MEASUREMENT TermB_Volt_M_f32 "" FLOAT32_IEEE NO_COMPU_METHOD 0 0 -44.2288 44.2288 ECU_ADDRESS 0 PHYS_UNIT "Volt" READ_WRITE /end MEASUREMENT
/begin MEASUREMENT TermBDeri_Volt_D_f32 "" FLOAT32_IEEE NO_COMPU_METHOD 0 0 -250 250 DISPLAY_IDENTIFIER TermBDeri_Volt ECU_ADDRESS 0 PHYS_UNIT "Volt" READ_WRITE /end MEASUREMENT
/begin MEASUREMENT TermBDerifinal_Volt_D_f32 "" FLOAT32_IEEE NO_COMPU_METHOD 0 0 -250 250 DISPLAY_IDENTIFIER TermBDerifinal_Volt ECU_ADDRESS 0 PHYS_UNIT "Volt" READ_WRITE /end MEASUREMENT
/begin MEASUREMENT MtrCtrl_VM_TermBSS_Volt_f32 "" FLOAT32_IEEE NO_COMPU_METHOD 0 0 -44.2288 44.2288 DISPLAY_IDENTIFIER Term_B ECU_ADDRESS 0 PHYS_UNIT "Volt" READ_WRITE SYMBOL_LINK "Rte_MtrCtrl_VM_TermBSS_Volt_f32" 0 /end MEASUREMENT
/begin MEASUREMENT MtrCtrl_VM_TermBTOT_Volt_f32 "" FLOAT32_IEEE NO_COMPU_METHOD 0 0 -294 294 DISPLAY_IDENTIFIER TermBTOT ECU_ADDRESS 0 PHYS_UNIT "Uls" READ_WRITE SYMBOL_LINK "Rte_MtrCtrl_VM_TermBTOT_Volt_f32" 0 /end MEASUREMENT
/begin MEASUREMENT TermBTOT_Volt_M_f32 "" FLOAT32_IEEE NO_COMPU_METHOD 0 0 -294 294 DISPLAY_IDENTIFIER TermBTOT ECU_ADDRESS 0 PHYS_UNIT "Uls" READ_WRITE /end MEASUREMENT
/begin MEASUREMENT MtrCtrl_VM_TermD_Volt_f32 "" FLOAT32_IEEE NO_COMPU_METHOD 0 0 -238.1812348 238.1812348 DISPLAY_IDENTIFIER Term_D ECU_ADDRESS 0 PHYS_UNIT "Volt" READ_WRITE SYMBOL_LINK "Rte_MtrCtrl_VM_TermD_Volt_f32" 0 /end MEASUREMENT
/begin MEASUREMENT TermD_Volt_M_f32 "" FLOAT32_IEEE NO_COMPU_METHOD 0 0 -238.1812348 238.1812348 ECU_ADDRESS 0 PHYS_UNIT "Volt" READ_WRITE /end MEASUREMENT
/begin MEASUREMENT MtrCtrl_VM_TermE_Volt_f32 "" FLOAT32_IEEE NO_COMPU_METHOD 0 0 -21.7532184 0 DISPLAY_IDENTIFIER Term_E ECU_ADDRESS 0 PHYS_UNIT "Volt" READ_WRITE SYMBOL_LINK "Rte_MtrCtrl_VM_TermE_Volt_f32" 0 /end MEASUREMENT
/begin MEASUREMENT TermE_Volt_M_f32 "" FLOAT32_IEEE NO_COMPU_METHOD 0 0 -21.7532184 0 ECU_ADDRESS 0 PHYS_UNIT "Volt" READ_WRITE /end MEASUREMENT
/begin MEASUREMENT TermEDeriScale_Volt_D_f32 "" FLOAT32_IEEE NO_COMPU_METHOD 0 0 -125 0 DISPLAY_IDENTIFIER TermEDeriScale_Volt ECU_ADDRESS 0 PHYS_UNIT "Volt" READ_WRITE /end MEASUREMENT
/begin MEASUREMENT TermEDeriScalefinal_Volt_D_f32 "" FLOAT32_IEEE NO_COMPU_METHOD 0 0 -125 0 DISPLAY_IDENTIFIER TermEDeriScalefinal_Volt ECU_ADDRESS 0 PHYS_UNIT "Volt" READ_WRITE /end MEASUREMENT
/begin MEASUREMENT MtrCtrl_VM_TermETOT_Volt_f32 "" FLOAT32_IEEE NO_COMPU_METHOD 0 0 -150 0 DISPLAY_IDENTIFIER TermETOT ECU_ADDRESS 0 PHYS_UNIT "Uls" READ_WRITE SYMBOL_LINK "Rte_MtrCtrl_VM_TermETOT_Volt_f32" 0 /end MEASUREMENT
/begin MEASUREMENT TermETOT_Volt_M_f32 "" FLOAT32_IEEE NO_COMPU_METHOD 0 0 -150 0 DISPLAY_IDENTIFIER TermETOT ECU_ADDRESS 0 PHYS_UNIT "Uls" READ_WRITE /end MEASUREMENT
/begin MEASUREMENT TermGInput_Volt_D_f32 "Input low pass filter" FLOAT32_IEEE NO_COMPU_METHOD 0 0 -1475.76 1475.76 ECU_ADDRESS 0 PHYS_UNIT "Volt" READ_WRITE /end MEASUREMENT
/begin MEASUREMENT TermGOutput_Volt_D_f32 "" FLOAT32_IEEE NO_COMPU_METHOD 0 0 -1506.76 1506.76 DISPLAY_IDENTIFIER TermGOutput_Volt ECU_ADDRESS 0 PHYS_UNIT "Volt" READ_WRITE /end MEASUREMENT
/begin MEASUREMENT TermH_Volt_D_f32 "" FLOAT32_IEEE NO_COMPU_METHOD 0 0 -50536.7304 50536.7304 DISPLAY_IDENTIFIER TermH_Volt ECU_ADDRESS 0 PHYS_UNIT "Uls" READ_WRITE /end MEASUREMENT
/begin MEASUREMENT MtrCtrl_VM_TermXd_Uls_f32 "" FLOAT32_IEEE NO_COMPU_METHOD 0 0 -33.54 33.54 DISPLAY_IDENTIFIER Term_Xd ECU_ADDRESS 0 PHYS_UNIT "Unitless" READ_WRITE SYMBOL_LINK "Rte_MtrCtrl_VM_TermXd_Uls_f32" 0 /end MEASUREMENT
/begin MEASUREMENT TermXd_Uls_M_f32 "" FLOAT32_IEEE NO_COMPU_METHOD 0 0 -33.54 33.54 ECU_ADDRESS 0 PHYS_UNIT "Unitless" READ_WRITE /end MEASUREMENT
/begin MEASUREMENT MtrCtrl_VM_TermXq_Uls_f32 "" FLOAT32_IEEE NO_COMPU_METHOD 0 0 -33.54 33.54 DISPLAY_IDENTIFIER Term_Xq ECU_ADDRESS 0 PHYS_UNIT "Unitless" READ_WRITE SYMBOL_LINK "Rte_MtrCtrl_VM_TermXq_Uls_f32" 0 /end MEASUREMENT
/begin MEASUREMENT TermXq_Uls_M_f32 "" FLOAT32_IEEE NO_COMPU_METHOD 0 0 -33.54 33.54 ECU_ADDRESS 0 PHYS_UNIT "Unitless" READ_WRITE /end MEASUREMENT
/begin MEASUREMENT MtrCtrl_VM_TermY_Uls_f32 "" FLOAT32_IEEE NO_COMPU_METHOD 0 0 -26631.36308 26631.36308 DISPLAY_IDENTIFIER Term_Y ECU_ADDRESS 0 PHYS_UNIT "Unitless" READ_WRITE SYMBOL_LINK "Rte_MtrCtrl_VM_TermY_Uls_f32" 0 /end MEASUREMENT
/begin MEASUREMENT TermY_Uls_M_f32 "" FLOAT32_IEEE NO_COMPU_METHOD 0 0 -26631.36308 26631.36308 ECU_ADDRESS 0 PHYS_UNIT "Unitless" READ_WRITE /end MEASUREMENT
/begin MEASUREMENT MtrCtrl_VM_TermZ_Uls_f32 "" FLOAT32_IEEE NO_COMPU_METHOD 0 0 1 75640.40078 DISPLAY_IDENTIFIER Term_Z ECU_ADDRESS 0 PHYS_UNIT "Unitless" READ_WRITE SYMBOL_LINK "Rte_MtrCtrl_VM_TermZ_Uls_f32" 0 /end MEASUREMENT
/begin MEASUREMENT UncorrPhsAdv_Cnt_M_s16 "" SWORD NO_COMPU_METHOD 0 0 -192 192 DISPLAY_IDENTIFIER Phase_Advance_Uncorrected ECU_ADDRESS 0 PHYS_UNIT "Counts" READ_WRITE /end MEASUREMENT
/begin MEASUREMENT Vdcoef_Uls_M_f32 "" FLOAT32_IEEE NO_COMPU_METHOD 0 0 -21.7532184 0 DISPLAY_IDENTIFIER Term_E_Coff ECU_ADDRESS 0 MATRIX_DIM 7 1 1 PHYS_UNIT "Uls" READ_WRITE /end MEASUREMENT
/begin MEASUREMENT VdTerm_Volt_D_f32 "" FLOAT32_IEEE NO_COMPU_METHOD 0 0 -505.8125 484.0493 DISPLAY_IDENTIFIER Vd ECU_ADDRESS 0 PHYS_UNIT "Volt" READ_WRITE /end MEASUREMENT
/begin MEASUREMENT MtrCtrl_VM_VdTerm_Volt_f32 "" FLOAT32_IEEE NO_COMPU_METHOD 0 0 -505.8125 484.0493 DISPLAY_IDENTIFIER Vd ECU_ADDRESS 0 PHYS_UNIT "Volt" READ_WRITE SYMBOL_LINK "Rte_MtrCtrl_VM_VdTerm_Volt_f32" 0 /end MEASUREMENT
/begin MEASUREMENT VdTerm_Volt_M_f32 "" FLOAT32_IEEE NO_COMPU_METHOD 0 0 -254.4601 254.4601 DISPLAY_IDENTIFIER Vq ECU_ADDRESS 0 PHYS_UNIT "Volt" READ_WRITE /end MEASUREMENT
/begin MEASUREMENT VFinal_Volt_D_f32 "" FLOAT32_IEEE NO_COMPU_METHOD 0 0 -283403.1 283403.1 DISPLAY_IDENTIFIER V ECU_ADDRESS 0 PHYS_UNIT "Volt" READ_WRITE /end MEASUREMENT
/begin MEASUREMENT VltgDenom_Uls_D_f32 "" FLOAT32_IEEE NO_COMPU_METHOD 0 0 -33.54 33.54 DISPLAY_IDENTIFIER Voltage_Denominator ECU_ADDRESS 0 PHYS_UNIT "Unitless" READ_WRITE /end MEASUREMENT
/begin MEASUREMENT VoltageLimit_Volt_D_f32 "" FLOAT32_IEEE NO_COMPU_METHOD 0 0 5 31 DISPLAY_IDENTIFIER Voltage_Limit ECU_ADDRESS 0 PHYS_UNIT "Volt" READ_WRITE /end MEASUREMENT
/begin MEASUREMENT Vqcoef_Uls_M_f32 "" FLOAT32_IEEE NO_COMPU_METHOD 0 0 -44.2288 44.2288 DISPLAY_IDENTIFIER Term_B_Coff ECU_ADDRESS 0 MATRIX_DIM 7 1 1 PHYS_UNIT "Uls" READ_WRITE /end MEASUREMENT
/begin MEASUREMENT VqTerm_Volt_D_f32 "" FLOAT32_IEEE NO_COMPU_METHOD 0 0 -254.4601 254.4601 DISPLAY_IDENTIFIER Vq ECU_ADDRESS 0 PHYS_UNIT "Volt" READ_WRITE /end MEASUREMENT
/begin MEASUREMENT MtrCtrl_VM_VqTerm_Volt_f32 "" FLOAT32_IEEE NO_COMPU_METHOD 0 0 -254.4601 254.4601 DISPLAY_IDENTIFIER Vq ECU_ADDRESS 0 PHYS_UNIT "Volt" READ_WRITE SYMBOL_LINK "Rte_MtrCtrl_VM_VqTerm_Volt_f32" 0 /end MEASUREMENT
/begin MEASUREMENT VqTerm_Volt_M_f32 "" FLOAT32_IEEE NO_COMPU_METHOD 0 0 -505.8125 484.0493 DISPLAY_IDENTIFIER Vd ECU_ADDRESS 0 PHYS_UNIT "Volt" READ_WRITE /end MEASUREMENT
/begin MEASUREMENT FiltShcur_Volts_M_f32 "" FLOAT32_IEEE NO_COMPU_METHOD 0 0 0 5 ECU_ADDRESS 0 PHYS_UNIT "Volts" READ_WRITE /end MEASUREMENT
/begin MEASUREMENT InvldRgnHi_Rev_M_f32 "" FLOAT32_IEEE NO_COMPU_METHOD 0 0 8.33333333333333E-02 0.416666666666667 ECU_ADDRESS 0 PHYS_UNIT "Rev" READ_WRITE /end MEASUREMENT
/begin MEASUREMENT InvldRgnLo_Rev_M_f32 "" FLOAT32_IEEE NO_COMPU_METHOD 0 0 8.33333333333333E-02 0.416666666666667 ECU_ADDRESS 0 PHYS_UNIT "Rev" READ_WRITE /end MEASUREMENT
/begin MEASUREMENT MtrCurr_VM_MtrCurrDax_Amp_f32 "DAX Motor Current" FLOAT32_IEEE NO_COMPU_METHOD 0 0 0 225 DISPLAY_IDENTIFIER MtrCurrDax_Amps ECU_ADDRESS 0 PHYS_UNIT "Amps" READ_WRITE SYMBOL_LINK "Rte_MtrCurr_VM_MtrCurrDax_Amp_f32" 0 /end MEASUREMENT
/begin MEASUREMENT MtrCurrDax_Amp_M_f32 "" FLOAT32_IEEE NO_COMPU_METHOD 0 0 0 225 ECU_ADDRESS 0 PHYS_UNIT "Amps" READ_WRITE /end MEASUREMENT
/begin MEASUREMENT MtrCurr_VM_MtrCurrQax_Amp_f32 "QAX Motor Current" FLOAT32_IEEE NO_COMPU_METHOD 0 0 0 225 DISPLAY_IDENTIFIER MtrCurrQax_Amps ECU_ADDRESS 0 PHYS_UNIT "Amps" READ_WRITE SYMBOL_LINK "Rte_MtrCurr_VM_MtrCurrQax_Amp_f32" 0 /end MEASUREMENT
/begin MEASUREMENT MtrCurrQax_Amp_M_f32 "" FLOAT32_IEEE NO_COMPU_METHOD 0 0 0 225 ECU_ADDRESS 0 PHYS_UNIT "Amps" READ_WRITE /end MEASUREMENT
/begin MEASUREMENT MtrCurr_VM_RawCurrFiltered_Amp_f32 "ADC Shunt Current reading scaled to amps" FLOAT32_IEEE NO_COMPU_METHOD 0 0 0 225 DISPLAY_IDENTIFIER RawCurrFiltered_Amps ECU_ADDRESS 0 PHYS_UNIT "Amps" READ_WRITE SYMBOL_LINK "Rte_MtrCurr_VM_RawCurrFiltered_Amp_f32" 0 /end MEASUREMENT
/begin MEASUREMENT ShCurLpFltrSV_Volts_M_u3p29 "" ULONG u3p29_T 0 0 0 5 ECU_ADDRESS 0 PHYS_UNIT "Volts" READ_WRITE /end MEASUREMENT
/begin MEASUREMENT MtrCurr_VM_ValidSampleFlag_Cnt_lgcValid "Flag indicating motor position is within the valid current reading" UBYTE Boolean 0 0 0 1 DISPLAY_IDENTIFIER Valid_Sample_Flag ECU_ADDRESS 0 PHYS_UNIT "Counts" READ_WRITE SYMBOL_LINK "Rte_MtrCurr_VM_ValidSampleFlag_Cnt_lgcValid" 0 /end MEASUREMENT
/begin MEASUREMENT MtrPos_AlignedCumMtrPosMRF_Deg_f32 "" FLOAT32_IEEE NO_COMPU_METHOD 0 0 -11794480 11796940 DISPLAY_IDENTIFIER Aligned_CumMtrPos_MRF ECU_ADDRESS 0 PHYS_UNIT "Deg" READ_WRITE SYMBOL_LINK "Rte_MtrPos_AlignedCumMtrPosMRF_Deg_f32" 0 /end MEASUREMENT
/begin MEASUREMENT MtrPos_CDD_CorrectedMtrPos_Rev_G_u0p16 "" UWORD u0p16_T 0 0 0 0.999984741210938 DISPLAY_IDENTIFIER CDD_CorrectedMtrPos_Rev_G_u0p16 ECU_ADDRESS 0 MATRIX_DIM 2 1 1 PHYS_UNIT "Rev" READ_WRITE SYMBOL_LINK "Rte_MtrPos_CDD_CorrectedMtrPos_Rev_G_u0p16" 0 /end MEASUREMENT
/begin MEASUREMENT MtrPos_CDD_CosTheta1_Volts_G_s2p13 "" SWORD s2p13_T 0 0 -3 3 DISPLAY_IDENTIFIER CosTheta1 ECU_ADDRESS 0 MATRIX_DIM 2 1 1 PHYS_UNIT "Volts" READ_WRITE SYMBOL_LINK "Rte_MtrPos_CDD_CosTheta1_Volts_G_s2p13" 0 /end MEASUREMENT
/begin MEASUREMENT MtrPos_CDD_SinTheta1_Volts_G_s2p13 "" SWORD s2p13_T 0 0 -3 3 DISPLAY_IDENTIFIER SinTheta1 ECU_ADDRESS 0 MATRIX_DIM 2 1 1 PHYS_UNIT "Volts" READ_WRITE SYMBOL_LINK "Rte_MtrPos_CDD_SinTheta1_Volts_G_s2p13" 0 /end MEASUREMENT
/begin MEASUREMENT CorrFltAcc_Cnt_M_u16 "" UWORD NO_COMPU_METHOD 0 0 0 65535 DISPLAY_IDENTIFIER CorrelationFltCntr ECU_ADDRESS 0 PHYS_UNIT "Counts" READ_WRITE /end MEASUREMENT
/begin MEASUREMENT Cos1GainCorr_Uls_M_f32 "" FLOAT32_IEEE NO_COMPU_METHOD 0 0 0.98 1.02 ECU_ADDRESS 0 PHYS_UNIT "Unitless" READ_WRITE /end MEASUREMENT
/begin MEASUREMENT Cos1OffsetCorr_Volts_M_f32 "" FLOAT32_IEEE NO_COMPU_METHOD 0 0 -0.02 0.02 ECU_ADDRESS 0 PHYS_UNIT "Volts" READ_WRITE /end MEASUREMENT
/begin MEASUREMENT MtrPos_Cos1RTAmpRec_Uls_f32 "" FLOAT32_IEEE NO_COMPU_METHOD 0 0 0.69 1.25 DISPLAY_IDENTIFIER Cos1RTAmpRec_Uls_f32 ECU_ADDRESS 0 PHYS_UNIT "Unitless" READ_WRITE SYMBOL_LINK "Rte_MtrPos_Cos1RTAmpRec_Uls_f32" 0 /end MEASUREMENT
/begin MEASUREMENT Cos1RTAmpRec_Uls_M_f32 "" FLOAT32_IEEE NO_COMPU_METHOD 0 0 0.69 1.25 ECU_ADDRESS 0 PHYS_UNIT "Unitless" READ_WRITE /end MEASUREMENT
/begin MEASUREMENT MtrPos_Cos1RTOffset_Volt_f32 "" FLOAT32_IEEE NO_COMPU_METHOD 0 0 1.2 1.8 DISPLAY_IDENTIFIER Cos1RTOffset_Volt_f32 ECU_ADDRESS 0 PHYS_UNIT "Volts" READ_WRITE SYMBOL_LINK "Rte_MtrPos_Cos1RTOffset_Volt_f32" 0 /end MEASUREMENT
/begin MEASUREMENT Cos1RTOffset_Volt_M_f32 "" FLOAT32_IEEE NO_COMPU_METHOD 0 0 1.2 1.8 ECU_ADDRESS 0 PHYS_UNIT "Volts" READ_WRITE /end MEASUREMENT
/begin MEASUREMENT CosSin1NomRatio_Uls_M_f32 "" FLOAT32_IEEE NO_COMPU_METHOD 0 0 0.552 1.81159420289855 ECU_ADDRESS 0 PHYS_UNIT "Unitless" READ_WRITE /end MEASUREMENT
/begin MEASUREMENT MtrPos_CumMtrPosMRF_Deg_f32 "" FLOAT32_IEEE NO_COMPU_METHOD 0 0 -11794480 11797200 DISPLAY_IDENTIFIER Cum_MtrPos_MRF ECU_ADDRESS 0 PHYS_UNIT "Deg" READ_WRITE SYMBOL_LINK "Rte_MtrPos_CumMtrPosMRF_Deg_f32" 0 /end MEASUREMENT
/begin MEASUREMENT CumMtrPosOff_Deg_M_f32 "" FLOAT32_IEEE NO_COMPU_METHOD 0 0 0 360 ECU_ADDRESS 0 PHYS_UNIT "Deg" READ_WRITE /end MEASUREMENT
/begin MEASUREMENT MtrPos_DiagCorrectedMtrPos_Rev_f32 "" FLOAT32_IEEE NO_COMPU_METHOD 0 0 0 0.999984741210938 DISPLAY_IDENTIFIER SysC_diagCorrected_MtrPos ECU_ADDRESS 0 PHYS_UNIT "Rev" READ_WRITE SYMBOL_LINK "Rte_MtrPos_DiagCorrectedMtrPos_Rev_f32" 0 /end MEASUREMENT
/begin MEASUREMENT DiagCorrectedMtrPos_Rev_M_f32 "" FLOAT32_IEEE NO_COMPU_METHOD 0 0 0 0.999984741210938 ECU_ADDRESS 0 PHYS_UNIT "Rev" READ_WRITE /end MEASUREMENT
/begin MEASUREMENT MtrPos_DiagMechMtrPos_Rev_f32 "" FLOAT32_IEEE NO_COMPU_METHOD 0 0 0 1 DISPLAY_IDENTIFIER DiagMechMtrPos_Rev_f32 ECU_ADDRESS 0 PHYS_UNIT "Rev" READ_WRITE SYMBOL_LINK "Rte_MtrPos_DiagMechMtrPos_Rev_f32" 0 /end MEASUREMENT
/begin MEASUREMENT MtrPos_EOLBEMF_Rev_f32 "" FLOAT32_IEEE NO_COMPU_METHOD 0 0 0 1 DISPLAY_IDENTIFIER EOLBEMF_Rev_f32 ECU_ADDRESS 0 PHYS_UNIT "Rev" READ_WRITE SYMBOL_LINK "Rte_MtrPos_EOLBEMF_Rev_f32" 0 /end MEASUREMENT
/begin MEASUREMENT MtrPos_Cos1Scaled_Volts_M_u3p13 "" UWORD u3p13_T 0 0 0 5 ECU_ADDRESS 0 MATRIX_DIM 2 1 1 PHYS_UNIT "Volts" READ_WRITE /end MEASUREMENT
/begin MEASUREMENT MtrPos_MtrPos_CosTheta1_Volts_G_s2p13 "" SWORD s2p13_T 0 0 -2 2 DISPLAY_IDENTIFIER CosTheta1 ECU_ADDRESS 0 PHYS_UNIT "Unitless" READ_WRITE SYMBOL_LINK "Rte_MtrPos_MtrPos_CosTheta1_Volts_G_s2p13" 0 /end MEASUREMENT
/begin MEASUREMENT MtrPos_MtrPos_MechMtrPos_Rev_G_u0p16 "" UWORD u0p16_T 0 0 0 0.999984741210938 DISPLAY_IDENTIFIER MechMtrPos ECU_ADDRESS 0 PHYS_UNIT "Rev" READ_WRITE SYMBOL_LINK "Rte_MtrPos_MtrPos_MechMtrPos_Rev_G_u0p16" 0 /end MEASUREMENT
/begin MEASUREMENT MtrPos_MtrPos_SampleTime_uS_G_u32 "" ULONG NO_COMPU_METHOD 0 0 0 4294967295 DISPLAY_IDENTIFIER MtrPos_SampleTime_uS_G_u32 ECU_ADDRESS 0 PHYS_UNIT "uS" READ_WRITE SYMBOL_LINK "Rte_MtrPos_MtrPos_SampleTime_uS_G_u32" 0 /end MEASUREMENT
/begin MEASUREMENT MtrPos_Sin1Scaled_Volts_M_u3p13 "" UWORD u3p13_T 0 0 0 5 ECU_ADDRESS 0 MATRIX_DIM 2 1 1 PHYS_UNIT "Volts" READ_WRITE /end MEASUREMENT
/begin MEASUREMENT MtrPos_MtrPos_SinTheta1_Volts_G_s2p13 "" SWORD s2p13_T 0 0 -2 2 DISPLAY_IDENTIFIER SinTheta1 ECU_ADDRESS 0 PHYS_UNIT "Unitless" READ_WRITE SYMBOL_LINK "Rte_MtrPos_MtrPos_SinTheta1_Volts_G_s2p13" 0 /end MEASUREMENT
/begin MEASUREMENT MtrPos2_Cos1RTAmpRec_Uls_M_u3p13 "" UWORD u3p13_T 0 0 0.666666666666666 4 DISPLAY_IDENTIFIER Cos1_Run_Time_AmpRec ECU_ADDRESS 0 MATRIX_DIM 2 1 1 PHYS_UNIT "Unitless" READ_WRITE /end MEASUREMENT
/begin MEASUREMENT MtrPos2_Cos1RTOffset_Volts_M_u3p13 "" UWORD u3p13_T 0 0 1.2 1.8 DISPLAY_IDENTIFIER Cos1_Run_Time_Offset ECU_ADDRESS 0 MATRIX_DIM 2 1 1 PHYS_UNIT "Volts" READ_WRITE /end MEASUREMENT
/begin MEASUREMENT MtrPos2_ErrorTerm_Rev_D_f32 "" FLOAT32_IEEE NO_COMPU_METHOD 0 0 0 0.5 DISPLAY_IDENTIFIER ErrorTerm ECU_ADDRESS 0 PHYS_UNIT "Rev" READ_WRITE /end MEASUREMENT
/begin MEASUREMENT MtrPos2_Sin1RTAmpRec_Uls_M_u3p13 "" UWORD u3p13_T 0 0 0.666666666666666 4 DISPLAY_IDENTIFIER Sin1_Run_Time_AmpRec ECU_ADDRESS 0 MATRIX_DIM 2 1 1 PHYS_UNIT "Unitless" READ_WRITE /end MEASUREMENT
/begin MEASUREMENT MtrPos2_Sin1RTOffset_Volts_M_u3p13 "" UWORD u3p13_T 0 0 1.2 1.8 DISPLAY_IDENTIFIER Sin1_Run_Time_Offset ECU_ADDRESS 0 MATRIX_DIM 2 1 1 PHYS_UNIT "Volts" READ_WRITE /end MEASUREMENT
/begin MEASUREMENT MtrPos2_ValidErr_VoltsSqrd_D_f32 "" FLOAT32_IEEE NO_COMPU_METHOD 0 0 0 4.5 DISPLAY_IDENTIFIER MtrPos_ValidErr ECU_ADDRESS 0 PHYS_UNIT "VoltsSqrd" READ_WRITE /end MEASUREMENT
/begin MEASUREMENT MtrPos3_SysCErrorTerm_Rev_D_f32 "" FLOAT32_IEEE NO_COMPU_METHOD 0 0 0 0.5 DISPLAY_IDENTIFIER SysC_ErrorTerm ECU_ADDRESS 0 PHYS_UNIT "Rev" READ_WRITE /end MEASUREMENT
/begin MEASUREMENT MtrPos3_SysCValidErr_VoltsSqrd_D_f32 "" FLOAT32_IEEE NO_COMPU_METHOD 0 0 0 4.5 DISPLAY_IDENTIFIER SysC_MtrPos_ValidErr ECU_ADDRESS 0 PHYS_UNIT "VoltsSqrd" READ_WRITE /end MEASUREMENT
/begin MEASUREMENT PrevCorrectedMtrPos_Rev_M_f32 "" FLOAT32_IEEE NO_COMPU_METHOD 0 0 0 0.999984741210938 ECU_ADDRESS 0 PHYS_UNIT "Rev" READ_WRITE /end MEASUREMENT
/begin MEASUREMENT PrevCos1RTOffset_Volts_M_f32 "" FLOAT32_IEEE NO_COMPU_METHOD 0 0 0.69 1.25 ECU_ADDRESS 0 PHYS_UNIT "Volts" READ_WRITE /end MEASUREMENT
/begin MEASUREMENT PrevSin1RTOffset_Volts_M_f32 "" FLOAT32_IEEE NO_COMPU_METHOD 0 0 0.69 1.25 ECU_ADDRESS 0 PHYS_UNIT "Volts" READ_WRITE /end MEASUREMENT
/begin MEASUREMENT RTToNomHighLmt_Uls_M_f32 "" FLOAT32_IEEE NO_COMPU_METHOD 0 0 1 1.02 ECU_ADDRESS 0 PHYS_UNIT "Unitless" READ_WRITE /end MEASUREMENT
/begin MEASUREMENT RTToNomLowLmt_Uls_M_f32 "" FLOAT32_IEEE NO_COMPU_METHOD 0 0 0.98 1 ECU_ADDRESS 0 PHYS_UNIT "Unitless" READ_WRITE /end MEASUREMENT
/begin MEASUREMENT Sin1GainCorr_Uls_M_f32 "" FLOAT32_IEEE NO_COMPU_METHOD 0 0 0.98 1.02 ECU_ADDRESS 0 PHYS_UNIT "Unitless" READ_WRITE /end MEASUREMENT
/begin MEASUREMENT Sin1OffsetCorr_Volts_M_f32 "" FLOAT32_IEEE NO_COMPU_METHOD 0 0 -0.02 0.02 ECU_ADDRESS 0 PHYS_UNIT "Volts" READ_WRITE /end MEASUREMENT
/begin MEASUREMENT MtrPos_Sin1RTAmpRec_Uls_f32 "" FLOAT32_IEEE NO_COMPU_METHOD 0 0 0.69 1.25 DISPLAY_IDENTIFIER Sin1RTAmpRec_Uls_f32 ECU_ADDRESS 0 PHYS_UNIT "Unitless" READ_WRITE SYMBOL_LINK "Rte_MtrPos_Sin1RTAmpRec_Uls_f32" 0 /end MEASUREMENT
/begin MEASUREMENT Sin1RTAmpRec_Uls_M_f32 "" FLOAT32_IEEE NO_COMPU_METHOD 0 0 0.69 1.25 ECU_ADDRESS 0 PHYS_UNIT "Unitless" READ_WRITE /end MEASUREMENT
/begin MEASUREMENT MtrPos_Sin1RTOffset_Volt_f32 "" FLOAT32_IEEE NO_COMPU_METHOD 0 0 1.2 1.8 DISPLAY_IDENTIFIER Sin1RTOffset_Volt_f32 ECU_ADDRESS 0 PHYS_UNIT "Volts" READ_WRITE SYMBOL_LINK "Rte_MtrPos_Sin1RTOffset_Volt_f32" 0 /end MEASUREMENT
/begin MEASUREMENT Sin1RTOffset_Volt_M_f32 "" FLOAT32_IEEE NO_COMPU_METHOD 0 0 1.2 1.8 ECU_ADDRESS 0 PHYS_UNIT "Volts" READ_WRITE /end MEASUREMENT
/begin MEASUREMENT SinCos1NomRatio_Uls_M_f32 "" FLOAT32_IEEE NO_COMPU_METHOD 0 0 0.552 1.81159420289855 ECU_ADDRESS 0 PHYS_UNIT "Unitless" READ_WRITE /end MEASUREMENT
/begin MEASUREMENT SinTheta2_Uls_D_s2p13 "" SWORD s2p13_T 0 0 -3 3 DISPLAY_IDENTIFIER SinTheta2 ECU_ADDRESS 0 PHYS_UNIT "Unitless" READ_WRITE /end MEASUREMENT
/begin MEASUREMENT SysCCorrFltAcc_Cnt_M_u16 "" UWORD NO_COMPU_METHOD 0 0 0 65535 DISPLAY_IDENTIFIER SysC_CorrelationFltCntr ECU_ADDRESS 0 PHYS_UNIT "Counts" READ_WRITE /end MEASUREMENT
/begin MEASUREMENT MtrPos_SysCCumMtrPosMRF_Deg_f32 "" FLOAT32_IEEE NO_COMPU_METHOD 0 0 -11794480 11797200 DISPLAY_IDENTIFIER SysC_Cum_MtrPos_MRF ECU_ADDRESS 0 PHYS_UNIT "Deg" READ_WRITE SYMBOL_LINK "Rte_MtrPos_SysCCumMtrPosMRF_Deg_f32" 0 /end MEASUREMENT
/begin MEASUREMENT SysCValidityFltAcc_Cnt_M_u16 "" UWORD NO_COMPU_METHOD 0 0 0 65535 DISPLAY_IDENTIFIER SysC_ValidityFltCntr ECU_ADDRESS 0 PHYS_UNIT "Counts" READ_WRITE /end MEASUREMENT
/begin MEASUREMENT tempAlignedCumMtrPosMRF_Rev_M_s15p16 "" SLONG s15p16_T 0 0 -32768 32767 DISPLAY_IDENTIFIER temp_Aligned_CumMtrPos_MRF ECU_ADDRESS 0 PHYS_UNIT "Rev" READ_WRITE /end MEASUREMENT
/begin MEASUREMENT ValidityFltAcc_Cnt_M_u16 "" UWORD NO_COMPU_METHOD 0 0 0 65535 ECU_ADDRESS 0 PHYS_UNIT "Counts" READ_WRITE /end MEASUREMENT
/begin MEASUREMENT MtrVel_CRFMotorVel_MtrRadpS_f32 "" FLOAT32_IEEE NO_COMPU_METHOD 0 0 -1350 1350 DISPLAY_IDENTIFIER Motor_Vel_CRF ECU_ADDRESS 0 PHYS_UNIT "MtrRadpS" READ_WRITE SYMBOL_LINK "Rte_MtrVel_CRFMotorVel_MtrRadpS_f32" 0 /end MEASUREMENT
/begin MEASUREMENT CrsMtrVel_MtrRadpS_D_f32 "" FLOAT32_IEEE NO_COMPU_METHOD 0 0 -1350 1350 DISPLAY_IDENTIFIER Coarse ECU_ADDRESS 0 MATRIX_DIM 2 1 1 PHYS_UNIT "MyrRadpS" READ_WRITE /end MEASUREMENT
/begin MEASUREMENT DeltaTheta_Uls_D_s18p13 "" SLONG s18p13_T 0 0 -262144 26214 DISPLAY_IDENTIFIER DeltaTheta ECU_ADDRESS 0 MATRIX_DIM 2 8 1 PHYS_UNIT "Uls" READ_WRITE /end MEASUREMENT
/begin MEASUREMENT MtrVel_HandwheelVel_HwRadpS_f32 "" FLOAT32_IEEE NO_COMPU_METHOD 0 0 -42 42 DISPLAY_IDENTIFIER Handwheel_Vel ECU_ADDRESS 0 PHYS_UNIT "HwRadpS" READ_WRITE SYMBOL_LINK "Rte_MtrVel_HandwheelVel_HwRadpS_f32" 0 /end MEASUREMENT
/begin MEASUREMENT HwVel_HwRadpS_M_f32 "" FLOAT32_IEEE NO_COMPU_METHOD 0 0 -42 42 ECU_ADDRESS 0 PHYS_UNIT "HwRadpS" READ_WRITE /end MEASUREMENT
/begin MEASUREMENT HwVelCorrLimDiff_HwRadpS_D_f32 "" FLOAT32_IEEE NO_COMPU_METHOD 0 0 0 84 DISPLAY_IDENTIFIER HwVel_CorrLim_Diff ECU_ADDRESS 0 PHYS_UNIT "HwRadpS" READ_WRITE /end MEASUREMENT
/begin MEASUREMENT HwVelDiffAcc_Cnt_M_u16 "" UWORD NO_COMPU_METHOD 0 0 0 255 DISPLAY_IDENTIFIER HwVelCC_FaultCount ECU_ADDRESS 0 PHYS_UNIT "Cnt" READ_WRITE /end MEASUREMENT
/begin MEASUREMENT MtrVel_HwVelValid_Cnt_lgc "" UBYTE Boolean 0 0 0 1 DISPLAY_IDENTIFIER Hw_Vel_Valid ECU_ADDRESS 0 PHYS_UNIT "Cnt" READ_WRITE SYMBOL_LINK "Rte_MtrVel_HwVelValid_Cnt_lgc" 0 /end MEASUREMENT
/begin MEASUREMENT MtrVel_MRFMotorVel_MtrRadpS_f32 "" FLOAT32_IEEE NO_COMPU_METHOD 0 0 -1350 1350 DISPLAY_IDENTIFIER Motor_Vel_MRF ECU_ADDRESS 0 PHYS_UNIT "MtrRadpS" READ_WRITE SYMBOL_LINK "Rte_MtrVel_MRFMotorVel_MtrRadpS_f32" 0 /end MEASUREMENT
/begin MEASUREMENT MtrVel_MRFMotorVelUnfiltered_MtrRadpS_f32 "Cum MtrPoValid for entire rack travel without rollover" FLOAT32_IEEE NO_COMPU_METHOD 0 0 -1350 1350 DISPLAY_IDENTIFIER Motor_Vel_MRF_Unfiltered ECU_ADDRESS 0 PHYS_UNIT "MtrRadpS" READ_WRITE SYMBOL_LINK "Rte_MtrVel_MRFMotorVelUnfiltered_MtrRadpS_f32" 0 /end MEASUREMENT
/begin MEASUREMENT MtrVel_ActiveBufSet_Cnt_M_u08 "" UBYTE NO_COMPU_METHOD 0 0 0 1 ECU_ADDRESS 0 PHYS_UNIT "Cnt" READ_WRITE /end MEASUREMENT
/begin MEASUREMENT MtrVel_AvgDeltaT_uS_D_u16p0 "" UWORD NO_COMPU_METHOD 0 0 0 65535 DISPLAY_IDENTIFIER average_delta_T ECU_ADDRESS 0 MATRIX_DIM 2 1 1 PHYS_UNIT "uS" READ_WRITE /end MEASUREMENT
/begin MEASUREMENT MtrVel_DeltaThetaIntercept_Uls_D_s7p24 "" SLONG s7p24_T 0 0 -128 127.9999 DISPLAY_IDENTIFIER delta_theata_intercept ECU_ADDRESS 0 MATRIX_DIM 2 1 1 PHYS_UNIT "Uls" READ_WRITE /end MEASUREMENT
/begin MEASUREMENT MtrVel_MtrRadpS_M_f32 "" FLOAT32_IEEE NO_COMPU_METHOD 0 0 -1350 1350 ECU_ADDRESS 0 PHYS_UNIT "MtrRadpS" READ_WRITE /end MEASUREMENT
/begin MEASUREMENT MtrVel_OldPosBuf_Cnt_M_u16 "" UWORD NO_COMPU_METHOD 0 0 0 3 ECU_ADDRESS 0 PHYS_UNIT "Cnt" READ_WRITE /end MEASUREMENT
/begin MEASUREMENT MtrVel_OsBufSelect_Cnt_M_u08 "Oversample buffer snapshot buffer set control.  This variable is protected from Xcp and other applications and determines the actively used buffer set.  The inactive set contains a consistent set of snap shot data.  This signal is set to a value 1 greater" UBYTE NO_COMPU_METHOD 0 0 0 4 ECU_ADDRESS 0 PHYS_UNIT "Cnt" READ_WRITE /end MEASUREMENT
/begin MEASUREMENT MtrVel_Slope_puS_D_sm11p42 "" SLONG sm11p42_T 0 0 -0.000488 0.00048828 DISPLAY_IDENTIFIER slope ECU_ADDRESS 0 MATRIX_DIM 2 1 1 PHYS_UNIT "puS" READ_WRITE /end MEASUREMENT
/begin MEASUREMENT MtrVel_SnapShotSet_Cnt_G_u08 "" UBYTE NO_COMPU_METHOD 0 0 0 1 ECU_ADDRESS 0 PHYS_UNIT "Cnt" READ_WRITE /end MEASUREMENT
/begin MEASUREMENT MtrVel3_CosBuffer_Uls_M_s2p13 "" SWORD s2p13_T 0 0 -2 2 DISPLAY_IDENTIFIER Cos_Theta1_Buffer ECU_ADDRESS 0 MATRIX_DIM 4 8 1 PHYS_UNIT "Uls" READ_WRITE /end MEASUREMENT
/begin MEASUREMENT MtrVel3_OsBufPos_Cnt_M_u08 "Oversample buffer position state variable array.  One state variable for each buffer set." UBYTE NO_COMPU_METHOD 0 0 0 7 ECU_ADDRESS 0 MATRIX_DIM 4 1 1 PHYS_UNIT "Cnt" READ_WRITE /end MEASUREMENT
/begin MEASUREMENT MtrVel3_PosBuffer_Rev_M_u0p16 "" UWORD u0p16_T 0 0 0 0.99998474 DISPLAY_IDENTIFIER MechMtrPos_Buffer ECU_ADDRESS 0 MATRIX_DIM 4 8 1 PHYS_UNIT "Rev" READ_WRITE /end MEASUREMENT
/begin MEASUREMENT MtrVel3_SinBuffer_Uls_M_s2p13 "" SWORD s2p13_T 0 0 -2 2 DISPLAY_IDENTIFIER Sin_Theta1_Buffer ECU_ADDRESS 0 MATRIX_DIM 4 8 1 PHYS_UNIT "Uls" READ_WRITE /end MEASUREMENT
/begin MEASUREMENT MtrVel3_TimeBuffer_uS_M_u16p0 "" UWORD NO_COMPU_METHOD 0 0 0 65535 DISPLAY_IDENTIFIER SampleTime_Buffer ECU_ADDRESS 0 MATRIX_DIM 4 8 1 PHYS_UNIT "uS" READ_WRITE /end MEASUREMENT
/begin MEASUREMENT MtrVelCorrLimDiff_MtrRadpS_D_f32 "" FLOAT32_IEEE NO_COMPU_METHOD 0 0 0 2236 DISPLAY_IDENTIFIER MtrVel_CorrLim_Diff ECU_ADDRESS 0 PHYS_UNIT "MtrRadpS" READ_WRITE /end MEASUREMENT
/begin MEASUREMENT MtrVelDelta_MtrRadpS_M_u12p4 "" UWORD u12p4_T 0 0 -2700 2700 ECU_ADDRESS 0 PHYS_UNIT "MtrRadpS" READ_WRITE /end MEASUREMENT
/begin MEASUREMENT MtrVelDiffAcc_Cnt_M_u16 "" UWORD NO_COMPU_METHOD 0 0 0 255 DISPLAY_IDENTIFIER MtrVelCC_FaultCount ECU_ADDRESS 0 PHYS_UNIT "Cnt" READ_WRITE /end MEASUREMENT
/begin MEASUREMENT MtrVelFiltSV_MtrRadpS_M_s11p20 "" SLONG s11p20_T 0 0 -1350 1350 ECU_ADDRESS 0 PHYS_UNIT "MtrRadpS" READ_WRITE /end MEASUREMENT
/begin MEASUREMENT OldMtrVel_MtrRadpS_M_s11p4 "" SWORD s11p4_T 0 0 -1350 1350 ECU_ADDRESS 0 PHYS_UNIT "MtrRadpS" READ_WRITE /end MEASUREMENT
/begin MEASUREMENT PosAvg_Rev_M_u0p16 "" UWORD u0p16_T 0 0 0 1 ECU_ADDRESS 0 PHYS_UNIT "Rev" READ_WRITE /end MEASUREMENT
/begin MEASUREMENT PredDeltaTheta_Uls_D_f32 "" FLOAT32_IEEE NO_COMPU_METHOD 0 0 -2147483648 2147483647 DISPLAY_IDENTIFIER theta ECU_ADDRESS 0 MATRIX_DIM 2 1 1 PHYS_UNIT "Uls" READ_WRITE /end MEASUREMENT
/begin MEASUREMENT PredDeltaThetaCor_Uls_D_f32 "" FLOAT32_IEEE NO_COMPU_METHOD 0 0 -2147483648 2147483647 ECU_ADDRESS 0 MATRIX_DIM 2 1 1 PHYS_UNIT "Uls" READ_WRITE /end MEASUREMENT
/begin MEASUREMENT PrevSysCDiagCumMtrPos_Rad_M_f32 "" FLOAT32_IEEE NO_COMPU_METHOD 0 0 -1745.32925199433 1745.32925199433 ECU_ADDRESS 0 PHYS_UNIT "Rad" READ_WRITE /end MEASUREMENT
/begin MEASUREMENT MtrVel_SysC_DiagHandWheelVel_HwRadpS_f32 "" FLOAT32_IEEE NO_COMPU_METHOD 0 0 -42 42 DISPLAY_IDENTIFIER SysC_diagHandwheel_Vel ECU_ADDRESS 0 PHYS_UNIT "HwRadpS" READ_WRITE SYMBOL_LINK "Rte_MtrVel_SysC_DiagHandWheelVel_HwRadpS_f32" 0 /end MEASUREMENT
/begin MEASUREMENT MtrVel_SysC_DiagMtrVel_MtrRadpS_f32 "" FLOAT32_IEEE NO_COMPU_METHOD 0 0 -1350 1350 DISPLAY_IDENTIFIER SysC_diagMotor_Vel_MRF ECU_ADDRESS 0 PHYS_UNIT "MtrRadpS" READ_WRITE SYMBOL_LINK "Rte_MtrVel_SysC_DiagMtrVel_MtrRadpS_f32" 0 /end MEASUREMENT
/begin MEASUREMENT SysCDiagCumMtrPosDelta_Rad_D_f32 "" FLOAT32_IEEE NO_COMPU_METHOD 0 0 -6.283185 6.283185 ECU_ADDRESS 0 PHYS_UNIT "Rad" READ_WRITE /end MEASUREMENT
/begin MEASUREMENT SysCDiagMtrVelRawMRF_MtrRadpS_D_f32 "" FLOAT32_IEEE NO_COMPU_METHOD 0 0 -1350 1350 ECU_ADDRESS 0 PHYS_UNIT "MtrRadpS" READ_WRITE /end MEASUREMENT
/begin MEASUREMENT SysCDiagMtrVelRawMRFSv_M_str.K_Uls_f32 "" FLOAT32_IEEE NO_COMPU_METHOD 0 0 0.222232320828211 0.529510782280182 ECU_ADDRESS 0 PHYS_UNIT "Unitless" READ_WRITE /end MEASUREMENT
/begin MEASUREMENT SysCDiagMtrVelRawMRFSv_M_str.SV_Uls_f32 "" FLOAT32_IEEE NO_COMPU_METHOD 0 0 -6283.0894 6283.0894 ECU_ADDRESS 0 PHYS_UNIT "Unitless" READ_WRITE /end MEASUREMENT
/begin MEASUREMENT MtrVel_SysCHandwheelVel_HwRadpS_f32 "" FLOAT32_IEEE NO_COMPU_METHOD 0 0 -42 42 DISPLAY_IDENTIFIER SysC_HandWheel_Vel ECU_ADDRESS 0 PHYS_UNIT "HwRadpS" READ_WRITE SYMBOL_LINK "Rte_MtrVel_SysCHandwheelVel_HwRadpS_f32" 0 /end MEASUREMENT
/begin MEASUREMENT SysCHwVelCorrLimDiff_HwRadpS_D_f32 "" FLOAT32_IEEE NO_COMPU_METHOD 0 0 0 84 ECU_ADDRESS 0 PHYS_UNIT "HwRadpS" READ_WRITE /end MEASUREMENT
/begin MEASUREMENT SysCHwVelCRF_HwRadpS_M_f32 "" FLOAT32_IEEE NO_COMPU_METHOD 0 0 -42 42 ECU_ADDRESS 0 PHYS_UNIT "HwRadpS" READ_WRITE /end MEASUREMENT
/begin MEASUREMENT SysCHwVelDiffAcc_Cnt_M_u16 "" SWORD NO_COMPU_METHOD 0 0 -32768 32767 ECU_ADDRESS 0 PHYS_UNIT "Cnt" READ_WRITE /end MEASUREMENT
/begin MEASUREMENT MtrVel_SysCMotorVelMRF_MtrRadpS_f32 "" FLOAT32_IEEE NO_COMPU_METHOD 0 0 -1350 1350 DISPLAY_IDENTIFIER SysC_Motor_Vel_MRF ECU_ADDRESS 0 PHYS_UNIT "MtrRadpS" READ_WRITE SYMBOL_LINK "Rte_MtrVel_SysCMotorVelMRF_MtrRadpS_f32" 0 /end MEASUREMENT
/begin MEASUREMENT SysCMtrVelCorrLimDiff_MtrRadpS_D_f32 "" FLOAT32_IEEE NO_COMPU_METHOD 0 0 -2236 2236 ECU_ADDRESS 0 PHYS_UNIT "MtrRadpS" READ_WRITE /end MEASUREMENT
/begin MEASUREMENT SysCMtrVelDiffAcc_Cnt_M_u16 "" UWORD NO_COMPU_METHOD 0 0 0 65535 ECU_ADDRESS 0 PHYS_UNIT "Vnt" READ_WRITE /end MEASUREMENT
/begin MEASUREMENT SysCMtrVelMRF_MtrRadpS_M_f32 "" FLOAT32_IEEE NO_COMPU_METHOD 0 0 -1350 1350 ECU_ADDRESS 0 PHYS_UNIT "MtrRadpS" READ_WRITE /end MEASUREMENT
/begin MEASUREMENT WestBlendedMtrVel_MtrRadpS_D_f32 "" FLOAT32_IEEE NO_COMPU_METHOD 0 0 -1350 1350 DISPLAY_IDENTIFIER West_Blended ECU_ADDRESS 0 MATRIX_DIM 2 1 1 PHYS_UNIT "MtrRadpS" READ_WRITE /end MEASUREMENT
/begin MEASUREMENT WestVelocity_MtrRadpS_D_f32 "" FLOAT32_IEEE NO_COMPU_METHOD 0 0 -1350 1350 DISPLAY_IDENTIFIER WestVelocity ECU_ADDRESS 0 MATRIX_DIM 2 1 1 PHYS_UNIT "MtrRadpS" READ_WRITE /end MEASUREMENT
/begin MEASUREMENT AmpInit_HwDeg_M_f32 "" FLOAT32_IEEE NO_COMPU_METHOD 0 0 -1440.11 1440.11 DISPLAY_IDENTIFIER Amplitude_Init ECU_ADDRESS 0 PHYS_UNIT "HwDeg" READ_WRITE /end MEASUREMENT
/begin MEASUREMENT Amplitude_HwDeg_M_f32 "Amplitude Amplitude of signal" FLOAT32_IEEE NO_COMPU_METHOD 0 0 -1440.11 1440.11 DISPLAY_IDENTIFIER Amplitude ECU_ADDRESS 0 PHYS_UNIT "HwDeg" READ_WRITE /end MEASUREMENT
/begin MEASUREMENT CalcFlag_Cnt_M_lgc "" UBYTE Boolean 0 0 0 1 ECU_ADDRESS 0 PHYS_UNIT "Cnts" READ_WRITE /end MEASUREMENT
/begin MEASUREMENT CmdState_Cnt_M_enum "" UBYTE NO_COMPU_METHOD 0 0 0 2 DISPLAY_IDENTIFIER Cmd_State ECU_ADDRESS 0 PHYS_UNIT "Cnts" READ_WRITE /end MEASUREMENT
/begin MEASUREMENT Cycles_Cnt_M_u08 "Number of Cycles" UBYTE NO_COMPU_METHOD 0 0 1 100 DISPLAY_IDENTIFIER Number_of_Cycles ECU_ADDRESS 0 PHYS_UNIT "Cnts" READ_WRITE /end MEASUREMENT
/begin MEASUREMENT CyclesInit_Cnts_M_u8 "" UBYTE NO_COMPU_METHOD 0 0 1 100 DISPLAY_IDENTIFIER Cycles_Init ECU_ADDRESS 0 PHYS_UNIT "Cnts" READ_WRITE /end MEASUREMENT
/begin MEASUREMENT FreqInit_Hz_M_f32 "" FLOAT32_IEEE NO_COMPU_METHOD 0 0 0.1 10 DISPLAY_IDENTIFIER Frequency_Init ECU_ADDRESS 0 PHYS_UNIT "Hz" READ_WRITE /end MEASUREMENT
/begin MEASUREMENT Frequency_Hz_M_f32 "Signal Frequency" FLOAT32_IEEE NO_COMPU_METHOD 0 0 0.1 10 DISPLAY_IDENTIFIER Frequency ECU_ADDRESS 0 PHYS_UNIT "Hz" READ_WRITE /end MEASUREMENT
/begin MEASUREMENT OscTraj_OscillateHwAngle_HwDeg_f32 "Time-based handwheel angle command signal" FLOAT32_IEEE NO_COMPU_METHOD 0 0 -1440.11 1440.11 DISPLAY_IDENTIFIER Oscillate_HwAngle ECU_ADDRESS 0 PHYS_UNIT "HwDeg" READ_WRITE SYMBOL_LINK "Rte_OscTraj_OscillateHwAngle_HwDeg_f32" 0 /end MEASUREMENT
/begin MEASUREMENT OscTraj_OscTrajState_Cnt_enum "State of signal generation" UBYTE NO_COMPU_METHOD 0 0 0 2 DISPLAY_IDENTIFIER Oscillate_State ECU_ADDRESS 0 PHYS_UNIT "Cnts" READ_WRITE SYMBOL_LINK "Rte_OscTraj_OscTrajState_Cnt_enum" 0 /end MEASUREMENT
/begin MEASUREMENT PosInit_HwDeg_M_f32 "" FLOAT32_IEEE NO_COMPU_METHOD 0 0 -1440.11 1440.11 DISPLAY_IDENTIFIER Position_Init ECU_ADDRESS 0 PHYS_UNIT "HwDeg" READ_WRITE /end MEASUREMENT
/begin MEASUREMENT FiltHwTrqSV_HwNm_M_s7p24 "" SLONG s7p24_T 0 0 -10 10 ECU_ADDRESS 0 PHYS_UNIT "HwNm" READ_WRITE /end MEASUREMENT
/begin MEASUREMENT HandsOnThrsh1_Cnt_M_lgc "" UBYTE Boolean 0 0 0 1 ECU_ADDRESS 0 PHYS_UNIT "Cnt" READ_WRITE /end MEASUREMENT
/begin MEASUREMENT HandsOnThrsh2_Cnt_M_lgc "" UBYTE Boolean 0 0 0 1 ECU_ADDRESS 0 PHYS_UNIT "Cnt" READ_WRITE /end MEASUREMENT
/begin MEASUREMENT HwVelFltStart_mS_M_u32 "" ULONG NO_COMPU_METHOD 0 0 0 4294967295 ECU_ADDRESS 0 PHYS_UNIT "mS" READ_WRITE /end MEASUREMENT
/begin MEASUREMENT PinionRateFlt_Cnt_M_lgc "" UBYTE Boolean 0 0 0 1 ECU_ADDRESS 0 PHYS_UNIT "Cnt" READ_WRITE /end MEASUREMENT
/begin MEASUREMENT PinionRateFltStart_mS_M_u32 "" ULONG NO_COMPU_METHOD 0 0 0 4294967295 ECU_ADDRESS 0 PHYS_UNIT "mS" READ_WRITE /end MEASUREMENT
/begin MEASUREMENT ParkAstEnbl_BMW_PosServoEnable_Cnt_lgc "Signal indicating activation of the Position servo PID control function." UBYTE Boolean 0 0 0 1 DISPLAY_IDENTIFIER PosServ_Enable ECU_ADDRESS 0 PHYS_UNIT "Cnt" READ_WRITE SYMBOL_LINK "Rte_ParkAstEnbl_BMW_PosServoEnable_Cnt_lgc" 0 /end MEASUREMENT
/begin MEASUREMENT ParkAstEnbl_BMW_PosServoHwAngle_HwDeg_f32 "Signal indicating the hw position value to be used based on the enabled function for park assist, or goto position trajectory or pendulum trajectory" FLOAT32_IEEE NO_COMPU_METHOD 0 0 -1440.11 1440.11 DISPLAY_IDENTIFIER PosServ_HwAngle ECU_ADDRESS 0 PHYS_UNIT "HwDeg" READ_WRITE SYMBOL_LINK "Rte_ParkAstEnbl_BMW_PosServoHwAngle_HwDeg_f32" 0 /end MEASUREMENT
/begin MEASUREMENT PosServoHwAngle_HwDeg_M_f32 "" FLOAT32_IEEE NO_COMPU_METHOD 0 0 -1440.11 1440.11 ECU_ADDRESS 0 PHYS_UNIT "HwDeg" READ_WRITE /end MEASUREMENT
/begin MEASUREMENT PrevHwPos_HwDeg_M_f32 "" FLOAT32_IEEE NO_COMPU_METHOD 0 0 -1440.11 1440.11 ECU_ADDRESS 0 PHYS_UNIT "HwDeg" READ_WRITE /end MEASUREMENT
/begin MEASUREMENT ParkAstEnbl_BMW_PrkAssistState_Cnt_u08 "Operating state of the Park Assist  function that is transmitted on the Serial Interface" UBYTE NO_COMPU_METHOD 0 0 0 255 DISPLAY_IDENTIFIER PrkAssist_State_QU_SER_PINA_EST_FTAX ECU_ADDRESS 0 PHYS_UNIT "Cnt" READ_WRITE SYMBOL_LINK "Rte_ParkAstEnbl_BMW_PrkAssistState_Cnt_u08" 0 /end MEASUREMENT
/begin MEASUREMENT PrkAstState_Cnt_M_enum "" UBYTE NO_COMPU_METHOD 0 0 0 8 ECU_ADDRESS 0 PHYS_UNIT "Cnt" READ_WRITE /end MEASUREMENT
/begin MEASUREMENT TimeoutHandsOn2Time_mS_M_u32 "" ULONG NO_COMPU_METHOD 0 0 0 4294967295 ECU_ADDRESS 0 PHYS_UNIT "mS" READ_WRITE /end MEASUREMENT
/begin MEASUREMENT ChrgPmpHiFltAcc_Cnt_M_u16 "" UWORD NO_COMPU_METHOD 0 0 0 65535 ECU_ADDRESS 0 PHYS_UNIT "Counts" READ_WRITE /end MEASUREMENT
/begin MEASUREMENT ChrgPmpLowFltAcc_Cnt_M_u16 "" UWORD NO_COMPU_METHOD 0 0 0 65535 ECU_ADDRESS 0 PHYS_UNIT "Counts" READ_WRITE /end MEASUREMENT
/begin MEASUREMENT IMeasAcuTime_mS_M_u16 "" UWORD NO_COMPU_METHOD 0 0 0 65535 ECU_ADDRESS 0 PHYS_UNIT "mS" READ_WRITE /end MEASUREMENT
/begin MEASUREMENT IMeasLPFKSV_Cnt_M_str.K_Uls_f32 "" FLOAT32_IEEE NO_COMPU_METHOD 0 0 0 1 ECU_ADDRESS 0 PHYS_UNIT "Unitless" READ_WRITE /end MEASUREMENT
/begin MEASUREMENT IMeasLPFKSV_Cnt_M_str.SV_Uls_f32 "" FLOAT32_IEEE NO_COMPU_METHOD 0 0 0 225 ECU_ADDRESS 0 PHYS_UNIT "Unitless" READ_WRITE /end MEASUREMENT
/begin MEASUREMENT IMeasNullFltAcc_Cnt_M_u16 "" UWORD NO_COMPU_METHOD 0 0 0 65535 ECU_ADDRESS 0 PHYS_UNIT "Counts" READ_WRITE /end MEASUREMENT
/begin MEASUREMENT IMeasTestDone_Cnt_M_lgc "" UBYTE Boolean 0 0 0 1 ECU_ADDRESS 0 PHYS_UNIT "Counts" READ_WRITE /end MEASUREMENT
/begin MEASUREMENT InitialTime_mS_M_u32 "" ULONG NO_COMPU_METHOD 0 0 0 4294967295 ECU_ADDRESS 0 PHYS_UNIT "mS" READ_WRITE /end MEASUREMENT
/begin MEASUREMENT PhaseDscnt_PDActivateTest_Cnt_lgc "activate the testing and engage the forcing of the Modulation Index and Phase Advance" UBYTE Boolean 0 0 0 1 DISPLAY_IDENTIFIER PDActivateTest ECU_ADDRESS 0 PHYS_UNIT "Counts" READ_WRITE SYMBOL_LINK "Rte_PhaseDscnt_PDActivateTest_Cnt_lgc" 0 /end MEASUREMENT
/begin MEASUREMENT PDCloseTimer_mS_M_u32 "" ULONG NO_COMPU_METHOD 0 0 0 4294967295 ECU_ADDRESS 0 PHYS_UNIT "mS" READ_WRITE /end MEASUREMENT
/begin MEASUREMENT PDControlStat_Cnt_D_u08 "" UWORD NO_COMPU_METHOD 0 0 0 6 ECU_ADDRESS 0 PHYS_UNIT "Counts" READ_WRITE /end MEASUREMENT
/begin MEASUREMENT PDOpenTimer_mS_M_u32 "" ULONG NO_COMPU_METHOD 0 0 0 4294967295 ECU_ADDRESS 0 PHYS_UNIT "mS" READ_WRITE /end MEASUREMENT
/begin MEASUREMENT PhaseDscnt_PDPhaseAdvSelect_Cnt_s16 "force a specific Phase Advance" SWORD NO_COMPU_METHOD 0 0 0 360 DISPLAY_IDENTIFIER PDPhaseAdvSelect ECU_ADDRESS 0 PHYS_UNIT "Counts" READ_WRITE SYMBOL_LINK "Rte_PhaseDscnt_PDPhaseAdvSelect_Cnt_s16" 0 /end MEASUREMENT
/begin MEASUREMENT PDSuplHighFltAcc_Cnt_M_u16 "" UWORD NO_COMPU_METHOD 0 0 0 65535 ECU_ADDRESS 0 PHYS_UNIT "Counts" READ_WRITE /end MEASUREMENT
/begin MEASUREMENT PDSupplyHiComplete_Cnt_M_lgc "" UBYTE Boolean 0 0 0 1 ECU_ADDRESS 0 PHYS_UNIT "Counts" READ_WRITE /end MEASUREMENT
/begin MEASUREMENT PDSupplyHiLatched_Cnt_M_lgc "" UBYTE Boolean 0 0 0 1 ECU_ADDRESS 0 PHYS_UNIT "Counts" READ_WRITE /end MEASUREMENT
/begin MEASUREMENT PDTestFailCurrTimer_mS_M_u32 "" ULONG NO_COMPU_METHOD 0 0 0 4294967295 ECU_ADDRESS 0 PHYS_UNIT "mS" READ_WRITE /end MEASUREMENT
/begin MEASUREMENT PDTestKSV_Cnt_M_str.K_Uls_f32 "" FLOAT32_IEEE NO_COMPU_METHOD 0 0 0 1 ECU_ADDRESS 0 PHYS_UNIT "Unitless" READ_WRITE /end MEASUREMENT
/begin MEASUREMENT PDTestKSV_Cnt_M_str.SV_Uls_f32 "" FLOAT32_IEEE NO_COMPU_METHOD 0 0 0 225 DISPLAY_IDENTIFIER PDTestFltrMtrCurr ECU_ADDRESS 0 PHYS_UNIT "Unitless" READ_WRITE /end MEASUREMENT
/begin MEASUREMENT PhaseDscnt_PDTestModIndex_Uls_f32 "force a specific Modulation Index" FLOAT32_IEEE NO_COMPU_METHOD 0 0 0.1 0.9 DISPLAY_IDENTIFIER PDTestModIndex ECU_ADDRESS 0 PHYS_UNIT "Unitless" READ_WRITE SYMBOL_LINK "Rte_PhaseDscnt_PDTestModIndex_Uls_f32" 0 /end MEASUREMENT
/begin MEASUREMENT PDTestScansCtr_Cnt_M_u16 "" UWORD NO_COMPU_METHOD 0 0 0 65535 DISPLAY_IDENTIFIER PDTestScansCtr ECU_ADDRESS 0 PHYS_UNIT "Counts" READ_WRITE /end MEASUREMENT
/begin MEASUREMENT PhaseDiscInitDiagState_Cnt_M_enum "" UBYTE NO_COMPU_METHOD 0 0 0 4 ECU_ADDRESS 0 PHYS_UNIT "Counts" READ_WRITE /end MEASUREMENT
/begin MEASUREMENT PhaseDisconStat_Cnt_M_enum "Flag indicating that the Phase Disconnect initialization test and initialization has completed" UBYTE NO_COMPU_METHOD 0 0 0 3 DISPLAY_IDENTIFIER PhaseDisconStat ECU_ADDRESS 0 PHYS_UNIT "Counts" READ_WRITE /end MEASUREMENT
/begin MEASUREMENT PhaseDscnt_PhsDiscTestComplete_Cnt_lgc "" UBYTE Boolean 0 0 0 1 DISPLAY_IDENTIFIER PhsDiscTestComplete_Cnt_lgc ECU_ADDRESS 0 PHYS_UNIT "Counts" READ_WRITE SYMBOL_LINK "Rte_PhaseDscnt_PhsDiscTestComplete_Cnt_lgc" 0 /end MEASUREMENT
/begin MEASUREMENT PrevSystemStatePer1_Cnt_M_enum "" UBYTE NO_COMPU_METHOD 0 0 0 4 ECU_ADDRESS 0 PHYS_UNIT "Counts" READ_WRITE /end MEASUREMENT
/begin MEASUREMENT PrevSystemStatePer2_Cnt_M_enum "" UBYTE NO_COMPU_METHOD 0 0 0 4 ECU_ADDRESS 0 PHYS_UNIT "Counts" READ_WRITE /end MEASUREMENT
/begin MEASUREMENT Polarity_AssistAssyPolarity_Cnt_s08 "" SBYTE NO_COMPU_METHOD 0 0 -1 1 DISPLAY_IDENTIFIER AssistAssy_Polarity ECU_ADDRESS 0 PHYS_UNIT "Cnt" READ_WRITE SYMBOL_LINK "Rte_Polarity_AssistAssyPolarity_Cnt_s08" 0 /end MEASUREMENT
/begin MEASUREMENT Polarity_HwPosPolarity_Cnt_s08 "" SBYTE NO_COMPU_METHOD 0 0 -1 1 DISPLAY_IDENTIFIER HwPos_Polarity ECU_ADDRESS 0 PHYS_UNIT "Cnt" READ_WRITE SYMBOL_LINK "Rte_Polarity_HwPosPolarity_Cnt_s08" 0 /end MEASUREMENT
/begin MEASUREMENT Polarity_HwTrqPolarity_Cnt_s08 "" SBYTE NO_COMPU_METHOD 0 0 -1 1 DISPLAY_IDENTIFIER HwTrq_Polarity ECU_ADDRESS 0 PHYS_UNIT "Cnt" READ_WRITE SYMBOL_LINK "Rte_Polarity_HwTrqPolarity_Cnt_s08" 0 /end MEASUREMENT
/begin MEASUREMENT Polarity_MtrElecMechPolarity_Cnt_s08 "" SBYTE NO_COMPU_METHOD 0 0 -1 1 DISPLAY_IDENTIFIER MtrElecMech_Polarity ECU_ADDRESS 0 PHYS_UNIT "Cnt" READ_WRITE SYMBOL_LINK "Rte_Polarity_MtrElecMechPolarity_Cnt_s08" 0 /end MEASUREMENT
/begin MEASUREMENT Polarity_MtrPosPolarity_Cnt_s08 "" SBYTE NO_COMPU_METHOD 0 0 -1 1 DISPLAY_IDENTIFIER MtrPos_Polarity ECU_ADDRESS 0 PHYS_UNIT "Cnt" READ_WRITE SYMBOL_LINK "Rte_Polarity_MtrPosPolarity_Cnt_s08" 0 /end MEASUREMENT
/begin MEASUREMENT Polarity_MtrVelPolarity_Cnt_s08 "" SBYTE NO_COMPU_METHOD 0 0 -1 1 DISPLAY_IDENTIFIER MtrVel_Polarity ECU_ADDRESS 0 PHYS_UNIT "Cnt" READ_WRITE SYMBOL_LINK "Rte_Polarity_MtrVelPolarity_Cnt_s08" 0 /end MEASUREMENT
/begin MEASUREMENT Polarity_SysC_MtrElecMechPolarity_Cnt_s32 "" SLONG NO_COMPU_METHOD 0 0 -1 1 DISPLAY_IDENTIFIER SysC_MtrElecMech_Polarity ECU_ADDRESS 0 PHYS_UNIT "Cnt" READ_WRITE SYMBOL_LINK "Rte_Polarity_SysC_MtrElecMechPolarity_Cnt_s32" 0 /end MEASUREMENT
/begin MEASUREMENT DTermKSV_M_str.K_Uls_f32 "" FLOAT32_IEEE NO_COMPU_METHOD 0 0 1.24877434763439E-02 0.71539045666397 ECU_ADDRESS 0 PHYS_UNIT "Unitless" READ_WRITE /end MEASUREMENT
/begin MEASUREMENT DTermKSV_M_str.SV_Uls_f32 "" FLOAT32_IEEE NO_COMPU_METHOD 0 0 -8.8 8.8 ECU_ADDRESS 0 PHYS_UNIT "MtrNm" READ_WRITE /end MEASUREMENT
/begin MEASUREMENT FiltHwPosKSV_M_str.K_Uls_f32 "" FLOAT32_IEEE NO_COMPU_METHOD 0 0 1.25584782371357E-03 0.22223232082821 ECU_ADDRESS 0 PHYS_UNIT "Unitless" READ_WRITE /end MEASUREMENT
/begin MEASUREMENT FiltHwPosKSV_M_str.SV_Uls_f32 "" FLOAT32_IEEE NO_COMPU_METHOD 0 0 -900 900 ECU_ADDRESS 0 PHYS_UNIT "HwDeg" READ_WRITE /end MEASUREMENT
/begin MEASUREMENT FiltHwTrqKSV_M_str.K_Uls_f32 "" FLOAT32_IEEE NO_COMPU_METHOD 0 0 1.25584782371357E-03 0.22223232082821 ECU_ADDRESS 0 PHYS_UNIT "Unitless" READ_WRITE /end MEASUREMENT
/begin MEASUREMENT FiltHwTrqKSV_M_str.SV_Uls_f32 "" FLOAT32_IEEE NO_COMPU_METHOD 0 0 -10 10 ECU_ADDRESS 0 PHYS_UNIT "HwNm" READ_WRITE /end MEASUREMENT
/begin MEASUREMENT ITermSV_HwDeg_M_s27p4 "" SLONG s27p4_T 0 0 -72089600 72089600 ECU_ADDRESS 0 PHYS_UNIT "HwDeg" READ_WRITE /end MEASUREMENT
/begin MEASUREMENT PosServo_DTerm_MtrNm_D_s8p7 "" SWORD NO_COMPU_METHOD 0 0 -8.8 8.8 DISPLAY_IDENTIFIER PosSrvo_Dterm ECU_ADDRESS 0 PHYS_UNIT "MtrNm" READ_WRITE /end MEASUREMENT
/begin MEASUREMENT PosServo_ITerm_MtrNm_D_s8p7 "" SWORD NO_COMPU_METHOD 0 0 -8.8 8.8 DISPLAY_IDENTIFIER PosSrvo_Iterm ECU_ADDRESS 0 PHYS_UNIT "MtrNm" READ_WRITE /end MEASUREMENT
/begin MEASUREMENT PosServo_PTerm_MtrNm_D_s24p7 "" SLONG NO_COMPU_METHOD 0 0 -8.8 8.8 DISPLAY_IDENTIFIER PosSrvo_Pterm ECU_ADDRESS 0 PHYS_UNIT "MtrNm" READ_WRITE /end MEASUREMENT
/begin MEASUREMENT PosServo_PosSrvoCmd_MtrNm_f32 "Motor torque command requested" FLOAT32_IEEE NO_COMPU_METHOD 0 0 -8.8 8.8 DISPLAY_IDENTIFIER PosSrvo_Cmd ECU_ADDRESS 0 PHYS_UNIT "MtrNm" READ_WRITE SYMBOL_LINK "Rte_PosServo_PosSrvoCmd_MtrNm_f32" 0 /end MEASUREMENT
/begin MEASUREMENT PosSrvoHWATargFilt_HwDeg_D_f32 "" FLOAT32_IEEE NO_COMPU_METHOD 0 0 -900 900 DISPLAY_IDENTIFIER PosSrvo_HWATargFilt ECU_ADDRESS 0 PHYS_UNIT "HwDeg" READ_WRITE /end MEASUREMENT
/begin MEASUREMENT PosSrvoPIDCmd_MtrNm_D_f32 "" FLOAT32_IEEE NO_COMPU_METHOD 0 0 -8.8 8.8 DISPLAY_IDENTIFIER PosSrvo_PIDCmd ECU_ADDRESS 0 PHYS_UNIT "MtrNm" READ_WRITE /end MEASUREMENT
/begin MEASUREMENT PosSrvoRampComplete_Cnt_D_lgc "" UBYTE Boolean 0 0 0 1 DISPLAY_IDENTIFIER PosSrvo_RampComplete ECU_ADDRESS 0 PHYS_UNIT "Cnt" READ_WRITE /end MEASUREMENT
/begin MEASUREMENT PosServo_PosSrvoReturnSclFct_Uls_f32 "Scale factor on return command" FLOAT32_IEEE NO_COMPU_METHOD 0 0 0 1 DISPLAY_IDENTIFIER PosSrvo_Return_SclFct ECU_ADDRESS 0 PHYS_UNIT "Uls" READ_WRITE SYMBOL_LINK "Rte_PosServo_PosSrvoReturnSclFct_Uls_f32" 0 /end MEASUREMENT
/begin MEASUREMENT PosServo_PosSrvoSmoothEnable_Uls_f32 "Enable Scale Factor" FLOAT32_IEEE NO_COMPU_METHOD 0 0 0 1 DISPLAY_IDENTIFIER PosSrvo_Smooth_Enable ECU_ADDRESS 0 PHYS_UNIT "Unitless" READ_WRITE SYMBOL_LINK "Rte_PosServo_PosSrvoSmoothEnable_Uls_f32" 0 /end MEASUREMENT
/begin MEASUREMENT PrevCmdError_HwDeg_M_s11p4 "" SWORD s11p4_T 0 0 -1800 1800 ECU_ADDRESS 0 PHYS_UNIT "HwDeg" READ_WRITE /end MEASUREMENT
/begin MEASUREMENT PrevLimitedHwPos_HwDeg_M_f32 "" FLOAT32_IEEE NO_COMPU_METHOD 0 0 -900 900 ECU_ADDRESS 0 PHYS_UNIT "HwDeg" READ_WRITE /end MEASUREMENT
/begin MEASUREMENT PrkAstRampSV_Uls_M_f32 "" FLOAT32_IEEE NO_COMPU_METHOD 0 0 0 1 ECU_ADDRESS 0 PHYS_UNIT "Uls" READ_WRITE /end MEASUREMENT
/begin MEASUREMENT PwrLmtFunc_AssistPowerLimit_MtrNm_f32 "Torque Limit Value due to all sub-functions in the Power Limit Function" FLOAT32_IEEE NO_COMPU_METHOD 0 0 0 8.8 DISPLAY_IDENTIFIER Assist_PowerLimit ECU_ADDRESS 0 PHYS_UNIT "MtrNm" READ_WRITE SYMBOL_LINK "Rte_PwrLmtFunc_AssistPowerLimit_MtrNm_f32" 0 /end MEASUREMENT
/begin MEASUREMENT FltTrqLmt_Uls_D_f32 "" FLOAT32_IEEE NO_COMPU_METHOD 0 0 0 1 DISPLAY_IDENTIFIER Filtered_Limit_Percent ECU_ADDRESS 0 PHYS_UNIT "Uls" READ_WRITE /end MEASUREMENT
/begin MEASUREMENT InvKeStdTemp_RadpSpV_M_f32 "" FLOAT32_IEEE NO_COMPU_METHOD 0 0 13.333 40 ECU_ADDRESS 0 PHYS_UNIT "RadpSpV" READ_WRITE /end MEASUREMENT
/begin MEASUREMENT LimitDiff_MtrNm_M_s4p11 "" SWORD s4p11_T 0 0 -8.8 8.8 DISPLAY_IDENTIFIER Limit_Difference ECU_ADDRESS 0 PHYS_UNIT "MtrNm" READ_WRITE /end MEASUREMENT
/begin MEASUREMENT LowVltAstTime_mS_M_u32p0 "" ULONG NO_COMPU_METHOD 0 0 0 4294967296 ECU_ADDRESS 0 PHYS_UNIT "mS" READ_WRITE /end MEASUREMENT
/begin MEASUREMENT MinStdOpLmt_MtrNm_M_u5p11 "" UWORD u5p11_T 0 0 0 8.8 DISPLAY_IDENTIFIER Min_Std_Op_Limit ECU_ADDRESS 0 PHYS_UNIT "MtrNm" READ_WRITE /end MEASUREMENT
/begin MEASUREMENT PwrLmtFunc_MtrEnvSpd_MtrRadpS_f32 "Value indicating the absolute value of the motor velocity plus the total motor velocity offset due to all supply current limiting adjustment functions" FLOAT32_IEEE NO_COMPU_METHOD 0 0 0 1118 DISPLAY_IDENTIFIER MtrEnvSpd ECU_ADDRESS 0 PHYS_UNIT "MtrRadpS" READ_WRITE SYMBOL_LINK "Rte_PwrLmtFunc_MtrEnvSpd_MtrRadpS_f32" 0 /end MEASUREMENT
/begin MEASUREMENT OPVelOffset_MtrRadpS_D_s11p4 "" SWORD s11p4_T 0 0 -571.35 571.35 DISPLAY_IDENTIFIER Output_Velocity_Offset ECU_ADDRESS 0 PHYS_UNIT "MtrRadpS" READ_WRITE /end MEASUREMENT
/begin MEASUREMENT PwrLmtFunc_PowerLimitPerc_Uls_f32 "Value indicating the magnitude of limiting being enforced by the Power Limit Function" FLOAT32_IEEE NO_COMPU_METHOD 0 0 0 1 DISPLAY_IDENTIFIER PowerLimitPerc ECU_ADDRESS 0 PHYS_UNIT "Uls" READ_WRITE SYMBOL_LINK "Rte_PwrLmtFunc_PowerLimitPerc_Uls_f32" 0 /end MEASUREMENT
/begin MEASUREMENT SpdAdj_MtrRadpS_M_s11p4 "" SWORD s11p4_T 0 0 -571.35 1142.7 DISPLAY_IDENTIFIER SpdAdj_MtrRadpS ECU_ADDRESS 0 PHYS_UNIT "MtrRadpS" READ_WRITE /end MEASUREMENT
/begin MEASUREMENT TLmtMaxCurr_MtrNm_D_u5p11 "" UWORD u5p11_T 0 0 0 26.4 DISPLAY_IDENTIFIER T_limit_max_curr_Nm ECU_ADDRESS 0 PHYS_UNIT "MtrNm" READ_WRITE /end MEASUREMENT
/begin MEASUREMENT TrqEnvLmt_MtrNm_D_u5p11 "" UWORD u5p11_T 0 0 0 8.8 ECU_ADDRESS 0 PHYS_UNIT "MtrNm" READ_WRITE /end MEASUREMENT
/begin MEASUREMENT TrqLmt_MtrNm_M_u5p11 "" UWORD u5p11_T 0 0 0 8.8 ECU_ADDRESS 0 PHYS_UNIT "MtrNm" READ_WRITE /end MEASUREMENT
/begin MEASUREMENT TrqLmt_Uls_D_f32 "" FLOAT32_IEEE NO_COMPU_METHOD 0 0 0 1 DISPLAY_IDENTIFIER Limit_Percent ECU_ADDRESS 0 PHYS_UNIT "Uls" READ_WRITE /end MEASUREMENT
/begin MEASUREMENT TrqLmtKSV_M_str.K_Uls_f32 "" FLOAT32_IEEE NO_COMPU_METHOD 0 0 0.001255847824 0.0124877743476 ECU_ADDRESS 0 PHYS_UNIT "Unitless" READ_WRITE /end MEASUREMENT
/begin MEASUREMENT TrqLmtKSV_M_str.SV_Uls_f32 "" FLOAT32_IEEE NO_COMPU_METHOD 0 0 0 1 ECU_ADDRESS 0 PHYS_UNIT "Unitless" READ_WRITE /end MEASUREMENT
/begin MEASUREMENT a1_DTFilt_M_f32 "" FLOAT32_IEEE NO_COMPU_METHOD 0 0 -0.9990004997 0.428571428 ECU_ADDRESS 0 PHYS_UNIT "Uls" READ_WRITE /end MEASUREMENT
/begin MEASUREMENT a1_LeadLagFilt_M_f32 "" FLOAT32_IEEE NO_COMPU_METHOD 0 0 -0.99900049975 0.428571428 ECU_ADDRESS 0 PHYS_UNIT "Uls" READ_WRITE /end MEASUREMENT
/begin MEASUREMENT AssistTrq_Nm_D_f32 "" FLOAT32_IEEE NO_COMPU_METHOD 0 0 -704 704 DISPLAY_IDENTIFIER AssistConv_Trq ECU_ADDRESS 0 PHYS_UNIT "Nm" READ_WRITE /end MEASUREMENT
/begin MEASUREMENT b0_DTFilt_M_f32 "" FLOAT32_IEEE NO_COMPU_METHOD 0 0 0.009995992498 428.571428 ECU_ADDRESS 0 PHYS_UNIT "Uls" READ_WRITE /end MEASUREMENT
/begin MEASUREMENT b1_DTFilt_M_f32 "" FLOAT32_IEEE NO_COMPU_METHOD 0 0 -428.571428 -0.009995992498 ECU_ADDRESS 0 PHYS_UNIT "Uls" READ_WRITE /end MEASUREMENT
/begin MEASUREMENT b1_LeadLagFilt_M_f32 "" FLOAT32_IEEE NO_COMPU_METHOD 0 0 -0.99900049975 0.428571428 ECU_ADDRESS 0 PHYS_UNIT "Uls" READ_WRITE /end MEASUREMENT
/begin MEASUREMENT bo_LeadLagFilt_M_f32 "" FLOAT32_IEEE NO_COMPU_METHOD 0 0 0.000699650177 1429.28571 ECU_ADDRESS 0 PHYS_UNIT "Uls" READ_WRITE /end MEASUREMENT
/begin MEASUREMENT CRFMtrTrqCmdQuad_MtrNm_M_f32 "" FLOAT32_IEEE NO_COMPU_METHOD 0 0 -8.8 8.8 DISPLAY_IDENTIFIER Torque_Cmd_CRF ECU_ADDRESS 0 PHYS_UNIT "MtrNm" READ_WRITE /end MEASUREMENT
/begin MEASUREMENT DTOpCRFMtrTrqCmdQuad_HwNm_M_f32 "" FLOAT32_IEEE NO_COMPU_METHOD 0 0 -352 352 ECU_ADDRESS 0 PHYS_UNIT "HwNm" READ_WRITE /end MEASUREMENT
/begin MEASUREMENT DTOpMtrAccel_RadpS2_M_f32 "" FLOAT32_IEEE NO_COMPU_METHOD 0 0 -17500 17500 DISPLAY_IDENTIFIER Motor_Accel_CRF ECU_ADDRESS 0 PHYS_UNIT "MtrRadpS2" READ_WRITE /end MEASUREMENT
/begin MEASUREMENT DTOpMtrAccelSV_RadpS2_M_s15p16 "" SLONG s15p16_T 0 0 -17500 17500 ECU_ADDRESS 0 PHYS_UNIT "MtrRadpS2" READ_WRITE /end MEASUREMENT
/begin MEASUREMENT InertiaTrq_Nm_M_f32 "" FLOAT32_IEEE NO_COMPU_METHOD 0 0 -1750 1750 DISPLAY_IDENTIFIER Inertia_Trq ECU_ADDRESS 0 PHYS_UNIT "Nm" READ_WRITE /end MEASUREMENT
/begin MEASUREMENT MechEff_Uls_M_f32 "" FLOAT32_IEEE NO_COMPU_METHOD 0 0 0 2 DISPLAY_IDENTIFIER MechEff ECU_ADDRESS 0 PHYS_UNIT "Uls" READ_WRITE /end MEASUREMENT
/begin MEASUREMENT MotorEff_Uls_M_f32 "" FLOAT32_IEEE NO_COMPU_METHOD 0 0 0 2 DISPLAY_IDENTIFIER MotorEff ECU_ADDRESS 0 PHYS_UNIT "Uls" READ_WRITE /end MEASUREMENT
/begin MEASUREMENT PrevDTFilterInputSV_M_f32 "" FLOAT32_IEEE NO_COMPU_METHOD 0 0 -1118 1118 ECU_ADDRESS 0 PHYS_UNIT "MtrRadpS" READ_WRITE /end MEASUREMENT
/begin MEASUREMENT PrevDTOpFilterSV_M_f32 "" FLOAT32_IEEE NO_COMPU_METHOD 0 0 -17500 17500 ECU_ADDRESS 0 PHYS_UNIT "MtrRadpS2" READ_WRITE /end MEASUREMENT
/begin MEASUREMENT PrevLeadLagFilterInputSV_M_f32 "" FLOAT32_IEEE NO_COMPU_METHOD 0 0 -352 352 ECU_ADDRESS 0 PHYS_UNIT "MtrNm" READ_WRITE /end MEASUREMENT
/begin MEASUREMENT PrevLeadLagOpFilterSV_M_f32 "" FLOAT32_IEEE NO_COMPU_METHOD 0 0 -352 352 ECU_ADDRESS 0 PHYS_UNIT "MtrNm" READ_WRITE /end MEASUREMENT
/begin MEASUREMENT RackDmpTrq_Nm_M_f32 "" FLOAT32_IEEE NO_COMPU_METHOD 0 0 -1118 1118 DISPLAY_IDENTIFIER RackDmp_Trq ECU_ADDRESS 0 PHYS_UNIT "Nm" READ_WRITE /end MEASUREMENT
/begin MEASUREMENT RackFrictionTrq_Nm_M_f32 "" FLOAT32_IEEE NO_COMPU_METHOD 0 0 -10 10 DISPLAY_IDENTIFIER RackFriction_Trq ECU_ADDRESS 0 PHYS_UNIT "Nm" READ_WRITE /end MEASUREMENT
/begin MEASUREMENT RackLoad_RackLoad_kN_f32 "" FLOAT32_IEEE NO_COMPU_METHOD 0 0 -17 17 DISPLAY_IDENTIFIER RackLoad ECU_ADDRESS 0 PHYS_UNIT "kN" READ_WRITE SYMBOL_LINK "Rte_RackLoad_RackLoad_kN_f32" 0 /end MEASUREMENT
/begin MEASUREMENT RackLoadSV_kN_M_s7p24 "" SLONG s7p24_T 0 0 -17 17 ECU_ADDRESS 0 PHYS_UNIT "kN" READ_WRITE /end MEASUREMENT
/begin MEASUREMENT RackTrq_Nm_M_f32 "" FLOAT32_IEEE NO_COMPU_METHOD 0 0 -3574 3574 DISPLAY_IDENTIFIER Rack_Trq ECU_ADDRESS 0 PHYS_UNIT "Nm" READ_WRITE /end MEASUREMENT
/begin MEASUREMENT AbsHwPosReturn_HwDeg_D_u12p4 "" UWORD u12p4_T 0 0 0 1640 DISPLAY_IDENTIFIER Rtrn_AbsHwPos ECU_ADDRESS 0 PHYS_UNIT "HwDeg" READ_WRITE /end MEASUREMENT
/begin MEASUREMENT CrntHandWheelAthScl_Uls_M_f32 "" FLOAT32_IEEE NO_COMPU_METHOD 0 0 0 1 ECU_ADDRESS 0 PHYS_UNIT "Uls" READ_WRITE /end MEASUREMENT
/begin MEASUREMENT CurrentOffset_HwDeg_M_f32 "" FLOAT32_IEEE NO_COMPU_METHOD 0 0 0 20 ECU_ADDRESS 0 PHYS_UNIT "HwDeg" READ_WRITE /end MEASUREMENT
/begin MEASUREMENT HwPosReturnCmd_MtrNm_D_f32 "" FLOAT32_IEEE NO_COMPU_METHOD 0 0 0 0.5 DISPLAY_IDENTIFIER Rtrn_HwPos_MtrNm ECU_ADDRESS 0 PHYS_UNIT "MtrNm" READ_WRITE /end MEASUREMENT
/begin MEASUREMENT HwTrqReturnScl_Uls_D_f32 "" FLOAT32_IEEE NO_COMPU_METHOD 0 0 0 1 DISPLAY_IDENTIFIER Rtrn_TrqScale ECU_ADDRESS 0 PHYS_UNIT "Uls" READ_WRITE /end MEASUREMENT
/begin MEASUREMENT HwVelReturnScl_Uls_D_f32 "" FLOAT32_IEEE NO_COMPU_METHOD 0 0 0 50 DISPLAY_IDENTIFIER Rtrn_VelScale ECU_ADDRESS 0 PHYS_UNIT "Uls" READ_WRITE /end MEASUREMENT
/begin MEASUREMENT Return_ReturnCmd_MtrNm_f32 "Return component of overall motor torque command computed" FLOAT32_IEEE NO_COMPU_METHOD 0 0 -8.8 8.8 DISPLAY_IDENTIFIER Return_Cmd ECU_ADDRESS 0 PHYS_UNIT "MtrNm" READ_WRITE SYMBOL_LINK "Rte_Return_ReturnCmd_MtrNm_f32" 0 /end MEASUREMENT
/begin MEASUREMENT RtrnBasicReturn_MtrNm_D_f32 "" FLOAT32_IEEE NO_COMPU_METHOD 0 0 -10 10 DISPLAY_IDENTIFIER Rtrn_BasicReturn ECU_ADDRESS 0 PHYS_UNIT "MtrNm" READ_WRITE /end MEASUREMENT
/begin MEASUREMENT SgnHwPosReturn_HwDeg_D_f32 "" FLOAT32_IEEE NO_COMPU_METHOD 0 0 -1 1 DISPLAY_IDENTIFIER Rtrn_SignHwPos ECU_ADDRESS 0 PHYS_UNIT "HwDeg" READ_WRITE /end MEASUREMENT
/begin MEASUREMENT TempReturnScl_Uls_D_f32 "" FLOAT32_IEEE NO_COMPU_METHOD 0 0 0 10 DISPLAY_IDENTIFIER Rtrn_TempScale ECU_ADDRESS 0 PHYS_UNIT "Uls" READ_WRITE /end MEASUREMENT
/begin MEASUREMENT ReturnFirewall_LimitedReturn_MtrNm_f32 "Limited motor torque commands" FLOAT32_IEEE NO_COMPU_METHOD 0 0 -8.8 8.8 DISPLAY_IDENTIFIER LimitedReturn ECU_ADDRESS 0 PHYS_UNIT "MtrNm" READ_WRITE SYMBOL_LINK "Rte_ReturnFirewall_LimitedReturn_MtrNm_f32" 0 /end MEASUREMENT
/begin MEASUREMENT LwrBound_MtrNm_D_f32 "" FLOAT32_IEEE NO_COMPU_METHOD 0 0 -8.8 8.8 DISPLAY_IDENTIFIER RtrnFW_LwrBound ECU_ADDRESS 0 PHYS_UNIT "MtrNm" READ_WRITE /end MEASUREMENT
/begin MEASUREMENT OverBound_Cnt_D_lgc "" UBYTE Boolean 0 0 0 1 DISPLAY_IDENTIFIER RtrnFW_OverBound ECU_ADDRESS 0 PHYS_UNIT "Cnt" READ_WRITE /end MEASUREMENT
/begin MEASUREMENT UprBound_MtrNm_D_f32 "" FLOAT32_IEEE NO_COMPU_METHOD 0 0 -8.8 8.8 DISPLAY_IDENTIFIER RtrnFW_UprBound ECU_ADDRESS 0 PHYS_UNIT "MtrNm" READ_WRITE /end MEASUREMENT
/begin MEASUREMENT ESMErrOutStat_Cnt_D_u08 "status from the Error Signal Module" UBYTE NO_COMPU_METHOD 0 0 0 1 DISPLAY_IDENTIFIER ESMErrOutstat ECU_ADDRESS 0 PHYS_UNIT "Counts" READ_WRITE /end MEASUREMENT
/begin MEASUREMENT GateDrvResetStat_Cnt_D_u32 "status of the GPIO bit for the physical Gate Drive Reset" ULONG NO_COMPU_METHOD 0 0 0 524288 DISPLAY_IDENTIFIER GateDrvResetStat ECU_ADDRESS 0 PHYS_UNIT "Counts" READ_WRITE /end MEASUREMENT
/begin MEASUREMENT NHETPwmStat_Cnt_D_u32 "status of the NHET control of the Gate Drive signals" ULONG NO_COMPU_METHOD 0 0 0 22282308 DISPLAY_IDENTIFIER NHETPwmStat ECU_ADDRESS 0 PHYS_UNIT "Counts" READ_WRITE /end MEASUREMENT
/begin MEASUREMENT SysFault2Stat_Cnt_D_u08 "status of the GPIO bit for the physical SYS_FAULT2 signal" UBYTE NO_COMPU_METHOD 0 0 0 8 DISPLAY_IDENTIFIER SysFault2Stat ECU_ADDRESS 0 PHYS_UNIT "Counts" READ_WRITE /end MEASUREMENT
/begin MEASUREMENT StabilityComp_AssistCmd_MtrNm_f32 "Assist component of computed overall motor torque command" FLOAT32_IEEE NO_COMPU_METHOD 0 0 -8.8 8.8 DISPLAY_IDENTIFIER Assist_Cmd ECU_ADDRESS 0 PHYS_UNIT "MtrNm" READ_WRITE SYMBOL_LINK "Rte_StabilityComp_AssistCmd_MtrNm_f32" 0 /end MEASUREMENT
/begin MEASUREMENT AssistCmdSV_MtrNm_M_f32 "Assist component of computed overall motor torque command" FLOAT32_IEEE NO_COMPU_METHOD 0 0 -8.8 8.8 ECU_ADDRESS 0 PHYS_UNIT "MtrNm" READ_WRITE /end MEASUREMENT
/begin MEASUREMENT AssistDDFactorSV_Uls_M_f32 "Multiplicative factor to be applied to assist.  Originates from the serial communication bus." FLOAT32_IEEE NO_COMPU_METHOD 0 0 1 2 ECU_ADDRESS 0 PHYS_UNIT "Uls" READ_WRITE /end MEASUREMENT
/begin MEASUREMENT CombAstNFSV_Cnt_M_Str[0].KPtr_Cnt_StrA1_Uls_f32 "" FLOAT32_IEEE NO_COMPU_METHOD 0 0 -2 0 ECU_ADDRESS 0 PHYS_UNIT "Uls" READ_WRITE SYMBOL_LINK "CombAstNFSV_Cnt_M_Str._0_.KPtr_Cnt_Str->A1_Uls_f32" 0 /end MEASUREMENT
/begin MEASUREMENT CombAstNFSV_Cnt_M_Str[0].KPtr_Cnt_StrA2_Uls_f32 "" FLOAT32_IEEE NO_COMPU_METHOD 0 0 -1 1 ECU_ADDRESS 0 PHYS_UNIT "Uls" READ_WRITE SYMBOL_LINK "CombAstNFSV_Cnt_M_Str._0_.KPtr_Cnt_Str->A2_Uls_f32" 0 /end MEASUREMENT
/begin MEASUREMENT CombAstNFSV_Cnt_M_Str[0].KPtr_Cnt_StrB0_Uls_f32 "" FLOAT32_IEEE NO_COMPU_METHOD 0 0 0 2300 ECU_ADDRESS 0 PHYS_UNIT "Uls" READ_WRITE SYMBOL_LINK "CombAstNFSV_Cnt_M_Str._0_.KPtr_Cnt_Str->B0_Uls_f32" 0 /end MEASUREMENT
/begin MEASUREMENT CombAstNFSV_Cnt_M_Str[0].KPtr_Cnt_StrB1_Uls_f32 "" FLOAT32_IEEE NO_COMPU_METHOD 0 0 -4500 0 ECU_ADDRESS 0 PHYS_UNIT "Uls" READ_WRITE SYMBOL_LINK "CombAstNFSV_Cnt_M_Str._0_.KPtr_Cnt_Str->B1_Uls_f32" 0 /end MEASUREMENT
/begin MEASUREMENT CombAstNFSV_Cnt_M_Str[0].KPtr_Cnt_StrB2_Uls_f32 "" FLOAT32_IEEE NO_COMPU_METHOD 0 0 -4 2300 ECU_ADDRESS 0 PHYS_UNIT "Uls" READ_WRITE SYMBOL_LINK "CombAstNFSV_Cnt_M_Str._0_.KPtr_Cnt_Str->B2_Uls_f32" 0 /end MEASUREMENT
/begin MEASUREMENT CombAstNFSV_Cnt_M_Str[0].Out_Uls_f32 "" FLOAT32_IEEE NO_COMPU_METHOD 0 0 -2312 2312 ECU_ADDRESS 0 PHYS_UNIT "Uls" READ_WRITE SYMBOL_LINK "CombAstNFSV_Cnt_M_Str._0_.Out_Uls_f32" 0 /end MEASUREMENT
/begin MEASUREMENT CombAstNFSV_Cnt_M_Str[0].SV1_Uls_f32 "" FLOAT32_IEEE NO_COMPU_METHOD 0 0 -2077 2077 ECU_ADDRESS 0 PHYS_UNIT "Uls" READ_WRITE SYMBOL_LINK "CombAstNFSV_Cnt_M_Str._0_.SV1_Uls_f32" 0 /end MEASUREMENT
/begin MEASUREMENT CombAstNFSV_Cnt_M_Str[0].SV2_Uls_f32 "" FLOAT32_IEEE NO_COMPU_METHOD 0 0 -1981 1981 ECU_ADDRESS 0 PHYS_UNIT "Uls" READ_WRITE SYMBOL_LINK "CombAstNFSV_Cnt_M_Str._0_.SV2_Uls_f32" 0 /end MEASUREMENT
/begin MEASUREMENT CombAstNFSV_Cnt_M_Str[1].KPtr_Cnt_StrA1_Uls_f32 "" FLOAT32_IEEE NO_COMPU_METHOD 0 0 -2 0 ECU_ADDRESS 0 PHYS_UNIT "Uls" READ_WRITE SYMBOL_LINK "CombAstNFSV_Cnt_M_Str._1_.KPtr_Cnt_Str->A1_Uls_f32" 0 /end MEASUREMENT
/begin MEASUREMENT CombAstNFSV_Cnt_M_Str[1].KPtr_Cnt_StrA2_Uls_f32 "" FLOAT32_IEEE NO_COMPU_METHOD 0 0 -1 1 ECU_ADDRESS 0 PHYS_UNIT "Uls" READ_WRITE SYMBOL_LINK "CombAstNFSV_Cnt_M_Str._1_.KPtr_Cnt_Str->A2_Uls_f32" 0 /end MEASUREMENT
/begin MEASUREMENT CombAstNFSV_Cnt_M_Str[1].KPtr_Cnt_StrB0_Uls_f32 "" FLOAT32_IEEE NO_COMPU_METHOD 0 0 0 2300 ECU_ADDRESS 0 PHYS_UNIT "Uls" READ_WRITE SYMBOL_LINK "CombAstNFSV_Cnt_M_Str._1_.KPtr_Cnt_Str->B0_Uls_f32" 0 /end MEASUREMENT
/begin MEASUREMENT CombAstNFSV_Cnt_M_Str[1].KPtr_Cnt_StrB1_Uls_f32 "" FLOAT32_IEEE NO_COMPU_METHOD 0 0 -4500 0 ECU_ADDRESS 0 PHYS_UNIT "Uls" READ_WRITE SYMBOL_LINK "CombAstNFSV_Cnt_M_Str._1_.KPtr_Cnt_Str->B1_Uls_f32" 0 /end MEASUREMENT
/begin MEASUREMENT CombAstNFSV_Cnt_M_Str[1].KPtr_Cnt_StrB2_Uls_f32 "" FLOAT32_IEEE NO_COMPU_METHOD 0 0 -4 2300 ECU_ADDRESS 0 PHYS_UNIT "Uls" READ_WRITE SYMBOL_LINK "CombAstNFSV_Cnt_M_Str._1_.KPtr_Cnt_Str->B2_Uls_f32" 0 /end MEASUREMENT
/begin MEASUREMENT CombAstNFSV_Cnt_M_Str[1].Out_Uls_f32 "" FLOAT32_IEEE NO_COMPU_METHOD 0 0 -2312 2312 ECU_ADDRESS 0 PHYS_UNIT "Uls" READ_WRITE SYMBOL_LINK "CombAstNFSV_Cnt_M_Str._1_.Out_Uls_f32" 0 /end MEASUREMENT
/begin MEASUREMENT CombAstNFSV_Cnt_M_Str[1].SV1_Uls_f32 "" FLOAT32_IEEE NO_COMPU_METHOD 0 0 -2077 2077 ECU_ADDRESS 0 PHYS_UNIT "Uls" READ_WRITE SYMBOL_LINK "CombAstNFSV_Cnt_M_Str._1_.SV1_Uls_f32" 0 /end MEASUREMENT
/begin MEASUREMENT CombAstNFSV_Cnt_M_Str[1].SV2_Uls_f32 "" FLOAT32_IEEE NO_COMPU_METHOD 0 0 -1981 1981 ECU_ADDRESS 0 PHYS_UNIT "Uls" READ_WRITE SYMBOL_LINK "CombAstNFSV_Cnt_M_Str._1_.SV2_Uls_f32" 0 /end MEASUREMENT
/begin MEASUREMENT CombAstNFSV_Cnt_M_Str[2].KPtr_Cnt_StrA1_Uls_f32 "" FLOAT32_IEEE NO_COMPU_METHOD 0 0 -2 0 ECU_ADDRESS 0 MATRIX_DIM 2 1 1 PHYS_UNIT "Uls" READ_WRITE SYMBOL_LINK "CombAstNFSV_Cnt_M_Str._2_.KPtr_Cnt_Str->A1_Uls_f32" 0 /end MEASUREMENT
/begin MEASUREMENT CombAstNFSV_Cnt_M_Str[2].KPtr_Cnt_StrA2_Uls_f32 "" FLOAT32_IEEE NO_COMPU_METHOD 0 0 -1 1 ECU_ADDRESS 0 MATRIX_DIM 2 1 1 PHYS_UNIT "Uls" READ_WRITE SYMBOL_LINK "CombAstNFSV_Cnt_M_Str._2_.KPtr_Cnt_Str->A2_Uls_f32" 0 /end MEASUREMENT
/begin MEASUREMENT CombAstNFSV_Cnt_M_Str[2].KPtr_Cnt_StrB0_Uls_f32 "" FLOAT32_IEEE NO_COMPU_METHOD 0 0 0 2300 ECU_ADDRESS 0 MATRIX_DIM 2 1 1 PHYS_UNIT "Uls" READ_WRITE SYMBOL_LINK "CombAstNFSV_Cnt_M_Str._2_.KPtr_Cnt_Str->B0_Uls_f32" 0 /end MEASUREMENT
/begin MEASUREMENT CombAstNFSV_Cnt_M_Str[2].KPtr_Cnt_StrB1_Uls_f32 "" FLOAT32_IEEE NO_COMPU_METHOD 0 0 -4500 0 ECU_ADDRESS 0 MATRIX_DIM 2 1 1 PHYS_UNIT "Uls" READ_WRITE SYMBOL_LINK "CombAstNFSV_Cnt_M_Str._2_.KPtr_Cnt_Str->B1_Uls_f32" 0 /end MEASUREMENT
/begin MEASUREMENT CombAstNFSV_Cnt_M_Str[2].KPtr_Cnt_StrB2_Uls_f32 "" FLOAT32_IEEE NO_COMPU_METHOD 0 0 -4 2300 ECU_ADDRESS 0 MATRIX_DIM 2 1 1 PHYS_UNIT "Uls" READ_WRITE SYMBOL_LINK "CombAstNFSV_Cnt_M_Str._2_.KPtr_Cnt_Str->B2_Uls_f32" 0 /end MEASUREMENT
/begin MEASUREMENT CombAstNFSV_Cnt_M_Str[2].Out_Uls_f32 "" FLOAT32_IEEE NO_COMPU_METHOD 0 0 -2312 2312 ECU_ADDRESS 0 MATRIX_DIM 2 1 1 PHYS_UNIT "Uls" READ_WRITE SYMBOL_LINK "CombAstNFSV_Cnt_M_Str._2_.Out_Uls_f32" 0 /end MEASUREMENT
/begin MEASUREMENT CombAstNFSV_Cnt_M_Str[2].SV1_Uls_f32 "" FLOAT32_IEEE NO_COMPU_METHOD 0 0 -2077 2077 ECU_ADDRESS 0 MATRIX_DIM 2 1 1 PHYS_UNIT "Uls" READ_WRITE SYMBOL_LINK "CombAstNFSV_Cnt_M_Str._2_.SV1_Uls_f32" 0 /end MEASUREMENT
/begin MEASUREMENT CombAstNFSV_Cnt_M_Str[2].SV2_Uls_f32 "" FLOAT32_IEEE NO_COMPU_METHOD 0 0 -1981 1981 ECU_ADDRESS 0 MATRIX_DIM 2 1 1 PHYS_UNIT "Uls" READ_WRITE SYMBOL_LINK "CombAstNFSV_Cnt_M_Str._2_.SV2_Uls_f32" 0 /end MEASUREMENT
/begin MEASUREMENT CombAstNFSV_Cnt_M_Str[3].KPtr_Cnt_StrA1_Uls_f32 "" FLOAT32_IEEE NO_COMPU_METHOD 0 0 -2 0 ECU_ADDRESS 0 MATRIX_DIM 3 1 1 PHYS_UNIT "Uls" READ_WRITE SYMBOL_LINK "CombAstNFSV_Cnt_M_Str._3_.KPtr_Cnt_Str->A1_Uls_f32" 0 /end MEASUREMENT
/begin MEASUREMENT CombAstNFSV_Cnt_M_Str[3].KPtr_Cnt_StrA2_Uls_f32 "" FLOAT32_IEEE NO_COMPU_METHOD 0 0 -1 1 ECU_ADDRESS 0 MATRIX_DIM 3 1 1 PHYS_UNIT "Uls" READ_WRITE SYMBOL_LINK "CombAstNFSV_Cnt_M_Str._3_.KPtr_Cnt_Str->A2_Uls_f32" 0 /end MEASUREMENT
/begin MEASUREMENT CombAstNFSV_Cnt_M_Str[3].KPtr_Cnt_StrB0_Uls_f32 "" FLOAT32_IEEE NO_COMPU_METHOD 0 0 0 2300 ECU_ADDRESS 0 MATRIX_DIM 3 1 1 PHYS_UNIT "Uls" READ_WRITE SYMBOL_LINK "CombAstNFSV_Cnt_M_Str._3_.KPtr_Cnt_Str->B0_Uls_f32" 0 /end MEASUREMENT
/begin MEASUREMENT CombAstNFSV_Cnt_M_Str[3].KPtr_Cnt_StrB1_Uls_f32 "" FLOAT32_IEEE NO_COMPU_METHOD 0 0 -4500 0 ECU_ADDRESS 0 MATRIX_DIM 3 1 1 PHYS_UNIT "Uls" READ_WRITE SYMBOL_LINK "CombAstNFSV_Cnt_M_Str._3_.KPtr_Cnt_Str->B1_Uls_f32" 0 /end MEASUREMENT
/begin MEASUREMENT CombAstNFSV_Cnt_M_Str[3].KPtr_Cnt_StrB2_Uls_f32 "" FLOAT32_IEEE NO_COMPU_METHOD 0 0 -4 2300 ECU_ADDRESS 0 MATRIX_DIM 3 1 1 PHYS_UNIT "Uls" READ_WRITE SYMBOL_LINK "CombAstNFSV_Cnt_M_Str._3_.KPtr_Cnt_Str->B2_Uls_f32" 0 /end MEASUREMENT
/begin MEASUREMENT CombAstNFSV_Cnt_M_Str[3].Out_Uls_f32 "" FLOAT32_IEEE NO_COMPU_METHOD 0 0 -2312 2312 ECU_ADDRESS 0 MATRIX_DIM 3 1 1 PHYS_UNIT "Uls" READ_WRITE SYMBOL_LINK "CombAstNFSV_Cnt_M_Str._3_.Out_Uls_f32" 0 /end MEASUREMENT
/begin MEASUREMENT CombAstNFSV_Cnt_M_Str[3].SV1_Uls_f32 "" FLOAT32_IEEE NO_COMPU_METHOD 0 0 -2077 2077 ECU_ADDRESS 0 MATRIX_DIM 3 1 1 PHYS_UNIT "Uls" READ_WRITE SYMBOL_LINK "CombAstNFSV_Cnt_M_Str._3_.SV1_Uls_f32" 0 /end MEASUREMENT
/begin MEASUREMENT CombAstNFSV_Cnt_M_Str[3].SV2_Uls_f32 "" FLOAT32_IEEE NO_COMPU_METHOD 0 0 -1981 1981 ECU_ADDRESS 0 MATRIX_DIM 3 1 1 PHYS_UNIT "Uls" READ_WRITE SYMBOL_LINK "CombAstNFSV_Cnt_M_Str._3_.SV2_Uls_f32" 0 /end MEASUREMENT
/begin MEASUREMENT CombAstNFSV2_Cnt_M_Str[0].KPtr_Cnt_StrA1_Uls_f32 "" FLOAT32_IEEE NO_COMPU_METHOD 0 0 -2 0 ECU_ADDRESS 0 PHYS_UNIT "Uls" READ_WRITE SYMBOL_LINK "CombAstNFSV2_Cnt_M_Str._0_.KPtr_Cnt_Str->A1_Uls_f32" 0 /end MEASUREMENT
/begin MEASUREMENT CombAstNFSV2_Cnt_M_Str[0].KPtr_Cnt_StrA2_Uls_f32 "" FLOAT32_IEEE NO_COMPU_METHOD 0 0 -1 1 ECU_ADDRESS 0 PHYS_UNIT "Uls" READ_WRITE SYMBOL_LINK "CombAstNFSV2_Cnt_M_Str._0_.KPtr_Cnt_Str->A2_Uls_f32" 0 /end MEASUREMENT
/begin MEASUREMENT CombAstNFSV2_Cnt_M_Str[0].KPtr_Cnt_StrB0_Uls_f32 "" FLOAT32_IEEE NO_COMPU_METHOD 0 0 0 2300 ECU_ADDRESS 0 PHYS_UNIT "Uls" READ_WRITE SYMBOL_LINK "CombAstNFSV2_Cnt_M_Str._0_.KPtr_Cnt_Str->B0_Uls_f32" 0 /end MEASUREMENT
/begin MEASUREMENT CombAstNFSV2_Cnt_M_Str[0].KPtr_Cnt_StrB1_Uls_f32 "" FLOAT32_IEEE NO_COMPU_METHOD 0 0 -4500 0 ECU_ADDRESS 0 PHYS_UNIT "Uls" READ_WRITE SYMBOL_LINK "CombAstNFSV2_Cnt_M_Str._0_.KPtr_Cnt_Str->B1_Uls_f32" 0 /end MEASUREMENT
/begin MEASUREMENT CombAstNFSV2_Cnt_M_Str[0].KPtr_Cnt_StrB2_Uls_f32 "" FLOAT32_IEEE NO_COMPU_METHOD 0 0 -4 2300 ECU_ADDRESS 0 PHYS_UNIT "Uls" READ_WRITE SYMBOL_LINK "CombAstNFSV2_Cnt_M_Str._0_.KPtr_Cnt_Str->B2_Uls_f32" 0 /end MEASUREMENT
/begin MEASUREMENT CombAstNFSV2_Cnt_M_Str[0].Out_Uls_f32 "" FLOAT32_IEEE NO_COMPU_METHOD 0 0 -2312 2312 ECU_ADDRESS 0 PHYS_UNIT "Uls" READ_WRITE SYMBOL_LINK "CombAstNFSV2_Cnt_M_Str._0_.Out_Uls_f32" 0 /end MEASUREMENT
/begin MEASUREMENT CombAstNFSV2_Cnt_M_Str[0].SV1_Uls_f32 "" FLOAT32_IEEE NO_COMPU_METHOD 0 0 -2077 2077 ECU_ADDRESS 0 PHYS_UNIT "Uls" READ_WRITE SYMBOL_LINK "CombAstNFSV2_Cnt_M_Str._0_.SV1_Uls_f32" 0 /end MEASUREMENT
/begin MEASUREMENT CombAstNFSV2_Cnt_M_Str[0].SV2_Uls_f32 "" FLOAT32_IEEE NO_COMPU_METHOD 0 0 -1981 1981 ECU_ADDRESS 0 PHYS_UNIT "Uls" READ_WRITE SYMBOL_LINK "CombAstNFSV2_Cnt_M_Str._0_.SV2_Uls_f32" 0 /end MEASUREMENT
/begin MEASUREMENT CombAstNFSV2_Cnt_M_Str[1].KPtr_Cnt_StrA1_Uls_f32 "" FLOAT32_IEEE NO_COMPU_METHOD 0 0 -2 0 ECU_ADDRESS 0 PHYS_UNIT "Uls" READ_WRITE SYMBOL_LINK "CombAstNFSV2_Cnt_M_Str._1_.KPtr_Cnt_Str->A1_Uls_f32" 0 /end MEASUREMENT
/begin MEASUREMENT CombAstNFSV2_Cnt_M_Str[1].KPtr_Cnt_StrA2_Uls_f32 "" FLOAT32_IEEE NO_COMPU_METHOD 0 0 -1 1 ECU_ADDRESS 0 PHYS_UNIT "Uls" READ_WRITE SYMBOL_LINK "CombAstNFSV2_Cnt_M_Str._1_.KPtr_Cnt_Str->A2_Uls_f32" 0 /end MEASUREMENT
/begin MEASUREMENT CombAstNFSV2_Cnt_M_Str[1].KPtr_Cnt_StrB0_Uls_f32 "" FLOAT32_IEEE NO_COMPU_METHOD 0 0 0 2300 ECU_ADDRESS 0 PHYS_UNIT "Uls" READ_WRITE SYMBOL_LINK "CombAstNFSV2_Cnt_M_Str._1_.KPtr_Cnt_Str->B0_Uls_f32" 0 /end MEASUREMENT
/begin MEASUREMENT CombAstNFSV2_Cnt_M_Str[1].KPtr_Cnt_StrB1_Uls_f32 "" FLOAT32_IEEE NO_COMPU_METHOD 0 0 -4500 0 ECU_ADDRESS 0 PHYS_UNIT "Uls" READ_WRITE SYMBOL_LINK "CombAstNFSV2_Cnt_M_Str._1_.KPtr_Cnt_Str->B1_Uls_f32" 0 /end MEASUREMENT
/begin MEASUREMENT CombAstNFSV2_Cnt_M_Str[1].KPtr_Cnt_StrB2_Uls_f32 "" FLOAT32_IEEE NO_COMPU_METHOD 0 0 -4 2300 ECU_ADDRESS 0 PHYS_UNIT "Uls" READ_WRITE SYMBOL_LINK "CombAstNFSV2_Cnt_M_Str._1_.KPtr_Cnt_Str->B2_Uls_f32" 0 /end MEASUREMENT
/begin MEASUREMENT CombAstNFSV2_Cnt_M_Str[1].Out_Uls_f32 "" FLOAT32_IEEE NO_COMPU_METHOD 0 0 -2312 2312 ECU_ADDRESS 0 PHYS_UNIT "Uls" READ_WRITE SYMBOL_LINK "CombAstNFSV2_Cnt_M_Str._1_.Out_Uls_f32" 0 /end MEASUREMENT
/begin MEASUREMENT CombAstNFSV2_Cnt_M_Str[1].SV1_Uls_f32 "" FLOAT32_IEEE NO_COMPU_METHOD 0 0 -2077 2077 ECU_ADDRESS 0 PHYS_UNIT "Uls" READ_WRITE SYMBOL_LINK "CombAstNFSV2_Cnt_M_Str._1_.SV1_Uls_f32" 0 /end MEASUREMENT
/begin MEASUREMENT CombAstNFSV2_Cnt_M_Str[1].SV2_Uls_f32 "" FLOAT32_IEEE NO_COMPU_METHOD 0 0 -1981 1981 ECU_ADDRESS 0 PHYS_UNIT "Uls" READ_WRITE SYMBOL_LINK "CombAstNFSV2_Cnt_M_Str._1_.SV2_Uls_f32" 0 /end MEASUREMENT
/begin MEASUREMENT CombAstNFSV2_Cnt_M_Str[2].KPtr_Cnt_StrA1_Uls_f32 "" FLOAT32_IEEE NO_COMPU_METHOD 0 0 -2 0 ECU_ADDRESS 0 MATRIX_DIM 2 1 1 PHYS_UNIT "Uls" READ_WRITE SYMBOL_LINK "CombAstNFSV2_Cnt_M_Str._2_.KPtr_Cnt_Str->A1_Uls_f32" 0 /end MEASUREMENT
/begin MEASUREMENT CombAstNFSV2_Cnt_M_Str[2].KPtr_Cnt_StrA2_Uls_f32 "" FLOAT32_IEEE NO_COMPU_METHOD 0 0 -1 1 ECU_ADDRESS 0 MATRIX_DIM 2 1 1 PHYS_UNIT "Uls" READ_WRITE SYMBOL_LINK "CombAstNFSV2_Cnt_M_Str._2_.KPtr_Cnt_Str->A2_Uls_f32" 0 /end MEASUREMENT
/begin MEASUREMENT CombAstNFSV2_Cnt_M_Str[2].KPtr_Cnt_StrB0_Uls_f32 "" FLOAT32_IEEE NO_COMPU_METHOD 0 0 0 2300 ECU_ADDRESS 0 MATRIX_DIM 2 1 1 PHYS_UNIT "Uls" READ_WRITE SYMBOL_LINK "CombAstNFSV2_Cnt_M_Str._2_.KPtr_Cnt_Str->B0_Uls_f32" 0 /end MEASUREMENT
/begin MEASUREMENT CombAstNFSV2_Cnt_M_Str[2].KPtr_Cnt_StrB1_Uls_f32 "" FLOAT32_IEEE NO_COMPU_METHOD 0 0 -4500 0 ECU_ADDRESS 0 MATRIX_DIM 2 1 1 PHYS_UNIT "Uls" READ_WRITE SYMBOL_LINK "CombAstNFSV2_Cnt_M_Str._2_.KPtr_Cnt_Str->B1_Uls_f32" 0 /end MEASUREMENT
/begin MEASUREMENT CombAstNFSV2_Cnt_M_Str[2].KPtr_Cnt_StrB2_Uls_f32 "" FLOAT32_IEEE NO_COMPU_METHOD 0 0 -4 2300 ECU_ADDRESS 0 MATRIX_DIM 2 1 1 PHYS_UNIT "Uls" READ_WRITE SYMBOL_LINK "CombAstNFSV2_Cnt_M_Str._2_.KPtr_Cnt_Str->B2_Uls_f32" 0 /end MEASUREMENT
/begin MEASUREMENT CombAstNFSV2_Cnt_M_Str[2].Out_Uls_f32 "" FLOAT32_IEEE NO_COMPU_METHOD 0 0 -2312 2312 ECU_ADDRESS 0 MATRIX_DIM 2 1 1 PHYS_UNIT "Uls" READ_WRITE SYMBOL_LINK "CombAstNFSV2_Cnt_M_Str._2_.Out_Uls_f32" 0 /end MEASUREMENT
/begin MEASUREMENT CombAstNFSV2_Cnt_M_Str[2].SV1_Uls_f32 "" FLOAT32_IEEE NO_COMPU_METHOD 0 0 -2077 2077 ECU_ADDRESS 0 MATRIX_DIM 2 1 1 PHYS_UNIT "Uls" READ_WRITE SYMBOL_LINK "CombAstNFSV2_Cnt_M_Str._2_.SV1_Uls_f32" 0 /end MEASUREMENT
/begin MEASUREMENT CombAstNFSV2_Cnt_M_Str[2].SV2_Uls_f32 "" FLOAT32_IEEE NO_COMPU_METHOD 0 0 -1981 1981 ECU_ADDRESS 0 MATRIX_DIM 2 1 1 PHYS_UNIT "Uls" READ_WRITE SYMBOL_LINK "CombAstNFSV2_Cnt_M_Str._2_.SV2_Uls_f32" 0 /end MEASUREMENT
/begin MEASUREMENT CombAstNFSV2_Cnt_M_Str[3].KPtr_Cnt_StrA1_Uls_f32 "" FLOAT32_IEEE NO_COMPU_METHOD 0 0 -2 0 ECU_ADDRESS 0 MATRIX_DIM 3 1 1 PHYS_UNIT "Uls" READ_WRITE SYMBOL_LINK "CombAstNFSV2_Cnt_M_Str._3_.KPtr_Cnt_Str->A1_Uls_f32" 0 /end MEASUREMENT
/begin MEASUREMENT CombAstNFSV2_Cnt_M_Str[3].KPtr_Cnt_StrA2_Uls_f32 "" FLOAT32_IEEE NO_COMPU_METHOD 0 0 -1 1 ECU_ADDRESS 0 MATRIX_DIM 3 1 1 PHYS_UNIT "Uls" READ_WRITE SYMBOL_LINK "CombAstNFSV2_Cnt_M_Str._3_.KPtr_Cnt_Str->A2_Uls_f32" 0 /end MEASUREMENT
/begin MEASUREMENT CombAstNFSV2_Cnt_M_Str[3].KPtr_Cnt_StrB0_Uls_f32 "" FLOAT32_IEEE NO_COMPU_METHOD 0 0 0 2300 ECU_ADDRESS 0 MATRIX_DIM 3 1 1 PHYS_UNIT "Uls" READ_WRITE SYMBOL_LINK "CombAstNFSV2_Cnt_M_Str._3_.KPtr_Cnt_Str->B0_Uls_f32" 0 /end MEASUREMENT
/begin MEASUREMENT CombAstNFSV2_Cnt_M_Str[3].KPtr_Cnt_StrB1_Uls_f32 "" FLOAT32_IEEE NO_COMPU_METHOD 0 0 -4500 0 ECU_ADDRESS 0 MATRIX_DIM 3 1 1 PHYS_UNIT "Uls" READ_WRITE SYMBOL_LINK "CombAstNFSV2_Cnt_M_Str._3_.KPtr_Cnt_Str->B1_Uls_f32" 0 /end MEASUREMENT
/begin MEASUREMENT CombAstNFSV2_Cnt_M_Str[3].KPtr_Cnt_StrB2_Uls_f32 "" FLOAT32_IEEE NO_COMPU_METHOD 0 0 -4 2300 ECU_ADDRESS 0 MATRIX_DIM 3 1 1 PHYS_UNIT "Uls" READ_WRITE SYMBOL_LINK "CombAstNFSV2_Cnt_M_Str._3_.KPtr_Cnt_Str->B2_Uls_f32" 0 /end MEASUREMENT
/begin MEASUREMENT CombAstNFSV2_Cnt_M_Str[3].Out_Uls_f32 "" FLOAT32_IEEE NO_COMPU_METHOD 0 0 -2312 2312 ECU_ADDRESS 0 MATRIX_DIM 3 1 1 PHYS_UNIT "Uls" READ_WRITE SYMBOL_LINK "CombAstNFSV2_Cnt_M_Str._3_.Out_Uls_f32" 0 /end MEASUREMENT
/begin MEASUREMENT CombAstNFSV2_Cnt_M_Str[3].SV1_Uls_f32 "" FLOAT32_IEEE NO_COMPU_METHOD 0 0 -2077 2077 ECU_ADDRESS 0 MATRIX_DIM 3 1 1 PHYS_UNIT "Uls" READ_WRITE SYMBOL_LINK "CombAstNFSV2_Cnt_M_Str._3_.SV1_Uls_f32" 0 /end MEASUREMENT
/begin MEASUREMENT CombAstNFSV2_Cnt_M_Str[3].SV2_Uls_f32 "" FLOAT32_IEEE NO_COMPU_METHOD 0 0 -1981 1981 ECU_ADDRESS 0 MATRIX_DIM 3 1 1 PHYS_UNIT "Uls" READ_WRITE SYMBOL_LINK "CombAstNFSV2_Cnt_M_Str._3_.SV2_Uls_f32" 0 /end MEASUREMENT
/begin MEASUREMENT HwTorqueSV_HwNm_M_f32 "Handwheel torque measured input" FLOAT32_IEEE NO_COMPU_METHOD 0 0 -10 10 ECU_ADDRESS 0 PHYS_UNIT "HwNm" READ_WRITE /end MEASUREMENT
/begin MEASUREMENT HwTrqSV_HwNm_M_Str.K_Uls_f32 "" FLOAT32_IEEE NO_COMPU_METHOD 0 0 0.000125 0.4666 ECU_ADDRESS 0 PHYS_UNIT "Uls" READ_WRITE /end MEASUREMENT
/begin MEASUREMENT HwTrqSV_HwNm_M_Str.SV_Uls_f32 "" FLOAT32_IEEE NO_COMPU_METHOD 0 0 -10 10 ECU_ADDRESS 0 PHYS_UNIT "Uls" READ_WRITE /end MEASUREMENT
/begin MEASUREMENT StabCompOverThresh_Cnt_D_lgc "" UBYTE Boolean 0 0 0 1 DISPLAY_IDENTIFIER StCmp_SysCorrOverThresh_lgc ECU_ADDRESS 0 PHYS_UNIT "lgc" READ_WRITE /end MEASUREMENT
/begin MEASUREMENT StCmp02Blend_Uls_D_f32 "" FLOAT32_IEEE NO_COMPU_METHOD 0 0 0 1 DISPLAY_IDENTIFIER StCmp_02Blend ECU_ADDRESS 0 PHYS_UNIT "Uls" READ_WRITE /end MEASUREMENT
/begin MEASUREMENT StCmp04Blend_Uls_D_f32 "" FLOAT32_IEEE NO_COMPU_METHOD 0 0 0 1 DISPLAY_IDENTIFIER StCmp_04Blend ECU_ADDRESS 0 PHYS_UNIT "Uls" READ_WRITE /end MEASUREMENT
/begin MEASUREMENT StCmp12Blend_Uls_D_f32 "" FLOAT32_IEEE NO_COMPU_METHOD 0 0 0 1 DISPLAY_IDENTIFIER StCmp_12Blend ECU_ADDRESS 0 PHYS_UNIT "Uls" READ_WRITE /end MEASUREMENT
/begin MEASUREMENT StCmp1Out_MtrNm_D_f32 "" FLOAT32_IEEE NO_COMPU_METHOD 0 0 -2312 2312 DISPLAY_IDENTIFIER StCmp_1Out ECU_ADDRESS 0 PHYS_UNIT "MtrNm" READ_WRITE /end MEASUREMENT
/begin MEASUREMENT StCmp1Out2_MtrNm_D_f32 "" FLOAT32_IEEE NO_COMPU_METHOD 0 0 -2312 2312 DISPLAY_IDENTIFIER StCmp_Sys1Out ECU_ADDRESS 0 PHYS_UNIT "MtrNm" READ_WRITE /end MEASUREMENT
/begin MEASUREMENT StCmp2Out_MtrNm_D_f32 "" FLOAT32_IEEE NO_COMPU_METHOD 0 0 -2312 2312 DISPLAY_IDENTIFIER StCmp_2Out ECU_ADDRESS 0 PHYS_UNIT "MtrNm" READ_WRITE /end MEASUREMENT
/begin MEASUREMENT StCmp2Out2_MtrNm_D_f32 "" FLOAT32_IEEE NO_COMPU_METHOD 0 0 -2312 2312 DISPLAY_IDENTIFIER StCmp_Sys2Out ECU_ADDRESS 0 PHYS_UNIT "MtrNm" READ_WRITE /end MEASUREMENT
/begin MEASUREMENT StCmp34Blend_Uls_D_f32 "" FLOAT32_IEEE NO_COMPU_METHOD 0 0 0 1 DISPLAY_IDENTIFIER StCmp_34Blend ECU_ADDRESS 0 PHYS_UNIT "Uls" READ_WRITE /end MEASUREMENT
/begin MEASUREMENT StCmp3Out_MtrNm_D_f32 "" FLOAT32_IEEE NO_COMPU_METHOD 0 0 -2312 2312 DISPLAY_IDENTIFIER StCmp_3Out ECU_ADDRESS 0 PHYS_UNIT "MtrNm" READ_WRITE /end MEASUREMENT
/begin MEASUREMENT StCmp3Out2_MtrNm_D_f32 "" FLOAT32_IEEE NO_COMPU_METHOD 0 0 -2312 2312 DISPLAY_IDENTIFIER StCmp_Sys3Out ECU_ADDRESS 0 PHYS_UNIT "MtrNm" READ_WRITE /end MEASUREMENT
/begin MEASUREMENT StCmp4Out_MtrNm_D_f32 "" FLOAT32_IEEE NO_COMPU_METHOD 0 0 -2312 2312 DISPLAY_IDENTIFIER StCmp_4Out ECU_ADDRESS 0 PHYS_UNIT "MtrNm" READ_WRITE /end MEASUREMENT
/begin MEASUREMENT StCmp4Out2_MtrNm_D_f32 "" FLOAT32_IEEE NO_COMPU_METHOD 0 0 -2312 2312 DISPLAY_IDENTIFIER StCmp_Sys4Out ECU_ADDRESS 0 PHYS_UNIT "MtrNm" READ_WRITE /end MEASUREMENT
/begin MEASUREMENT StCmpAsstFctrCmpBlnd_Uls_D_f32 "" FLOAT32_IEEE NO_COMPU_METHOD 0 0 0 1 DISPLAY_IDENTIFIER StCmp_AsstFctrCmpBlnd ECU_ADDRESS 0 PHYS_UNIT "Uls" READ_WRITE /end MEASUREMENT
/begin MEASUREMENT StCmpPNAccum_Cnt_M_u16 "" UWORD NO_COMPU_METHOD 0 0 0 5000 DISPLAY_IDENTIFIER StCmp_SysCorrPNAccum ECU_ADDRESS 0 PHYS_UNIT "Cnt" READ_WRITE /end MEASUREMENT
/begin MEASUREMENT StCmpPNStatus_Cnt_M_lgc "" UBYTE Boolean 0 0 0 1 ECU_ADDRESS 0 PHYS_UNIT "lgc" READ_WRITE /end MEASUREMENT
/begin MEASUREMENT StabilityComp_SysAssistCmd_MtrNm_f32 "Assist component of computed overall motor torque command" FLOAT32_IEEE NO_COMPU_METHOD 0 0 -8.8 8.8 DISPLAY_IDENTIFIER StbCmp_SysAssistCmd ECU_ADDRESS 0 PHYS_UNIT "MtrNm" READ_WRITE SYMBOL_LINK "Rte_StabilityComp_SysAssistCmd_MtrNm_f32" 0 /end MEASUREMENT
/begin MEASUREMENT VehicleSpeedSV_Kph_M_f32 "Vehicle speed from serial communications bus" FLOAT32_IEEE NO_COMPU_METHOD 0 0 0 511.9921875 ECU_ADDRESS 0 PHYS_UNIT "Kph" READ_WRITE /end MEASUREMENT
/begin MEASUREMENT StOpCtrl_OutputRampMult_Uls_f32 "scaling multiplier used to perform ramp down of motor torque" FLOAT32_IEEE NO_COMPU_METHOD 0 0 0 1 DISPLAY_IDENTIFIER OutputRampMult ECU_ADDRESS 0 PHYS_UNIT "Uls" READ_WRITE SYMBOL_LINK "Rte_StOpCtrl_OutputRampMult_Uls_f32" 0 /end MEASUREMENT
/begin MEASUREMENT PrevRate_XpmS_M_f32 "" FLOAT32_IEEE NO_COMPU_METHOD 0 0 0.0001 0.5 DISPLAY_IDENTIFIER Rate ECU_ADDRESS 0 PHYS_UNIT "XpmS" READ_WRITE /end MEASUREMENT
/begin MEASUREMENT PrevTargetRampMult_Uls_M_f32 "" FLOAT32_IEEE NO_COMPU_METHOD 0 0 0 1 DISPLAY_IDENTIFIER Ramp_Target ECU_ADDRESS 0 PHYS_UNIT "Uls" READ_WRITE /end MEASUREMENT
/begin MEASUREMENT StOpCtrl_RampDwnStatusComplete_Cnt_lgc "Output indicating that the ramp factor has reached zero and the output is to be completely ramped down to zero." UBYTE Boolean 0 0 0 1 DISPLAY_IDENTIFIER RampStatusComplete ECU_ADDRESS 0 PHYS_UNIT "Cnt" READ_WRITE SYMBOL_LINK "Rte_StOpCtrl_RampDwnStatusComplete_Cnt_lgc" 0 /end MEASUREMENT
/begin MEASUREMENT SVDiag_FETFaultPhase_Cnt_enum "" UBYTE NO_COMPU_METHOD 0 0 0 3 DISPLAY_IDENTIFIER FETFaultPhase_Cnt_enum ECU_ADDRESS 0 PHYS_UNIT "Counts" READ_WRITE SYMBOL_LINK "Rte_SVDiag_FETFaultPhase_Cnt_enum" 0 /end MEASUREMENT
/begin MEASUREMENT FETFaultPhase_Cnt_M_enum "" UBYTE NO_COMPU_METHOD 0 0 0 3 ECU_ADDRESS 0 PHYS_UNIT "Counts" READ_WRITE /end MEASUREMENT
/begin MEASUREMENT SVDiag_FETFaultType_Cnt_enum "" UBYTE NO_COMPU_METHOD 0 0 0 2 DISPLAY_IDENTIFIER FETFaultType_Cnt_enum ECU_ADDRESS 0 PHYS_UNIT "Counts" READ_WRITE SYMBOL_LINK "Rte_SVDiag_FETFaultType_Cnt_enum" 0 /end MEASUREMENT
/begin MEASUREMENT FETFaultType_Cnt_M_enum "" UBYTE NO_COMPU_METHOD 0 0 0 2 ECU_ADDRESS 0 PHYS_UNIT "Counts" READ_WRITE /end MEASUREMENT
/begin MEASUREMENT FilterSV_Cnt_M_s18p13 "LPF State Variable for each phase" SLONG s18p13_T 0 0 262136 0.0001221 ECU_ADDRESS 0 MATRIX_DIM 3 1 1 PHYS_UNIT "s18p13_T" READ_WRITE /end MEASUREMENT
/begin MEASUREMENT GateDriveFltAcc_Cnt_M_u16 "" UWORD NO_COMPU_METHOD 0 0 0 65535 ECU_ADDRESS 0 PHYS_UNIT "Counts" READ_WRITE /end MEASUREMENT
/begin MEASUREMENT GateDrvFltSts_Cnt_D_b16 "" UWORD NO_COMPU_METHOD 0 0 0 65535 DISPLAY_IDENTIFIER FET_DiagSts ECU_ADDRESS 0 PHYS_UNIT "Counts" READ_WRITE /end MEASUREMENT
/begin MEASUREMENT GenGateDriveFltAcc_Cnt_M_u16 "" UWORD NO_COMPU_METHOD 0 0 0 65535 ECU_ADDRESS 0 PHYS_UNIT "Counts" READ_WRITE /end MEASUREMENT
/begin MEASUREMENT HighResPhsReasDisable_M_u8 "Delay counter for HighRes Phase Reasonableness" UBYTE NO_COMPU_METHOD 0 0 0 100 DISPLAY_IDENTIFIER HighResPhsReasDisable ECU_ADDRESS 0 PHYS_UNIT "Counts" READ_WRITE /end MEASUREMENT
/begin MEASUREMENT LowResPhsReasDisable_M_u8 "Delay counter for LowRes  Phase Reasonableness" UBYTE NO_COMPU_METHOD 0 0 0 100 DISPLAY_IDENTIFIER LowResPhsReasDisable ECU_ADDRESS 0 PHYS_UNIT "Counts" READ_WRITE /end MEASUREMENT
/begin MEASUREMENT MtrDrvInitActive_Cnt_M_lgc "" UBYTE Boolean 0 0 0 1 ECU_ADDRESS 0 PHYS_UNIT "Counts" READ_WRITE /end MEASUREMENT
/begin MEASUREMENT MtrDrvInitComp_Cnt_M_lgc "" UBYTE Boolean 0 0 0 1 ECU_ADDRESS 0 PHYS_UNIT "Counts" READ_WRITE /end MEASUREMENT
/begin MEASUREMENT MtrDrvInitStartTime_mS_M_u32p0 "" ULONG NO_COMPU_METHOD 0 0 0 4294967295 ECU_ADDRESS 0 PHYS_UNIT "mS" READ_WRITE /end MEASUREMENT
/begin MEASUREMENT SVDiag_MtrDrvrInitComplete_Cnt_lgc "" UBYTE Boolean 0 0 0 1 DISPLAY_IDENTIFIER MtrDrvrInit_Complete ECU_ADDRESS 0 PHYS_UNIT "Counts" READ_WRITE SYMBOL_LINK "Rte_SVDiag_MtrDrvrInitComplete_Cnt_lgc" 0 /end MEASUREMENT
/begin MEASUREMENT OnStateFltAcc_Cnt_M_u16 "" UWORD NO_COMPU_METHOD 0 0 0 65535 ECU_ADDRESS 0 PHYS_UNIT "Counts" READ_WRITE /end MEASUREMENT
/begin MEASUREMENT ResetWaitLoop_Cnt_M_lgc "" UBYTE Boolean 0 0 0 1 ECU_ADDRESS 0 PHYS_UNIT "Counts" READ_WRITE /end MEASUREMENT
/begin MEASUREMENT CDD_DitherFlt1SV_Cnt_M_u16 "" UWORD NO_COMPU_METHOD 0 0 0 65535 ECU_ADDRESS 0 PHYS_UNIT "Cnts" READ_WRITE /end MEASUREMENT
/begin MEASUREMENT CDD_DitherFlt2SV_Cnt_M_u16 "" UWORD NO_COMPU_METHOD 0 0 0 65535 ECU_ADDRESS 0 PHYS_UNIT "Cnts" READ_WRITE /end MEASUREMENT
/begin MEASUREMENT SVDrvr_CDD_DutyCycleSmall_Cnt_G_u16 "" UWORD NO_COMPU_METHOD 0 0 0 65535 DISPLAY_IDENTIFIER CDD_DutyCycleSmall_Cnt_G_u16 ECU_ADDRESS 0 MATRIX_DIM 2 1 1 PHYS_UNIT "Cnts" READ_WRITE SYMBOL_LINK "Rte_SVDrvr_CDD_DutyCycleSmall_Cnt_G_u16" 0 /end MEASUREMENT
/begin MEASUREMENT CDD_NextDCSmall_Cnt_M_u16 "" UWORD NO_COMPU_METHOD 0 0 0 65535 ECU_ADDRESS 0 PHYS_UNIT "Cnts" READ_WRITE /end MEASUREMENT
/begin MEASUREMENT CDD_PhaseOffset_Rev_M_u0p16 "" UWORD u0p16_T 0 0 0 0.99998474 ECU_ADDRESS 0 MATRIX_DIM 4 1 1 PHYS_UNIT "Cnts" READ_WRITE /end MEASUREMENT
/begin MEASUREMENT SVDrvr_CDD_PhsReasA_Cnt_G_u16 "Deprecated from version FDD 15C 001. Applied voltage to the motor phase" UWORD NO_COMPU_METHOD 0 0 0 4095 DISPLAY_IDENTIFIER phy_PhsAV ECU_ADDRESS 0 MATRIX_DIM 2 1 1 PHYS_UNIT "Cnts" READ_WRITE SYMBOL_LINK "Rte_SVDrvr_CDD_PhsReasA_Cnt_G_u16" 0 /end MEASUREMENT
/begin MEASUREMENT SVDrvr_CDD_PhsReasB_Cnt_G_u16 "Deprecated from version FDD 15C 001. Applied voltage to the motor phase" UWORD NO_COMPU_METHOD 0 0 0 4095 DISPLAY_IDENTIFIER phy_PhsBV ECU_ADDRESS 0 MATRIX_DIM 2 1 1 PHYS_UNIT "Cnts" READ_WRITE SYMBOL_LINK "Rte_SVDrvr_CDD_PhsReasB_Cnt_G_u16" 0 /end MEASUREMENT
/begin MEASUREMENT SVDrvr_CDD_PhsReasC_Cnt_G_u16 "Deprecated from version FDD 15C 001. Applied voltage to the motor phase" UWORD NO_COMPU_METHOD 0 0 0 4095 DISPLAY_IDENTIFIER phy_PhsCV ECU_ADDRESS 0 MATRIX_DIM 2 1 1 PHYS_UNIT "Cnts" READ_WRITE SYMBOL_LINK "Rte_SVDrvr_CDD_PhsReasC_Cnt_G_u16" 0 /end MEASUREMENT
/begin MEASUREMENT SVDrvr_CDD_PWMDutyCycleASum_Cnt_G_u32 "Sum of the phase on time. Intermediate unnamed signal in the FDD." ULONG NO_COMPU_METHOD 0 0 0 4294967295 DISPLAY_IDENTIFIER CDD_PWMDutyCycleASum_Cnt_G_u32 ECU_ADDRESS 0 MATRIX_DIM 2 1 1 PHYS_UNIT "Cnts" READ_WRITE SYMBOL_LINK "Rte_SVDrvr_CDD_PWMDutyCycleASum_Cnt_G_u32" 0 /end MEASUREMENT
/begin MEASUREMENT SVDrvr_CDD_PWMDutyCycleBSum_Cnt_G_u32 "Sum of the phase on time. Intermediate unnamed signal in the FDD." ULONG NO_COMPU_METHOD 0 0 0 4294967295 DISPLAY_IDENTIFIER CDD_PWMDutyCycleBSum_Cnt_G_u32 ECU_ADDRESS 0 MATRIX_DIM 2 1 1 PHYS_UNIT "Cnts" READ_WRITE SYMBOL_LINK "Rte_SVDrvr_CDD_PWMDutyCycleBSum_Cnt_G_u32" 0 /end MEASUREMENT
/begin MEASUREMENT SVDrvr_CDD_PWMDutyCycleCSum_Cnt_G_u32 "Sum of the phase on time. Intermediate unnamed signal in the FDD." ULONG NO_COMPU_METHOD 0 0 0 4294967295 DISPLAY_IDENTIFIER CDD_PWMDutyCycleCSum_Cnt_G_u32 ECU_ADDRESS 0 MATRIX_DIM 2 1 1 PHYS_UNIT "Cnts" READ_WRITE SYMBOL_LINK "Rte_SVDrvr_CDD_PWMDutyCycleCSum_Cnt_G_u32" 0 /end MEASUREMENT
/begin MEASUREMENT SVDrvr_CDD_PWMPeriodSum_Cnt_G_u32 "Deprecated from version FDD 15C 001" ULONG NO_COMPU_METHOD 0 0 0 4294967295 DISPLAY_IDENTIFIER CDD_PWMPeriodSum_Cnt_G_u32 ECU_ADDRESS 0 MATRIX_DIM 2 1 1 PHYS_UNIT "Cnts" READ_WRITE SYMBOL_LINK "Rte_SVDrvr_CDD_PWMPeriodSum_Cnt_G_u32" 0 /end MEASUREMENT
/begin MEASUREMENT CDD_SeedPWMDither_Cnt_M_u16 "" UWORD NO_COMPU_METHOD 0 0 0 65535 ECU_ADDRESS 0 PHYS_UNIT "Cnts" READ_WRITE /end MEASUREMENT
/begin MEASUREMENT DCPhsAComp_Cnt_M_u16p0 "Number of On-Time high res NHET Counts for  phase" UWORD NO_COMPU_METHOD 0 0 0 7150 DISPLAY_IDENTIFIER PWM_Duty_Cycle_A ECU_ADDRESS 0 PHYS_UNIT "Cnts" READ_WRITE /end MEASUREMENT
/begin MEASUREMENT DCPhsBComp_Cnt_M_u16p0 "Number of On-Time high res NHET Counts for  phase" UWORD NO_COMPU_METHOD 0 0 0 7150 DISPLAY_IDENTIFIER PWM_Duty_Cycle_B ECU_ADDRESS 0 PHYS_UNIT "Cnts" READ_WRITE /end MEASUREMENT
/begin MEASUREMENT DCPhsCComp_Cnt_M_u16p0 "Number of On-Time high res NHET Counts for  phase" UWORD NO_COMPU_METHOD 0 0 0 7150 DISPLAY_IDENTIFIER PWM_Duty_Cycle_C ECU_ADDRESS 0 PHYS_UNIT "Cnts" READ_WRITE /end MEASUREMENT
/begin MEASUREMENT PrevDCPhsAComp_Cnt_M_u16p0 "z-1 Number of On-Time high res NHET Counts for  phase" UWORD NO_COMPU_METHOD 0 0 0 7150 ECU_ADDRESS 0 PHYS_UNIT "Cnts" READ_WRITE /end MEASUREMENT
/begin MEASUREMENT PrevDCPhsBComp_Cnt_M_u16p0 "z-1 Number of On-Time high res NHET Counts for  phase" UWORD NO_COMPU_METHOD 0 0 0 7150 ECU_ADDRESS 0 PHYS_UNIT "Cnts" READ_WRITE /end MEASUREMENT
/begin MEASUREMENT PrevDCPhsCComp_Cnt_M_u16p0 "z-1 Number of On-Time high res NHET Counts for  phase" UWORD NO_COMPU_METHOD 0 0 0 7150 ECU_ADDRESS 0 PHYS_UNIT "Cnts" READ_WRITE /end MEASUREMENT
/begin MEASUREMENT PrevLowerEnd_Cnt_M_u16 "" UWORD NO_COMPU_METHOD 0 0 0 65535 ECU_ADDRESS 0 MATRIX_DIM 4 1 1 PHYS_UNIT "Cnts" READ_WRITE /end MEASUREMENT
/begin MEASUREMENT PrevPWMPeriod_Cnt_M_u16 "z-1 Number of high res NHET Counts for the current period" UWORD NO_COMPU_METHOD 0 0 2950 7150 ECU_ADDRESS 0 PHYS_UNIT "Cnts" READ_WRITE /end MEASUREMENT
/begin MEASUREMENT PWMPeriod_Cnt_M_u16 "Number of high res NHET Counts for the current period" UWORD NO_COMPU_METHOD 0 0 2950 7150 DISPLAY_IDENTIFIER PWM_Period ECU_ADDRESS 0 PHYS_UNIT "Cnts" READ_WRITE /end MEASUREMENT
/begin MEASUREMENT AbsTempFltAcc_Cnt_M_u16 "" UWORD NO_COMPU_METHOD 0 0 0 65535 DISPLAY_IDENTIFIER Duty_AbsTempFaultCnt ECU_ADDRESS 0 PHYS_UNIT "Counts" READ_WRITE /end MEASUREMENT
/begin MEASUREMENT AbsTempLimit_MtrNm_D_f32 "" FLOAT32_IEEE NO_COMPU_METHOD 0 0 0 8.8 DISPLAY_IDENTIFIER Duty_AbsTemp_Limit ECU_ADDRESS 0 PHYS_UNIT "MtrNm" READ_WRITE /end MEASUREMENT
/begin MEASUREMENT AbsTempLimit_MtrNm_M_f32 "" FLOAT32_IEEE NO_COMPU_METHOD 0 0 0 8.8 DISPLAY_IDENTIFIER Duty_AbsTempLim ECU_ADDRESS 0 PHYS_UNIT "MtrNm" READ_WRITE /end MEASUREMENT
/begin MEASUREMENT ThrmDutyCycle_AssistThermScalar_Uls_f32 "Additional feature which provides a torque command scale factor to reduce the assist gain once the duty cycle usage system level performance specification has been exceeded" FLOAT32_IEEE NO_COMPU_METHOD 0 0 0 1 DISPLAY_IDENTIFIER AssistThermScalar ECU_ADDRESS 0 PHYS_UNIT "Unitless" READ_WRITE SYMBOL_LINK "Rte_ThrmDutyCycle_AssistThermScalar_Uls_f32" 0 /end MEASUREMENT
/begin MEASUREMENT eFilter3ValueTyH_Cnt_M_u8 "" UBYTE NO_COMPU_METHOD 0 0 0 200 DISPLAY_IDENTIFIER Duty_e_Filt3Val_cnt ECU_ADDRESS 0 PHYS_UNIT "Counts" READ_WRITE /end MEASUREMENT
/begin MEASUREMENT eFilter4ValueTyH_Cnt_M_u8 "" UBYTE NO_COMPU_METHOD 0 0 0 200 DISPLAY_IDENTIFIER Duty_e_Filt4Val_cnt ECU_ADDRESS 0 PHYS_UNIT "Counts" READ_WRITE /end MEASUREMENT
/begin MEASUREMENT eFilter5ValueTyH_Cnt_M_u8 "" UBYTE NO_COMPU_METHOD 0 0 0 200 DISPLAY_IDENTIFIER Duty_e_Filt5Val_cnt ECU_ADDRESS 0 PHYS_UNIT "Counts" READ_WRITE /end MEASUREMENT
/begin MEASUREMENT eFilter6ValueTyH_Cnt_M_u8 "" UBYTE NO_COMPU_METHOD 0 0 0 200 DISPLAY_IDENTIFIER Duty_e_Filt6Val_cnt ECU_ADDRESS 0 PHYS_UNIT "Counts" READ_WRITE /end MEASUREMENT
/begin MEASUREMENT Filter1KSV_M_str.K_Uls_f32 "" FLOAT32_IEEE NO_COMPU_METHOD 0 0 0.326433727109184 0.326433727109184 ECU_ADDRESS 0 PHYS_UNIT "Unitless" READ_WRITE /end MEASUREMENT
/begin MEASUREMENT Filter1KSV_M_str.SV_Uls_f32 "" FLOAT32_IEEE NO_COMPU_METHOD 0 0 0 31250 DISPLAY_IDENTIFIER Duty_Filt1Out ECU_ADDRESS 0 PHYS_UNIT "Unitless" READ_WRITE /end MEASUREMENT
/begin MEASUREMENT Filter2KSV_M_str.K_Uls_f32 "" FLOAT32_IEEE NO_COMPU_METHOD 0 0 3.87462804956383E-02 3.87462804956383E-02 ECU_ADDRESS 0 PHYS_UNIT "Unitless" READ_WRITE /end MEASUREMENT
/begin MEASUREMENT Filter2KSV_M_str.SV_Uls_f32 "" FLOAT32_IEEE NO_COMPU_METHOD 0 0 0 31250 DISPLAY_IDENTIFIER Duty_Filt2Out ECU_ADDRESS 0 PHYS_UNIT "Unitless" READ_WRITE /end MEASUREMENT
/begin MEASUREMENT Filter3KSV_M_str.K_Uls_f32 "" FLOAT32_IEEE NO_COMPU_METHOD 0 0 3.9438912246419E-03 3.9438912246419E-03 ECU_ADDRESS 0 PHYS_UNIT "Unitless" READ_WRITE /end MEASUREMENT
/begin MEASUREMENT Filter3KSV_M_str.SV_Uls_f32 "" FLOAT32_IEEE NO_COMPU_METHOD 0 0 0 31250 DISPLAY_IDENTIFIER Duty_Filt3Out ECU_ADDRESS 0 PHYS_UNIT "Unitless" READ_WRITE /end MEASUREMENT
/begin MEASUREMENT Filter4KSV_M_str.K_Uls_f32 "" FLOAT32_IEEE NO_COMPU_METHOD 0 0 2.0922033873435E-03 2.0922033873435E-03 ECU_ADDRESS 0 PHYS_UNIT "Unitless" READ_WRITE /end MEASUREMENT
/begin MEASUREMENT Filter4KSV_M_str.SV_Uls_f32 "" FLOAT32_IEEE NO_COMPU_METHOD 0 0 0 31250 DISPLAY_IDENTIFIER Duty_Filt4Out ECU_ADDRESS 0 PHYS_UNIT "Unitless" READ_WRITE /end MEASUREMENT
/begin MEASUREMENT Filter5KSV_M_str.K_Uls_f32 "" FLOAT32_IEEE NO_COMPU_METHOD 0 0 3.95090818303087E-04 3.95090818303087E-04 ECU_ADDRESS 0 PHYS_UNIT "Unitless" READ_WRITE /end MEASUREMENT
/begin MEASUREMENT Filter5KSV_M_str.SV_Uls_f32 "" FLOAT32_IEEE NO_COMPU_METHOD 0 0 0 125000 DISPLAY_IDENTIFIER Duty_Filt5Out ECU_ADDRESS 0 PHYS_UNIT "Unitless" READ_WRITE /end MEASUREMENT
/begin MEASUREMENT Filter6KSV_M_str.K_Uls_f32 "" FLOAT32_IEEE NO_COMPU_METHOD 0 0 1.57067296319927E-04 1.57067296319927E-04 ECU_ADDRESS 0 PHYS_UNIT "Unitless" READ_WRITE /end MEASUREMENT
/begin MEASUREMENT Filter6KSV_M_str.SV_Uls_f32 "" FLOAT32_IEEE NO_COMPU_METHOD 0 0 0 125000 DISPLAY_IDENTIFIER Duty_Filt6Out ECU_ADDRESS 0 PHYS_UNIT "Unitless" READ_WRITE /end MEASUREMENT
/begin MEASUREMENT LastTblVal_MtrNm_D_u9p7 "" UWORD u9p7_T 0 0 0 8.8 DISPLAY_IDENTIFIER Duty_LastTblVal ECU_ADDRESS 0 PHYS_UNIT "MtrNm" READ_WRITE /end MEASUREMENT
/begin MEASUREMENT LastTblValSlew_MtrNm_D_u9p7 "" UWORD u9p7_T 0 0 0 8.8 DISPLAY_IDENTIFIER Duty_LastTblValSlew ECU_ADDRESS 0 PHYS_UNIT "MtrNm" READ_WRITE /end MEASUREMENT
/begin MEASUREMENT MaxOut_Uls_D_u16p0 "" UWORD NO_COMPU_METHOD 0 0 0 200 DISPLAY_IDENTIFIER Duty_MaxOut ECU_ADDRESS 0 PHYS_UNIT "Unitless" READ_WRITE /end MEASUREMENT
/begin MEASUREMENT Mult1_Uls_D_u3p13 "" UWORD u3p13_T 0 0 0 0.5 DISPLAY_IDENTIFIER Duty_Mult1 ECU_ADDRESS 0 PHYS_UNIT "Unitless" READ_WRITE /end MEASUREMENT
/begin MEASUREMENT Mult12Temp_DegC_D_f32 "" FLOAT32_IEEE NO_COMPU_METHOD 0 0 -50 150 DISPLAY_IDENTIFIER Duty_Mult12Temp ECU_ADDRESS 0 PHYS_UNIT "DegC" READ_WRITE /end MEASUREMENT
/begin MEASUREMENT Mult2_Uls_D_u3p13 "" UWORD u3p13_T 0 0 0 0.5 DISPLAY_IDENTIFIER Duty_Mult2 ECU_ADDRESS 0 PHYS_UNIT "Unitless" READ_WRITE /end MEASUREMENT
/begin MEASUREMENT Mult3_Uls_D_u3p13 "" UWORD u3p13_T 0 0 0 0.5 DISPLAY_IDENTIFIER Duty_Mult3 ECU_ADDRESS 0 PHYS_UNIT "Unitless" READ_WRITE /end MEASUREMENT
/begin MEASUREMENT Mult36Temp_DegC_D_f32 "" FLOAT32_IEEE NO_COMPU_METHOD 0 0 -50 150 DISPLAY_IDENTIFIER Duty_Mult36Temp ECU_ADDRESS 0 PHYS_UNIT "DegC" READ_WRITE /end MEASUREMENT
/begin MEASUREMENT Mult4_Uls_D_u3p13 "" UWORD u3p13_T 0 0 0 0.5 DISPLAY_IDENTIFIER Duty_Mult4 ECU_ADDRESS 0 PHYS_UNIT "Unitless" READ_WRITE /end MEASUREMENT
/begin MEASUREMENT Mult5_Uls_D_u3p13 "" UWORD u3p13_T 0 0 0 2 DISPLAY_IDENTIFIER Duty_Mult5 ECU_ADDRESS 0 PHYS_UNIT "Unitless" READ_WRITE /end MEASUREMENT
/begin MEASUREMENT Mult6_Uls_D_u3p13 "" UWORD u3p13_T 0 0 0 2 DISPLAY_IDENTIFIER Duty_Mult6 ECU_ADDRESS 0 PHYS_UNIT "Unitless" READ_WRITE /end MEASUREMENT
/begin MEASUREMENT ThrmDutyCycle_ThermalLimit_MtrNm_f32 "Unsigned torque limit value in units of Motor Nm based on usage and temperature" FLOAT32_IEEE NO_COMPU_METHOD 0 0 0 8.8 DISPLAY_IDENTIFIER Thermal_Limit ECU_ADDRESS 0 PHYS_UNIT "MtrNm" READ_WRITE SYMBOL_LINK "Rte_ThrmDutyCycle_ThermalLimit_MtrNm_f32" 0 /end MEASUREMENT
/begin MEASUREMENT ThermLim_MtrNm_D_f32 "" FLOAT32_IEEE NO_COMPU_METHOD 0 0 0 8.8 DISPLAY_IDENTIFIER Duty_ThermLimNm ECU_ADDRESS 0 PHYS_UNIT "MtrNm" READ_WRITE /end MEASUREMENT
/begin MEASUREMENT ThrmDutyCycle_ThermLimitPerc_Uls_f32 "Value representing the percent reduction in assist being produced by the Thermal_Limit value" FLOAT32_IEEE NO_COMPU_METHOD 0 0 0 1 DISPLAY_IDENTIFIER ThermLimitPerc ECU_ADDRESS 0 PHYS_UNIT "Unitless" READ_WRITE SYMBOL_LINK "Rte_ThrmDutyCycle_ThermLimitPerc_Uls_f32" 0 /end MEASUREMENT
/begin MEASUREMENT ThrmLoadLmtTblYVal_MtrNm_D_f32 "" FLOAT32_IEEE NO_COMPU_METHOD 0 0 0.01 8.8 DISPLAY_IDENTIFIER Duty_ThrmLoadLmtTblYVal ECU_ADDRESS 0 PHYS_UNIT "MtrNm" READ_WRITE /end MEASUREMENT
/begin MEASUREMENT TrqCmdTblYRam_MtrNm_M_u9p7 "" UWORD u9p7_T 0 0 0 8.8 DISPLAY_IDENTIFIER Duty_LastTblValRAM ECU_ADDRESS 0 MATRIX_DIM 8 1 1 PHYS_UNIT "MtrNm" READ_WRITE /end MEASUREMENT
/begin MEASUREMENT InitTestStatus_Cnt_M_enum "Initialization Test Status" UBYTE NO_COMPU_METHOD 0 0 0 3 DISPLAY_IDENTIFIER DTC_TMF_Circuitry_Init ECU_ADDRESS 0 PHYS_UNIT "Counts" READ_WRITE /end MEASUREMENT
/begin MEASUREMENT NTCStatusByte_Cnt_M_u08 "Error status byte" UBYTE NO_COMPU_METHOD 0 0 0 13 ECU_ADDRESS 0 PHYS_UNIT "Counts" READ_WRITE /end MEASUREMENT
/begin MEASUREMENT TmprlMon_TMFTestComplete_Cnt_lgc "Signal to Hardware Power Up  to signal init sequence complete" UBYTE Boolean 0 0 0 1 DISPLAY_IDENTIFIER TMFTestComplete_Cnt_lgc ECU_ADDRESS 0 PHYS_UNIT "Counts" READ_WRITE SYMBOL_LINK "Rte_TmprlMon_TMFTestComplete_Cnt_lgc" 0 /end MEASUREMENT
/begin MEASUREMENT TmprlMonSt_Cnt_M_enum "State of Temporal Monitor Initialization" UBYTE NO_COMPU_METHOD 0 0 0 13 DISPLAY_IDENTIFIER Step ECU_ADDRESS 0 PHYS_UNIT "Counts" READ_WRITE /end MEASUREMENT
/begin MEASUREMENT FinalGain_Uls_D_f32 "" FLOAT32_IEEE NO_COMPU_METHOD 0 0 0 118.3152 DISPLAY_IDENTIFIER TBIC_FinalGain ECU_ADDRESS 0 PHYS_UNIT "Uls" READ_WRITE /end MEASUREMENT
/begin MEASUREMENT TrqBasedInrtCmp_HighFreqAssist_MtrNm_f32 "" FLOAT32_IEEE NO_COMPU_METHOD 0 0 -8.8 8.8 DISPLAY_IDENTIFIER HighFreqAssist ECU_ADDRESS 0 PHYS_UNIT "MtrNm" READ_WRITE SYMBOL_LINK "Rte_TrqBasedInrtCmp_HighFreqAssist_MtrNm_f32" 0 /end MEASUREMENT
/begin MEASUREMENT HP1FiltHwTrq_HwNm_D_f32 "" FLOAT32_IEEE NO_COMPU_METHOD 0 0 -10 10 DISPLAY_IDENTIFIER TBIC_HPFTrq1 ECU_ADDRESS 0 PHYS_UNIT "HwNm" READ_WRITE /end MEASUREMENT
/begin MEASUREMENT HP2FiltHwTrq_HwNm_D_f32 "" FLOAT32_IEEE NO_COMPU_METHOD 0 0 -10 10 DISPLAY_IDENTIFIER TBIC_HPFTrq2 ECU_ADDRESS 0 PHYS_UNIT "HwNm" READ_WRITE /end MEASUREMENT
/begin MEASUREMENT HwTrqFilt1SV_HwNm_M_str.K_Uls_f32 "" FLOAT32_IEEE NO_COMPU_METHOD 0 0 0.0124877435 0.466511909 DISPLAY_IDENTIFIER _1LP1B_Filter1_SV ECU_ADDRESS 0 PHYS_UNIT "Uls" READ_WRITE /end MEASUREMENT
/begin MEASUREMENT HwTrqFilt1SV_HwNm_M_str.SV_Uls_f32 "" FLOAT32_IEEE NO_COMPU_METHOD 0 0 -10 10 DISPLAY_IDENTIFIER _1LP1B_Filter1_SV ECU_ADDRESS 0 PHYS_UNIT "HwNm" READ_WRITE /end MEASUREMENT
/begin MEASUREMENT HwTrqFilt2SV_HwNm_M_str.K_Uls_f32 "" FLOAT32_IEEE NO_COMPU_METHOD 0 0 0.0124877435 0.466511909 DISPLAY_IDENTIFIER _1LP1B_Filter2_SV ECU_ADDRESS 0 PHYS_UNIT "Uls" READ_WRITE /end MEASUREMENT
/begin MEASUREMENT HwTrqFilt2SV_HwNm_M_str.SV_Uls_f32 "" FLOAT32_IEEE NO_COMPU_METHOD 0 0 -10 10 DISPLAY_IDENTIFIER _1LP1B_Filter2_SV ECU_ADDRESS 0 PHYS_UNIT "HwNm" READ_WRITE /end MEASUREMENT
/begin MEASUREMENT TuningSelAuth_ActiveTunPers_Cnt_u16 "" UWORD NO_COMPU_METHOD 0 0 0 100 DISPLAY_IDENTIFIER ActiveTunPers ECU_ADDRESS 0 PHYS_UNIT "Cnt" READ_WRITE SYMBOL_LINK "Rte_TuningSelAuth_ActiveTunPers_Cnt_u16" 0 /end MEASUREMENT
/begin MEASUREMENT TuningSelAuth_ActiveTunSet_Cnt_u16 "" UWORD NO_COMPU_METHOD 0 0 0 100 DISPLAY_IDENTIFIER ActiveTunSet ECU_ADDRESS 0 PHYS_UNIT "Cnt" READ_WRITE SYMBOL_LINK "Rte_TuningSelAuth_ActiveTunSet_Cnt_u16" 0 /end MEASUREMENT
/begin MEASUREMENT PrevTunPers_Cnt_M_u16 "" UWORD NO_COMPU_METHOD 0 0 0 100 ECU_ADDRESS 0 PHYS_UNIT "Cnt" READ_WRITE /end MEASUREMENT
/begin MEASUREMENT PrevTunSet_Cnt_M_u16 "" UWORD NO_COMPU_METHOD 0 0 0 100 ECU_ADDRESS 0 PHYS_UNIT "Cnt" READ_WRITE /end MEASUREMENT
/begin MEASUREMENT AcmpToTcOffsetInit_Cnt_M_lgc "" UBYTE Boolean 0 0 0 1 DISPLAY_IDENTIFIER ACMPtoTCoffsetInitalized ECU_ADDRESS 0 PHYS_UNIT "Cnt" READ_WRITE /end MEASUREMENT
/begin MEASUREMENT AllowProcessTCErrs_Cnt_M_lgc "" UBYTE Boolean 0 0 0 1 DISPLAY_IDENTIFIER AllowProcessTcErrs ECU_ADDRESS 0 PHYS_UNIT "Cnt" READ_WRITE /end MEASUREMENT
/begin MEASUREMENT MRFTcMtrPosOffs_Deg_M_f32 "" FLOAT32_IEEE NO_COMPU_METHOD 0 0 -3712500 3712500 ECU_ADDRESS 0 PHYS_UNIT "Deg" READ_WRITE /end MEASUREMENT
/begin MEASUREMENT MtrPos_Deg_M_f32 "" FLOAT32_IEEE NO_COMPU_METHOD 0 0 -3712500 3712500 DISPLAY_IDENTIFIER TcRevAdjMtrPos ECU_ADDRESS 0 PHYS_UNIT "Deg" READ_WRITE /end MEASUREMENT
/begin MEASUREMENT NTCPrMainResets_Cnt_M_u08 "" UBYTE NO_COMPU_METHOD 0 0 0 7 ECU_ADDRESS 0 PHYS_UNIT "Cnt" READ_WRITE /end MEASUREMENT
/begin MEASUREMENT RackCenterComplete_Cnt_M_lgc "" UBYTE Boolean 0 0 0 1 DISPLAY_IDENTIFIER RackCenter_Complete ECU_ADDRESS 0 PHYS_UNIT "Cnt" READ_WRITE /end MEASUREMENT
/begin MEASUREMENT RTBemfErrCnt_Cnt_M_u16 "" UWORD NO_COMPU_METHOD 0 0 0 65535 DISPLAY_IDENTIFIER RTBemfErrCnt ECU_ADDRESS 0 PHYS_UNIT "Cnt" READ_WRITE /end MEASUREMENT
/begin MEASUREMENT t_TcActivePN_Cnt_M_u8 "" UBYTE NO_COMPU_METHOD 0 0 0 255 DISPLAY_IDENTIFIER TcActivePN_u8 ECU_ADDRESS 0 MATRIX_DIM 4 1 1 PHYS_UNIT "Cnt" READ_WRITE /end MEASUREMENT
/begin MEASUREMENT t_TcActivePNvldCnt_Cnt_M_u8 "" UBYTE NO_COMPU_METHOD 0 0 0 255 DISPLAY_IDENTIFIER TcActivePNvldCnt ECU_ADDRESS 0 MATRIX_DIM 4 1 1 PHYS_UNIT "Cnt" READ_WRITE /end MEASUREMENT
/begin MEASUREMENT t_TcImagePN_Cnt_M_u8 "" UBYTE NO_COMPU_METHOD 0 0 0 255 DISPLAY_IDENTIFIER TcImagePN_u8 ECU_ADDRESS 0 MATRIX_DIM 4 1 1 PHYS_UNIT "Cnt" READ_WRITE /end MEASUREMENT
/begin MEASUREMENT TcAllowSCMnMxErrs_Cnt_M_lgc "" UBYTE Boolean 0 0 0 1 DISPLAY_IDENTIFIER AllowSinCosMinMaxErrs ECU_ADDRESS 0 PHYS_UNIT "Cnt" READ_WRITE /end MEASUREMENT
/begin MEASUREMENT TcClrInfoBitsField_Cnt_M_b08 "" UBYTE NO_COMPU_METHOD 0 0 0 255 DISPLAY_IDENTIFIER ClrInfoBits ECU_ADDRESS 0 PHYS_UNIT "Cnt" READ_WRITE /end MEASUREMENT
/begin MEASUREMENT TcFlashStatus_Cnt_M_u08 "" UBYTE NO_COMPU_METHOD 0 0 0 255 DISPLAY_IDENTIFIER TC_FlashStatus ECU_ADDRESS 0 PHYS_UNIT "Cnt" READ_WRITE /end MEASUREMENT
/begin MEASUREMENT TcFlashVerify_Cnt_M_lgc "" UBYTE Boolean 0 0 0 1 ECU_ADDRESS 0 PHYS_UNIT "Cnt" READ_WRITE /end MEASUREMENT
/begin MEASUREMENT TcInitComplete_Cnt_M_lgc "" UBYTE Boolean 0 0 0 1 DISPLAY_IDENTIFIER TcInitComplete ECU_ADDRESS 0 PHYS_UNIT "Cnt" READ_WRITE /end MEASUREMENT
/begin MEASUREMENT TcInitMtrOctField_Cnt_M_b08 "" UBYTE NO_COMPU_METHOD 0 0 0 255 DISPLAY_IDENTIFIER ICMtoTC_MtrOcts_T_s16 ECU_ADDRESS 0 PHYS_UNIT "Cnt" READ_WRITE /end MEASUREMENT
/begin MEASUREMENT TcInitMtrRevField_Cnt_M_b08 "" UBYTE NO_COMPU_METHOD 0 0 0 255 DISPLAY_IDENTIFIER initMtrRev ECU_ADDRESS 0 PHYS_UNIT "Cnt" READ_WRITE /end MEASUREMENT
/begin MEASUREMENT TcMOSIErrCnt_Cnt_M_u16 "" UWORD NO_COMPU_METHOD 0 0 0 65535 DISPLAY_IDENTIFIER TcMOSIErrCnt ECU_ADDRESS 0 PHYS_UNIT "Cnt" READ_WRITE /end MEASUREMENT
/begin MEASUREMENT TurnsCounter_TCMtrPosOffsMRF_Deg_f32 "Motor position offset, in motor reference frame, used to re-align the aligned cumulative motor position with the absolute motor position set at factory/service initialization." FLOAT32_IEEE NO_COMPU_METHOD 0 0 -3712500 3712500 DISPLAY_IDENTIFIER TC_MtrPosOffs_MRF ECU_ADDRESS 0 PHYS_UNIT "Deg" READ_WRITE SYMBOL_LINK "Rte_TurnsCounter_TCMtrPosOffsMRF_Deg_f32" 0 /end MEASUREMENT
/begin MEASUREMENT TCprocessing_Cnt_D_lgc "" UBYTE Boolean 0 0 0 1 DISPLAY_IDENTIFIER TCprocessing ECU_ADDRESS 0 PHYS_UNIT "Cnt" READ_WRITE /end MEASUREMENT
/begin MEASUREMENT TCprocessing_Cnt_M_lgc "" UBYTE Boolean 0 0 0 1 ECU_ADDRESS 0 PHYS_UNIT "Cnt" READ_WRITE /end MEASUREMENT
/begin MEASUREMENT TcReflashActive_Cnt_M_lgc "" UBYTE Boolean 0 0 0 1 ECU_ADDRESS 0 PHYS_UNIT "Cnt" READ_WRITE /end MEASUREMENT
/begin MEASUREMENT TcResetDelayStart_uS_M_u32 "" ULONG NO_COMPU_METHOD 0 0 0 4294967295 ECU_ADDRESS 0 PHYS_UNIT "uS" READ_WRITE /end MEASUREMENT
/begin MEASUREMENT TcSCMnMxErrCnt_Cnt_M_u16 "" UWORD NO_COMPU_METHOD 0 0 0 65535 DISPLAY_IDENTIFIER TcSinCosMinMaxErrCnt ECU_ADDRESS 0 PHYS_UNIT "Cnt" READ_WRITE /end MEASUREMENT
/begin MEASUREMENT TcSpiBuffer_Cnt_M_str "" SWORD NO_COMPU_METHOD 0 0 -32768 32767 ECU_ADDRESS 0 PHYS_UNIT "Cnt" READ_WRITE /end MEASUREMENT
/begin MEASUREMENT TcSpiComFltAcc_Cnt_M_u16 "" UWORD NO_COMPU_METHOD 0 0 0 65535 DISPLAY_IDENTIFIER NoComCnt ECU_ADDRESS 0 PHYS_UNIT "Cnt" READ_WRITE /end MEASUREMENT
/begin MEASUREMENT TcSpiDataFltAcc_Cnt_M_u16 "" UWORD NO_COMPU_METHOD 0 0 0 65535 DISPLAY_IDENTIFIER RxDataErrCnt ECU_ADDRESS 0 PHYS_UNIT "Cnt" READ_WRITE /end MEASUREMENT
/begin MEASUREMENT TcSpiDataValid_Cnt_M_lgc "" UBYTE Boolean 0 0 0 1 DISPLAY_IDENTIFIER ProcessRxData ECU_ADDRESS 0 PHYS_UNIT "Cnt" READ_WRITE /end MEASUREMENT
/begin MEASUREMENT TcSpiResetReq_Cnt_M_lgc "" UBYTE Boolean 0 0 0 1 DISPLAY_IDENTIFIER ResetTC ECU_ADDRESS 0 PHYS_UNIT "Cnt" READ_WRITE /end MEASUREMENT
/begin MEASUREMENT TcSpiTxMode_Cnt_M_enum "" SWORD NO_COMPU_METHOD 0 0 0 3 DISPLAY_IDENTIFIER SPI_TxMode ECU_ADDRESS 0 PHYS_UNIT "Cnt" READ_WRITE /end MEASUREMENT
/begin MEASUREMENT TcSpiTxRC_Cnt_M_u08 "" UBYTE NO_COMPU_METHOD 0 0 0 255 DISPLAY_IDENTIFIER SPI_TxRC ECU_ADDRESS 0 PHYS_UNIT "Cnt" READ_WRITE /end MEASUREMENT
/begin MEASUREMENT TCvsMtrPosErrCnt_Cnt_M_u16 "" UWORD NO_COMPU_METHOD 0 0 0 65535 ECU_ADDRESS 0 PHYS_UNIT "Cnt" READ_WRITE /end MEASUREMENT
/begin MEASUREMENT VehPwrMd_ATermActive_Cnt_lgc "" UBYTE Boolean 0 0 0 1 DISPLAY_IDENTIFIER Customer_Term_A ECU_ADDRESS 0 PHYS_UNIT "Cnt" READ_WRITE SYMBOL_LINK "Rte_VehPwrMd_ATermActive_Cnt_lgc" 0 /end MEASUREMENT
/begin MEASUREMENT VehPwrMd_CTermActive_Cnt_lgc "" UBYTE Boolean 0 0 0 1 DISPLAY_IDENTIFIER Customer_Term_C ECU_ADDRESS 0 PHYS_UNIT "Cnt" READ_WRITE SYMBOL_LINK "Rte_VehPwrMd_CTermActive_Cnt_lgc" 0 /end MEASUREMENT
/begin MEASUREMENT VehPwrMd_MSACommand_Cnt_enum "" UBYTE NO_COMPU_METHOD 0 0 0 3 DISPLAY_IDENTIFIER MSACommand_Cnt_enum ECU_ADDRESS 0 PHYS_UNIT "Cnt" READ_WRITE SYMBOL_LINK "Rte_VehPwrMd_MSACommand_Cnt_enum" 0 /end MEASUREMENT
/begin MEASUREMENT VehPwrMd_OperRampRate_XpmS_f32 "" FLOAT32_IEEE NO_COMPU_METHOD 0 0 0.0001 0.005 DISPLAY_IDENTIFIER OperationalRampRate ECU_ADDRESS 0 PHYS_UNIT "XpmS" READ_WRITE SYMBOL_LINK "Rte_VehPwrMd_OperRampRate_XpmS_f32" 0 /end MEASUREMENT
/begin MEASUREMENT VehPwrMd_OperRampValue_Uls_f32 "" FLOAT32_IEEE NO_COMPU_METHOD 0 0 0 1 DISPLAY_IDENTIFIER OperationalRampValue ECU_ADDRESS 0 PHYS_UNIT "Uls" READ_WRITE SYMBOL_LINK "Rte_VehPwrMd_OperRampValue_Uls_f32" 0 /end MEASUREMENT
/begin MEASUREMENT VehSpdLmt_AstVehSpdLimit_MtrNm_f32 "" FLOAT32_IEEE NO_COMPU_METHOD 0 0 0 8.8 DISPLAY_IDENTIFIER Assist_VehSpdLimit ECU_ADDRESS 0 PHYS_UNIT "MtrNm" READ_WRITE SYMBOL_LINK "Rte_VehSpdLmt_AstVehSpdLimit_MtrNm_f32" 0 /end MEASUREMENT
/begin MEASUREMENT BkPtOne_HwDeg_D_u12p4 "" UWORD u12p4_T 0 0 0 900 DISPLAY_IDENTIFIER VSpdLim_BkPtOne ECU_ADDRESS 0 PHYS_UNIT "HwDeg" READ_WRITE /end MEASUREMENT
/begin MEASUREMENT BkPtTwo_HwDeg_D_u12p4 "" UWORD u12p4_T 0 0 0 900 DISPLAY_IDENTIFIER VSpdLim_BkPtTwo ECU_ADDRESS 0 PHYS_UNIT "HwDeg" READ_WRITE /end MEASUREMENT
/begin MEASUREMENT LimitTerm_MtrNm_D_u5p11 "" UWORD u5p11_T 0 0 0 8.8 DISPLAY_IDENTIFIER VSpdLim_YPtTwo ECU_ADDRESS 0 PHYS_UNIT "MtrNm" READ_WRITE /end MEASUREMENT
/begin MEASUREMENT ZeroVehSpd_MtrNm_D_u5p11 "" UWORD u5p11_T 0 0 0 8.8 DISPLAY_IDENTIFIER VSpdLim_YPtOne ECU_ADDRESS 0 PHYS_UNIT "MtrNm" READ_WRITE /end MEASUREMENT
/begin GROUP SF99.Internals ""
 /begin REF_MEASUREMENT DaxCurrFiltSV_Amp_M_s11p20 Delta1_Cnt_D_u16 Delta2_Cnt_D_s16 Delta3_Cnt_D_s16 DisplayAfterUncorrPhsAdv_Cnt_D_s16 EstKeFF_VpRadpS_M_f32 EstPkCurrFiltSV_AmpSq_M_u16p16 EstRfetFF_Ohm_D_f32 EstRFF_Ohm_M_f32 EstRmtrFF_Ohm_D_f32 FiltMtrCurEst_Id_Amp_D_f32 FiltMtrCurEst_Iq_Amp_D_f32 IdDes_Amp_D_f32 IdDesRaw_Amp_D_f32 IdDesTblX_MtrRadpS_M_u12p4 IntTermG_Volt_D_f32 KeIntError_Amp_D_f32 KeIntgSV_Amp_M_f32 KeIntValid_Cnt_D_lgc KeSatSclFac_Uls_D_f32 KTimeConstanst_Uls_D_f32 LdSatSclFac_Uls_D_f32 LmtdModIdx_Uls_M_f32 LqSatSclFac_Uls_D_f32 MtrCurEst_Id_Amp_D_f32 MtrCurEst_Id_AmpSq_D_f32 MtrCurEst_Iq_AmpSq_D_f32 MtrTrqCmdSign_Cnt_D_s08 MtrTrqCmdSign_Cnt_M_s08 PDOverrideCounter_Cnt_M_u16 PDTestTimeNOTElapsed_Cnt_M_lgc PhaseCorrec_Cnt_D_u16 PhsAdv_Cnt_M_s16 PhsAdvY_Uls_D_f32 PhsOffCorr_Cnt_D_s16 PreLmtEstKe_VpRadpS_D_f32 PreLmtEstLd_Henry_D_f32 PreLmtEstLq_Henry_D_f32 PreLmtEstR_Ohm_D_f32 PrevCumMtrPos_Deg_M_f32 PrevEstKe_VpRadpS_M_f32 PrevInstMtrDir_Cnt_M_s08 PrevMtrTrqCmd_MtrNm_M_f32 PrvExpIq_Amp_M_f32 QaxCurrFiltSV_Amp_M_s11p20 RIntError_Amp_D_f32 RIntgSV_Amp_M_f32 RIntValid_Cnt_D_lgc SineLkpTbl_Uls_D_f32 TermA_Volt_M_f32 TermB_Volt_M_f32 TermBDeri_Volt_D_f32 TermBDerifinal_Volt_D_f32 TermBTOT_Volt_M_f32 TermD_Volt_M_f32 TermE_Volt_M_f32 TermEDeriScale_Volt_D_f32 TermEDeriScalefinal_Volt_D_f32 TermETOT_Volt_M_f32 TermGInput_Volt_D_f32 TermGOutput_Volt_D_f32 TermH_Volt_D_f32 TermXd_Uls_M_f32 TermXq_Uls_M_f32 TermY_Uls_M_f32 UncorrPhsAdv_Cnt_M_s16 Vdcoef_Uls_M_f32 VdTerm_Volt_D_f32 VdTerm_Volt_M_f32 VFinal_Volt_D_f32 VltgDenom_Uls_D_f32 VoltageLimit_Volt_D_f32 Vqcoef_Uls_M_f32 VqTerm_Volt_D_f32 VqTerm_Volt_M_f32 /end REF_MEASUREMENT
/end GROUP
/begin GROUP SF99_MotorControl "" /begin SUB_GROUP SF99.Internals SF99.Outputs SF99.Inputs /end SUB_GROUP /end GROUP
/begin GROUP SF99.Outputs ""
 /begin REF_MEASUREMENT MtrCtrl_VM_EstKe_VpRadpS_f32 MtrCtrl_VM_EstLd_Henry_f32 MtrCtrl_VM_EstLq_Henry_f32 MtrCtrl_VM_EstPkCurr_AmpSq_f32 MtrCtrl_VM_EstR_Ohm_f32 MtrCtrl_VM_ExpIq_Amp_f32 MtrCtrl_VM_FiltEstPkCurr_AmpSq_f32 MtrCtrl_VM_IdEst_Amp_f32 MtrCtrl_VM_InstMtrDir_Cnt_s08 MtrCtrl_VM_MRFMtrTrqCmdScl_MtrNm_f32 MtrCtrl_VM_MtrQuad_Cnt_u08 MtrCtrl_VM_PhsAdv_Cnt_s16 MtrCtrl_VM_TermA_Volt_f32 MtrCtrl_VM_TermBSS_Volt_f32 MtrCtrl_VM_TermBTOT_Volt_f32 MtrCtrl_VM_TermD_Volt_f32 MtrCtrl_VM_TermE_Volt_f32 MtrCtrl_VM_TermETOT_Volt_f32 MtrCtrl_VM_TermXd_Uls_f32 MtrCtrl_VM_TermXq_Uls_f32 MtrCtrl_VM_TermY_Uls_f32 MtrCtrl_VM_TermZ_Uls_f32 MtrCtrl_VM_VdTerm_Volt_f32 MtrCtrl_VM_VqTerm_Volt_f32 /end REF_MEASUREMENT
/end GROUP
/begin GROUP FDD01B.Internals ""
 /begin REF_MEASUREMENT FiltShcur_Volts_M_f32 InvldRgnHi_Rev_M_f32 InvldRgnLo_Rev_M_f32 MtrCurrDax_Amp_M_f32 MtrCurrQax_Amp_M_f32 ShCurLpFltrSV_Volts_M_u3p29 /end REF_MEASUREMENT
/end GROUP
/begin GROUP FDD01B_CurrentMeasurement "" /begin SUB_GROUP FDD01B.Internals FDD01B.Outputs FDD01B.Inputs /end SUB_GROUP /end GROUP
/begin GROUP FDD01B.Outputs ""
 /begin REF_MEASUREMENT MtrCurr_VM_MtrCurrDax_Amp_f32 MtrCurr_VM_MtrCurrQax_Amp_f32 MtrCurr_VM_RawCurrFiltered_Amp_f32 MtrCurr_VM_ValidSampleFlag_Cnt_lgcValid /end REF_MEASUREMENT
/end GROUP
/begin GROUP FDD06B.Outputs ""
 /begin REF_MEASUREMENT MtrPos_AlignedCumMtrPosMRF_Deg_f32 MtrPos_CDD_CorrectedMtrPos_Rev_G_u0p16 MtrPos_CDD_CosTheta1_Volts_G_s2p13 MtrPos_CDD_SinTheta1_Volts_G_s2p13 MtrPos_Cos1RTAmpRec_Uls_f32 MtrPos_Cos1RTOffset_Volt_f32 MtrPos_CumMtrPosMRF_Deg_f32 MtrPos_DiagCorrectedMtrPos_Rev_f32 MtrPos_DiagMechMtrPos_Rev_f32 MtrPos_EOLBEMF_Rev_f32 MtrPos_MtrPos_CosTheta1_Volts_G_s2p13 MtrPos_MtrPos_MechMtrPos_Rev_G_u0p16 MtrPos_MtrPos_SampleTime_uS_G_u32 MtrPos_MtrPos_SinTheta1_Volts_G_s2p13 MtrPos_Sin1RTAmpRec_Uls_f32 MtrPos_Sin1RTOffset_Volt_f32 MtrPos_SysCCumMtrPosMRF_Deg_f32 /end REF_MEASUREMENT
/end GROUP
/begin GROUP FDD06B_MotorPositionMeasurement "" /begin SUB_GROUP FDD06B.Outputs FDD06B.Internals FDD06B.Inputs /end SUB_GROUP /end GROUP
/begin GROUP FDD06B.Internals ""
 /begin REF_MEASUREMENT CorrFltAcc_Cnt_M_u16 Cos1GainCorr_Uls_M_f32 Cos1OffsetCorr_Volts_M_f32 Cos1RTAmpRec_Uls_M_f32 Cos1RTOffset_Volt_M_f32 CosSin1NomRatio_Uls_M_f32 CumMtrPosOff_Deg_M_f32 DiagCorrectedMtrPos_Rev_M_f32 MtrPos_Cos1Scaled_Volts_M_u3p13 MtrPos_Sin1Scaled_Volts_M_u3p13 MtrPos2_Cos1RTAmpRec_Uls_M_u3p13 MtrPos2_Cos1RTOffset_Volts_M_u3p13 MtrPos2_ErrorTerm_Rev_D_f32 MtrPos2_Sin1RTAmpRec_Uls_M_u3p13 MtrPos2_Sin1RTOffset_Volts_M_u3p13 MtrPos2_ValidErr_VoltsSqrd_D_f32 MtrPos3_SysCErrorTerm_Rev_D_f32 MtrPos3_SysCValidErr_VoltsSqrd_D_f32 PrevCorrectedMtrPos_Rev_M_f32 PrevCos1RTOffset_Volts_M_f32 PrevSin1RTOffset_Volts_M_f32 RTToNomHighLmt_Uls_M_f32 RTToNomLowLmt_Uls_M_f32 Sin1GainCorr_Uls_M_f32 Sin1OffsetCorr_Volts_M_f32 Sin1RTAmpRec_Uls_M_f32 Sin1RTOffset_Volt_M_f32 SinCos1NomRatio_Uls_M_f32 SinTheta2_Uls_D_s2p13 SysCCorrFltAcc_Cnt_M_u16 SysCValidityFltAcc_Cnt_M_u16 tempAlignedCumMtrPosMRF_Rev_M_s15p16 ValidityFltAcc_Cnt_M_u16 /end REF_MEASUREMENT
/end GROUP
/begin GROUP FDD02B.Outputs ""
 /begin REF_MEASUREMENT MtrVel_CRFMotorVel_MtrRadpS_f32 MtrVel_HandwheelVel_HwRadpS_f32 MtrVel_HwVelValid_Cnt_lgc MtrVel_MRFMotorVel_MtrRadpS_f32 MtrVel_MRFMotorVelUnfiltered_MtrRadpS_f32 MtrVel_SysC_DiagHandWheelVel_HwRadpS_f32 MtrVel_SysC_DiagMtrVel_MtrRadpS_f32 MtrVel_SysCHandwheelVel_HwRadpS_f32 MtrVel_SysCMotorVelMRF_MtrRadpS_f32 /end REF_MEASUREMENT
/end GROUP
/begin GROUP FDD02B_MotorVelocity "" /begin SUB_GROUP FDD02B.Outputs FDD02B.Internals FDD02B.Inputs /end SUB_GROUP /end GROUP
/begin GROUP FDD02B.Internals ""
 /begin REF_MEASUREMENT CrsMtrVel_MtrRadpS_D_f32 DeltaTheta_Uls_D_s18p13 HwVel_HwRadpS_M_f32 HwVelCorrLimDiff_HwRadpS_D_f32 HwVelDiffAcc_Cnt_M_u16 MtrVel_ActiveBufSet_Cnt_M_u08 MtrVel_AvgDeltaT_uS_D_u16p0 MtrVel_DeltaThetaIntercept_Uls_D_s7p24 MtrVel_MtrRadpS_M_f32 MtrVel_OldPosBuf_Cnt_M_u16 MtrVel_OsBufSelect_Cnt_M_u08 MtrVel_Slope_puS_D_sm11p42 MtrVel_SnapShotSet_Cnt_G_u08 MtrVel3_CosBuffer_Uls_M_s2p13 MtrVel3_OsBufPos_Cnt_M_u08 MtrVel3_PosBuffer_Rev_M_u0p16 MtrVel3_SinBuffer_Uls_M_s2p13 MtrVel3_TimeBuffer_uS_M_u16p0 MtrVelCorrLimDiff_MtrRadpS_D_f32 MtrVelDelta_MtrRadpS_M_u12p4 MtrVelDiffAcc_Cnt_M_u16 MtrVelFiltSV_MtrRadpS_M_s11p20 OldMtrVel_MtrRadpS_M_s11p4 PosAvg_Rev_M_u0p16 PredDeltaTheta_Uls_D_f32 PredDeltaThetaCor_Uls_D_f32 PrevSysCDiagCumMtrPos_Rad_M_f32 SysCDiagCumMtrPosDelta_Rad_D_f32 SysCDiagMtrVelRawMRF_MtrRadpS_D_f32 SysCDiagMtrVelRawMRFSv_M_str.K_Uls_f32 SysCDiagMtrVelRawMRFSv_M_str.SV_Uls_f32 SysCHwVelCorrLimDiff_HwRadpS_D_f32 SysCHwVelCRF_HwRadpS_M_f32 SysCHwVelDiffAcc_Cnt_M_u16 SysCMtrVelCorrLimDiff_MtrRadpS_D_f32 SysCMtrVelDiffAcc_Cnt_M_u16 SysCMtrVelMRF_MtrRadpS_M_f32 WestBlendedMtrVel_MtrRadpS_D_f32 WestVelocity_MtrRadpS_D_f32 /end REF_MEASUREMENT
/end GROUP
/begin GROUP SF22.Internals ""
 /begin REF_MEASUREMENT AmpInit_HwDeg_M_f32 Amplitude_HwDeg_M_f32 CalcFlag_Cnt_M_lgc CmdState_Cnt_M_enum Cycles_Cnt_M_u08 CyclesInit_Cnts_M_u8 FreqInit_Hz_M_f32 Frequency_Hz_M_f32 PosInit_HwDeg_M_f32 /end REF_MEASUREMENT
/end GROUP
/begin GROUP SF22_GenerateOscillationTrajectory "" /begin SUB_GROUP SF22.Internals SF22.Outputs SF22.Inputs /end SUB_GROUP /end GROUP
/begin GROUP SF22.Outputs ""
 /begin REF_MEASUREMENT OscTraj_OscillateHwAngle_HwDeg_f32 OscTraj_OscTrajState_Cnt_enum /end REF_MEASUREMENT
/end GROUP
/begin GROUP FDD40A.Internals ""
 /begin REF_MEASUREMENT FiltHwTrqSV_HwNm_M_s7p24 HandsOnThrsh1_Cnt_M_lgc HandsOnThrsh2_Cnt_M_lgc HwVelFltStart_mS_M_u32 PinionRateFlt_Cnt_M_lgc PinionRateFltStart_mS_M_u32 PosServoHwAngle_HwDeg_M_f32 PrevHwPos_HwDeg_M_f32 PrkAstState_Cnt_M_enum TimeoutHandsOn2Time_mS_M_u32 /end REF_MEASUREMENT
/end GROUP
/begin GROUP FDD40A.Outputs ""
 /begin REF_MEASUREMENT ParkAstEnbl_BMW_PosServoEnable_Cnt_lgc ParkAstEnbl_BMW_PosServoHwAngle_HwDeg_f32 ParkAstEnbl_BMW_PrkAssistState_Cnt_u08 /end REF_MEASUREMENT
/end GROUP
/begin GROUP FDD47.Internals ""
 /begin REF_MEASUREMENT ChrgPmpHiFltAcc_Cnt_M_u16 ChrgPmpLowFltAcc_Cnt_M_u16 IMeasAcuTime_mS_M_u16 IMeasLPFKSV_Cnt_M_str.K_Uls_f32 IMeasLPFKSV_Cnt_M_str.SV_Uls_f32 IMeasNullFltAcc_Cnt_M_u16 IMeasTestDone_Cnt_M_lgc InitialTime_mS_M_u32 PDCloseTimer_mS_M_u32 PDControlStat_Cnt_D_u08 PDOpenTimer_mS_M_u32 PDSuplHighFltAcc_Cnt_M_u16 PDSupplyHiComplete_Cnt_M_lgc PDSupplyHiLatched_Cnt_M_lgc PDTestFailCurrTimer_mS_M_u32 PDTestKSV_Cnt_M_str.K_Uls_f32 PDTestKSV_Cnt_M_str.SV_Uls_f32 PDTestScansCtr_Cnt_M_u16 PhaseDiscInitDiagState_Cnt_M_enum PhaseDisconStat_Cnt_M_enum PrevSystemStatePer1_Cnt_M_enum PrevSystemStatePer2_Cnt_M_enum /end REF_MEASUREMENT
/end GROUP
/begin GROUP FDD47_PhaseDisconnect "" /begin SUB_GROUP FDD47.Internals FDD47.Outputs FDD47.Inputs /end SUB_GROUP /end GROUP
/begin GROUP FDD47.Outputs ""
 /begin REF_MEASUREMENT PhaseDscnt_PDActivateTest_Cnt_lgc PhaseDscnt_PDPhaseAdvSelect_Cnt_s16 PhaseDscnt_PDTestModIndex_Uls_f32 PhaseDscnt_PhsDiscTestComplete_Cnt_lgc /end REF_MEASUREMENT
/end GROUP
/begin GROUP FDD25.Outputs ""
 /begin REF_MEASUREMENT Polarity_AssistAssyPolarity_Cnt_s08 Polarity_HwPosPolarity_Cnt_s08 Polarity_HwTrqPolarity_Cnt_s08 Polarity_MtrElecMechPolarity_Cnt_s08 Polarity_MtrPosPolarity_Cnt_s08 Polarity_MtrVelPolarity_Cnt_s08 Polarity_SysC_MtrElecMechPolarity_Cnt_s32 /end REF_MEASUREMENT
/end GROUP
/begin GROUP FDD25_PolarityAssignments "" /begin SUB_GROUP FDD25.Outputs /end SUB_GROUP /end GROUP
/begin GROUP SF20.Internals ""
 /begin REF_MEASUREMENT DTermKSV_M_str.K_Uls_f32 DTermKSV_M_str.SV_Uls_f32 FiltHwPosKSV_M_str.K_Uls_f32 FiltHwPosKSV_M_str.SV_Uls_f32 FiltHwTrqKSV_M_str.K_Uls_f32 FiltHwTrqKSV_M_str.SV_Uls_f32 ITermSV_HwDeg_M_s27p4 PosServo_DTerm_MtrNm_D_s8p7 PosServo_ITerm_MtrNm_D_s8p7 PosServo_PTerm_MtrNm_D_s24p7 PosSrvoHWATargFilt_HwDeg_D_f32 PosSrvoPIDCmd_MtrNm_D_f32 PosSrvoRampComplete_Cnt_D_lgc PrevCmdError_HwDeg_M_s11p4 PrevLimitedHwPos_HwDeg_M_f32 PrkAstRampSV_Uls_M_f32 /end REF_MEASUREMENT
/end GROUP
/begin GROUP SF20_PositionTrackingServo "" /begin SUB_GROUP SF20.Internals SF20.Outputs SF20.Inputs /end SUB_GROUP /end GROUP
/begin GROUP SF20.Outputs ""
 /begin REF_MEASUREMENT PosServo_PosSrvoCmd_MtrNm_f32 PosServo_PosSrvoReturnSclFct_Uls_f32 PosServo_PosSrvoSmoothEnable_Uls_f32 /end REF_MEASUREMENT
/end GROUP
/begin GROUP SF19.Outputs ""
 /begin REF_MEASUREMENT PwrLmtFunc_AssistPowerLimit_MtrNm_f32 PwrLmtFunc_MtrEnvSpd_MtrRadpS_f32 PwrLmtFunc_PowerLimitPerc_Uls_f32 /end REF_MEASUREMENT
/end GROUP
/begin GROUP SF19_PowerLimitFunction "" /begin SUB_GROUP SF19.Outputs SF19.Internals SF19.Inputs /end SUB_GROUP /end GROUP
/begin GROUP SF19.Internals ""
 /begin REF_MEASUREMENT FltTrqLmt_Uls_D_f32 InvKeStdTemp_RadpSpV_M_f32 LimitDiff_MtrNm_M_s4p11 LowVltAstTime_mS_M_u32p0 MinStdOpLmt_MtrNm_M_u5p11 OPVelOffset_MtrRadpS_D_s11p4 SpdAdj_MtrRadpS_M_s11p4 TLmtMaxCurr_MtrNm_D_u5p11 TrqEnvLmt_MtrNm_D_u5p11 TrqLmt_MtrNm_M_u5p11 TrqLmt_Uls_D_f32 TrqLmtKSV_M_str.K_Uls_f32 TrqLmtKSV_M_str.SV_Uls_f32 /end REF_MEASUREMENT
/end GROUP
/begin GROUP SF10.Internals ""
 /begin REF_MEASUREMENT a1_DTFilt_M_f32 a1_LeadLagFilt_M_f32 AssistTrq_Nm_D_f32 b0_DTFilt_M_f32 b1_DTFilt_M_f32 b1_LeadLagFilt_M_f32 bo_LeadLagFilt_M_f32 CRFMtrTrqCmdQuad_MtrNm_M_f32 DTOpCRFMtrTrqCmdQuad_HwNm_M_f32 DTOpMtrAccel_RadpS2_M_f32 DTOpMtrAccelSV_RadpS2_M_s15p16 InertiaTrq_Nm_M_f32 MechEff_Uls_M_f32 MotorEff_Uls_M_f32 PrevDTFilterInputSV_M_f32 PrevDTOpFilterSV_M_f32 PrevLeadLagFilterInputSV_M_f32 PrevLeadLagOpFilterSV_M_f32 RackDmpTrq_Nm_M_f32 RackFrictionTrq_Nm_M_f32 RackLoadSV_kN_M_s7p24 RackTrq_Nm_M_f32 /end REF_MEASUREMENT
/end GROUP
/begin GROUP SF10_RackLoadEstimation "" /begin SUB_GROUP SF10.Internals SF10.Outputs SF10.Inputs /end SUB_GROUP /end GROUP
/begin GROUP SF10.Outputs "" /begin REF_MEASUREMENT RackLoad_RackLoad_kN_f32 /end REF_MEASUREMENT /end GROUP
/begin GROUP SF02.Internals ""
 /begin REF_MEASUREMENT AbsHwPosReturn_HwDeg_D_u12p4 CrntHandWheelAthScl_Uls_M_f32 CurrentOffset_HwDeg_M_f32 HwPosReturnCmd_MtrNm_D_f32 HwTrqReturnScl_Uls_D_f32 HwVelReturnScl_Uls_D_f32 RtrnBasicReturn_MtrNm_D_f32 SgnHwPosReturn_HwDeg_D_f32 TempReturnScl_Uls_D_f32 /end REF_MEASUREMENT
/end GROUP
/begin GROUP SF02.Outputs "" /begin REF_MEASUREMENT Return_ReturnCmd_MtrNm_f32 /end REF_MEASUREMENT /end GROUP
/begin GROUP SF36.Outputs "" /begin REF_MEASUREMENT ReturnFirewall_LimitedReturn_MtrNm_f32 /end REF_MEASUREMENT /end GROUP
/begin GROUP SF36_ReturnFirewall "" /begin SUB_GROUP SF36.Outputs SF36.Internals SF36.Inputs /end SUB_GROUP /end GROUP
/begin GROUP SF36.Internals ""
 /begin REF_MEASUREMENT LwrBound_MtrNm_D_f32 OverBound_Cnt_D_lgc UprBound_MtrNm_D_f32 /end REF_MEASUREMENT
/end GROUP
/begin GROUP FDD18.Internals ""
 /begin REF_MEASUREMENT ESMErrOutStat_Cnt_D_u08 GateDrvResetStat_Cnt_D_u32 NHETPwmStat_Cnt_D_u32 SysFault2Stat_Cnt_D_u08 /end REF_MEASUREMENT
/end GROUP
/begin GROUP FDD18_ShutdownMechanisms "" /begin SUB_GROUP FDD18.Internals /end SUB_GROUP /end GROUP
/begin GROUP SF29.Outputs ""
 /begin REF_MEASUREMENT StabilityComp_AssistCmd_MtrNm_f32 StabilityComp_SysAssistCmd_MtrNm_f32 /end REF_MEASUREMENT
/end GROUP
/begin GROUP SF29_StabilityCompensation "" /begin SUB_GROUP SF29.Outputs SF29.Internals SF29.Inputs /end SUB_GROUP /end GROUP
/begin GROUP SF29.Internals ""
 /begin REF_MEASUREMENT AssistCmdSV_MtrNm_M_f32 AssistDDFactorSV_Uls_M_f32 CombAstNFSV_Cnt_M_Str[0].KPtr_Cnt_StrA1_Uls_f32 CombAstNFSV_Cnt_M_Str[0].KPtr_Cnt_StrA2_Uls_f32 CombAstNFSV_Cnt_M_Str[0].KPtr_Cnt_StrB0_Uls_f32 CombAstNFSV_Cnt_M_Str[0].KPtr_Cnt_StrB1_Uls_f32 CombAstNFSV_Cnt_M_Str[0].KPtr_Cnt_StrB2_Uls_f32 CombAstNFSV_Cnt_M_Str[0].Out_Uls_f32 CombAstNFSV_Cnt_M_Str[0].SV1_Uls_f32 CombAstNFSV_Cnt_M_Str[0].SV2_Uls_f32 CombAstNFSV_Cnt_M_Str[1].KPtr_Cnt_StrA1_Uls_f32 CombAstNFSV_Cnt_M_Str[1].KPtr_Cnt_StrA2_Uls_f32 CombAstNFSV_Cnt_M_Str[1].KPtr_Cnt_StrB0_Uls_f32 CombAstNFSV_Cnt_M_Str[1].KPtr_Cnt_StrB1_Uls_f32 CombAstNFSV_Cnt_M_Str[1].KPtr_Cnt_StrB2_Uls_f32 CombAstNFSV_Cnt_M_Str[1].Out_Uls_f32 CombAstNFSV_Cnt_M_Str[1].SV1_Uls_f32 CombAstNFSV_Cnt_M_Str[1].SV2_Uls_f32 CombAstNFSV_Cnt_M_Str[2].KPtr_Cnt_StrA1_Uls_f32 CombAstNFSV_Cnt_M_Str[2].KPtr_Cnt_StrA2_Uls_f32 CombAstNFSV_Cnt_M_Str[2].KPtr_Cnt_StrB0_Uls_f32 CombAstNFSV_Cnt_M_Str[2].KPtr_Cnt_StrB1_Uls_f32 CombAstNFSV_Cnt_M_Str[2].KPtr_Cnt_StrB2_Uls_f32 CombAstNFSV_Cnt_M_Str[2].Out_Uls_f32 CombAstNFSV_Cnt_M_Str[2].SV1_Uls_f32 CombAstNFSV_Cnt_M_Str[2].SV2_Uls_f32 CombAstNFSV_Cnt_M_Str[3].KPtr_Cnt_StrA1_Uls_f32 CombAstNFSV_Cnt_M_Str[3].KPtr_Cnt_StrA2_Uls_f32 CombAstNFSV_Cnt_M_Str[3].KPtr_Cnt_StrB0_Uls_f32 CombAstNFSV_Cnt_M_Str[3].KPtr_Cnt_StrB1_Uls_f32 CombAstNFSV_Cnt_M_Str[3].KPtr_Cnt_StrB2_Uls_f32 CombAstNFSV_Cnt_M_Str[3].Out_Uls_f32 CombAstNFSV_Cnt_M_Str[3].SV1_Uls_f32 CombAstNFSV_Cnt_M_Str[3].SV2_Uls_f32 CombAstNFSV2_Cnt_M_Str[0].KPtr_Cnt_StrA1_Uls_f32 CombAstNFSV2_Cnt_M_Str[0].KPtr_Cnt_StrA2_Uls_f32 CombAstNFSV2_Cnt_M_Str[0].KPtr_Cnt_StrB0_Uls_f32 CombAstNFSV2_Cnt_M_Str[0].KPtr_Cnt_StrB1_Uls_f32 CombAstNFSV2_Cnt_M_Str[0].KPtr_Cnt_StrB2_Uls_f32 CombAstNFSV2_Cnt_M_Str[0].Out_Uls_f32 CombAstNFSV2_Cnt_M_Str[0].SV1_Uls_f32 CombAstNFSV2_Cnt_M_Str[0].SV2_Uls_f32 CombAstNFSV2_Cnt_M_Str[1].KPtr_Cnt_StrA1_Uls_f32 CombAstNFSV2_Cnt_M_Str[1].KPtr_Cnt_StrA2_Uls_f32 CombAstNFSV2_Cnt_M_Str[1].KPtr_Cnt_StrB0_Uls_f32 CombAstNFSV2_Cnt_M_Str[1].KPtr_Cnt_StrB1_Uls_f32 CombAstNFSV2_Cnt_M_Str[1].KPtr_Cnt_StrB2_Uls_f32 CombAstNFSV2_Cnt_M_Str[1].Out_Uls_f32 CombAstNFSV2_Cnt_M_Str[1].SV1_Uls_f32 CombAstNFSV2_Cnt_M_Str[1].SV2_Uls_f32 CombAstNFSV2_Cnt_M_Str[2].KPtr_Cnt_StrA1_Uls_f32 CombAstNFSV2_Cnt_M_Str[2].KPtr_Cnt_StrA2_Uls_f32 CombAstNFSV2_Cnt_M_Str[2].KPtr_Cnt_StrB0_Uls_f32 CombAstNFSV2_Cnt_M_Str[2].KPtr_Cnt_StrB1_Uls_f32 CombAstNFSV2_Cnt_M_Str[2].KPtr_Cnt_StrB2_Uls_f32 CombAstNFSV2_Cnt_M_Str[2].Out_Uls_f32 CombAstNFSV2_Cnt_M_Str[2].SV1_Uls_f32 CombAstNFSV2_Cnt_M_Str[2].SV2_Uls_f32 CombAstNFSV2_Cnt_M_Str[3].KPtr_Cnt_StrA1_Uls_f32 CombAstNFSV2_Cnt_M_Str[3].KPtr_Cnt_StrA2_Uls_f32 CombAstNFSV2_Cnt_M_Str[3].KPtr_Cnt_StrB0_Uls_f32 CombAstNFSV2_Cnt_M_Str[3].KPtr_Cnt_StrB1_Uls_f32 CombAstNFSV2_Cnt_M_Str[3].KPtr_Cnt_StrB2_Uls_f32 CombAstNFSV2_Cnt_M_Str[3].Out_Uls_f32 CombAstNFSV2_Cnt_M_Str[3].SV1_Uls_f32 CombAstNFSV2_Cnt_M_Str[3].SV2_Uls_f32 HwTorqueSV_HwNm_M_f32 HwTrqSV_HwNm_M_Str.K_Uls_f32 HwTrqSV_HwNm_M_Str.SV_Uls_f32 StabCompOverThresh_Cnt_D_lgc StCmp02Blend_Uls_D_f32 StCmp04Blend_Uls_D_f32 StCmp12Blend_Uls_D_f32 StCmp1Out_MtrNm_D_f32 StCmp1Out2_MtrNm_D_f32 StCmp2Out_MtrNm_D_f32 StCmp2Out2_MtrNm_D_f32 StCmp34Blend_Uls_D_f32 StCmp3Out_MtrNm_D_f32 StCmp3Out2_MtrNm_D_f32 StCmp4Out_MtrNm_D_f32 StCmp4Out2_MtrNm_D_f32 StCmpAsstFctrCmpBlnd_Uls_D_f32 StCmpPNAccum_Cnt_M_u16 StCmpPNStatus_Cnt_M_lgc VehicleSpeedSV_Kph_M_f32 /end REF_MEASUREMENT
/end GROUP
/begin GROUP SF05.Outputs ""
 /begin REF_MEASUREMENT StOpCtrl_OutputRampMult_Uls_f32 StOpCtrl_RampDwnStatusComplete_Cnt_lgc /end REF_MEASUREMENT
/end GROUP
/begin GROUP SF05_StateOutputControl "" /begin SUB_GROUP SF05.Outputs SF05.Internals /end SUB_GROUP /end GROUP
/begin GROUP SF05.Internals "" /begin REF_MEASUREMENT PrevRate_XpmS_M_f32 PrevTargetRampMult_Uls_M_f32 /end REF_MEASUREMENT /end GROUP
/begin GROUP FDD49.Outputs ""
 /begin REF_MEASUREMENT SVDiag_FETFaultPhase_Cnt_enum SVDiag_FETFaultType_Cnt_enum SVDiag_MtrDrvrInitComplete_Cnt_lgc /end REF_MEASUREMENT
/end GROUP
/begin GROUP FDD49_SineVoltageGenerationDiagnostics "" /begin SUB_GROUP FDD49.Outputs FDD49.Internals FDD49.Inputs /end SUB_GROUP /end GROUP
/begin GROUP FDD49.Internals ""
 /begin REF_MEASUREMENT FETFaultPhase_Cnt_M_enum FETFaultType_Cnt_M_enum FilterSV_Cnt_M_s18p13 GateDriveFltAcc_Cnt_M_u16 GateDrvFltSts_Cnt_D_b16 GenGateDriveFltAcc_Cnt_M_u16 HighResPhsReasDisable_M_u8 LowResPhsReasDisable_M_u8 MtrDrvInitActive_Cnt_M_lgc MtrDrvInitComp_Cnt_M_lgc MtrDrvInitStartTime_mS_M_u32p0 OnStateFltAcc_Cnt_M_u16 ResetWaitLoop_Cnt_M_lgc /end REF_MEASUREMENT
/end GROUP
/begin GROUP FDD15C.Internals ""
 /begin REF_MEASUREMENT CDD_DitherFlt1SV_Cnt_M_u16 CDD_DitherFlt2SV_Cnt_M_u16 CDD_NextDCSmall_Cnt_M_u16 CDD_PhaseOffset_Rev_M_u0p16 CDD_SeedPWMDither_Cnt_M_u16 DCPhsAComp_Cnt_M_u16p0 DCPhsBComp_Cnt_M_u16p0 DCPhsCComp_Cnt_M_u16p0 PrevDCPhsAComp_Cnt_M_u16p0 PrevDCPhsBComp_Cnt_M_u16p0 PrevDCPhsCComp_Cnt_M_u16p0 PrevLowerEnd_Cnt_M_u16 PrevPWMPeriod_Cnt_M_u16 PWMPeriod_Cnt_M_u16 /end REF_MEASUREMENT
/end GROUP
/begin GROUP FDD15C_SineVoltageGenerationDrive "" /begin SUB_GROUP FDD15C.Internals FDD15C.Outputs FDD15C.Inputs /end SUB_GROUP /end GROUP
/begin GROUP FDD15C.Outputs ""
 /begin REF_MEASUREMENT SVDrvr_CDD_DutyCycleSmall_Cnt_G_u16 SVDrvr_CDD_PhsReasA_Cnt_G_u16 SVDrvr_CDD_PhsReasB_Cnt_G_u16 SVDrvr_CDD_PhsReasC_Cnt_G_u16 SVDrvr_CDD_PWMDutyCycleASum_Cnt_G_u32 SVDrvr_CDD_PWMDutyCycleBSum_Cnt_G_u32 SVDrvr_CDD_PWMDutyCycleCSum_Cnt_G_u32 SVDrvr_CDD_PWMPeriodSum_Cnt_G_u32 /end REF_MEASUREMENT
/end GROUP
/begin GROUP SF09.Internals ""
 /begin REF_MEASUREMENT AbsTempFltAcc_Cnt_M_u16 AbsTempLimit_MtrNm_D_f32 AbsTempLimit_MtrNm_M_f32 eFilter3ValueTyH_Cnt_M_u8 eFilter4ValueTyH_Cnt_M_u8 eFilter5ValueTyH_Cnt_M_u8 eFilter6ValueTyH_Cnt_M_u8 Filter1KSV_M_str.K_Uls_f32 Filter1KSV_M_str.SV_Uls_f32 Filter2KSV_M_str.K_Uls_f32 Filter2KSV_M_str.SV_Uls_f32 Filter3KSV_M_str.K_Uls_f32 Filter3KSV_M_str.SV_Uls_f32 Filter4KSV_M_str.K_Uls_f32 Filter4KSV_M_str.SV_Uls_f32 Filter5KSV_M_str.K_Uls_f32 Filter5KSV_M_str.SV_Uls_f32 Filter6KSV_M_str.K_Uls_f32 Filter6KSV_M_str.SV_Uls_f32 LastTblVal_MtrNm_D_u9p7 LastTblValSlew_MtrNm_D_u9p7 MaxOut_Uls_D_u16p0 Mult1_Uls_D_u3p13 Mult12Temp_DegC_D_f32 Mult2_Uls_D_u3p13 Mult3_Uls_D_u3p13 Mult36Temp_DegC_D_f32 Mult4_Uls_D_u3p13 Mult5_Uls_D_u3p13 Mult6_Uls_D_u3p13 ThermLim_MtrNm_D_f32 ThrmLoadLmtTblYVal_MtrNm_D_f32 TrqCmdTblYRam_MtrNm_M_u9p7 /end REF_MEASUREMENT
/end GROUP
/begin GROUP SF09_ThermalDutyCycleProtection "" /begin SUB_GROUP SF09.Internals SF09.Outputs SF09.Inputs /end SUB_GROUP /end GROUP
/begin GROUP SF09.Outputs ""
 /begin REF_MEASUREMENT ThrmDutyCycle_AssistThermScalar_Uls_f32 ThrmDutyCycle_ThermalLimit_MtrNm_f32 ThrmDutyCycle_ThermLimitPerc_Uls_f32 /end REF_MEASUREMENT
/end GROUP
/begin GROUP FDD19.Internals ""
 /begin REF_MEASUREMENT InitTestStatus_Cnt_M_enum NTCStatusByte_Cnt_M_u08 TmprlMonSt_Cnt_M_enum /end REF_MEASUREMENT
/end GROUP
/begin GROUP FDD19_TemporalMonitor "" /begin SUB_GROUP FDD19.Internals FDD19.Outputs FDD19.Inputs /end SUB_GROUP /end GROUP
/begin GROUP FDD19.Outputs "" /begin REF_MEASUREMENT TmprlMon_TMFTestComplete_Cnt_lgc /end REF_MEASUREMENT /end GROUP
/begin GROUP SF30.Internals ""
 /begin REF_MEASUREMENT FinalGain_Uls_D_f32 HP1FiltHwTrq_HwNm_D_f32 HP2FiltHwTrq_HwNm_D_f32 HwTrqFilt1SV_HwNm_M_str.K_Uls_f32 HwTrqFilt1SV_HwNm_M_str.SV_Uls_f32 HwTrqFilt2SV_HwNm_M_str.K_Uls_f32 HwTrqFilt2SV_HwNm_M_str.SV_Uls_f32 /end REF_MEASUREMENT
/end GROUP
/begin GROUP SF30_TorqueBasedInertiaCompensation "" /begin SUB_GROUP SF30.Internals SF30.Outputs SF30.Inputs /end SUB_GROUP /end GROUP
/begin GROUP SF30.Outputs "" /begin REF_MEASUREMENT TrqBasedInrtCmp_HighFreqAssist_MtrNm_f32 /end REF_MEASUREMENT /end GROUP
/begin GROUP SF23.Outputs ""
 /begin REF_MEASUREMENT TuningSelAuth_ActiveTunPers_Cnt_u16 TuningSelAuth_ActiveTunSet_Cnt_u16 /end REF_MEASUREMENT
/end GROUP
/begin GROUP SF23_TuningSelectAuthority "" /begin SUB_GROUP SF23.Outputs SF23.Internals SF23.Inputs /end SUB_GROUP /end GROUP
/begin GROUP SF23.Internals "" /begin REF_MEASUREMENT PrevTunPers_Cnt_M_u16 PrevTunSet_Cnt_M_u16 /end REF_MEASUREMENT /end GROUP
/begin GROUP FDD20C.Internals ""
 /begin REF_MEASUREMENT AcmpToTcOffsetInit_Cnt_M_lgc AllowProcessTCErrs_Cnt_M_lgc MRFTcMtrPosOffs_Deg_M_f32 MtrPos_Deg_M_f32 NTCPrMainResets_Cnt_M_u08 RackCenterComplete_Cnt_M_lgc RTBemfErrCnt_Cnt_M_u16 t_TcActivePN_Cnt_M_u8 t_TcActivePNvldCnt_Cnt_M_u8 t_TcImagePN_Cnt_M_u8 TcAllowSCMnMxErrs_Cnt_M_lgc TcClrInfoBitsField_Cnt_M_b08 TcFlashStatus_Cnt_M_u08 TcFlashVerify_Cnt_M_lgc TcInitComplete_Cnt_M_lgc TcInitMtrOctField_Cnt_M_b08 TcInitMtrRevField_Cnt_M_b08 TcMOSIErrCnt_Cnt_M_u16 TCprocessing_Cnt_D_lgc TCprocessing_Cnt_M_lgc TcReflashActive_Cnt_M_lgc TcResetDelayStart_uS_M_u32 TcSCMnMxErrCnt_Cnt_M_u16 TcSpiBuffer_Cnt_M_str TcSpiComFltAcc_Cnt_M_u16 TcSpiDataFltAcc_Cnt_M_u16 TcSpiDataValid_Cnt_M_lgc TcSpiResetReq_Cnt_M_lgc TcSpiTxMode_Cnt_M_enum TcSpiTxRC_Cnt_M_u08 TCvsMtrPosErrCnt_Cnt_M_u16 /end REF_MEASUREMENT
/end GROUP
/begin GROUP FDD20C_TurnsCounterColumnPositionSensor "" /begin SUB_GROUP FDD20C.Internals FDD20C.Outputs FDD20C.Inputs /end SUB_GROUP /end GROUP
/begin GROUP FDD20C.Outputs "" /begin REF_MEASUREMENT TurnsCounter_TCMtrPosOffsMRF_Deg_f32 /end REF_MEASUREMENT /end GROUP
/begin GROUP SER.Outputs ""
 /begin REF_MEASUREMENT VehPwrMd_ATermActive_Cnt_lgc VehPwrMd_CTermActive_Cnt_lgc VehPwrMd_MSACommand_Cnt_enum VehPwrMd_OperRampRate_XpmS_f32 VehPwrMd_OperRampValue_Uls_f32 /end REF_MEASUREMENT
/end GROUP
/begin GROUP SF16.Outputs "" /begin REF_MEASUREMENT VehSpdLmt_AstVehSpdLimit_MtrNm_f32 /end REF_MEASUREMENT /end GROUP
/begin GROUP SF16_VehicleSpeedLimiting "" /begin SUB_GROUP SF16.Outputs SF16.Internals SF16.Inputs /end SUB_GROUP /end GROUP
/begin GROUP SF16.Internals ""
 /begin REF_MEASUREMENT BkPtOne_HwDeg_D_u12p4 BkPtTwo_HwDeg_D_u12p4 LimitTerm_MtrNm_D_u5p11 ZeroVehSpd_MtrNm_D_u5p11 /end REF_MEASUREMENT
/end GROUP
/begin GROUP FDD05C.Inputs ""
 /begin REF_MEASUREMENT TurnsCounter_TCMtrPosOffsMRF_Deg_f32 TurnsCounter_TurnsCntrValidity_Cnt_enum /end REF_MEASUREMENT
/end GROUP
/begin GROUP SF01.Inputs "" /begin REF_MEASUREMENT ThrmDutyCycle_AssistThermScalar_Uls_f32 /end REF_MEASUREMENT /end GROUP
/begin GROUP SF34.Inputs "" /begin REF_MEASUREMENT TrqBasedInrtCmp_HighFreqAssist_MtrNm_f32 /end REF_MEASUREMENT /end GROUP
/begin GROUP SF04.Inputs ""
 /begin REF_MEASUREMENT StabilityComp_AssistCmd_MtrNm_f32 PwrLmtFunc_AssistPowerLimit_MtrNm_f32 Return_ReturnCmd_MtrNm_f32 PwrLmtFunc_PowerLimitPerc_Uls_f32 /end REF_MEASUREMENT
/end GROUP
/begin GROUP SF26.Inputs "" /begin REF_MEASUREMENT MtrVel_CRFMotorVel_MtrRadpS_f32 /end REF_MEASUREMENT /end GROUP
/begin GROUP CF06.Inputs ""
 /begin REF_MEASUREMENT VehCfg_CBATCURLIMITCURRENT_Amp_f32 VehCfg_CVEHSPDCURLIMITCURRENT_Amp_f32 VehCfg_CVEHSPDCURLIMITSPEED_Kph_f32 /end REF_MEASUREMENT
/end GROUP
/begin GROUP SF03.Inputs ""
 /begin REF_MEASUREMENT StabilityComp_AssistCmd_MtrNm_f32 MtrVel_CRFMotorVel_MtrRadpS_f32 /end REF_MEASUREMENT
/end GROUP
/begin GROUP SF08.Inputs ""
 /begin REF_MEASUREMENT MtrCtrl_VM_EstR_Ohm_f32 MtrCtrl_VM_TermA_Volt_f32 MtrCtrl_VM_TermXq_Uls_f32 MtrCtrl_VM_TermZ_Uls_f32 /end REF_MEASUREMENT
/end GROUP
/begin GROUP SF18.Inputs "" /begin REF_MEASUREMENT MtrVel_CRFMotorVel_MtrRadpS_f32 /end REF_MEASUREMENT /end GROUP
/begin GROUP DF01.Inputs "" /begin REF_MEASUREMENT MtrVel_CRFMotorVel_MtrRadpS_f32 /end REF_MEASUREMENT /end GROUP
/begin GROUP SF14.Inputs "" /begin REF_MEASUREMENT MtrVel_CRFMotorVel_MtrRadpS_f32 /end REF_MEASUREMENT /end GROUP
/begin GROUP SF21.Inputs "" /begin REF_MEASUREMENT ParkAstEnbl_BMW_PosServoHwAngle_HwDeg_f32 /end REF_MEASUREMENT /end GROUP
/begin GROUP SF37.Inputs ""
 /begin REF_MEASUREMENT MtrVel_HandwheelVel_HwRadpS_f32 MtrVel_CRFMotorVel_MtrRadpS_f32 MtrVel_MRFMotorVel_MtrRadpS_f32 Polarity_MtrElecMechPolarity_Cnt_s08 MtrVel_SysCHandwheelVel_HwRadpS_f32 MtrVel_SysCMotorVelMRF_MtrRadpS_f32 Polarity_SysC_MtrElecMechPolarity_Cnt_s32 /end REF_MEASUREMENT
/end GROUP
/begin GROUP SF17.Inputs "" /begin REF_MEASUREMENT MtrVel_CRFMotorVel_MtrRadpS_f32 /end REF_MEASUREMENT /end GROUP
/begin GROUP SF38.Inputs ""
 /begin REF_MEASUREMENT VehSpdLmt_AstVehSpdLimit_MtrNm_f32 StOpCtrl_OutputRampMult_Uls_f32 ThrmDutyCycle_ThermalLimit_MtrNm_f32 /end REF_MEASUREMENT
/end GROUP
/begin GROUP SF99.Inputs ""
 /begin REF_MEASUREMENT MtrCtrl_VM_EstR_Ohm_f32 MtrCtrl_VM_ExpIq_Amp_f32 MtrCtrl_VM_MRFMtrTrqCmdScl_MtrNm_f32 MtrVel_MRFMotorVel_MtrRadpS_f32 MtrCurr_VM_MtrCurrQax_Amp_f32 PwrLmtFunc_MtrEnvSpd_MtrRadpS_f32 MtrCtrl_VM_MtrQuad_Cnt_u08 PhaseDscnt_PDActivateTest_Cnt_lgc PhaseDscnt_PDPhaseAdvSelect_Cnt_s16 MtrCtrl_VM_TermA_Volt_f32 MtrCtrl_VM_TermBSS_Volt_f32 MtrCtrl_VM_TermBTOT_Volt_f32 MtrCtrl_VM_TermD_Volt_f32 MtrCtrl_VM_TermE_Volt_f32 MtrCtrl_VM_TermXd_Uls_f32 MtrCtrl_VM_TermXq_Uls_f32 MtrCtrl_VM_TermY_Uls_f32 MtrCurr_VM_ValidSampleFlag_Cnt_lgcValid /end REF_MEASUREMENT
/end GROUP
/begin GROUP FDD01B.Inputs "" /begin REF_MEASUREMENT MtrCtrl_VM_InstMtrDir_Cnt_s08 /end REF_MEASUREMENT /end GROUP
/begin GROUP FDD06B.Inputs ""
 /begin REF_MEASUREMENT MtrPos_MtrPos_MechMtrPos_Rev_G_u0p16 MtrVel_MRFMotorVel_MtrRadpS_f32 /end REF_MEASUREMENT
/end GROUP
/begin GROUP SF06.Inputs ""
 /begin REF_MEASUREMENT MtrCtrl_VM_EstPkCurr_AmpSq_f32 MtrVel_HandwheelVel_HwRadpS_f32 /end REF_MEASUREMENT
/end GROUP
/begin GROUP FDD02B.Inputs ""
 /begin REF_MEASUREMENT MtrPos_CumMtrPosMRF_Deg_f32 MtrVel_HandwheelVel_HwRadpS_f32 MtrVel_MRFMotorVel_MtrRadpS_f32 MtrPos_MtrPos_MechMtrPos_Rev_G_u0p16 MtrVel_SysC_DiagHandWheelVel_HwRadpS_f32 MtrVel_SysC_DiagMtrVel_MtrRadpS_f32 /end REF_MEASUREMENT
/end GROUP
/begin GROUP FDD40A.Inputs "" /begin REF_MEASUREMENT MtrVel_HandwheelVel_HwRadpS_f32 /end REF_MEASUREMENT /end GROUP
/begin GROUP FDD47.Inputs ""
 /begin REF_MEASUREMENT MtrCtrl_VM_MtrQuad_Cnt_u08 MtrVel_MRFMotorVel_MtrRadpS_f32 MtrCurr_VM_RawCurrFiltered_Amp_f32 /end REF_MEASUREMENT
/end GROUP
/begin GROUP SF20.Inputs "" /begin REF_MEASUREMENT MtrVel_CRFMotorVel_MtrRadpS_f32 /end REF_MEASUREMENT /end GROUP
/begin GROUP SF10.Inputs "" /begin REF_MEASUREMENT MtrVel_CRFMotorVel_MtrRadpS_f32 /end REF_MEASUREMENT /end GROUP
/begin GROUP SF02.Inputs "" /begin REF_MEASUREMENT MtrVel_HandwheelVel_HwRadpS_f32 /end REF_MEASUREMENT /end GROUP
/begin GROUP SF36.Inputs "" /begin REF_MEASUREMENT Return_ReturnCmd_MtrNm_f32 /end REF_MEASUREMENT /end GROUP
/begin GROUP FDD49.Inputs "" /begin REF_MEASUREMENT PhaseDscnt_PDActivateTest_Cnt_lgc /end REF_MEASUREMENT /end GROUP
/begin GROUP FDD15C.Inputs "" /begin REF_MEASUREMENT MtrCtrl_VM_PhsAdv_Cnt_s16 /end REF_MEASUREMENT /end GROUP
/begin GROUP SF09.Inputs ""
 /begin REF_MEASUREMENT MtrCtrl_VM_FiltEstPkCurr_AmpSq_f32 MtrVel_CRFMotorVel_MtrRadpS_f32 MtrCtrl_VM_EstPkCurr_AmpSq_f32 /end REF_MEASUREMENT
/end GROUP
/begin GROUP FDD20C.Inputs ""
 /begin REF_MEASUREMENT MtrPos_AlignedCumMtrPosMRF_Deg_f32 VehCfg_EnergyModeState_Cnt_enum MtrVel_MRFMotorVel_MtrRadpS_f32 /end REF_MEASUREMENT
/end GROUP
