/begin COMPU_VTAB_RANGE PhsDisCmd "" 4 0 2 "Invalid" 3 3 "On (50%)" 4 6 "Invalid" 7 65535 "Off" DEFAULT_VALUE "" /end COMPU_VTAB_RANGE
/begin COMPU_METHOD ad1_Sin2.CONVERSION "@@@@RuleName created by CANape" LINEAR "%3.1" "" COEFFS_LINEAR 0.001221001221 0 /end COMPU_METHOD
/begin COMPU_METHOD ad1_Cos2.CONVERSION "@@@@RuleName created by CANape" LINEAR "%3.1" "" COEFFS_LINEAR 0.001221001221 0 /end COMPU_METHOD
/begin COMPU_METHOD ad1_T2.CONVERSION "@@@@RuleName created by CANape" LINEAR "%3.1" "" COEFFS_LINEAR 0.001221001221 0 /end COMPU_METHOD
/begin COMPU_METHOD ad2_Sin1.CONVERSION "@@@@RuleName created by CANape" LINEAR "%3.1" "" COEFFS_LINEAR 0.001221001221 0 /end COMPU_METHOD
/begin COMPU_METHOD ad1_Batt.CONVERSION "@@@@RuleName created by CANape" LINEAR "%3.1" "" COEFFS_LINEAR 0.00823825 0 /end COMPU_METHOD
/begin COMPU_METHOD ad2_T1.CONVERSION "@@@@RuleName created by CANape" LINEAR "%3.1" "" COEFFS_LINEAR 0.001221001221 0 /end COMPU_METHOD
/begin COMPU_METHOD ad1_Vref.CONVERSION "@@@@RuleName created by CANape" LINEAR "%3.1" "" COEFFS_LINEAR 0.002442002442 0 /end COMPU_METHOD
/begin COMPU_METHOD ad2_Shcur2.CONVERSION "@@@@RuleName created by CANape" LINEAR "%3.1" "" COEFFS_LINEAR 0.001221001221 0 /end COMPU_METHOD
/begin COMPU_METHOD ad2_PhsFdbkA.CONVERSION "@@@@RuleName created by CANape" LINEAR "%3.1" "" COEFFS_LINEAR 0.001221001221 0 /end COMPU_METHOD
/begin COMPU_METHOD ad1_CtrlTemp.CONVERSION "@@@@RuleName created by CANape" LINEAR "%3.1" "" COEFFS_LINEAR 0.001221001221 0 /end COMPU_METHOD
/begin COMPU_METHOD ad1_BattSwtchd.CONVERSION "@@@@RuleName created by CANape" LINEAR "%3.1" "" COEFFS_LINEAR 0.004114369 0 /end COMPU_METHOD
/begin COMPU_METHOD ad2_PhsFdbkB.CONVERSION "@@@@RuleName created by CANape" LINEAR "%3.1" "" COEFFS_LINEAR 0.001221001221 0 /end COMPU_METHOD
/begin COMPU_METHOD ad2_Cos1.CONVERSION "@@@@RuleName created by CANape" LINEAR "%3.1" "" COEFFS_LINEAR 0.001221001221 0 /end COMPU_METHOD
/begin COMPU_METHOD ad2_Shcur.CONVERSION "@@@@RuleName created by CANape" LINEAR "%3.1" "" COEFFS_LINEAR 0.001221001221 0 /end COMPU_METHOD
/begin COMPU_METHOD ad1_T1.CONVERSION "@@@@RuleName created by CANape" LINEAR "%3.1" "" COEFFS_LINEAR 0.001221001221 0 /end COMPU_METHOD
/begin COMPU_METHOD ad1_Sin1.CONVERSION "@@@@RuleName created by CANape" LINEAR "%3.1" "" COEFFS_LINEAR 0.001221001221 0 /end COMPU_METHOD
/begin COMPU_METHOD ad2_T2.CONVERSION "@@@@RuleName created by CANape" LINEAR "%3.1" "" COEFFS_LINEAR 0.001221001221 0 /end COMPU_METHOD
/begin COMPU_METHOD ad2_PhsFdbkC.CONVERSION "@@@@RuleName created by CANape" LINEAR "%3.1" "" COEFFS_LINEAR 0.001221001221 0 /end COMPU_METHOD
/begin COMPU_METHOD ad1_Cos1.CONVERSION "@@@@RuleName created by CANape" LINEAR "%3.1" "" COEFFS_LINEAR 0.001221001221 0 /end COMPU_METHOD
/begin COMPU_VTAB PHASE_DSCNT_cmd.CONVERSION "@@@@RuleName created by CANape" TAB_VERB 2 384 "ON" 896 "OFF" DEFAULT_VALUE "OFF" /end COMPU_VTAB
/begin COMPU_METHOD PHASE_DSCNT_cmd.CONVERSION "@@@@RuleName created by CANape" TAB_VERB "%3.1" "" COMPU_TAB_REF PHASE_DSCNT_cmd.CONVERSION /end COMPU_METHOD
/begin CHARACTERISTIC AD1_ADEVSAMP "" VALUE 0xFFF7C060 __ULONG_S 0 NO_COMPU_METHOD 0 255 BIT_MASK 0xFFF FORMAT "%.15" /end CHARACTERISTIC
/begin CHARACTERISTIC AD2_ADBNDCR "" VALUE 0xFFF7C258 __ULONG_S 0 NO_COMPU_METHOD 0 4294967296 FORMAT "%.15" /end CHARACTERISTIC
/begin CHARACTERISTIC AD2_ADBNDEND "" VALUE 0xFFF7C25C __ULONG_S 0 NO_COMPU_METHOD 0 4294967296 FORMAT "%.15" /end CHARACTERISTIC
/begin CHARACTERISTIC AD2_ADCALCR "" VALUE 0xFFF7C20C __ULONG_S 0 NO_COMPU_METHOD 0 4294967296 FORMAT "%.15" /end CHARACTERISTIC
/begin CHARACTERISTIC AD2_ADCALR "" VALUE 0xFFF7C284 __ULONG_S 0 NO_COMPU_METHOD 0 4294967296 FORMAT "%.15" /end CHARACTERISTIC
/begin CHARACTERISTIC AD2_ADCLOCKCR "" VALUE 0xFFF7C208 __ULONG_S 0 NO_COMPU_METHOD 0 4294967296 FORMAT "%.15" /end CHARACTERISTIC
/begin CHARACTERISTIC AD2_ADEVBUFFER1 "" VALUE 0xFFF7C290 __ULONG_S 0 NO_COMPU_METHOD 0 4294967296 FORMAT "%.15" /end CHARACTERISTIC
/begin CHARACTERISTIC AD2_ADEVBUFFER2 "" VALUE 0xFFF7C294 __ULONG_S 0 NO_COMPU_METHOD 0 4294967296 FORMAT "%.15" /end CHARACTERISTIC
/begin CHARACTERISTIC AD2_ADEVBUFFER3 "" VALUE 0xFFF7C298 __ULONG_S 0 NO_COMPU_METHOD 0 4294967296 FORMAT "%.15" /end CHARACTERISTIC
/begin CHARACTERISTIC AD2_ADEVBUFFER4 "" VALUE 0xFFF7C29C __ULONG_S 0 NO_COMPU_METHOD 0 4294967296 FORMAT "%.15" /end CHARACTERISTIC
/begin CHARACTERISTIC AD2_ADEVBUFFER5 "" VALUE 0xFFF7C2A0 __ULONG_S 0 NO_COMPU_METHOD 0 4294967296 FORMAT "%.15" /end CHARACTERISTIC
/begin CHARACTERISTIC AD2_ADEVBUFFER6 "" VALUE 0xFFF7C2A4 __ULONG_S 0 NO_COMPU_METHOD 0 4294967296 FORMAT "%.15" /end CHARACTERISTIC
/begin CHARACTERISTIC AD2_ADEVBUFFER7 "" VALUE 0xFFF7C2A8 __ULONG_S 0 NO_COMPU_METHOD 0 4294967296 FORMAT "%.15" /end CHARACTERISTIC
/begin CHARACTERISTIC AD2_ADEVBUFFER8 "" VALUE 0xFFF7C2AC __ULONG_S 0 NO_COMPU_METHOD 0 4294967296 FORMAT "%.15" /end CHARACTERISTIC
/begin CHARACTERISTIC AD2_ADEVDMACR "" VALUE 0xFFF7C24C __ULONG_S 0 NO_COMPU_METHOD 0 4294967296 FORMAT "%.15" /end CHARACTERISTIC
/begin CHARACTERISTIC AD2_ADEVEMUBUFFER "" VALUE 0xFFF7C2F0 __ULONG_S 0 NO_COMPU_METHOD 0 4294967296 FORMAT "%.15" /end CHARACTERISTIC
/begin CHARACTERISTIC AD2_ADEVFIFORESETCR "" VALUE 0xFFF7C368 __ULONG_S 0 NO_COMPU_METHOD 0 4294967296 FORMAT "%.15" /end CHARACTERISTIC
/begin CHARACTERISTIC AD2_ADEVINTCR "" VALUE 0xFFF7C240 __ULONG_S 0 NO_COMPU_METHOD 0 4294967296 FORMAT "%.15" /end CHARACTERISTIC
/begin CHARACTERISTIC AD2_ADEVINTENA "" VALUE 0xFFF7C228 __ULONG_S 0 NO_COMPU_METHOD 0 4294967296 FORMAT "%.15" /end CHARACTERISTIC
/begin CHARACTERISTIC AD2_ADEVINTFLG "" VALUE 0xFFF7C234 __ULONG_S 0 NO_COMPU_METHOD 0 4294967296 FORMAT "%.15" /end CHARACTERISTIC
/begin CHARACTERISTIC AD2_ADEVMODECR "" VALUE 0xFFF7C210 __ULONG_S 0 NO_COMPU_METHOD 0 4294967296 FORMAT "%.15" /end CHARACTERISTIC
/begin CHARACTERISTIC AD2_ADEVRAMADDR "" VALUE 0xFFF7C374 __ULONG_S 0 NO_COMPU_METHOD 0 4294967296 FORMAT "%.15" /end CHARACTERISTIC
/begin CHARACTERISTIC AD2_ADEVSAMP "" VALUE 0xFFF7C260 __ULONG_S 0 NO_COMPU_METHOD 0 4294967296 BIT_MASK 0xFFF FORMAT "%.15" /end CHARACTERISTIC
/begin CHARACTERISTIC AD2_ADEVSAMPDISEN "" VALUE 0xFFF7C31C __ULONG_S 0 NO_COMPU_METHOD 0 4294967296 FORMAT "%.15" /end CHARACTERISTIC
/begin CHARACTERISTIC AD2_ADEVSEL "" VALUE 0xFFF7C278 __ULONG_S 0 NO_COMPU_METHOD 0 4294967296 FORMAT "%.15" /end CHARACTERISTIC
/begin CHARACTERISTIC AD2_ADEVSR "" VALUE 0xFFF7C26C __ULONG_S 0 NO_COMPU_METHOD 0 4294967296 FORMAT "%.15" /end CHARACTERISTIC
/begin CHARACTERISTIC AD2_ADEVSRC "" VALUE 0xFFF7C21C __ULONG_S 0 NO_COMPU_METHOD 0 4294967296 FORMAT "%.15" /end CHARACTERISTIC
/begin CHARACTERISTIC AD2_ADEVTCLR "" VALUE 0xFFF7C30C __ULONG_S 0 NO_COMPU_METHOD 0 4294967296 FORMAT "%.15" /end CHARACTERISTIC
/begin CHARACTERISTIC AD2_ADEVTDIR "" VALUE 0xFFF7C2FC __ULONG_S 0 NO_COMPU_METHOD 0 4294967296 FORMAT "%.15" /end CHARACTERISTIC
/begin CHARACTERISTIC AD2_ADEVTIN "" VALUE 0xFFF7C304 __ULONG_S 0 NO_COMPU_METHOD 0 4294967296 FORMAT "%.15" /end CHARACTERISTIC
/begin CHARACTERISTIC AD2_ADEVTOUT "" VALUE 0xFFF7C300 __ULONG_S 0 NO_COMPU_METHOD 0 4294967296 FORMAT "%.15" /end CHARACTERISTIC
/begin CHARACTERISTIC AD2_ADEVTPDIS "" VALUE 0xFFF7C314 __ULONG_S 0 NO_COMPU_METHOD 0 4294967296 FORMAT "%.15" /end CHARACTERISTIC
/begin CHARACTERISTIC AD2_ADEVTPDR "" VALUE 0xFFF7C310 __ULONG_S 0 NO_COMPU_METHOD 0 4294967296 FORMAT "%.15" /end CHARACTERISTIC
/begin CHARACTERISTIC AD2_ADEVTPSEL "" VALUE 0xFFF7C318 __ULONG_S 0 NO_COMPU_METHOD 0 4294967296 FORMAT "%.15" /end CHARACTERISTIC
/begin CHARACTERISTIC AD2_ADEVTSET "" VALUE 0xFFF7C308 __ULONG_S 0 NO_COMPU_METHOD 0 4294967296 FORMAT "%.15" /end CHARACTERISTIC
/begin CHARACTERISTIC AD2_ADG1BUFFER1 "" VALUE 0xFFF7C2B0 __ULONG_S 0 NO_COMPU_METHOD 0 4294967296 FORMAT "%.15" /end CHARACTERISTIC
/begin CHARACTERISTIC AD2_ADG1BUFFER2 "" VALUE 0xFFF7C2B4 __ULONG_S 0 NO_COMPU_METHOD 0 4294967296 FORMAT "%.15" /end CHARACTERISTIC
/begin CHARACTERISTIC AD2_ADG1BUFFER3 "" VALUE 0xFFF7C2B8 __ULONG_S 0 NO_COMPU_METHOD 0 4294967296 FORMAT "%.15" /end CHARACTERISTIC
/begin CHARACTERISTIC AD2_ADG1BUFFER4 "" VALUE 0xFFF7C2BC __ULONG_S 0 NO_COMPU_METHOD 0 4294967296 FORMAT "%.15" /end CHARACTERISTIC
/begin CHARACTERISTIC AD2_ADG1BUFFER5 "" VALUE 0xFFF7C2C0 __ULONG_S 0 NO_COMPU_METHOD 0 4294967296 FORMAT "%.15" /end CHARACTERISTIC
/begin CHARACTERISTIC AD2_ADG1BUFFER6 "" VALUE 0xFFF7C2C4 __ULONG_S 0 NO_COMPU_METHOD 0 4294967296 FORMAT "%.15" /end CHARACTERISTIC
/begin CHARACTERISTIC AD2_ADG1BUFFER7 "" VALUE 0xFFF7C2C8 __ULONG_S 0 NO_COMPU_METHOD 0 4294967296 FORMAT "%.15" /end CHARACTERISTIC
/begin CHARACTERISTIC AD2_ADG1BUFFER8 "" VALUE 0xFFF7C2CC __ULONG_S 0 NO_COMPU_METHOD 0 4294967296 FORMAT "%.15" /end CHARACTERISTIC
/begin CHARACTERISTIC AD2_ADG1DMACR "" VALUE 0xFFF7C250 __ULONG_S 0 NO_COMPU_METHOD 0 4294967296 FORMAT "%.15" /end CHARACTERISTIC
/begin CHARACTERISTIC AD2_ADG1EMUBUFFER "" VALUE 0xFFF7C2F4 __ULONG_S 0 NO_COMPU_METHOD 0 4294967296 FORMAT "%.15" /end CHARACTERISTIC
/begin CHARACTERISTIC AD2_ADG1FIFORESETCR "" VALUE 0xFFF7C36C __ULONG_S 0 NO_COMPU_METHOD 0 4294967296 FORMAT "%.15" /end CHARACTERISTIC
/begin CHARACTERISTIC AD2_ADG1INTCR "" VALUE 0xFFF7C244 __ULONG_S 0 NO_COMPU_METHOD 0 4294967296 FORMAT "%.15" /end CHARACTERISTIC
/begin CHARACTERISTIC AD2_ADG1INTENA "" VALUE 0xFFF7C22C __ULONG_S 0 NO_COMPU_METHOD 0 4294967296 FORMAT "%.15" /end CHARACTERISTIC
/begin CHARACTERISTIC AD2_ADG1INTFLG "" VALUE 0xFFF7C238 __ULONG_S 0 NO_COMPU_METHOD 0 4294967296 FORMAT "%.15" /end CHARACTERISTIC
/begin CHARACTERISTIC AD2_ADG1MODECR "" VALUE 0xFFF7C214 __ULONG_S 0 NO_COMPU_METHOD 0 4294967296 FORMAT "%.15" /end CHARACTERISTIC
/begin CHARACTERISTIC AD2_ADG1RAMADDR "" VALUE 0xFFF7C378 __ULONG_S 0 NO_COMPU_METHOD 0 4294967296 FORMAT "%.15" /end CHARACTERISTIC
/begin CHARACTERISTIC AD2_ADG1SAMP "" VALUE 0xFFF7C264 __ULONG_S 0 NO_COMPU_METHOD 0 4294967296 FORMAT "%.15" /end CHARACTERISTIC
/begin CHARACTERISTIC AD2_ADG1SAMPDISEN "" VALUE 0xFFF7C320 __ULONG_S 0 NO_COMPU_METHOD 0 4294967296 FORMAT "%.15" /end CHARACTERISTIC
/begin CHARACTERISTIC AD2_ADG1SEL "" VALUE 0xFFF7C27C __ULONG_S 0 NO_COMPU_METHOD 0 4294967296 FORMAT "%.15" /end CHARACTERISTIC
/begin CHARACTERISTIC AD2_ADG1SR "" VALUE 0xFFF7C270 __ULONG_S 0 NO_COMPU_METHOD 0 4294967296 FORMAT "%.15" /end CHARACTERISTIC
/begin CHARACTERISTIC AD2_ADG1SRC "" VALUE 0xFFF7C220 __ULONG_S 0 NO_COMPU_METHOD 0 4294967296 FORMAT "%.15" /end CHARACTERISTIC
/begin CHARACTERISTIC AD2_ADG2BUFFER1 "" VALUE 0xFFF7C2D0 __ULONG_S 0 NO_COMPU_METHOD 0 4294967296 FORMAT "%.15" /end CHARACTERISTIC
/begin CHARACTERISTIC AD2_ADG2BUFFER2 "" VALUE 0xFFF7C2D4 __ULONG_S 0 NO_COMPU_METHOD 0 4294967296 FORMAT "%.15" /end CHARACTERISTIC
/begin CHARACTERISTIC AD2_ADG2BUFFER3 "" VALUE 0xFFF7C2D8 __ULONG_S 0 NO_COMPU_METHOD 0 4294967296 FORMAT "%.15" /end CHARACTERISTIC
/begin CHARACTERISTIC AD2_ADG2BUFFER4 "" VALUE 0xFFF7C2DC __ULONG_S 0 NO_COMPU_METHOD 0 4294967296 FORMAT "%.15" /end CHARACTERISTIC
/begin CHARACTERISTIC AD2_ADG2BUFFER5 "" VALUE 0xFFF7C2E0 __ULONG_S 0 NO_COMPU_METHOD 0 4294967296 FORMAT "%.15" /end CHARACTERISTIC
/begin CHARACTERISTIC AD2_ADG2BUFFER6 "" VALUE 0xFFF7C2E4 __ULONG_S 0 NO_COMPU_METHOD 0 4294967296 FORMAT "%.15" /end CHARACTERISTIC
/begin CHARACTERISTIC AD2_ADG2BUFFER7 "" VALUE 0xFFF7C2E8 __ULONG_S 0 NO_COMPU_METHOD 0 4294967296 FORMAT "%.15" /end CHARACTERISTIC
/begin CHARACTERISTIC AD2_ADG2BUFFER8 "" VALUE 0xFFF7C2EC __ULONG_S 0 NO_COMPU_METHOD 0 4294967296 FORMAT "%.15" /end CHARACTERISTIC
/begin CHARACTERISTIC AD2_ADG2DMACR "" VALUE 0xFFF7C254 __ULONG_S 0 NO_COMPU_METHOD 0 4294967296 FORMAT "%.15" /end CHARACTERISTIC
/begin CHARACTERISTIC AD2_ADG2EMUBUFFER "" VALUE 0xFFF7C2F8 __ULONG_S 0 NO_COMPU_METHOD 0 4294967296 FORMAT "%.15" /end CHARACTERISTIC
/begin CHARACTERISTIC AD2_ADG2FIFORESETCR "" VALUE 0xFFF7C370 __ULONG_S 0 NO_COMPU_METHOD 0 4294967296 FORMAT "%.15" /end CHARACTERISTIC
/begin CHARACTERISTIC AD2_ADG2INTCR "" VALUE 0xFFF7C248 __ULONG_S 0 NO_COMPU_METHOD 0 4294967296 FORMAT "%.15" /end CHARACTERISTIC
/begin CHARACTERISTIC AD2_ADG2INTENA "" VALUE 0xFFF7C230 __ULONG_S 0 NO_COMPU_METHOD 0 4294967296 FORMAT "%.15" /end CHARACTERISTIC
/begin CHARACTERISTIC AD2_ADG2INTFLG "" VALUE 0xFFF7C23C __ULONG_S 0 NO_COMPU_METHOD 0 4294967296 FORMAT "%.15" /end CHARACTERISTIC
/begin CHARACTERISTIC AD2_ADG2MODECR "" VALUE 0xFFF7C218 __ULONG_S 0 NO_COMPU_METHOD 0 4294967296 FORMAT "%.15" /end CHARACTERISTIC
/begin CHARACTERISTIC AD2_ADG2RAMADDR "" VALUE 0xFFF7C37C __ULONG_S 0 NO_COMPU_METHOD 0 4294967296 FORMAT "%.15" /end CHARACTERISTIC
/begin CHARACTERISTIC AD2_ADG2SAMP "" VALUE 0xFFF7C268 __ULONG_S 0 NO_COMPU_METHOD 0 4294967296 FORMAT "%.15" /end CHARACTERISTIC
/begin CHARACTERISTIC AD2_ADG2SAMPDISEN "" VALUE 0xFFF7C324 __ULONG_S 0 NO_COMPU_METHOD 0 4294967296 FORMAT "%.15" /end CHARACTERISTIC
/begin CHARACTERISTIC AD2_ADG2SEL "" VALUE 0xFFF7C280 __ULONG_S 0 NO_COMPU_METHOD 0 4294967296 FORMAT "%.15" /end CHARACTERISTIC
/begin CHARACTERISTIC AD2_ADG2SR "" VALUE 0xFFF7C274 __ULONG_S 0 NO_COMPU_METHOD 0 4294967296 FORMAT "%.15" /end CHARACTERISTIC
/begin CHARACTERISTIC AD2_ADG2SRC "" VALUE 0xFFF7C224 __ULONG_S 0 NO_COMPU_METHOD 0 4294967296 FORMAT "%.15" /end CHARACTERISTIC
/begin CHARACTERISTIC AD2_ADLASTCONV "" VALUE 0xFFF7C28C __ULONG_S 0 NO_COMPU_METHOD 0 4294967296 FORMAT "%.15" /end CHARACTERISTIC
/begin CHARACTERISTIC AD2_ADMAGINT1MASK "" VALUE 0xFFF7C32C __ULONG_S 0 NO_COMPU_METHOD 0 4294967296 FORMAT "%.15" /end CHARACTERISTIC
/begin CHARACTERISTIC AD2_ADMAGINT2MASK "" VALUE 0xFFF7C334 __ULONG_S 0 NO_COMPU_METHOD 0 4294967296 FORMAT "%.15" /end CHARACTERISTIC
/begin CHARACTERISTIC AD2_ADMAGINT3MASK "" VALUE 0xFFF7C33C __ULONG_S 0 NO_COMPU_METHOD 0 4294967296 FORMAT "%.15" /end CHARACTERISTIC
/begin CHARACTERISTIC AD2_ADMAGINTCR1 "" VALUE 0xFFF7C328 __ULONG_S 0 NO_COMPU_METHOD 0 4294967296 FORMAT "%.15" /end CHARACTERISTIC
/begin CHARACTERISTIC AD2_ADMAGINTCR2 "" VALUE 0xFFF7C330 __ULONG_S 0 NO_COMPU_METHOD 0 4294967296 FORMAT "%.15" /end CHARACTERISTIC
/begin CHARACTERISTIC AD2_ADMAGINTCR3 "" VALUE 0xFFF7C338 __ULONG_S 0 NO_COMPU_METHOD 0 4294967296 FORMAT "%.15" /end CHARACTERISTIC
/begin CHARACTERISTIC AD2_ADMAGINTENACLR "" VALUE 0xFFF7C35C __ULONG_S 0 NO_COMPU_METHOD 0 4294967296 FORMAT "%.15" /end CHARACTERISTIC
/begin CHARACTERISTIC AD2_ADMAGTHRINTENASET "" VALUE 0xFFF7C358 __ULONG_S 0 NO_COMPU_METHOD 0 4294967296 FORMAT "%.15" /end CHARACTERISTIC
/begin CHARACTERISTIC AD2_ADMAGTHRINTFLG "" VALUE 0xFFF7C360 __ULONG_S 0 NO_COMPU_METHOD 0 4294967296 FORMAT "%.15" /end CHARACTERISTIC
/begin CHARACTERISTIC AD2_ADMAGTHRINTOFFSET "" VALUE 0xFFF7C364 __ULONG_S 0 NO_COMPU_METHOD 0 4294967296 FORMAT "%.15" /end CHARACTERISTIC
/begin CHARACTERISTIC AD2_ADOPMODECR "" VALUE 0xFFF7C204 __ULONG_S 0 NO_COMPU_METHOD 0 4294967296 FORMAT "%.15" /end CHARACTERISTIC
/begin CHARACTERISTIC AD2_ADPARADDR "" VALUE 0xFFF7C384 __ULONG_S 0 NO_COMPU_METHOD 0 4294967296 FORMAT "%.15" /end CHARACTERISTIC
/begin CHARACTERISTIC AD2_ADPARCR "" VALUE 0xFFF7C380 __ULONG_S 0 NO_COMPU_METHOD 0 4294967296 FORMAT "%.15" /end CHARACTERISTIC
/begin CHARACTERISTIC AD2_ADPWRUPDLYCTRL "" VALUE 0xFFF7C388 __ULONG_S 0 NO_COMPU_METHOD 0 4294967296 FORMAT "%.15" /end CHARACTERISTIC
/begin CHARACTERISTIC AD2_ADRSTCR "" VALUE 0xFFF7C200 __ULONG_S 0 NO_COMPU_METHOD 0 4294967296 FORMAT "%.15" /end CHARACTERISTIC
/begin CHARACTERISTIC AD2_ADSMSTATE "" VALUE 0xFFF7C288 __ULONG_S 0 NO_COMPU_METHOD 0 4294967296 FORMAT "%.15" /end CHARACTERISTIC
/begin MEASUREMENT ADEVTIN1 "offset 0x104" ULONG NO_COMPU_METHOD 0 0 0 255 ECU_ADDRESS 0xFFF7C104 FORMAT "%.15" /end MEASUREMENT
/begin MEASUREMENT CLKTEST "" ULONG NO_COMPU_METHOD 0 0 0 255 ECU_ADDRESS 0xFFFFFF8C FORMAT "%.15" /end MEASUREMENT
/begin MEASUREMENT CRC_BCTOPLD1 "" ULONG NO_COMPU_METHOD 0 0 0 255 BYTE_ORDER MSB_FIRST ECU_ADDRESS 0xFE000050 FORMAT "%.15" /end MEASUREMENT
/begin MEASUREMENT CRC_BCTOPLD2 "" ULONG NO_COMPU_METHOD 0 0 0 255 BYTE_ORDER MSB_FIRST ECU_ADDRESS 0xFE000090 FORMAT "%.15" /end MEASUREMENT
/begin MEASUREMENT CRC_BCTOPLD3 "" ULONG NO_COMPU_METHOD 0 0 0 255 BYTE_ORDER MSB_FIRST ECU_ADDRESS 0xFE0000D0 FORMAT "%.15" /end MEASUREMENT
/begin MEASUREMENT CRC_BUSY "" ULONG NO_COMPU_METHOD 0 0 0 255 BYTE_ORDER MSB_FIRST ECU_ADDRESS 0xFE000038 FORMAT "%.15" /end MEASUREMENT
/begin MEASUREMENT CRC_CTRL0 "" ULONG NO_COMPU_METHOD 0 0 0 255 BYTE_ORDER MSB_FIRST ECU_ADDRESS 0xFE000000 FORMAT "%.15" /end MEASUREMENT
/begin MEASUREMENT CRC_CTRL1 "" ULONG NO_COMPU_METHOD 0 0 0 255 BYTE_ORDER MSB_FIRST ECU_ADDRESS 0xFE000008 FORMAT "%.15" /end MEASUREMENT
/begin MEASUREMENT CRC_CTRL2 "" ULONG NO_COMPU_METHOD 0 0 0 255 BYTE_ORDER MSB_FIRST ECU_ADDRESS 0xFE000010 FORMAT "%.15" /end MEASUREMENT
/begin MEASUREMENT CRC_CURSEC_REG1 "" ULONG NO_COMPU_METHOD 0 0 0 255 BYTE_ORDER MSB_FIRST ECU_ADDRESS 0xFE000048 FORMAT "%.15" /end MEASUREMENT
/begin MEASUREMENT CRC_CURSEC_REG2 "" ULONG NO_COMPU_METHOD 0 0 0 255 BYTE_ORDER MSB_FIRST ECU_ADDRESS 0xFE000088 FORMAT "%.15" /end MEASUREMENT
/begin MEASUREMENT CRC_CURSEC_REG3 "" ULONG NO_COMPU_METHOD 0 0 0 255 BYTE_ORDER MSB_FIRST ECU_ADDRESS 0xFE0000C8 FORMAT "%.15" /end MEASUREMENT
/begin MEASUREMENT CRC_INTR "" ULONG NO_COMPU_METHOD 0 0 0 255 BYTE_ORDER MSB_FIRST ECU_ADDRESS 0xFE000020 FORMAT "%.15" /end MEASUREMENT
/begin MEASUREMENT CRC_INTS "" ULONG NO_COMPU_METHOD 0 0 0 255 BYTE_ORDER MSB_FIRST ECU_ADDRESS 0xFE000018 FORMAT "%.15" /end MEASUREMENT
/begin MEASUREMENT CRC_PCOUNT_REG1 "" ULONG NO_COMPU_METHOD 0 0 0 255 BYTE_ORDER MSB_FIRST ECU_ADDRESS 0xFE000040 FORMAT "%.15" /end MEASUREMENT
/begin MEASUREMENT CRC_PCOUNT_REG2 "" ULONG NO_COMPU_METHOD 0 0 0 255 BYTE_ORDER MSB_FIRST ECU_ADDRESS 0xFE000080 FORMAT "%.15" /end MEASUREMENT
/begin MEASUREMENT CRC_PCOUNT_REG3 "" ULONG NO_COMPU_METHOD 0 0 0 255 BYTE_ORDER MSB_FIRST ECU_ADDRESS 0xFE0000C0 FORMAT "%.15" /end MEASUREMENT
/begin MEASUREMENT CRC_REGH1 "" ULONG NO_COMPU_METHOD 0 0 0 255 BYTE_ORDER MSB_FIRST ECU_ADDRESS 0xFE00006C FORMAT "%.15" /end MEASUREMENT
/begin MEASUREMENT CRC_REGH2 "" ULONG NO_COMPU_METHOD 0 0 0 255 BYTE_ORDER MSB_FIRST ECU_ADDRESS 0xFE0000AC FORMAT "%.15" /end MEASUREMENT
/begin MEASUREMENT CRC_REGH3 "" ULONG NO_COMPU_METHOD 0 0 0 255 BYTE_ORDER MSB_FIRST ECU_ADDRESS 0xFE0000EC FORMAT "%.15" /end MEASUREMENT
/begin MEASUREMENT CRC_REGL1 "" ULONG NO_COMPU_METHOD 0 0 0 255 BYTE_ORDER MSB_FIRST ECU_ADDRESS 0xFE000068 FORMAT "%.15" /end MEASUREMENT
/begin MEASUREMENT CRC_REGL2 "" ULONG NO_COMPU_METHOD 0 0 0 255 BYTE_ORDER MSB_FIRST ECU_ADDRESS 0xFE0000A8 FORMAT "%.15" /end MEASUREMENT
/begin MEASUREMENT CRC_REGL3 "" ULONG NO_COMPU_METHOD 0 0 0 255 BYTE_ORDER MSB_FIRST ECU_ADDRESS 0xFE0000E8 FORMAT "%.15" /end MEASUREMENT
/begin MEASUREMENT CRC_SCOUNT_REG1 "" ULONG NO_COMPU_METHOD 0 0 0 255 BYTE_ORDER MSB_FIRST ECU_ADDRESS 0xFE000044 FORMAT "%.15" /end MEASUREMENT
/begin MEASUREMENT CRC_SCOUNT_REG2 "" ULONG NO_COMPU_METHOD 0 0 0 255 BYTE_ORDER MSB_FIRST ECU_ADDRESS 0xFE000084 FORMAT "%.15" /end MEASUREMENT
/begin MEASUREMENT CRC_SCOUNT_REG3 "" ULONG NO_COMPU_METHOD 0 0 0 255 BYTE_ORDER MSB_FIRST ECU_ADDRESS 0xFE0000C4 FORMAT "%.15" /end MEASUREMENT
/begin MEASUREMENT CRC_STATUS "" ULONG NO_COMPU_METHOD 0 0 0 255 BYTE_ORDER MSB_FIRST ECU_ADDRESS 0xFE000028 FORMAT "%.15" /end MEASUREMENT
/begin MEASUREMENT CRC_WDTOPLD1 "" ULONG NO_COMPU_METHOD 0 0 0 255 BYTE_ORDER MSB_FIRST ECU_ADDRESS 0xFE00004C FORMAT "%.15" /end MEASUREMENT
/begin MEASUREMENT CRC_WDTOPLD2 "" ULONG NO_COMPU_METHOD 0 0 0 255 BYTE_ORDER MSB_FIRST ECU_ADDRESS 0xFE00008C FORMAT "%.15" /end MEASUREMENT
/begin MEASUREMENT CRC_WDTOPLD3 "" ULONG NO_COMPU_METHOD 0 0 0 255 BYTE_ORDER MSB_FIRST ECU_ADDRESS 0xFE0000CC FORMAT "%.15" /end MEASUREMENT
/begin MEASUREMENT DCAN3_RIOC "Base 0xFFF7E000, offset 0x1E4" ULONG NO_COMPU_METHOD 0 0 0 255 ECU_ADDRESS 0xFFF7E1E4 FORMAT "%.15" /end MEASUREMENT
/begin MEASUREMENT DCAN3_TIOC "Base 0xFFF7E000, offset 0x1E0" ULONG NO_COMPU_METHOD 0 0 0 255 ECU_ADDRESS 0xFFF7E1E0 FORMAT "%.15" /end MEASUREMENT
/begin MEASUREMENT DSP_EPS_EN "R230 CCA" ULONG NO_COMPU_METHOD 0 0 0 1 BIT_MASK 0x1 ECU_ADDRESS 0xFFF7C104 FORMAT "%.15" DISCRETE /end MEASUREMENT
/begin MEASUREMENT DSP_TOD "I220 CCA" ULONG NO_COMPU_METHOD 0 0 0 1 BIT_MASK 0x20 ECU_ADDRESS 0xFFF7BC38 FORMAT "%.15" PHYS_UNIT "" DISCRETE /end MEASUREMENT
/begin MEASUREMENT ESMEKR "" ULONG NO_COMPU_METHOD 0 0 0 255 ECU_ADDRESS 0xFFFFF538 FORMAT "%.15" /end MEASUREMENT
/begin MEASUREMENT ESMEPSR "" ULONG NO_COMPU_METHOD 0 0 0 255 ECU_ADDRESS 0xFFFFF524 FORMAT "%.15" /end MEASUREMENT
/begin MEASUREMENT ESMSR1 "" ULONG NO_COMPU_METHOD 0 0 0 255 ECU_ADDRESS 0xFFFFF518 FORMAT "%.15" /end MEASUREMENT
/begin MEASUREMENT ESMSR2 "" ULONG NO_COMPU_METHOD 0 0 0 255 ECU_ADDRESS 0xFFFFF51C FORMAT "%.15" /end MEASUREMENT
/begin MEASUREMENT ESMSR3 "" ULONG NO_COMPU_METHOD 0 0 0 255 ECU_ADDRESS 0xFFFFF520 FORMAT "%.15" /end MEASUREMENT
/begin MEASUREMENT FET_DRV_CNTL "R230 CCA" ULONG NO_COMPU_METHOD 0 0 0 1 BIT_MASK 0x200 ECU_ADDRESS 0xFFF7B850 FORMAT "%.15" DISCRETE /end MEASUREMENT
/begin MEASUREMENT FET_DRV_RESET "R230 CCA" ULONG NO_COMPU_METHOD 0 0 0 1 BIT_MASK 0x40 ECU_ADDRESS 0xFFF7BC38 FORMAT "%.15" DISCRETE /end MEASUREMENT
/begin MEASUREMENT FET_DRV_RESET_cmd "" ULONG NO_COMPU_METHOD 0 0 0 1 READ_WRITE BIT_MASK 0x80000 ECU_ADDRESS 0xFFF7FC20 FORMAT "%.15" /end MEASUREMENT
/begin MEASUREMENT FF1_DATA "I220 CCA" ULONG NO_COMPU_METHOD 0 0 0 1 BIT_MASK 0x40 ECU_ADDRESS 0xFFF7BC38 FORMAT "%.15" DISCRETE /end MEASUREMENT
/begin MEASUREMENT FF2_CLK "R230 CCA" ULONG NO_COMPU_METHOD 0 0 0 1 BIT_MASK 0x10000 ECU_ADDRESS 0xFFF7FC1C FORMAT "%.15" DISCRETE /end MEASUREMENT
/begin MEASUREMENT FR_ERRn "R230 CCA" ULONG NO_COMPU_METHOD 0 0 0 1 BIT_MASK 0x4000 ECU_ADDRESS 0xFFF7B850 FORMAT "%.15" DISCRETE /end MEASUREMENT
/begin MEASUREMENT GIODINA "" ULONG NO_COMPU_METHOD 0 0 0 255 BYTE_ORDER MSB_FIRST ECU_ADDRESS 0xFFF7BC38 FORMAT "%.15" /end MEASUREMENT
/begin MEASUREMENT GIODIRA "" ULONG NO_COMPU_METHOD 0 0 0 255 READ_WRITE BYTE_ORDER MSB_FIRST ECU_ADDRESS 0xFFF7BC34 FORMAT "%.15" /end MEASUREMENT
/begin MEASUREMENT GIODOUTA "" ULONG NO_COMPU_METHOD 0 0 0 255 READ_WRITE BYTE_ORDER MSB_FIRST ECU_ADDRESS 0xFFF7BC3C FORMAT "%.15" /end MEASUREMENT
/begin MEASUREMENT GIODSETA "" ULONG NO_COMPU_METHOD 0 0 0 255 READ_WRITE BYTE_ORDER MSB_FIRST ECU_ADDRESS 0xFFF7BC40 FORMAT "%.15" /end MEASUREMENT
/begin MEASUREMENT GIOEMUA "" ULONG NO_COMPU_METHOD 0 0 0 255 BYTE_ORDER MSB_FIRST ECU_ADDRESS 0xFFF7BC2C FORMAT "%.15" /end MEASUREMENT
/begin MEASUREMENT GIOOFFA "" ULONG NO_COMPU_METHOD 0 0 0 255 BYTE_ORDER MSB_FIRST ECU_ADDRESS 0xFFF7BC24 FORMAT "%.15" /end MEASUREMENT
/begin MEASUREMENT GIOPDRA "" ULONG NO_COMPU_METHOD 0 0 0 255 BYTE_ORDER MSB_FIRST ECU_ADDRESS 0xFFF7BC48 FORMAT "%.15" /end MEASUREMENT
/begin MEASUREMENT GIOPSLA "" ULONG NO_COMPU_METHOD 0 0 0 255 BYTE_ORDER MSB_FIRST ECU_ADDRESS 0xFFF7BC50 FORMAT "%.15" /end MEASUREMENT
/begin MEASUREMENT GIOPULDISA "" ULONG NO_COMPU_METHOD 0 0 0 255 BYTE_ORDER MSB_FIRST ECU_ADDRESS 0xFFF7BC4C FORMAT "%.15" /end MEASUREMENT
/begin MEASUREMENT HETGCR "" ULONG NO_COMPU_METHOD 0 0 0 255 ECU_ADDRESS 0xFFF7B800 FORMAT "%.15" /end MEASUREMENT
/begin MEASUREMENT HETGCR_2 "" ULONG NO_COMPU_METHOD 0 0 0 255 ECU_ADDRESS 0xFFF7B900 FORMAT "%.15" /end MEASUREMENT
/begin MEASUREMENT N2HET_1_Prog "" ULONG NO_COMPU_METHOD 0 0 0 4294967295 READ_WRITE ECU_ADDRESS 0xFF460000 FORMAT "%.15" MATRIX_DIM 4 128 1 LAYOUT ROW_DIR /end MEASUREMENT
/begin MEASUREMENT N2HET_2_Prog "" ULONG NO_COMPU_METHOD 0 0 0 4294967295 READ_WRITE ECU_ADDRESS 0xFF440000 FORMAT "%.15" MATRIX_DIM 4 128 1 LAYOUT ROW_DIR /end MEASUREMENT
/begin MEASUREMENT PCSPWRDWNCLR0 "0: Read– The peripheral memory clock[31–0] is active.
Write– The bit is unchanged.

1: Read– The peripheral memory clock[31–0] is inactive.
Write– The bit in the PCSPWRDWNSET1 and
PCSPWRDWNCLR1 reg is cleared to 0." ULONG NO_COMPU_METHOD 0 0 0 255 BYTE_ORDER MSB_FIRST ECU_ADDRESS 0xFFFFE070 FORMAT "%.15" /end MEASUREMENT
/begin MEASUREMENT PCSPWRDWNCLR1 "0: Read– The peripheral memory clock[63–32] is active.
Write– The bit is unchanged.

1: Read– The peripheral memory clock[63–32] is inactive.
Write– The bit in the PCSPWRDWNSET1 and
PCSPWRDWNCLR1 reg is cleared to 0." ULONG NO_COMPU_METHOD 0 0 0 255 BYTE_ORDER MSB_FIRST ECU_ADDRESS 0xFFFFE074 FORMAT "%.15" /end MEASUREMENT
/begin MEASUREMENT PCSPWRDWNSET0 "0: Read– The peripheral memory clock[31–0] is active.
Write– The bit is unchanged.

1: Read– The peripheral memory clock[31–0] is inactive.
Write– The bit in the PCSPWRDWNSET1 and
PCSPWRDWNCLR1 reg is cleared to 1." ULONG NO_COMPU_METHOD 0 0 0 255 BYTE_ORDER MSB_FIRST ECU_ADDRESS 0xFFFFE060 FORMAT "%.15" /end MEASUREMENT
/begin MEASUREMENT PCSPWRDWNSET1 "0: Read– The peripheral memory clock[63–32] is active.
Write– The bit is unchanged.

1: Read– The peripheral memory clock[63–32] is inactive.
Write– The bit in the PCSPWRDWNSET1 and
PCSPWRDWNCLR1 reg is cleared to 1." ULONG NO_COMPU_METHOD 0 0 0 255 BYTE_ORDER MSB_FIRST ECU_ADDRESS 0xFFFFE064 FORMAT "%.15" /end MEASUREMENT
/begin MEASUREMENT PEADR "" ULONG NO_COMPU_METHOD 0 0 0 255 ECU_ADDRESS 0xFFF7A070 FORMAT "%.15" /end MEASUREMENT
/begin MEASUREMENT PHASE_DSCNT "R230 CCA" ULONG NO_COMPU_METHOD 0 0 0 1 BIT_MASK 0x40000000 ECU_ADDRESS 0xFFF7B850 FORMAT "%.15" DISCRETE /end MEASUREMENT
/begin MEASUREMENT PHASE_DSCNT_cmd "Base address of NHET RAM is 0xFF460000.  The instruction for phase disconect is at index 118(0x76).  The length of an instruction is 0x10, which provides an offset of 0x760.  The data field is a uint32 that has an offset fo 0x08.  Total offset is 0x768." ULONG PHASE_DSCNT_cmd.CONVERSION 0 0 384 896 ECU_ADDRESS 0xFF460768 FORMAT "%.15" /end MEASUREMENT
/begin CHARACTERISTIC PINMMRx "Base Address 0xFFFFEA00, offset 0x110" VAL_BLK 0xFFFFEB10 __ULONG_Z 0 NO_COMPU_METHOD 0 255 READ_ONLY MATRIX_DIM 1 31 1 FORMAT "%.15" /end CHARACTERISTIC
/begin MEASUREMENT PLLCTL1 "" ULONG NO_COMPU_METHOD 0 0 0 255 BYTE_ORDER MSB_FIRST ECU_ADDRESS 0xFFFFFF70 FORMAT "%.15" /end MEASUREMENT
/begin MEASUREMENT PLLCTL2 "" ULONG NO_COMPU_METHOD 0 0 0 255 BYTE_ORDER MSB_FIRST ECU_ADDRESS 0xFFFFFF74 FORMAT "%.15" /end MEASUREMENT
/begin MEASUREMENT PLLCTL3 "" ULONG NO_COMPU_METHOD 0 0 0 255 BYTE_ORDER MSB_FIRST ECU_ADDRESS 0xFFFFE100 FORMAT "%.15" /end MEASUREMENT
/begin MEASUREMENT PSA_SECSIGREGH1 "" ULONG NO_COMPU_METHOD 0 0 0 255 BYTE_ORDER MSB_FIRST ECU_ADDRESS 0xFE000074 FORMAT "%.15" /end MEASUREMENT
/begin MEASUREMENT PSA_SECSIGREGH2 "" ULONG NO_COMPU_METHOD 0 0 0 255 BYTE_ORDER MSB_FIRST ECU_ADDRESS 0xFE0000B4 FORMAT "%.15" /end MEASUREMENT
/begin MEASUREMENT PSA_SECSIGREGH3 "" ULONG NO_COMPU_METHOD 0 0 0 255 BYTE_ORDER MSB_FIRST ECU_ADDRESS 0xFE0000F4 FORMAT "%.15" /end MEASUREMENT
/begin MEASUREMENT PSA_SECSIGREGL1 "" ULONG NO_COMPU_METHOD 0 0 0 255 BYTE_ORDER MSB_FIRST ECU_ADDRESS 0xFE000070 FORMAT "%.15" /end MEASUREMENT
/begin MEASUREMENT PSA_SECSIGREGL2 "" ULONG NO_COMPU_METHOD 0 0 0 255 BYTE_ORDER MSB_FIRST ECU_ADDRESS 0xFE0000B0 FORMAT "%.15" /end MEASUREMENT
/begin MEASUREMENT PSA_SECSIGREGL3 "" ULONG NO_COMPU_METHOD 0 0 0 255 BYTE_ORDER MSB_FIRST ECU_ADDRESS 0xFE0000F0 FORMAT "%.15" /end MEASUREMENT
/begin MEASUREMENT PSA_SIGREGH1 "" ULONG NO_COMPU_METHOD 0 0 0 255 BYTE_ORDER MSB_FIRST ECU_ADDRESS 0xFE000064 FORMAT "%.15" /end MEASUREMENT
/begin MEASUREMENT PSA_SIGREGH2 "" ULONG NO_COMPU_METHOD 0 0 0 255 BYTE_ORDER MSB_FIRST ECU_ADDRESS 0xFE0000A4 FORMAT "%.15" /end MEASUREMENT
/begin MEASUREMENT PSA_SIGREGH3 "" ULONG NO_COMPU_METHOD 0 0 0 255 BYTE_ORDER MSB_FIRST ECU_ADDRESS 0xFE0000E4 FORMAT "%.15" /end MEASUREMENT
/begin MEASUREMENT PSA_SIGREGL1 "" ULONG NO_COMPU_METHOD 0 0 0 255 BYTE_ORDER MSB_FIRST ECU_ADDRESS 0xFE000060 FORMAT "%.15" /end MEASUREMENT
/begin MEASUREMENT PSA_SIGREGL2 "" ULONG NO_COMPU_METHOD 0 0 0 255 BYTE_ORDER MSB_FIRST ECU_ADDRESS 0xFE0000A0 FORMAT "%.15" /end MEASUREMENT
/begin MEASUREMENT PSA_SIGREGL3 "" ULONG NO_COMPU_METHOD 0 0 0 255 BYTE_ORDER MSB_FIRST ECU_ADDRESS 0xFE0000E0 FORMAT "%.15" /end MEASUREMENT
/begin MEASUREMENT PSPWRDWNCLR0 "0: Read– The clock to the peripheral select quadrant is active.
Write– The bit is unchanged.

1: Read– The clock to the peripheral select quadrant is inactive.
Write– The corresponding bit in PSPWRDWNSET0 and
PSPWRDWNCLR0 registers is cleared to 0." ULONG NO_COMPU_METHOD 0 0 0 255 BYTE_ORDER MSB_FIRST ECU_ADDRESS 0xFFFFE0A0 FORMAT "%.15" /end MEASUREMENT
/begin MEASUREMENT PSPWRDWNCLR1 "0: Read– The clock to the peripheral select quadrant is active.
Write– The bit is unchanged.

1: Read– The clock to the peripheral select quadrant is inactive.
Write– The corresponding bit in PSPWRDWNSET0 and
PSPWRDWNCLR0 registers is cleared to 0." ULONG NO_COMPU_METHOD 0 0 0 255 BYTE_ORDER MSB_FIRST ECU_ADDRESS 0xFFFFE0A4 FORMAT "%.15" /end MEASUREMENT
/begin MEASUREMENT PSPWRDWNCLR2 "0: Read– The clock to the peripheral select quadrant is active.
Write– The bit is unchanged.

1: Read– The clock to the peripheral select quadrant is inactive.
Write– The corresponding bit in PSPWRDWNSET0 and
PSPWRDWNCLR0 registers is cleared to 0." ULONG NO_COMPU_METHOD 0 0 0 255 BYTE_ORDER MSB_FIRST ECU_ADDRESS 0xFFFFE0A8 FORMAT "%.15" /end MEASUREMENT
/begin MEASUREMENT PSPWRDWNCLR3 "0: Read– The clock to the peripheral select quadrant is active.
Write– The bit is unchanged.

1: Read– The clock to the peripheral select quadrant is inactive.
Write– The corresponding bit in PSPWRDWNSET0 and
PSPWRDWNCLR0 registers is cleared to 0." ULONG NO_COMPU_METHOD 0 0 0 255 BYTE_ORDER MSB_FIRST ECU_ADDRESS 0xFFFFE0AC FORMAT "%.15" /end MEASUREMENT
/begin MEASUREMENT PSPWRDWNSET0 "0: Read– The clock to the peripheral select quadrant is active.
Write– The bit is unchanged.

1: Read– The clock to the peripheral select quadrant is inactive.
Write– The corresponding bit in PSPWRDWNSET0 and
PSPWRDWNCLR0 registers is set to 1" ULONG NO_COMPU_METHOD 0 0 0 255 BYTE_ORDER MSB_FIRST ECU_ADDRESS 0xFFFFE080 FORMAT "%.15" /end MEASUREMENT
/begin MEASUREMENT PSPWRDWNSET1 "0: Read– The clock to the peripheral select quadrant is active.
Write– The bit is unchanged.

1: Read– The clock to the peripheral select quadrant is inactive.
Write– The corresponding bit in PSPWRDWNSET0 and
PSPWRDWNCLR0 registers is set to 1" ULONG NO_COMPU_METHOD 0 0 0 255 BYTE_ORDER MSB_FIRST ECU_ADDRESS 0xFFFFE084 FORMAT "%.15" /end MEASUREMENT
/begin MEASUREMENT PSPWRDWNSET2 "0: Read– The clock to the peripheral select quadrant is active.
Write– The bit is unchanged.

1: Read– The clock to the peripheral select quadrant is inactive.
Write– The corresponding bit in PSPWRDWNSET0 and
PSPWRDWNCLR0 registers is set to 1" ULONG NO_COMPU_METHOD 0 0 0 255 BYTE_ORDER MSB_FIRST ECU_ADDRESS 0xFFFFE088 FORMAT "%.15" /end MEASUREMENT
/begin MEASUREMENT PSPWRDWNSET3 "0: Read– The clock to the peripheral select quadrant is active.
Write– The bit is unchanged.

1: Read– The clock to the peripheral select quadrant is inactive.
Write– The corresponding bit in PSPWRDWNSET0 and
PSPWRDWNCLR0 registers is set to 1" ULONG NO_COMPU_METHOD 0 0 0 255 BYTE_ORDER MSB_FIRST ECU_ADDRESS 0xFFFFE08C FORMAT "%.15" /end MEASUREMENT
/begin MEASUREMENT PWR_SWITCH_EN "R230 CCA" ULONG NO_COMPU_METHOD 0 0 0 1 BIT_MASK 0x1000 ECU_ADDRESS 0xFFF7B850 FORMAT "%.15" DISCRETE /end MEASUREMENT
/begin MEASUREMENT RAW_DATAREGH1 "" ULONG NO_COMPU_METHOD 0 0 0 255 BYTE_ORDER MSB_FIRST ECU_ADDRESS 0xFE00007C FORMAT "%.15" /end MEASUREMENT
/begin MEASUREMENT RAW_DATAREGH2 "" ULONG NO_COMPU_METHOD 0 0 0 255 BYTE_ORDER MSB_FIRST ECU_ADDRESS 0xFE0000BC FORMAT "%.15" /end MEASUREMENT
/begin MEASUREMENT RAW_DATAREGH3 "" ULONG NO_COMPU_METHOD 0 0 0 255 BYTE_ORDER MSB_FIRST ECU_ADDRESS 0xFE0000FC FORMAT "%.15" /end MEASUREMENT
/begin MEASUREMENT RAW_DATAREGL1 "" ULONG NO_COMPU_METHOD 0 0 0 255 BYTE_ORDER MSB_FIRST ECU_ADDRESS 0xFE000078 FORMAT "%.15" /end MEASUREMENT
/begin MEASUREMENT RAW_DATAREGL2 "" ULONG NO_COMPU_METHOD 0 0 0 255 BYTE_ORDER MSB_FIRST ECU_ADDRESS 0xFE0000B8 FORMAT "%.15" /end MEASUREMENT
/begin MEASUREMENT RAW_DATAREGL3 "" ULONG NO_COMPU_METHOD 0 0 0 255 BYTE_ORDER MSB_FIRST ECU_ADDRESS 0xFE0000F8 FORMAT "%.15" /end MEASUREMENT
/begin MEASUREMENT RTICAFRC0 "" ULONG NO_COMPU_METHOD 0 0 0 255 ECU_ADDRESS 0xFFFFFC20 FORMAT "%.15" /end MEASUREMENT
/begin MEASUREMENT RTICAFRC1 "" ULONG NO_COMPU_METHOD 0 0 0 255 ECU_ADDRESS 0xFFFFFC40 FORMAT "%.15" /end MEASUREMENT
/begin MEASUREMENT RTICAPCTRL "" ULONG NO_COMPU_METHOD 0 0 0 255 ECU_ADDRESS 0xFFFFFC08 FORMAT "%.15" /end MEASUREMENT
/begin MEASUREMENT RTICAUC0 "" ULONG NO_COMPU_METHOD 0 0 0 255 ECU_ADDRESS 0xFFFFFC24 FORMAT "%.15" /end MEASUREMENT
/begin MEASUREMENT RTICAUC1 "" ULONG NO_COMPU_METHOD 0 0 0 255 ECU_ADDRESS 0xFFFFFC44 FORMAT "%.15" /end MEASUREMENT
/begin MEASUREMENT RTICLEARINTENA "" ULONG NO_COMPU_METHOD 0 0 0 255 ECU_ADDRESS 0xFFFFFC84 FORMAT "%.15" /end MEASUREMENT
/begin MEASUREMENT RTICOMP0 "" ULONG NO_COMPU_METHOD 0 0 0 255 ECU_ADDRESS 0xFFFFFC50 FORMAT "%.15" /end MEASUREMENT
/begin MEASUREMENT RTICOMP1 "" ULONG NO_COMPU_METHOD 0 0 0 255 ECU_ADDRESS 0xFFFFFC58 FORMAT "%.15" /end MEASUREMENT
/begin MEASUREMENT RTICOMP2 "" ULONG NO_COMPU_METHOD 0 0 0 255 ECU_ADDRESS 0xFFFFFC60 FORMAT "%.15" /end MEASUREMENT
/begin MEASUREMENT RTICOMP3 "" ULONG NO_COMPU_METHOD 0 0 0 255 ECU_ADDRESS 0xFFFFFC68 FORMAT "%.15" /end MEASUREMENT
/begin MEASUREMENT RTICOMPCTRL "" ULONG NO_COMPU_METHOD 0 0 0 255 ECU_ADDRESS 0xFFFFFC0C FORMAT "%.15" /end MEASUREMENT
/begin MEASUREMENT RTICPUC0 "" ULONG NO_COMPU_METHOD 0 0 0 255 ECU_ADDRESS 0xFFFFFC18 FORMAT "%.15" /end MEASUREMENT
/begin MEASUREMENT RTICPUC1 "" ULONG NO_COMPU_METHOD 0 0 0 255 ECU_ADDRESS 0xFFFFFC38 FORMAT "%.15" /end MEASUREMENT
/begin MEASUREMENT RTIFRC0 "" ULONG NO_COMPU_METHOD 0 0 0 255 ECU_ADDRESS 0xFFFFFC10 FORMAT "%.15" /end MEASUREMENT
/begin MEASUREMENT RTIFRC1 "" ULONG NO_COMPU_METHOD 0 0 0 255 ECU_ADDRESS 0xFFFFFC30 FORMAT "%.15" /end MEASUREMENT
/begin MEASUREMENT RTIGCTRL "" ULONG NO_COMPU_METHOD 0 0 0 255 ECU_ADDRESS 0xFFFFFC00 FORMAT "%.15" /end MEASUREMENT
/begin MEASUREMENT RTIINTFLAG "" ULONG NO_COMPU_METHOD 0 0 0 255 ECU_ADDRESS 0xFFFFFC88 FORMAT "%.15" /end MEASUREMENT
/begin MEASUREMENT RTISETINTENA "" ULONG NO_COMPU_METHOD 0 0 0 255 ECU_ADDRESS 0xFFFFFC80 FORMAT "%.15" /end MEASUREMENT
/begin MEASUREMENT RTITBCTRL "" ULONG NO_COMPU_METHOD 0 0 0 255 ECU_ADDRESS 0xFFFFFC04 FORMAT "%.15" /end MEASUREMENT
/begin MEASUREMENT RTITBHCOMP "" ULONG NO_COMPU_METHOD 0 0 0 255 ECU_ADDRESS 0xFFFFFC74 FORMAT "%.15" /end MEASUREMENT
/begin MEASUREMENT RTITBLCOMP "" ULONG NO_COMPU_METHOD 0 0 0 255 ECU_ADDRESS 0xFFFFFC70 FORMAT "%.15" /end MEASUREMENT
/begin MEASUREMENT RTIUC0 "" ULONG NO_COMPU_METHOD 0 0 0 255 ECU_ADDRESS 0xFFFFFC14 FORMAT "%.15" /end MEASUREMENT
/begin MEASUREMENT RTIUC1 "" ULONG NO_COMPU_METHOD 0 0 0 255 ECU_ADDRESS 0xFFFFFC34 FORMAT "%.15" /end MEASUREMENT
/begin MEASUREMENT RTIUDCP0 "" ULONG NO_COMPU_METHOD 0 0 0 255 ECU_ADDRESS 0xFFFFFC54 FORMAT "%.15" /end MEASUREMENT
/begin MEASUREMENT RTIUDCP1 "" ULONG NO_COMPU_METHOD 0 0 0 255 ECU_ADDRESS 0xFFFFFC5C FORMAT "%.15" /end MEASUREMENT
/begin MEASUREMENT RTIUDCP2 "" ULONG NO_COMPU_METHOD 0 0 0 255 ECU_ADDRESS 0xFFFFFC64 FORMAT "%.15" /end MEASUREMENT
/begin MEASUREMENT RTIUDCP3 "" ULONG NO_COMPU_METHOD 0 0 0 255 ECU_ADDRESS 0xFFFFFC6C FORMAT "%.15" /end MEASUREMENT
/begin MEASUREMENT SPI5PC0 "" ULONG NO_COMPU_METHOD 0 0 0 255 ECU_ADDRESS 0xFFF7FC14 FORMAT "%.15" /end MEASUREMENT
/begin MEASUREMENT SPI5PC1 "" ULONG NO_COMPU_METHOD 0 0 0 255 ECU_ADDRESS 0xFFF7FC18 FORMAT "%.15" /end MEASUREMENT
/begin MEASUREMENT SPI5PC2 "" ULONG NO_COMPU_METHOD 0 0 0 255 ECU_ADDRESS 0xFFF7FC1C FORMAT "%.15" /end MEASUREMENT
/begin MEASUREMENT SPI5PC3 "" ULONG NO_COMPU_METHOD 0 0 0 255 ECU_ADDRESS 0xFFF7FC20 FORMAT "%.15" /end MEASUREMENT
/begin MEASUREMENT SPI5PC4 "" ULONG NO_COMPU_METHOD 0 0 0 255 ECU_ADDRESS 0xFFF7FC24 FORMAT "%.15" /end MEASUREMENT
/begin MEASUREMENT SPI5PC5 "" ULONG NO_COMPU_METHOD 0 0 0 255 ECU_ADDRESS 0xFFF7FC28 FORMAT "%.15" /end MEASUREMENT
/begin MEASUREMENT SPI5PC6 "" ULONG NO_COMPU_METHOD 0 0 0 255 ECU_ADDRESS 0xFFF7FC2C FORMAT "%.15" /end MEASUREMENT
/begin MEASUREMENT SPI5PC7 "" ULONG NO_COMPU_METHOD 0 0 0 255 ECU_ADDRESS 0xFFF7FC30 FORMAT "%.15" /end MEASUREMENT
/begin MEASUREMENT SPI5PC8 "" ULONG NO_COMPU_METHOD 0 0 0 255 ECU_ADDRESS 0xFFF7FC34 FORMAT "%.15" /end MEASUREMENT
/begin MEASUREMENT SYS_FAULT2 "R230 CCA" ULONG NO_COMPU_METHOD 0 0 0 1 BIT_MASK 0x8000 ECU_ADDRESS 0xFFF7B850 FORMAT "%.15" DISCRETE /end MEASUREMENT
/begin MEASUREMENT SYS_FAULT2_cmd "" ULONG NO_COMPU_METHOD 0 0 0 255 READ_WRITE BIT_MASK 0x8000 ECU_ADDRESS 0xFFF7B854 FORMAT "%.15" /end MEASUREMENT
/begin MEASUREMENT WD_MONITOR "R230 CCA" ULONG NO_COMPU_METHOD 0 0 0 1 BIT_MASK 0x1 ECU_ADDRESS 0xFFF7E1E4 FORMAT "%.15" DISCRETE /end MEASUREMENT
/begin MEASUREMENT WD_MONITOR_cmd "" ULONG NO_COMPU_METHOD 0 0 0 1 READ_WRITE BIT_MASK 0x20000 ECU_ADDRESS 0xFFF7FC20 FORMAT "%.15" /end MEASUREMENT
/begin MEASUREMENT WD_RESET "R230 CCA" ULONG NO_COMPU_METHOD 0 0 0 1 BIT_MASK 0x1 ECU_ADDRESS 0xFFF7E1E0 FORMAT "%.15" DISCRETE /end MEASUREMENT
/begin MEASUREMENT WD_RESET_cmd "" ULONG NO_COMPU_METHOD 0 0 0 1 READ_WRITE BIT_MASK 0x40000 ECU_ADDRESS 0xFFF7FC20 FORMAT "%.15" /end MEASUREMENT
/begin MEASUREMENT ad1_Batt "Scaling for R230 CCA" UWORD ad1_Batt.CONVERSION 0 0 0 18 ECU_ADDRESS 0x80079EE FORMAT "%.3" SYMBOL_LINK "IO_FdbkPthAdcBufRead_M_Cnt._1_" 0 PHYS_UNIT "V" /end MEASUREMENT
/begin MEASUREMENT ad1_BattSwtchd "Scaling for R230 CCA" UWORD ad1_BattSwtchd.CONVERSION 0 0 0 18 ECU_ADDRESS 0x80079FA FORMAT "%.3" SYMBOL_LINK "IO_FdbkPthAdcBufRead_M_Cnt._7_" 0 PHYS_UNIT "V" /end MEASUREMENT
/begin MEASUREMENT ad1_Cos1 "Scaling for R230 CCA" UWORD ad1_Cos1.CONVERSION 0 0 0 5 ECU_ADDRESS 0x80079F2 FORMAT "%.3" SYMBOL_LINK "IO_FdbkPthAdcBufRead_M_Cnt._3_" 0 PHYS_UNIT "V" /end MEASUREMENT
/begin MEASUREMENT ad1_Cos2 "Scaling for R230 CCA" UWORD ad1_Cos2.CONVERSION 0 0 0 5 ECU_ADDRESS 0x80079F8 FORMAT "%.3" SYMBOL_LINK "IO_FdbkPthAdcBufRead_M_Cnt._6_" 0 PHYS_UNIT "V" /end MEASUREMENT
/begin MEASUREMENT ad1_CtrlTemp "Scaling for R230 CCA" UWORD ad1_CtrlTemp.CONVERSION 0 0 0 5 ECU_ADDRESS 0x80079EC FORMAT "%.3" SYMBOL_LINK "IO_FdbkPthAdcBufRead_M_Cnt._0_" 0 PHYS_UNIT "V" /end MEASUREMENT
/begin MEASUREMENT ad1_Sin1 "Scaling for R230 CCA" UWORD ad1_Sin1.CONVERSION 0 0 0 5 ECU_ADDRESS 0x80079F4 FORMAT "%.3" SYMBOL_LINK "IO_FdbkPthAdcBufRead_M_Cnt._4_" 0 PHYS_UNIT "V" /end MEASUREMENT
/begin MEASUREMENT ad1_Sin2 "Scaling for R230 CCA" UWORD ad1_Sin2.CONVERSION 0 0 0 5 ECU_ADDRESS 0x80079F6 FORMAT "%.3" SYMBOL_LINK "IO_FdbkPthAdcBufRead_M_Cnt._5_" 0 PHYS_UNIT "V" /end MEASUREMENT
/begin MEASUREMENT ad1_T1 "Scaling for R230 CCA" UWORD ad1_T1.CONVERSION 0 0 0 5 ECU_ADDRESS 0x800B540 FORMAT "%.3" SYMBOL_LINK "IO_FwdPthAdcBufRead_M_Cnt._0_" 0 PHYS_UNIT "V" /end MEASUREMENT
/begin MEASUREMENT ad1_T2 "Scaling for R230 CCA" UWORD ad1_T2.CONVERSION 0 0 0 5 ECU_ADDRESS 0x800B542 FORMAT "%.3" SYMBOL_LINK "IO_FwdPthAdcBufRead_M_Cnt._1_" 0 PHYS_UNIT "V" /end MEASUREMENT
/begin MEASUREMENT ad1_Vref "Scaling for R230 CCA" UWORD ad1_Vref.CONVERSION 0 0 0 5 ECU_ADDRESS 0x80079F0 FORMAT "%.3" SYMBOL_LINK "IO_FdbkPthAdcBufRead_M_Cnt._2_" 0 PHYS_UNIT "V" /end MEASUREMENT
/begin MEASUREMENT ad2_Cos1 "Scaling for R230 CCA" ULONG ad2_Cos1.CONVERSION 0 0 0 5 BIT_MASK 0xFFF ECU_ADDRESS 0xFF3A0008 FORMAT "%.3" PHYS_UNIT "V" /end MEASUREMENT
/begin MEASUREMENT ad2_PhsFdbkA "Scaling for R230 CCA" ULONG ad2_PhsFdbkA.CONVERSION 0 0 0 5 BIT_MASK 0xFFF ECU_ADDRESS 0xFF3A0014 FORMAT "%.3" PHYS_UNIT "V" /end MEASUREMENT
/begin MEASUREMENT ad2_PhsFdbkB "Scaling for R230 CCA" ULONG ad2_PhsFdbkB.CONVERSION 0 0 0 5 BIT_MASK 0xFFF ECU_ADDRESS 0xFF3A0018 FORMAT "%.3" PHYS_UNIT "V" /end MEASUREMENT
/begin MEASUREMENT ad2_PhsFdbkC "Scaling for R230 CCA" ULONG ad2_PhsFdbkC.CONVERSION 0 0 0 5 BIT_MASK 0xFFF ECU_ADDRESS 0xFF3A001C FORMAT "%.3" PHYS_UNIT "V" /end MEASUREMENT
/begin MEASUREMENT ad2_Shcur "Scaling for R230 CCA" ULONG ad2_Shcur.CONVERSION 0 0 0 5 BIT_MASK 0xFFF ECU_ADDRESS 0xFF3A0000 FORMAT "%.3" PHYS_UNIT "V" /end MEASUREMENT
/begin MEASUREMENT ad2_Shcur2 "Scaling for R230 CCA" ULONG ad2_Shcur2.CONVERSION 0 0 0 5 BIT_MASK 0xFFFF ECU_ADDRESS 0xFF3A0010 FORMAT "%.3" PHYS_UNIT "V" /end MEASUREMENT
/begin MEASUREMENT ad2_Sin1 "Scaling for R230 CCA" ULONG ad2_Sin1.CONVERSION 0 0 0 5 BIT_MASK 0xFFF ECU_ADDRESS 0xFF3A000C FORMAT "%.3" PHYS_UNIT "V" /end MEASUREMENT
/begin MEASUREMENT ad2_T1 "Scaling for R230 CCA" ULONG ad2_T1.CONVERSION 0 0 0 5 BIT_MASK 0xFFF ECU_ADDRESS 0xFF3A0020 FORMAT "%.3" PHYS_UNIT "V" /end MEASUREMENT
/begin MEASUREMENT ad2_T2 "Scaling for R230 CCA" ULONG ad2_T2.CONVERSION 0 0 0 5 BIT_MASK 0xFFF ECU_ADDRESS 0xFF3A0024 FORMAT "%.3" PHYS_UNIT "V" /end MEASUREMENT
/begin MEASUREMENT adc2_Evt_Results "" ULONG NO_COMPU_METHOD 0 0 0 65535 ECU_ADDRESS 0xFF3A0000 FORMAT "%.15" MATRIX_DIM 1 4 1 LAYOUT COLUMN_DIR PHYS_UNIT "Cnt" /end MEASUREMENT
/begin MEASUREMENT adc2_Grp1_Results "" ULONG NO_COMPU_METHOD 0 0 0 65535 ECU_ADDRESS 0xFF3A0010 FORMAT "%.15" MATRIX_DIM 1 6 1 LAYOUT COLUMN_DIR PHYS_UNIT "Cnt" /end MEASUREMENT
/begin MEASUREMENT adc2_Grp2_Results "" ULONG NO_COMPU_METHOD 0 0 0 65535 ECU_ADDRESS 0xFF3A0028 FORMAT "%.15" MATRIX_DIM 1 8 1 LAYOUT COLUMN_DIR PHYS_UNIT "Cnt" /end MEASUREMENT
/begin GROUP CLR "Clearing the bit to 0 deactivates the peripheral or perihperal RAM"
 /begin REF_MEASUREMENT PCSPWRDWNCLR0 PCSPWRDWNCLR1 PSPWRDWNCLR0 PSPWRDWNCLR1 PSPWRDWNCLR2 PSPWRDWNCLR3 /end REF_MEASUREMENT
/end GROUP
/begin GROUP CRC "Comment" /begin SUB_GROUP REG1 REG2 REG3 /end SUB_GROUP
 /begin REF_MEASUREMENT CRC_BUSY CRC_CTRL0 CRC_CTRL1 CRC_CTRL2 CRC_INTR CRC_INTS CRC_STATUS /end REF_MEASUREMENT
/end GROUP
/begin GROUP DCAN "Comment" /begin REF_MEASUREMENT DCAN3_RIOC DCAN3_TIOC /end REF_MEASUREMENT /end GROUP
/begin GROUP DIO "Comment" /begin SUB_GROUP Dout_Cmd /end SUB_GROUP
 /begin REF_MEASUREMENT DSP_EPS_EN DSP_TOD FET_DRV_CNTL FET_DRV_RESET FF1_DATA FF2_CLK FR_ERRn PHASE_DSCNT PWR_SWITCH_EN SYS_FAULT2 WD_MONITOR WD_RESET /end REF_MEASUREMENT
/end GROUP
/begin GROUP Dout_Cmd "Comment"
 /begin REF_MEASUREMENT FET_DRV_RESET_cmd SYS_FAULT2_cmd WD_MONITOR_cmd WD_RESET_cmd /end REF_MEASUREMENT
/end GROUP
/begin GROUP ESM "Comment" /begin REF_MEASUREMENT ESMEKR ESMEPSR ESMSR1 ESMSR2 ESMSR3 /end REF_MEASUREMENT /end GROUP
/begin GROUP FlexRay "FlexRay Comunicaiton Controller (CC) register address range is 0xFFF7_C800 - 0xFFF7_CFFF" /begin REF_MEASUREMENT PEADR /end REF_MEASUREMENT /end GROUP
/begin GROUP GIO "Comment"
 /begin REF_MEASUREMENT GIODINA GIODIRA GIODOUTA GIODSETA GIOEMUA GIOOFFA GIOPDRA GIOPSLA GIOPULDISA /end REF_MEASUREMENT
/end GROUP
/begin GROUP IOMM "Comment" /begin REF_CHARACTERISTIC PINMMRx /end REF_CHARACTERISTIC /end GROUP
/begin GROUP MibAdc1 "Comment" /begin REF_CHARACTERISTIC AD1_ADEVSAMP /end REF_CHARACTERISTIC
 /begin REF_MEASUREMENT ADEVTIN1 ad1_Batt ad1_BattSwtchd ad1_Cos1 ad1_Cos2 ad1_CtrlTemp ad1_Sin1 ad1_Sin2 ad1_T1 ad1_T2 ad1_Vref /end REF_MEASUREMENT
/end GROUP
/begin GROUP MibAdc2 "Comment"
 /begin REF_CHARACTERISTIC AD2_ADBNDCR AD2_ADBNDEND AD2_ADCALCR AD2_ADCALR AD2_ADCLOCKCR AD2_ADEVBUFFER1 AD2_ADEVBUFFER2 AD2_ADEVBUFFER3 AD2_ADEVBUFFER4 AD2_ADEVBUFFER5 AD2_ADEVBUFFER6 AD2_ADEVBUFFER7 AD2_ADEVBUFFER8 AD2_ADEVDMACR AD2_ADEVEMUBUFFER AD2_ADEVFIFORESETCR AD2_ADEVINTCR AD2_ADEVINTENA AD2_ADEVINTFLG AD2_ADEVMODECR AD2_ADEVRAMADDR AD2_ADEVSAMP AD2_ADEVSAMPDISEN AD2_ADEVSEL AD2_ADEVSR AD2_ADEVSRC AD2_ADEVTCLR AD2_ADEVTDIR AD2_ADEVTIN AD2_ADEVTOUT AD2_ADEVTPDIS AD2_ADEVTPDR AD2_ADEVTPSEL AD2_ADEVTSET AD2_ADG1BUFFER1 AD2_ADG1BUFFER2 AD2_ADG1BUFFER3 AD2_ADG1BUFFER4 AD2_ADG1BUFFER5 AD2_ADG1BUFFER6 AD2_ADG1BUFFER7 AD2_ADG1BUFFER8 AD2_ADG1DMACR AD2_ADG1EMUBUFFER AD2_ADG1FIFORESETCR AD2_ADG1INTCR AD2_ADG1INTENA AD2_ADG1INTFLG AD2_ADG1MODECR AD2_ADG1RAMADDR AD2_ADG1SAMP AD2_ADG1SAMPDISEN AD2_ADG1SEL AD2_ADG1SR AD2_ADG1SRC AD2_ADG2BUFFER1 AD2_ADG2BUFFER2 AD2_ADG2BUFFER3 AD2_ADG2BUFFER4 AD2_ADG2BUFFER5 AD2_ADG2BUFFER6 AD2_ADG2BUFFER7 AD2_ADG2BUFFER8 AD2_ADG2DMACR AD2_ADG2EMUBUFFER AD2_ADG2FIFORESETCR AD2_ADG2INTCR AD2_ADG2INTENA AD2_ADG2INTFLG AD2_ADG2MODECR AD2_ADG2RAMADDR AD2_ADG2SAMP AD2_ADG2SAMPDISEN AD2_ADG2SEL AD2_ADG2SR AD2_ADG2SRC AD2_ADLASTCONV AD2_ADMAGINT1MASK AD2_ADMAGINT2MASK AD2_ADMAGINT3MASK AD2_ADMAGINTCR1 AD2_ADMAGINTCR2 AD2_ADMAGINTCR3 AD2_ADMAGINTENACLR AD2_ADMAGTHRINTENASET AD2_ADMAGTHRINTFLG AD2_ADMAGTHRINTOFFSET AD2_ADOPMODECR AD2_ADPARADDR AD2_ADPARCR AD2_ADPWRUPDLYCTRL AD2_ADRSTCR AD2_ADSMSTATE /end REF_CHARACTERISTIC
 /begin REF_MEASUREMENT ad2_Cos1 ad2_PhsFdbkA ad2_PhsFdbkB ad2_PhsFdbkC ad2_Shcur ad2_Shcur2 ad2_Sin1 ad2_T1 ad2_T2 adc2_Evt_Results adc2_Grp1_Results adc2_Grp2_Results /end REF_MEASUREMENT
/end GROUP
/begin GROUP N2HET1 "Comment" /begin REF_MEASUREMENT HETGCR N2HET_1_Prog PHASE_DSCNT_cmd /end REF_MEASUREMENT /end GROUP
/begin GROUP N2HET2 "Comment" /begin REF_MEASUREMENT HETGCR_2 N2HET_2_Prog /end REF_MEASUREMENT /end GROUP
/begin GROUP PLL "Comment" /begin REF_MEASUREMENT PLLCTL1 PLLCTL2 PLLCTL3 /end REF_MEASUREMENT /end GROUP
/begin GROUP REG1 "Comment"
 /begin REF_MEASUREMENT CRC_BCTOPLD1 CRC_CURSEC_REG1 CRC_PCOUNT_REG1 CRC_REGH1 CRC_REGL1 CRC_SCOUNT_REG1 CRC_WDTOPLD1 PSA_SECSIGREGH1 PSA_SECSIGREGL1 PSA_SIGREGH1 PSA_SIGREGL1 RAW_DATAREGH1 RAW_DATAREGL1 /end REF_MEASUREMENT
/end GROUP
/begin GROUP REG2 "Comment"
 /begin REF_MEASUREMENT CRC_BCTOPLD2 CRC_CURSEC_REG2 CRC_PCOUNT_REG2 CRC_REGH2 CRC_REGL2 CRC_SCOUNT_REG2 CRC_WDTOPLD2 PSA_SECSIGREGH2 PSA_SECSIGREGL2 PSA_SIGREGH2 PSA_SIGREGL2 RAW_DATAREGH2 RAW_DATAREGL2 /end REF_MEASUREMENT
/end GROUP
/begin GROUP REG3 "Comment"
 /begin REF_MEASUREMENT CRC_BCTOPLD3 CRC_CURSEC_REG3 CRC_PCOUNT_REG3 CRC_REGH3 CRC_REGL3 CRC_SCOUNT_REG3 CRC_WDTOPLD3 PSA_SECSIGREGH3 PSA_SECSIGREGL3 PSA_SIGREGH3 PSA_SIGREGL3 RAW_DATAREGH3 RAW_DATAREGL3 /end REF_MEASUREMENT
/end GROUP
/begin GROUP RTI "Comment"
 /begin REF_MEASUREMENT RTICAFRC0 RTICAFRC1 RTICAPCTRL RTICAUC0 RTICAUC1 RTICLEARINTENA RTICOMP0 RTICOMP1 RTICOMP2 RTICOMP3 RTICOMPCTRL RTICPUC0 RTICPUC1 RTIFRC0 RTIFRC1 RTIGCTRL RTIINTFLAG RTISETINTENA RTITBCTRL RTITBHCOMP RTITBLCOMP RTIUC0 RTIUC1 RTIUDCP0 RTIUDCP1 RTIUDCP2 RTIUDCP3 /end REF_MEASUREMENT
/end GROUP
/begin GROUP SET "Setting the bit to 1 deactivates the peripheral or perihperal RAM"
 /begin REF_MEASUREMENT PCSPWRDWNSET0 PCSPWRDWNSET1 PSPWRDWNSET0 PSPWRDWNSET1 PSPWRDWNSET2 PSPWRDWNSET3 /end REF_MEASUREMENT
/end GROUP
/begin GROUP SPI5 "Comment"
 /begin REF_MEASUREMENT SPI5PC0 SPI5PC1 SPI5PC2 SPI5PC3 SPI5PC4 SPI5PC5 SPI5PC6 SPI5PC7 SPI5PC8 /end REF_MEASUREMENT
/end GROUP
/begin GROUP System "Comment" /begin REF_MEASUREMENT CLKTEST /end REF_MEASUREMENT /end GROUP
/begin GROUP TMS570_65nm "TMS570 registers" ROOT
 /begin SUB_GROUP CRC DCAN DIO ESM FlexRay GIO IOMM MibAdc1 MibAdc2 N2HET1 N2HET2 PLL RTI SPI5 System xPWRDWN /end SUB_GROUP
/end GROUP
/begin GROUP xPWRDWN "Perihperal power down registers.  These registers control the clock distribution/activation of peripherals and peripheral memory." /begin SUB_GROUP CLR SET /end SUB_GROUP /end GROUP
