/begin CHARACTERISTIC EA_BLOCK_BOOT_PROG_COUNTER "" VAL_BLK 0x3D __UBYTE_Z 0 NO_COMPU_METHOD 0 255 ECU_ADDRESS_EXTENSION 0x2 MATRIX_DIM 10 1 1 FORMAT "%.15" /end CHARACTERISTIC
/begin CHARACTERISTIC EA_BLOCK_BOOT_PROG_DATA "" VAL_BLK 0x0 __UBYTE_Z 0 NO_COMPU_METHOD 0 255 ECU_ADDRESS_EXTENSION 0x2 MATRIX_DIM 49 1 1 FORMAT "%.15" /end CHARACTERISTIC
/begin CHARACTERISTIC EA_BLOCK_BOOT_PROG_STATUS "" VAL_BLK 0x35 __UBYTE_Z 0 NO_COMPU_METHOD 0 255 ECU_ADDRESS_EXTENSION 0x2 MATRIX_DIM 8 1 1 FORMAT "%.15" /end CHARACTERISTIC
/begin CHARACTERISTIC EA_BLOCK_BOOT_SVK_HISTORY "" VAL_BLK 0x47 __UBYTE_Z 0 NO_COMPU_METHOD 0 255 ECU_ADDRESS_EXTENSION 0x2 MATRIX_DIM 135 1 1 FORMAT "%.15" /end CHARACTERISTIC
/begin CHARACTERISTIC EA_BLOCK_BOOT_SVK_PLANT "" VAL_BLK 0x112 __UBYTE_Z 0 NO_COMPU_METHOD 0 255 ECU_ADDRESS_EXTENSION 0x2 MATRIX_DIM 68 1 1 FORMAT "%.15" /end CHARACTERISTIC
/begin CHARACTERISTIC EA_BLOCK_BOOT_SVK_SYS_SUPP "" VAL_BLK 0xCE __UBYTE_Z 0 NO_COMPU_METHOD 0 255 ECU_ADDRESS_EXTENSION 0x2 MATRIX_DIM 68 1 1 FORMAT "%.15" /end CHARACTERISTIC
/begin CHARACTERISTIC EA_BLOCK_EOLCTRLPOLARITY "" VAL_BLK 0x2D6 __UBYTE_Z 0 NO_COMPU_METHOD 0 255 ECU_ADDRESS_EXTENSION 0x2 MATRIX_DIM 6 1 1 FORMAT "%.15" /end CHARACTERISTIC
/begin CHARACTERISTIC EA_BLOCK_EOLMTRPOSSNSR "" VAL_BLK 0x1EB6 __UBYTE_Z 0 NO_COMPU_METHOD 0 255 ECU_ADDRESS_EXTENSION 0x2 MATRIX_DIM 158 2 1 FORMAT "%.15" /end CHARACTERISTIC
/begin CHARACTERISTIC EA_BLOCK_EOLMTRPOSSNSR_DEPREC "" VAL_BLK 0x17E __UBYTE_Z 0 NO_COMPU_METHOD 0 255 ECU_ADDRESS_EXTENSION 0x2 MATRIX_DIM 163 2 1 FORMAT "%.15" /end CHARACTERISTIC
/begin CHARACTERISTIC EA_BLOCK_EOLNOMMTRPARAM "" VAL_BLK 0x2C4 __UBYTE_Z 0 NO_COMPU_METHOD 0 255 ECU_ADDRESS_EXTENSION 0x2 MATRIX_DIM 14 1 1 FORMAT "%.15" /end CHARACTERISTIC
/begin CHARACTERISTIC EA_BLOCK_EOLRETURNRANGE "" VAL_BLK 0x39A __UBYTE_Z 0 NO_COMPU_METHOD 0 255 ECU_ADDRESS_EXTENSION 0x2 MATRIX_DIM 6 1 1 FORMAT "%.15" /end CHARACTERISTIC
/begin CHARACTERISTIC EA_BLOCK_EOLRETURNRANGE_DEPR "" VAL_BLK 0x372 __UBYTE_Z 0 NO_COMPU_METHOD 0 255 ECU_ADDRESS_EXTENSION 0x2 MATRIX_DIM 4 1 1 FORMAT "%.15" /end CHARACTERISTIC
/begin CHARACTERISTIC EA_BLOCK_EOLTRQCMDSCLFAC_DEPREC "" VAL_BLK 0x2D2 __UBYTE_Z 0 NO_COMPU_METHOD 0 255 ECU_ADDRESS_EXTENSION 0x2 MATRIX_DIM 4 1 1 FORMAT "%.15" /end CHARACTERISTIC
/begin CHARACTERISTIC EA_BLOCK_EPSDEFEATS "" VAL_BLK 0x364 __UBYTE_Z 0 NO_COMPU_METHOD 0 255 ECU_ADDRESS_EXTENSION 0x2 MATRIX_DIM 8 1 1 FORMAT "%.15" /end CHARACTERISTIC
/begin CHARACTERISTIC EA_BLOCK_HWDESCDATA "" VAL_BLK 0x33E __UBYTE_Z 0 NO_COMPU_METHOD 0 255 ECU_ADDRESS_EXTENSION 0x2 MATRIX_DIM 38 1 1 FORMAT "%.15" /end CHARACTERISTIC
/begin CHARACTERISTIC EA_BLOCK_HWTRQSCALE "" VAL_BLK 0x376 __UBYTE_Z 0 NO_COMPU_METHOD 0 255 ECU_ADDRESS_EXTENSION 0x2 MATRIX_DIM 7 1 1 FORMAT "%.15" /end CHARACTERISTIC
/begin CHARACTERISTIC EA_BLOCK_HWTRQSCALE_DEPRECATED "" VAL_BLK 0x2DC __UBYTE_Z 0 NO_COMPU_METHOD 0 255 ECU_ADDRESS_EXTENSION 0x2 MATRIX_DIM 10 1 1 FORMAT "%.15" /end CHARACTERISTIC
/begin CHARACTERISTIC EA_BLOCK_HWTRQTRIM "" VAL_BLK 0x37D __UBYTE_Z 0 NO_COMPU_METHOD 0 255 ECU_ADDRESS_EXTENSION 0x2 MATRIX_DIM 17 1 1 FORMAT "%.15" /end CHARACTERISTIC
/begin CHARACTERISTIC EA_BLOCK_HWTRQTRIM_DEPRECATED "" VAL_BLK 0x2E6 __UBYTE_Z 0 NO_COMPU_METHOD 0 255 ECU_ADDRESS_EXTENSION 0x2 MATRIX_DIM 20 1 1 FORMAT "%.15" /end CHARACTERISTIC
/begin CHARACTERISTIC EA_BLOCK_LEARNEDEOT "" VAL_BLK 0x38E __UBYTE_Z 0 NO_COMPU_METHOD 0 255 ECU_ADDRESS_EXTENSION 0x2 MATRIX_DIM 12 1 1 FORMAT "%.15" /end CHARACTERISTIC
/begin CHARACTERISTIC EA_BLOCK_LEARNEDEOT_DEPRECATED "" VAL_BLK 0x326 __UBYTE_Z 0 NO_COMPU_METHOD 0 255 ECU_ADDRESS_EXTENSION 0x2 MATRIX_DIM 14 1 1 FORMAT "%.15" /end CHARACTERISTIC
/begin CHARACTERISTIC EA_BLOCK_MTRCURR "" VAL_BLK 0x174 __UBYTE_Z 0 NO_COMPU_METHOD 0 255 ECU_ADDRESS_EXTENSION 0x2 MATRIX_DIM 10 1 1 FORMAT "%.15" /end CHARACTERISTIC
/begin CHARACTERISTIC EA_BLOCK_MTRSNSRLRN "" VAL_BLK 0x2FA __UBYTE_Z 0 NO_COMPU_METHOD 0 255 ECU_ADDRESS_EXTENSION 0x2 MATRIX_DIM 34 1 1 FORMAT "%.15" /end CHARACTERISTIC
/begin CHARACTERISTIC EA_BLOCK_SNSRLESSHWPOS "" VAL_BLK 0x334 __UBYTE_Z 0 NO_COMPU_METHOD 0 255 ECU_ADDRESS_EXTENSION 0x2 MATRIX_DIM 4 1 1 FORMAT "%.15" /end CHARACTERISTIC
/begin CHARACTERISTIC EA_BLOCK_TORQUECMDSF "" VAL_BLK 0x36C __UBYTE_Z 0 NO_COMPU_METHOD 0 255 ECU_ADDRESS_EXTENSION 0x2 MATRIX_DIM 6 1 1 FORMAT "%.15" /end CHARACTERISTIC
/begin CHARACTERISTIC EA_BLOCK_VSMOMC_DATA "" VAL_BLK 0x31 __UBYTE_Z 0 NO_COMPU_METHOD 0 255 ECU_ADDRESS_EXTENSION 0x2 MATRIX_DIM 4 1 1 FORMAT "%.15" /end CHARACTERISTIC
/begin CHARACTERISTIC EA_CONFIG_BLOCK "" VAL_BLK 0x168 __UBYTE_Z 0 NO_COMPU_METHOD 0 255 ECU_ADDRESS_EXTENSION 0x2 MATRIX_DIM 6 1 1 FORMAT "%.15" /end CHARACTERISTIC
/begin CHARACTERISTIC EA_CORRDIAGFILT_DEPRECATED "" VAL_BLK 0x338 __UBYTE_Z 0 NO_COMPU_METHOD 0 255 ECU_ADDRESS_EXTENSION 0x2 MATRIX_DIM 6 1 1 FORMAT "%.15" /end CHARACTERISTIC
/begin CHARACTERISTIC EA_MTRPARAMLEARNED_DEPRECATED "" VAL_BLK 0x31C __UBYTE_Z 0 NO_COMPU_METHOD 0 255 ECU_ADDRESS_EXTENSION 0x2 MATRIX_DIM 10 1 1 FORMAT "%.15" /end CHARACTERISTIC
/begin CHARACTERISTIC Ea.ABSHWPOS_TRIM_0 "Primary data set in redundant block config" VAL_BLK 0x1E7E __UBYTE_Z 0 NO_COMPU_METHOD 0 255 ECU_ADDRESS_EXTENSION 0x2 MATRIX_DIM 18 1 1 FORMAT "%.15" /end CHARACTERISTIC
/begin CHARACTERISTIC Ea.ABSHWPOS_TRIM_1 "Redundant data set in redundant block config" VAL_BLK 0x1E90 __UBYTE_Z 0 NO_COMPU_METHOD 0 255 ECU_ADDRESS_EXTENSION 0x2 MATRIX_DIM 18 1 1 FORMAT "%.15" /end CHARACTERISTIC
/begin CHARACTERISTIC Ea.LTVEHCNTRCOMP_DEPR "" VAL_BLK 0xD35 __UBYTE_Z 0 NO_COMPU_METHOD 0 255 ECU_ADDRESS_EXTENSION 0x2 MATRIX_DIM 3 1 1 FORMAT "%.15" /end CHARACTERISTIC
/begin CHARACTERISTIC Ea.LTVEHCNTRCOMP_DEPR_RC "" VAL_BLK 0x1EA2 __UBYTE_Z 0 NO_COMPU_METHOD 0 255 ECU_ADDRESS_EXTENSION 0x2 MATRIX_DIM 4 1 1 FORMAT "%.15" /end CHARACTERISTIC
/begin CHARACTERISTIC Ea.RACKTOVEHCNTROFFSET_DEPR "" VAL_BLK 0xD2B __UBYTE_Z 0 NO_COMPU_METHOD 0 255 ECU_ADDRESS_EXTENSION 0x2 MATRIX_DIM 4 1 1 FORMAT "%.15" /end CHARACTERISTIC
/begin CHARACTERISTIC Ea.RACKTOVEHCNTROFFSET_DEPR_RC "" VAL_BLK 0x1EB0 __UBYTE_Z 0 NO_COMPU_METHOD 0 255 ECU_ADDRESS_EXTENSION 0x2 MATRIX_DIM 6 1 1 FORMAT "%.15" /end CHARACTERISTIC
/begin CHARACTERISTIC Ea.VEHCNTRPOSOFFSET_DEPR "" VAL_BLK 0xD2F __UBYTE_Z 0 NO_COMPU_METHOD 0 255 ECU_ADDRESS_EXTENSION 0x2 MATRIX_DIM 6 1 1 FORMAT "%.15" /end CHARACTERISTIC
/begin CHARACTERISTIC Ea.VEHCNTRPOSOFFSET_DEPR_RC "" VAL_BLK 0x1EA6 __UBYTE_Z 0 NO_COMPU_METHOD 0 255 ECU_ADDRESS_EXTENSION 0x2 MATRIX_DIM 10 1 1 FORMAT "%.15" /end CHARACTERISTIC
/begin CHARACTERISTIC NvM_All "Entire NvM block (8192 bytes)" VAL_BLK 0x0 __UBYTE_Z 0 NO_COMPU_METHOD 0 255 ECU_ADDRESS_EXTENSION 0x2 MATRIX_DIM 32 128 1 FORMAT "%.15" /end CHARACTERISTIC
/begin GROUP NVM "Comment" ROOT
 /begin REF_CHARACTERISTIC EA_BLOCK_BOOT_PROG_COUNTER EA_BLOCK_BOOT_PROG_DATA EA_BLOCK_BOOT_PROG_STATUS EA_BLOCK_BOOT_SVK_HISTORY EA_BLOCK_BOOT_SVK_PLANT EA_BLOCK_BOOT_SVK_SYS_SUPP EA_BLOCK_EOLCTRLPOLARITY EA_BLOCK_EOLMTRPOSSNSR EA_BLOCK_EOLMTRPOSSNSR_DEPREC EA_BLOCK_EOLNOMMTRPARAM EA_BLOCK_EOLRETURNRANGE EA_BLOCK_EOLRETURNRANGE_DEPR EA_BLOCK_EOLTRQCMDSCLFAC_DEPREC EA_BLOCK_EPSDEFEATS EA_BLOCK_HWDESCDATA EA_BLOCK_HWTRQSCALE EA_BLOCK_HWTRQSCALE_DEPRECATED EA_BLOCK_HWTRQTRIM EA_BLOCK_HWTRQTRIM_DEPRECATED EA_BLOCK_LEARNEDEOT EA_BLOCK_LEARNEDEOT_DEPRECATED EA_BLOCK_MTRCURR EA_BLOCK_MTRSNSRLRN EA_BLOCK_SNSRLESSHWPOS EA_BLOCK_TORQUECMDSF EA_BLOCK_VSMOMC_DATA EA_CONFIG_BLOCK EA_CORRDIAGFILT_DEPRECATED EA_MTRPARAMLEARNED_DEPRECATED Ea.ABSHWPOS_TRIM_0 Ea.ABSHWPOS_TRIM_1 Ea.LTVEHCNTRCOMP_DEPR Ea.LTVEHCNTRCOMP_DEPR_RC Ea.RACKTOVEHCNTROFFSET_DEPR Ea.RACKTOVEHCNTROFFSET_DEPR_RC Ea.VEHCNTRPOSOFFSET_DEPR Ea.VEHCNTRPOSOFFSET_DEPR_RC NvM_All /end REF_CHARACTERISTIC
/end GROUP
