/begin COMPU_VTAB MemIf_StatusType "" TAB_VERB 4 0 "MEMIF_UNINIT" 1 "MEMIF_IDLE" 2 "MEMIF_BUSY" 3 "MEMIF_BUSY_INTERNAL" DEFAULT_VALUE "0" /end COMPU_VTAB
/begin COMPU_METHOD MemIf_StatusType "" TAB_VERB "%3.1" "" COMPU_TAB_REF MemIf_StatusType /end COMPU_METHOD
/begin MEASUREMENT Ea_ModuleStatus_t "" SBYTE MemIf_StatusType 0 0 -127 128 ECU_ADDRESS 0x800A1D4 /end MEASUREMENT
/begin MEASUREMENT Eep_30_At25128_BufferP "" UBYTE NO_COMPU_METHOD 0 0 0 255 READ_WRITE ECU_ADDRESS 0x800A010 FORMAT "%.15" MATRIX_DIM 1 3 1 LAYOUT COLUMN_DIR /end MEASUREMENT
/begin MEASUREMENT Eep_30_At25128_LocalData_t "" UBYTE NO_COMPU_METHOD 0 0 0 255 ECU_ADDRESS 0x800A014 FORMAT "%.15" /end MEASUREMENT
/begin GROUP BSW "AUTOSAR Basic Software" ROOT /begin SUB_GROUP CDD Ea Eep Os Spi /end SUB_GROUP /end GROUP
/begin GROUP CDD "Comment" /end GROUP
/begin GROUP Ea "Comment" /begin REF_MEASUREMENT Ea_ModuleStatus_t /end REF_MEASUREMENT /end GROUP
/begin GROUP Eep "Comment" /begin REF_MEASUREMENT Eep_30_At25128_BufferP Eep_30_At25128_LocalData_t /end REF_MEASUREMENT /end GROUP
/begin GROUP Os "Comment" /end GROUP
/begin GROUP Spi "Comment" /end GROUP
