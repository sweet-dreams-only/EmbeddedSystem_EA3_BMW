/* @@@@ File written by CANAPE_VERSION 9 0 40 @@@@ */ ASAP2_VERSION 1 60
/begin PROJECT Eps_Xcp ""
/begin MODULE CPP ""
/begin MOD_COMMON "" BYTE_ORDER MSB_FIRST ALIGNMENT_BYTE 1 ALIGNMENT_WORD 1 ALIGNMENT_LONG 1 ALIGNMENT_INT64 1 ALIGNMENT_FLOAT32_IEEE 1 ALIGNMENT_FLOAT64_IEEE 1 /end MOD_COMMON
/begin IF_DATA XCP
 /begin PROTOCOL_LAYER 0x0100 0x07D0 0x00C8 0 0 0 0 0 0x1C 0x000C BYTE_ORDER_MSB_FIRST ADDRESS_GRANULARITY_BYTE OPTIONAL_CMD ALLOC_ODT_ENTRY OPTIONAL_CMD ALLOC_ODT OPTIONAL_CMD ALLOC_DAQ OPTIONAL_CMD FREE_DAQ OPTIONAL_CMD GET_DAQ_EVENT_INFO OPTIONAL_CMD GET_DAQ_RESOLUTION_INFO OPTIONAL_CMD GET_DAQ_PROCESSOR_INFO OPTIONAL_CMD GET_DAQ_CLOCK OPTIONAL_CMD START_STOP_SYNCH OPTIONAL_CMD START_STOP_DAQ_LIST OPTIONAL_CMD GET_DAQ_LIST_MODE OPTIONAL_CMD SET_DAQ_LIST_MODE OPTIONAL_CMD WRITE_DAQ OPTIONAL_CMD SET_DAQ_PTR OPTIONAL_CMD CLEAR_DAQ_LIST OPTIONAL_CMD DOWNLOAD OPTIONAL_CMD SHORT_UPLOAD OPTIONAL_CMD UPLOAD OPTIONAL_CMD SET_MTA OPTIONAL_CMD GET_COMM_MODE_INFO COMMUNICATION_MODE_SUPPORTED BLOCK SLAVE MASTER 0x0A 0x00 /end PROTOCOL_LAYER
 /begin DAQ DYNAMIC 0x0000 0x000B 0x00 OPTIMISATION_TYPE_DEFAULT ADDRESS_EXTENSION_FREE IDENTIFICATION_FIELD_TYPE_ABSOLUTE GRANULARITY_ODT_ENTRY_SIZE_DAQ_BYTE 0x0B OVERLOAD_INDICATION_PID /begin TIMESTAMP_SUPPORTED 0x0001 SIZE_WORD UNIT_1US /end TIMESTAMP_SUPPORTED /begin EVENT "2ms_DAQ" "2ms_DAQ" 0x0000 DAQ 0x01 0x02 0x06 0x00 /end EVENT /begin EVENT "MtrCtl_DAQ" "MtrCtl_DA" 0x0001 DAQ 0x01 0x3E 0x03 0x00 /end EVENT /begin EVENT "4ms_DAQ" "4ms_DAQ" 0x0002 DAQ 0x01 0x04 0x06 0x00 /end EVENT /begin EVENT "5ms_DAQ" "5ms_DAQ" 0x0003 DAQ 0x01 0x05 0x06 0x00 /end EVENT /begin EVENT "8ms_DAQ" "8ms_DAQ" 0x0004 DAQ 0x01 0x08 0x06 0x00 /end EVENT /begin EVENT "10ms_DAQ" "10ms_DAQ" 0x0005 DAQ 0x01 0x0A 0x06 0x00 /end EVENT /begin EVENT "16ms_DAQ" "16ms_DAQ" 0x0006 DAQ 0x01 0x10 0x06 0x00 /end EVENT /begin EVENT "64ms_DAQ" "64ms_DAQ" 0x0007 DAQ 0x01 0x40 0x06 0x00 /end EVENT /begin EVENT "128ms_DAQ" "128ms_DAQ" 0x0008 DAQ 0x01 0x80 0x06 0x00 /end EVENT /begin EVENT "256ms_DAQ" "256ms_DAQ" 0x0009 DAQ 0x01 0xFA 0x06 0x00 /end EVENT /begin EVENT "8192ms_DAQ" "8192ms_DA" 0x000A DAQ 0x01 0x08 0x09 0x00 /end EVENT /end DAQ
 /begin PAG 0x00 /end PAG
 /begin PGM PGM_MODE_ABSOLUTE 0x01 0x00 /begin SECTOR "Sector" 0x0 0x2000000 0x2000 0x0 0x0 0x0 /end SECTOR /end PGM
 /begin XCP_ON_FLX 256 100 "UKL_KW31_11_V3_A_FlexRay_V23_EPS_V77_patch_2011_09_23.xml" "_fd291b9e256847bbb40b16cbeddce005_23" 0x30 HEADER_NAX_CTR_FILL_LEN PACKET_ALIGNMENT_16
  /begin INITIAL_CMD_BUFFER 0x0 MAX_FLX_LEN_BUF VARIABLE 0x20
   /begin LPDU_ID FLX_SLOT_ID VARIABLE INITIAL_VALUE 219 OFFSET VARIABLE INITIAL_VALUE 0x0 CYCLE_REPETITION VARIABLE INITIAL_VALUE 0x1 CHANNEL FIXED A /end LPDU_ID
   /begin XCP_PACKET CMD NOT_ALLOWED RES_ERR NOT_ALLOWED EV_SERV NOT_ALLOWED DAQ NOT_ALLOWED STIM NOT_ALLOWED /end XCP_PACKET
  /end INITIAL_CMD_BUFFER
  /begin INITIAL_RES_ERR_BUFFER 0x2 MAX_FLX_LEN_BUF VARIABLE 0x20
   /begin LPDU_ID FLX_SLOT_ID VARIABLE INITIAL_VALUE 220 OFFSET VARIABLE INITIAL_VALUE 0x0 CYCLE_REPETITION VARIABLE INITIAL_VALUE 0x1 CHANNEL FIXED A /end LPDU_ID
   /begin XCP_PACKET CMD NOT_ALLOWED RES_ERR NOT_ALLOWED EV_SERV NOT_ALLOWED DAQ NOT_ALLOWED STIM NOT_ALLOWED /end XCP_PACKET
  /end INITIAL_RES_ERR_BUFFER
  /begin POOL_BUFFER 0x1 MAX_FLX_LEN_BUF VARIABLE 0xfe
   /begin LPDU_ID FLX_SLOT_ID FIXED 294 OFFSET FIXED 0x0 CYCLE_REPETITION FIXED 0x1 CHANNEL FIXED A /end LPDU_ID
   /begin XCP_PACKET CMD NOT_ALLOWED RES_ERR NOT_ALLOWED EV_SERV NOT_ALLOWED DAQ VARIABLE STIM NOT_ALLOWED /end XCP_PACKET
  /end POOL_BUFFER
 /end XCP_ON_FLX
/end IF_DATA
/begin MOD_PAR "" /end MOD_PAR
/include "Partial_A2L\DataDictionary.a2l"
/include "Partial_A2L\Rte.a2l"
/include "Partial_A2L\BSW.a2l"
/include "Partial_A2L\MicroRegs.a2l"
/include "Partial_A2L\NVM.a2l"
/include "Partial_A2L\Metrics.a2l"
/begin GROUP InputBuffer "offset 0x400 - 0x4FC" ROOT /end GROUP
/begin RECORD_LAYOUT __UBYTE_Z FNC_VALUES 1 UBYTE ROW_DIR DIRECT /end RECORD_LAYOUT
/begin RECORD_LAYOUT __UWORD_Z FNC_VALUES 1 UWORD ROW_DIR DIRECT /end RECORD_LAYOUT
/begin RECORD_LAYOUT __ULONG_Z FNC_VALUES 1 ULONG ROW_DIR DIRECT /end RECORD_LAYOUT
/begin RECORD_LAYOUT __SBYTE_Z FNC_VALUES 1 SBYTE ROW_DIR DIRECT /end RECORD_LAYOUT
/begin RECORD_LAYOUT __SWORD_Z FNC_VALUES 1 SWORD ROW_DIR DIRECT /end RECORD_LAYOUT
/begin RECORD_LAYOUT __SLONG_Z FNC_VALUES 1 SLONG ROW_DIR DIRECT /end RECORD_LAYOUT
/begin RECORD_LAYOUT __FLOAT32_IEEE_Z FNC_VALUES 1 FLOAT32_IEEE ROW_DIR DIRECT /end RECORD_LAYOUT
/begin RECORD_LAYOUT __FLOAT64_IEEE_Z FNC_VALUES 1 FLOAT64_IEEE ROW_DIR DIRECT /end RECORD_LAYOUT
/begin RECORD_LAYOUT __UBYTE_S FNC_VALUES 1 UBYTE COLUMN_DIR DIRECT /end RECORD_LAYOUT
/begin RECORD_LAYOUT __UWORD_S FNC_VALUES 1 UWORD COLUMN_DIR DIRECT /end RECORD_LAYOUT
/begin RECORD_LAYOUT __ULONG_S FNC_VALUES 1 ULONG COLUMN_DIR DIRECT /end RECORD_LAYOUT
/begin RECORD_LAYOUT __SBYTE_S FNC_VALUES 1 SBYTE COLUMN_DIR DIRECT /end RECORD_LAYOUT
/begin RECORD_LAYOUT __SWORD_S FNC_VALUES 1 SWORD COLUMN_DIR DIRECT /end RECORD_LAYOUT
/begin RECORD_LAYOUT __SLONG_S FNC_VALUES 1 SLONG COLUMN_DIR DIRECT /end RECORD_LAYOUT
/begin RECORD_LAYOUT __FLOAT32_IEEE_S FNC_VALUES 1 FLOAT32_IEEE COLUMN_DIR DIRECT /end RECORD_LAYOUT
/begin RECORD_LAYOUT __FLOAT64_IEEE_S FNC_VALUES 1 FLOAT64_IEEE COLUMN_DIR DIRECT /end RECORD_LAYOUT
/begin RECORD_LAYOUT SSV__UBYTE_S AXIS_PTS_X 1 UBYTE INDEX_INCR DIRECT /end RECORD_LAYOUT
/begin RECORD_LAYOUT SSV__UWORD_S AXIS_PTS_X 1 UWORD INDEX_INCR DIRECT /end RECORD_LAYOUT
/begin RECORD_LAYOUT SSV__ULONG_S AXIS_PTS_X 1 ULONG INDEX_INCR DIRECT /end RECORD_LAYOUT
/begin RECORD_LAYOUT SSV__SBYTE_S AXIS_PTS_X 1 SBYTE INDEX_INCR DIRECT /end RECORD_LAYOUT
/begin RECORD_LAYOUT SSV__SWORD_S AXIS_PTS_X 1 SWORD INDEX_INCR DIRECT /end RECORD_LAYOUT
/begin RECORD_LAYOUT SSV__SLONG_S AXIS_PTS_X 1 SLONG INDEX_INCR DIRECT /end RECORD_LAYOUT
/begin RECORD_LAYOUT SSV__FLOAT32_IEEE_S AXIS_PTS_X 1 FLOAT32_IEEE INDEX_INCR DIRECT /end RECORD_LAYOUT
/begin RECORD_LAYOUT SSV__FLOAT64_IEEE_S AXIS_PTS_X 1 FLOAT64_IEEE INDEX_INCR DIRECT /end RECORD_LAYOUT
/begin RECORD_LAYOUT __A_UINT64_Z FNC_VALUES 1 A_UINT64 ROW_DIR DIRECT /end RECORD_LAYOUT
/begin RECORD_LAYOUT __A_INT64_Z FNC_VALUES 1 A_INT64 ROW_DIR DIRECT /end RECORD_LAYOUT
/begin RECORD_LAYOUT __A_UINT64_S FNC_VALUES 1 A_UINT64 COLUMN_DIR DIRECT /end RECORD_LAYOUT
/begin RECORD_LAYOUT __A_INT64_S FNC_VALUES 1 A_INT64 COLUMN_DIR DIRECT /end RECORD_LAYOUT
/begin RECORD_LAYOUT SSV__A_UINT64_S AXIS_PTS_X 1 A_UINT64 INDEX_INCR DIRECT /end RECORD_LAYOUT
/begin RECORD_LAYOUT SSV__A_INT64_S AXIS_PTS_X 1 A_INT64 INDEX_INCR DIRECT /end RECORD_LAYOUT
/end MODULE
/end PROJECT
